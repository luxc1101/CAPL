/*@!Encoding:1252*/
includes
{
  
}
variables
{
  //message CAN2.*m;
  /* Fiat */
  message Speed_ FAxleSpd;
  message SteerWheelAngle StWhl_Angl;
  message VehicleDynamicControl VDC;
  /* J1939 */
  message CCVS WheelSpeed;
  message LD Lighting;
  
  float BenzFactor;
  float BenzOffset;
  float BenzFactor1;
  float BenzOffset1;
  
  float FiatFactor;
  float FiatOffset;
  float FiatFactor1;
  float FiatOffset1;
  
  float J1939Factor;
  float J1939Offset;
  /*VehSpeed variables*/
  float VehSpeedPhys_B;
  int VehSpeedRaw_B;
  int VehSpeedRaw_F;
  int VehSpeedRaw_J;
  /*SteerWheelAngle variables*/
  float StWhlPhys_B;
  int StWhlRaw_B;
  int StWhlRaw_F;
  /*VDC variables*/
  float LateralAccPhys_B;
  int LateralAccRaw_B;
  int LateralAccRaw_F;
  float LongitudinalAccPhys_B;
  int LongitudinalAccRaw_B;
  int LongitudinalAccRaw_F;
  float YawRatePhys_B;
  int YawRateRaw_B;
  int YawRateRaw_F;
  
  
  
}
void attribut_msg(message*m,int chn, int dlc, dword ID)
{
  m.can = chn; // assign channel 
  m.dlc = dlc; // assign dlc
  m.id = mkExtId(ID); // assign message ID
}

InfoText()
{
  write("-----------------------------------------------------------------------");
  write("convert can singal of Benz E200L to can singal fo Fiat Ducato and J1939"); 
  write("-----------------------------------------------------------------------");
  write("");
}
On start
{
  writeClear(1);
  InfoText();
}
/************************************************************** 
convert VehSpeed signal of Benz to Fiat
***************************************************************/
on message VehSpd_X_AR2
{
  FiatFactor = 0.05;
  FiatOffset = 0.0;
  BenzFactor = 0.1;
  BenzOffset = 0.0;
  J1939Factor = 0.0039062485409696;
  J1939Offset = 0.0;
  
  VehSpeedRaw_B = this.VehSpd_X; // get the row value of Benz
  //Write("VehspeedRaw: %d", VehSpeedRaw_B);
  VehSpeedPhys_B = BenzFactor*VehSpeedRaw_B + BenzOffset; // calculate the Benz phys value here km/h
  //Write("VehspeedPhys: %f", VehSpeedPhys_B);
  VehSpeedRaw_F = (VehSpeedPhys_B-FiatOffset)/FiatFactor; // calculate raw value of Fiat
  //Write("VehspeedRaw Fiat: %X", VehSpeedRaw_F);
  VehSpeedRaw_J = (VehSpeedPhys_B-J1939Offset)/J1939Factor; // calculate raw value of J1939
  attribut_msg(FAxleSpd,2,this.dlc, 0xA18A006);
  attribut_msg(WheelSpeed,2,this.dlc, 0x18FEF1FE);
  FAxleSpd.byte(2) = (0xFF00 & VehSpeedRaw_F) >>8;
  FAxleSpd.byte(3) = (0x00FF & VehSpeedRaw_F);
  WheelSpeed.byte(1) = 0x00FF & VehSpeedRaw_J;
  WheelSpeed.byte(2) = (0xFF00 & VehSpeedRaw_J) >> 8;
  output(FAxleSpd);
  output(WheelSpeed);
}
/*****************************End*****************************/
/************************************************************** 
convert SteeringWheelAngle signal of Benz to Fiat
***************************************************************/
on message StWhl_Angl_Stat_AR2
{
  FiatFactor = 0.1;
  FiatOffset = -772.4;
  BenzFactor = 0.1;
  BenzOffset = -819.2;
  StWhlRaw_B = this.StWhl_Angl; // get the row value of Benz
  //Write("StWhlRaw: %d",StWhlRaw_B);
  StWhlPhys_B= (BenzFactor*StWhlRaw_B + BenzOffset); // calculate the Benz phys value
  //Write("StWhlPhys_B: %f", StWhlRaw_B);
  StWhlRaw_F = (StWhlPhys_B-FiatOffset)/FiatFactor; // calculate raw value
  //Write("StWhlRaw Fiat: %X", StWhlRaw_F);
  attribut_msg(StWhl_Angl,2,this.dlc, 0x38A00C);
  StWhl_Angl.byte(0) = (0xFF00 & StWhlRaw_F) >>8;
  StWhl_Angl.byte(1) = (0x00FF & StWhlRaw_F);
  output(StWhl_Angl);
}
/*****************************End*****************************/
/************************************************************** 
convert VDC signal of Benz to Fiat
***************************************************************/
on message VehDyn_Stat1_AR2
{
  FiatFactor = 0.02;
  FiatOffset = -40.96;
  FiatFactor1 = 0.02;
  FiatOffset1 = -40.7824;
  
  BenzFactor = 0.02;
  BenzOffset = -10.24;
  BenzFactor1 = 0.02;
  BenzOffset1 = -40.96;

  LateralAccRaw_B = this.VehAccel_Y_V2; // get the row value of Benz
  LongitudinalAccRaw_B = this.VehAccel_X_V2; // get the row value of Benz
  
  LateralAccPhys_B= (BenzFactor*LateralAccRaw_B + BenzOffset); // calculate the Benz phys value
  LongitudinalAccPhys_B= (BenzFactor1*LongitudinalAccRaw_B + BenzOffset1); // calculate the Benz phys value
  
  LateralAccRaw_F = (LateralAccPhys_B-FiatOffset)/FiatFactor; // calculate raw value
  LongitudinalAccRaw_F = (LongitudinalAccPhys_B-FiatOffset1)/FiatFactor1; // calculate raw value
  
  attribut_msg(VDC,2,this.dlc, 0x28A006);
  VDC.byte(0) = (0x0FF0 & LongitudinalAccRaw_F) >>4;
  VDC.byte(1) = ((0x000F & LongitudinalAccRaw_F) <<4) | ((0x0F00 & LateralAccRaw_F) >>8);
  VDC.byte(2) = (0x00FF & LateralAccRaw_F);
  output(VDC);
}

on message VehDyn_Stat2_AR2
{
  BenzFactor = 0.01;
  BenzOffset = -327.68;
  FiatFactor = 0.079074;
  FiatOffset = -161.9292;
  
  YawRateRaw_F = (this.VehYawRate_Raw.phys-FiatOffset)/FiatFactor; // calculate raw value
  VDC.byte(3) = (0x0FF0 & YawRateRaw_F) >> 4;
  VDC.byte(4) = (0x000F & YawRateRaw_F) << 4;
  //Write("diff: %f", this.VehYawRate_Raw.phys - VDC.YawRate.phys);
}
/*****************************End*****************************/
/************************************************************** 
Convert TurnIndLvr_Stat to J1939 RightTurnSignalLights and LeftTurnSignalLights
***************************************************************/
On message SCCM_Sw_Stat_AR2
{
  attribut_msg(Lighting,2,this.dlc,0x18FE40FE);
  // write("Benz Turn %X", this.TurnIndLvr_Stat);
  switch(this.TurnIndLvr_Stat)
  {
    case 1: Lighting.byte(1) = 0x40;break;
    case 2: Lighting.byte(1) = 0x10;break;
    case 0: Lighting.byte(1) = 0x00;break;  
  }
  output(Lighting);
}
/*****************************End*****************************/
/************************************************************** 
I/O Port convert digital to analog signal
***************************************************************/
on message LD
{
  int RTurnsignal;
  RTurnsignal = this.RightTurnSignalLights;
  if (RTurnsignal == 1)
  {
    write("1939 RighTurn %x",RTurnsignal);
    @sysvar::IO::VN5620_1::DOUT = 1; // Set 13 V analog siganl
  }
  else
  {
    @sysvar::IO::VN5620_1::DOUT = 0; // Set 0 V analog signal
  }
 }
/*****************************End*****************************/ 
