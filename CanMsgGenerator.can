/*@!Encoding:1252*/
includes
{
  
}

variables
{
  /*CAN1*/
  // message CCVS WheelSpeed;
  message LD Lighting;
  message VDC2 Movement;
  message TCO1 Tacho;
  int UnitRaws;
  /*Timer*/
  msTimer timer1;
  msTimer timer2;
  msTimer timer3;
  /*factor offset*/
  float J1939Factor;
  float J1939Offset;
  /*VehSpeed variables*/
  int VehSpeedRaw;
  int maxSpeed = 120; // km/h 
  int minSpeed = 0; // km/h
  /*SteerWheelAngle variables*/
  int StWhlRaw;
  int maxAngle = 744; // deg
  int minAngle = -744; // deg
  int i = 0;
  float j = 0.0;
}

void attribut_msg(message*m,int chn, int dlc, dword ID)
{
  m.can = chn; // assign channel 
  m.dlc = dlc; // assign dlc
  m.id = mkExtId(ID); // assign message ID
}

int PhysToRawUnit(float factor,float UnitPhys) 
{
  UnitRaws = UnitPhys/factor; // caculate unit physdata to rawdata
  return UnitRaws;
}
  
InfoText()
{
  write("");
  write("----------------------------------------");
  write("You have to press:"); 
  write("<r>: turn right light;"); 
  write("<l>: turn left light;"); 
  write("<w>: accelerate (max: %d km/h);", maxSpeed);
  write("<s>: brake (min: 0 km/h);");
  write("<a>: steel wheel angle left(max: %d deg);",maxAngle);
  write("<d>: steel wheel angle right(min: %d deg);",minAngle);
  write("<c>: cancel timer;");
  write("----------------------------------------");
}

On start
{
  writeClear(1);
  InfoText();
  
  attribut_msg(Tacho,1,Tacho.dlc,0xCFE6CEE);
  Tacho.TachographVehicleSpeed = 0x0000; // Init Tachospeed
  
  attribut_msg(Movement,1,Movement.dlc,0x18F0093E);
  Movement.SteeringWheelAngle = 0x7D7D; // Init SteerWheelAngle
  Movement.LongitudinalAcceleration = 0x7D; // Init LongitudinalAcce
  Movement.SteeringWheelAngleSensorType = 0x01; // Init SteeringWheelAngleSensorType
  Movement.YawRate = 0x7D70; // init YawRate
  Movement.LateralAcceleration = 0x7D7D; // init LateralAcce
  Movement.SteeringWheelTurnCounter = 0x3F; // init SteeringWheelTurnCounter
  
  attribut_msg(Lighting,1, Lighting.dlc, 0x18FFA121);
  Lighting.RightTurnSignalLights = 0x0; // Init turn signal right
  Lighting.LeftTurnSignalLights = 0x0; // Init turn signal left
  
  settimer(timer1,Tacho.GenMsgCycleTime);
  settimer(timer2,Movement.GenMsgCycleTime); 
  settimer(timer3,500); 
}
On timer timer1
{
  output(Tacho);
  settimer(timer1,Tacho.GenMsgCycleTime);
}

On timer timer2
{
  output(Movement);
  settimer(timer2, Movement.GenMsgCycleTime);
}

On timer timer3
{
  output(Lighting);
  settimer(timer3,500);
}

On key 'w' // Accelation
{
  VehSpeedRaw = PhysToRawUnit(Tacho.TachographVehicleSpeed.factor,1.0);
  if(i < maxSpeed)
  {
    i+=1;
    //write("%d",i);
    Tacho.TachographVehicleSpeed+=VehSpeedRaw;
    write("Tachospeed: %f km/h",Tacho.TachographVehicleSpeed.phys);
  }
}

On key 's' // Break
{
  VehSpeedRaw = PhysToRawUnit(Tacho.TachographVehicleSpeed.factor,1.0);
  if(i > minSpeed)
  {
    i-=1;
    //write("%d",i);
    Tacho.TachographVehicleSpeed-=VehSpeedRaw;
    write("Tachospeed: %f km/h",Tacho.TachographVehicleSpeed.phys);
  }
}

On key 'a' // Turn left
{
  StWhlRaw = PhysToRawUnit(Movement.SteeringWheelAngle.factor,10); // (PI*10/180) rad/10degree
  if(j < maxAngle)
  {
    j+=(10);
    //write("%f",j);
    Movement.SteeringWheelAngle+=StWhlRaw;
    write("SteerWheelAngle: %f°", Movement.SteeringWheelAngle.phys);
  }
}

On key 'd' // Turn right 
{
  StWhlRaw = PhysToRawUnit(Movement.SteeringWheelAngle.factor,10); // (PI*10/180) rad/10degree
  if(j > minAngle)
  {
    j-=(10);
    //write("%f",j);
    Movement.SteeringWheelAngle-=StWhlRaw;
    write("SteerWheelAngle: %f°", Movement.SteeringWheelAngle.phys);
  }
}

On key 'l' // Turn left light signal
{
  if (Lighting.LeftTurnSignalLights == 0)
  {
    Lighting.LeftTurnSignalLights = 1;
  }
  else
  {
    Lighting.LeftTurnSignalLights = 0;
  }
  // write("leftlight %x",Lighting.LeftTurnSignalLights);
  
}

On key 'r' // Turn right left signal
{
  if (Lighting.RightTurnSignalLights == 0)
  {
    Lighting.RightTurnSignalLights = 1;
  }
  else
  {
    Lighting.RightTurnSignalLights = 0;
  }
  // write("rightlight %x",Lighting.RightTurnSignalLights);
  
}
/**************************************************************/ 
/*I/O Port convert digital to analog signal*/
/***************************************************************/
on message LD
{
  int RTurnsignal;
  int LTurnsignal;
  RTurnsignal = this.RightTurnSignalLights;
  LTurnsignal = this.LeftTurnSignalLights;
  // write("J1939 RighTurn %x",RTurnsignal);
  if (RTurnsignal == 1)
  {
    @sysvar::IO::VN5620_1::DOUT = 1; // Set 13 V analog siganl
  }
  else
  {
    @sysvar::IO::VN5620_1::DOUT = 0; // Set 0 V analog signal
  }
 }



