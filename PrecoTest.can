/*@!Encoding:1252*/
/*
convert CAN foramt message (Benz E200L) to CAN extended foramt message (J1939)
*/
includes
{
  
}

variables
{
  message CAN2.*m;
  float BenzFactor;
  float BenzOffset;
  float J1939Factor;
  float J1939Offset;
  /*VehSpeed variables*/
  float VehSpeedPhys_B;
  int VehSpeedRaw_B;
  int VehSpeedRaw_J;
  /*SteerWheelAngle variables*/
  float StWhlPhys_B;
  int StWhlRaw_B;
  int StWhlRaw_J;

}

void attribut_msg(message*m,int chn, int dlc, dword ID)
{
  m.can = chn; // assign channel 
  m.dlc = dlc; // assign dlc
  m.id = mkExtId(ID); // assign message ID
}
/************************************************************** 
convert VehSpeed signal of Benz to J1939 WheelBasedVehicleSpeed
***************************************************************/
on message VehSpd_X_AR2
{
  J1939Factor = 0.0039062485409696;
  BenzFactor = 0.1;
  BenzOffset = 0.0;
  J1939Offset = 0.0;
  VehSpeedRaw_B = this.VehSpd_X; // get the row value of Benz
  //Write("VehspeedRaw: %d", VehSpeedRaw_B);
  VehSpeedPhys_B = BenzFactor*VehSpeedRaw_B + BenzOffset; // calculate the Benz phys value hier km/h
  //Write("VehspeedPhys: %f", VehSpeedPhys_B);
  VehSpeedRaw_J = (VehSpeedPhys_B-J1939Offset)/J1939Factor; // calculate raw value of J1939
  //Write("VehspeedRaw J1939: %X", VehSpeedRaw_J);
  attribut_msg(m,2,this.dlc, 0x18FEF1FE);
  m.byte(1) = 0x00FF & VehSpeedRaw_J;
  m.byte(2) = (0xFF00 & VehSpeedRaw_J) >> 8;
  output(m);
}
/*****************************End*****************************/


/************************************************************** 
convert StWheel signal of Benz to J1939 Steering of wheel

on message StWhl_Angl_Stat_AR2
{
  J1939Factor = 0.00097654657225119;
  BenzFactor = 0.1;
  BenzOffset = -819.2;
  J1939Offset = -31.374;
  StWhlRaw_B = this.StWhl_Angl; // get the row value of Benz
  //Write("StWhlRaw: %d",StWhlRaw_B);
  StWhlPhys_B= BenzFactor*StWhlRaw_B + BenzOffset; // calculate the Benz phys value hier rad
  //Write("StWhlPhys_B: %f", StWhlRaw_B);
  StWhlRaw_J = (StWhlPhys_B-J1939Offset)/J1939Factor; // calculate raw value of J1939
  //Write("StWhlRaw J1939: %X", StWhlRaw_J);
  attribut_msg(m,2,this.dlc, 0x18F0090B);
  m.byte(0) = 0x00FF & StWhlRaw_J;
  m.byte(1) = (0xFF00 & StWhlRaw_J) >> 8;
  output(m);
}
/*****************************End*****************************/
/*
on message CAN1.* // Called when a message received on CAN1
{
  if(this.DIR==RX)        // if it is a received frame
  {
   if(this.CAN==1 & this.dlc!=0) // block message from channel 2 and filter message based on dlc
   {
    BenzSpdFactor =  0.1;
    J1939SpdFactor = 0.0039062485409696;
    if(this.ID==0x98) 
    {
      VehSpeed = this.VehSpd_X;
      Write("Vehspeed %d", VehSpeed);
      attribut_msg(m,2,this.dlc, 0xCFE6C17);
      m.byte(6) = ((0x0F & this.byte(4)) << 4)|((0xF0 & this.byte(3)) >> 4); // ((00001111 & this.byte(4)) shift to left 4 bits)|((11110000 & this.byte(3)) shift to right 4 bits)
      m.byte(7) = (0xF0 & this.byte(4)) >> 4;                                // (11110000 & this.byte(4)) shift to right 4 bits
      output(m);      // send it to the other channel
    }
    
    
   }
  }
}
*/
