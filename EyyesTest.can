/*@!Encoding:1252*/
/*
convert CAN foramt message (Benz E200L) to CAN extended foramt message (J1939)
*/
includes
{
  
}

variables
{
  //message CAN2.*m;
  message CCVS WheelSpeed;
  message LD Lighting;
  message VDC2 Movement;
  message TCO1 Tacho;
  //message SCCM_Sw_Stat_AR2 TurnLight;
  msTimer timer1;
  int isTurn;
  float BenzFactor;
  float BenzOffset;
  float J1939Factor;
  float J1939Offset;
  /*VehSpeed variables*/
  float VehSpeedPhys_B;
  int VehSpeedRaw_B;
  int VehSpeedRaw_J;
  /*SteerWheelAngle variables*/
  float StWhlPhys_B;
  int StWhlRaw_B;
  int StWhlRaw_J;
}

void attribut_msg(message*m,int chn, int dlc, dword ID)
{
  m.can = chn; // assign channel 
  m.dlc = dlc; // assign dlc
  m.id = mkExtId(ID); // assign message ID
}
/************************************************************** 
convert VehSpeed signal of Benz to J1939 WheelBasedVehicleSpeed
***************************************************************/
on message VehSpd_X_AR2
{
  J1939Factor = 0.0039062485409696;
  J1939Offset = 0.0;
  BenzFactor = 0.1;
  BenzOffset = 0.0;
  J1939Offset = 0.0;
  VehSpeedRaw_B = this.VehSpd_X; // get the row value of Benz
  //Write("VehspeedRaw: %d", VehSpeedRaw_B);
  VehSpeedPhys_B = BenzFactor*VehSpeedRaw_B + BenzOffset; // calculate the Benz phys value hier km/h
  //Write("VehspeedPhys: %f", VehSpeedPhys_B);
  VehSpeedRaw_J = (VehSpeedPhys_B-J1939Offset)/J1939Factor; // calculate raw value of J1939
  //Write("VehspeedRaw J1939: %X", VehSpeedRaw_J);
  attribut_msg(WheelSpeed,2,this.dlc, 0x18FEF1FE);
  attribut_msg(Tacho,2,this.dlc, 0xCFE6C17);
  WheelSpeed.byte(1) = 0x00FF & VehSpeedRaw_J;
  WheelSpeed.byte(2) = (0xFF00 & VehSpeedRaw_J) >> 8;
  Tacho.byte(6) = 0x00FF & VehSpeedRaw_J;
  Tacho.byte(7) = (0xFF00 & VehSpeedRaw_J) >> 8;
  output(WheelSpeed);
  output(Tacho);
}
/*****************************End*****************************/
/************************************************************** 
convert StWheel signal of Benz to J1939 Steering of wheel
***************************************************************/
on message StWhl_Angl_Stat_AR2
{
  J1939Factor = 0.00097654657225119;
  BenzFactor = 0.1;
  BenzOffset = -819.2;
  J1939Offset = -31.374;
  StWhlRaw_B = this.StWhl_Angl; // get the row value of Benz
  //Write("StWhlRaw: %d",StWhlRaw_B);
  StWhlPhys_B= (BenzFactor*StWhlRaw_B + BenzOffset)*(PI/180); // calculate the Benz phys value hier rad
  //Write("StWhlPhys_B: %f", StWhlRaw_B);
  StWhlRaw_J = (StWhlPhys_B-J1939Offset)/J1939Factor; // calculate raw value of J1939
  //Write("StWhlRaw J1939: %X", StWhlRaw_J);
  attribut_msg(Movement,2,this.dlc, 0x18F0090B);
  Movement.byte(0) = 0x00FF & StWhlRaw_J;
  Movement.byte(1) = (0xFF00 & StWhlRaw_J) >> 8;
  Write("Benz Phys degree: %f", this.StWhl_Angl.phys);
  Write("J1939 Phys degree: %f", Movement.SteerWheelAngle.phys*(180/PI));
  output(Movement);
}
/*****************************End*****************************/
/************************************************************** 
manuel send Turn light message
***************************************************************/
On key*
{
  switch(this)
  {
    case 'r': isTurn = 1; break; // turn right
    case 'l': isTurn = -1; break; // turn left
    case 's': isTurn = 0; break; // go straight
    case 'c': isTurn = 2; break; // og
    default : write("You have to press: 'r' for turn right; 'l' for turn left; 's' for go straight; 'c' for cancel"); break;
  }
  settimer(timer1,1);
}
On timer timer1
{
  message SCCM_Sw_Stat_AR2 msg;
  if(isTurn == 1) // turn right
  {
    msg.TurnIndLvr_Stat = 2;
    output(msg);
  }
  if(isTurn == -1) // turn left
  {
    msg.TurnIndLvr_Stat = 1;
    output(msg);
  }
  if(isTurn == 0) // go straight
  {
    msg.TurnIndLvr_Stat = 0;
    output(msg);
  }
  if(isTurn == 2) // cancel timer
  {
    cancelTimer(timer1);
  }
  settimer(timer1,1);
}
/*****************************End*****************************/
/************************************************************** 
Convert TurnIndLvr_Stat to J1939 RightTurnSignalLights and LeftTurnSignalLights PGN 65088
***************************************************************/
On message SCCM_Sw_Stat_AR2
{
  attribut_msg(Lighting,2,this.dlc,0x18FE40FE);
  write("Benz Turn %X", this.TurnIndLvr_Stat);
  switch(this.TurnIndLvr_Stat)
  {
    case 1: Lighting.byte(1) = 0x40;break;
    case 2: Lighting.byte(1) = 0x10;break;
    case 0: Lighting.byte(1) = 0x00;break;  
  }
  output(Lighting);
}
/*****************************End*****************************/
/************************************************************** 
I/O Port convert digital to analog signal
***************************************************************/
on message LD
{
  int RTurnsignal;
  int LTurnsignal;
  RTurnsignal = this.RightTurnSignalLights;
  LTurnsignal = this.LeftTurnSignalLights;
  write("J1939 RighTurn %x",RTurnsignal);
  if (RTurnsignal == 1)
  {
    @sysvar::IO::VN5620_1::DOUT = 1; // Set 13 V analog siganl
  }
  else
  {
    @sysvar::IO::VN5620_1::DOUT = 0; // Set 0 V analog signal
  }
 }
/*****************************End*****************************/
