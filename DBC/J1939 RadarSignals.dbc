VERSION ""

NS_ :

BS_:

BU_: Turbocharger OnBoardDataLogger OffBoardDiagnosticTool2 OffBoardDiagnosticTool1 FileServer ParkingBrakeController SeatControl2 FanDriveController SteeringColumnUnit CommunicationUnitRadio CommunicationUnitSatellite CommunicationUnitCellular PropulsionBatteryCharger ChassisController2 ChassisController1 EngineValveControl AuxiliaryHeater2 AuxiliaryHeater1 ClutchUnit RampControl InformationSystem1 SuspensionSystemController2 OilSensor VehicleDynamicStability ExhaustEmissionController TransmissionDisplay2 TransmissionDisplay1 ClimateControl2 WaterPumpController RearAxleSteeringController LightingOperatorControl SeatController1 IgnitionController2 IgnitionController1 TirePressureController CabController2 CabController1 PneumaticSystemController SuspensionSystemController1 HydraulicPumpController EnduranceBrakingSystem RetarderExhaustEngine2 OnBoardDiagnosticUnit HeadwayController RetarderExhaustEngine1 CabDisplay1 ManagementComputer VirtualTerminal OffVehicleGateway PowerTakeOffFront HitchControl AuxiliaryValveControl BodyController TractorTrailerBridge1 StarterSystem ElectricalSystem VehicleSecurity VehicleNavigation AerodynamicControl ElectricalChargingSystem ClimateControl1 TripRecorder InstrumentCluster SuspensionDriveAxle2 SuspensionDriveAxle1 SuspensionSteerAxle SteeringController FuelSystem CruiseControl RetarderDriveline RetarderEngine BrakesDriveAxle2 BrakesDriveAxle1 BrakesSystemController BrakesSteerAxle AxleDrive2 AxleDrive1 AxleSteering PowerTakeOff ShiftConsoleSecondary ShiftConsolePrimary Transmission2 Transmission1 Engine2 Engine1

BO_ 3221225472 VECTOR__INDEPENDENT_SIG_MSG: 0 Vector__XXX
 SG_ Jystck10GrpXAxsLvrRghtPstvPsStts : 0|2@1+ (1,0) [0|3] "" Vector__XXX
 SG_ Jystck10GrpXAxsLvrLftNgtvPsSttus : 0|2@1+ (1,0) [0|3] "" Vector__XXX
 SG_ Jystck10GrpXAxisNeutralPosStatus : 0|2@1+ (1,0) [0|3] "" Vector__XXX
 SG_ EngFuelFilterIntakeAbsPress : 0|8@1+ (2,0) [0|500] "kPa" Vector__XXX
 SG_ EngExhstGsRcrcltn1OutletAbsPress : 0|16@1+ (0.1,0) [0|6425.5] "kPa" Vector__XXX
 SG_ EngExhstGsRcrcltn1IntakeAbsPress : 0|16@1+ (0.1,0) [0|6425.5] "kPa" Vector__XXX
 SG_ EngExhstGsRcrcltn2IntakeAbsPress : 0|16@1+ (0.1,0) [0|6425.5] "kPa" Vector__XXX
 SG_ EngExhstGsRcrcltn2OutletAbsPress : 0|16@1+ (0.1,0) [0|6425.5] "kPa" Vector__XXX
 SG_ EngExhstGsRcrclation2IntakePress : 0|8@1+ (2,0) [0|500] "kPa" Vector__XXX
 SG_ EngExhstGsRcirculation2DiffPress : 0|16@1+ (0.0078124659559567,-250) [-250|251.99] "kPa" Vector__XXX
 SG_ CmmndedEngFuelInjectionCtrlPress : 0|16@1+ (0.0039063107929344,0) [0|251] "MPa" Vector__XXX
 SG_ CommandedEngFuelRailPress : 0|16@1+ (0.0039063107929344,0) [0|251] "MPa" Vector__XXX
 SG_ EngExhstGsRcirculation2Valve2Pos : 0|16@1+ (0.0025,0) [0|160.6375] "%" Vector__XXX
 SG_ EngExhstGsRecirculation2ValvePos : 0|16@1+ (0.0025,0) [0|160.6375] "%" Vector__XXX
 SG_ EngExhstGsRcrculation2Valve2Ctrl : 0|16@1+ (0.0025,0) [0|160.6375] "%" Vector__XXX
 SG_ EngExhstGsRcirculation2ValveCtrl : 0|16@1+ (0.0025,0) [0|160.6375] "%" Vector__XXX
 SG_ EGR2CoolerBypassActuatorPos : 0|8@1+ (0.4,0) [0|100] "%" Vector__XXX
 SG_ EngExhstGsRcrcltn2ClerEfficiency : 0|8@1+ (0.4,0) [0|100] "%" Vector__XXX
 SG_ EngExhstGsRcrcltn2ClrIntkGsAbsPr : 0|16@1+ (0.5,0) [0|32127.5] "kPa" Vector__XXX
 SG_ EngExhstGsRcrcltn2ClerIntakeTemp : 0|16@1+ (0.03125,-273) [-273|1734.96875] "deg C" Vector__XXX
 SG_ EngFrctnPrcentTorqueAtIdlePoint7 : 0|8@1+ (1,-125) [-125|125] "%" Vector__XXX
 SG_ EngFrctnPrcentTorqueAtIdlePoint6 : 0|8@1+ (1,-125) [-125|125] "%" Vector__XXX
 SG_ EngFrctnPrcentTorqueAtIdlePoint5 : 0|8@1+ (1,-125) [-125|125] "%" Vector__XXX
 SG_ EngFrctnPrcentTorqueAtIdlePoint4 : 0|8@1+ (1,-125) [-125|125] "%" Vector__XXX
 SG_ EngFrctnPrcentTorqueAtIdlePoint3 : 0|8@1+ (1,-125) [-125|125] "%" Vector__XXX
 SG_ EngFrctnPrcentTorqueAtIdlePoint2 : 0|8@1+ (1,-125) [-125|125] "%" Vector__XXX
 SG_ EngFrctnPrcentTorqueAtIdlePoint1 : 0|8@1+ (1,-125) [-125|125] "%" Vector__XXX
 SG_ DslPrtcltFltrActvRgnrtnFrcdSttus : 0|3@1+ (1,0) [0|7] "" Vector__XXX
 SG_ ExhaustSystemHighTempLampCmd : 0|3@1+ (1,0) [0|7] "" Vector__XXX
 SG_ DslPrtcltFltrAtmtcActvRgnrtnIntt : 0|2@1+ (1,0) [0|3] "" Vector__XXX
 SG_ DslPrtcltFltrActvRgnrtnInhbtdDTV : 0|2@1+ (1,0) [0|3] "" Vector__XXX
 SG_ DslPrtcltFltrActvRgnrtnInhbtdDTE : 0|2@1+ (1,0) [0|3] "" Vector__XXX
 SG_ DslPrtcltFltrActvRgnrtnInhb_0000 : 0|2@1+ (1,0) [0|3] "" Vector__XXX
 SG_ DslPrtcltFltrActvRgnrtnInhbtdDTT : 0|2@1+ (1,0) [0|3] "" Vector__XXX
 SG_ DslPrtcltFltrActvRgnrtnInhbtdDTS : 0|2@1+ (1,0) [0|3] "" Vector__XXX
 SG_ DslPrtcltFltrActvRgnrtnInhbtdDTS : 0|2@1+ (1,0) [0|3] "" Vector__XXX
 SG_ DslPrtcltFltrActvRgnrtnInhbtdDTL : 0|2@1+ (1,0) [0|3] "" Vector__XXX
 SG_ DslPrtcltFltrActvRgnrtnInhb_0001 : 0|2@1+ (1,0) [0|3] "" Vector__XXX
 SG_ DslPrtcltFltrActvRgnrtnInhb_0002 : 0|2@1+ (1,0) [0|3] "" Vector__XXX
 SG_ DslPrtcltFltrActvRgnrtnInhbtdDTO : 0|2@1+ (1,0) [0|3] "" Vector__XXX
 SG_ DslPrtcltFltrActvRgnrtnInhbtdDTA : 0|2@1+ (1,0) [0|3] "" Vector__XXX
 SG_ DslPrtcltFltrActvRgnrtnInhbtdDTP : 0|2@1+ (1,0) [0|3] "" Vector__XXX
 SG_ DslPrtcltFltrActvRgnrtnInhbtdDTS : 0|2@1+ (1,0) [0|3] "" Vector__XXX
 SG_ DslPrtcltFltrActvRgnrtnInhbtdDTC : 0|2@1+ (1,0) [0|3] "" Vector__XXX
 SG_ DslPrtcltFltrActvRgnrtnInhbtdDTI : 0|2@1+ (1,0) [0|3] "" Vector__XXX
 SG_ DslPrtcltFltrActvRgnrtnInhbtdStt : 0|2@1+ (1,0) [0|3] "" Vector__XXX
 SG_ DieselParticulateFilterStatus : 0|3@1+ (1,0) [0|7] "" Vector__XXX
 SG_ DslPrtcltFltrActvRgnrationStatus : 0|2@1+ (1,0) [0|3] "" Vector__XXX
 SG_ DslPrtcltFltrPssvRgnrationStatus : 0|2@1+ (1,0) [0|3] "" Vector__XXX
 SG_ DieselParticulateFilterLampCmd : 0|3@1+ (1,0) [0|7] "" Vector__XXX
 SG_ DslPrtculateFilter2SootSignalMin : 0|16@1+ (0.0025,0) [0|160.6375] "%" Vector__XXX
 SG_ DslPrtculateFilter2SootSignalMax : 0|16@1+ (0.0025,0) [0|160.6375] "%" Vector__XXX
 SG_ DslPrtcltFltr2StSgnlStndrdDvtion : 0|16@1+ (0.0025,0) [0|160.6375] "%" Vector__XXX
 SG_ DslPrtcltFltr2StSnsrPrlminaryFMI : 0|5@1+ (1,0) [0|31] "" Vector__XXX
 SG_ DslPrtcltFilter2MedianSootSignal : 0|16@1+ (0.0025,0) [0|160.6375] "%" Vector__XXX
 SG_ DslPrtclateFilter2MeanSootSignal : 0|16@1+ (0.0025,0) [0|160.6375] "%" Vector__XXX
 SG_ DslParticulateFilter2SootDensity : 0|8@1+ (0.08,0) [0|20] "g/L" Vector__XXX
 SG_ DieselParticulateFilter2SootMass : 0|8@1+ (4,0) [0|1000] "g" Vector__XXX
 SG_ DslPrtculateFilter1SootSignalMin : 0|16@1+ (0.0025,0) [0|160.6375] "%" Vector__XXX
 SG_ DslPrtculateFilter1SootSignalMax : 0|16@1+ (0.0025,0) [0|160.6375] "%" Vector__XXX
 SG_ DslPrtcltFltr1StSgnlStndrdDvtion : 0|16@1+ (0.0025,0) [0|160.6375] "%" Vector__XXX
 SG_ DslPrtcltFltr1StSnsrPrlminaryFMI : 0|5@1+ (1,0) [0|31] "" Vector__XXX
 SG_ DslPrtcltFilter1MedianSootSignal : 0|16@1+ (0.0025,0) [0|160.6375] "%" Vector__XXX
 SG_ DslPrtclateFilter1MeanSootSignal : 0|16@1+ (0.0025,0) [0|160.6375] "%" Vector__XXX
 SG_ DslParticulateFilter1SootDensity : 0|8@1+ (0.08,0) [0|20] "g/L" Vector__XXX
 SG_ DieselParticulateFilter1SootMass : 0|8@1+ (4,0) [0|1000] "g" Vector__XXX
 SG_ VehicleBatteryChargingLampData : 0|2@1+ (1,0) [0|3] "" Vector__XXX
 SG_ VehicleHVACRecirculationLampData : 0|2@1+ (1,0) [0|3] "" Vector__XXX
 SG_ VehicleAirPressLowLampData : 0|2@1+ (1,0) [0|3] "" Vector__XXX
 SG_ VehicleFuelLevelLowLampData : 0|2@1+ (1,0) [0|3] "" Vector__XXX
 SG_ VehicleBatteryVoltageLowLampData : 0|2@1+ (1,0) [0|3] "" Vector__XXX
 SG_ EngWaitToStartLampData : 0|2@1+ (1,0) [0|3] "" Vector__XXX
 SG_ EngFuelFilterRestrictedLampData : 0|2@1+ (1,0) [0|3] "" Vector__XXX
 SG_ EngAirFilterRestrictionLampData : 0|2@1+ (1,0) [0|3] "" Vector__XXX
 SG_ EngIdleManagementActiveLampData : 0|2@1+ (1,0) [0|3] "" Vector__XXX
 SG_ EngCoolantLevelLowLampData : 0|2@1+ (1,0) [0|3] "" Vector__XXX
 SG_ EngCoolantTempHighLampData : 0|2@1+ (1,0) [0|3] "" Vector__XXX
 SG_ EngOilPressLowLampData : 0|2@1+ (1,0) [0|3] "" Vector__XXX
 SG_ CmprssnBrkEnblSwtchIndctrLmpData : 0|2@1+ (1,0) [0|3] "" Vector__XXX
 SG_ EngBrakeActiveLampData : 0|2@1+ (1,0) [0|3] "" Vector__XXX
 SG_ OBDMalfunctionIndicatorLampData : 0|2@1+ (1,0) [0|3] "" Vector__XXX
 SG_ EngRedStopLampData : 0|2@1+ (1,0) [0|3] "" Vector__XXX
 SG_ EngAmberWarningLampData : 0|2@1+ (1,0) [0|3] "" Vector__XXX
 SG_ EngProtectLampData : 0|2@1+ (1,0) [0|3] "" Vector__XXX
 SG_ VehicleBatteryChargingLampCmd : 0|2@1+ (1,0) [0|3] "" Vector__XXX
 SG_ VehicleHVACRecirculationLampCmd : 0|2@1+ (1,0) [0|3] "" Vector__XXX
 SG_ VehicleAirPressLowLampCmd : 0|2@1+ (1,0) [0|3] "" Vector__XXX
 SG_ VehicleFuelLevelLowLampCmd : 0|2@1+ (1,0) [0|3] "" Vector__XXX
 SG_ VehicleBatteryVoltageLowLampCmd : 0|2@1+ (1,0) [0|3] "" Vector__XXX
 SG_ DTCTimeUntilDerate : 0|8@1+ (0.25,0) [0|62.5] "hr" Vector__XXX
 SG_ DTCTotalPreviouslyActiveTime : 0|16@1+ (0.2,0) [0|12851] "hr" Vector__XXX
 SG_ DTCTotalActiveTime : 0|16@1+ (0.2,0) [0|12851] "hr" Vector__XXX
 SG_ FailureModeIdentifier1 : 0|5@1+ (1,0) [0|0] "" Vector__XXX
 SG_ SPN1High : 0|3@1+ (1,0) [0|7] "" Vector__XXX
 SG_ SPN1 : 0|16@1+ (1,0) [0|65536] "" Vector__XXX
 SG_ TextDisplayIndex : 0|8@1+ (1,0) [0|250] "" Vector__XXX
 SG_ TextDisplayInstructions : 0|4@1+ (1,0) [0|15] "" Vector__XXX
 SG_ RetractStatusOfRamp5 : 0|2@1+ (1,0) [0|3] "" Vector__XXX
 SG_ RetractStatusOfRamp4 : 0|2@1+ (1,0) [0|3] "" Vector__XXX
 SG_ MovementStatusOfRamp5 : 0|2@1+ (1,0) [0|3] "" Vector__XXX
 SG_ MovementStatusOfRamp4 : 0|2@1+ (1,0) [0|3] "" Vector__XXX
 SG_ EnableStatusOfRamp5 : 0|2@1+ (1,0) [0|3] "" Vector__XXX
 SG_ EnableStatusOfRamp4 : 0|2@1+ (1,0) [0|3] "" Vector__XXX
 SG_ MovementStatusOfRamp3 : 0|2@1+ (1,0) [0|3] "" Vector__XXX
 SG_ EnableStatusOfRamp3 : 0|2@1+ (1,0) [0|3] "" Vector__XXX
 SG_ RetractStatusOfRamp3 : 0|2@1+ (1,0) [0|3] "" Vector__XXX
 SG_ MovementStatusOfRamp2 : 0|2@1+ (1,0) [0|3] "" Vector__XXX
 SG_ EnableStatusOfRamp2 : 0|2@1+ (1,0) [0|3] "" Vector__XXX
 SG_ RetractStatusOfRamp2 : 0|2@1+ (1,0) [0|3] "" Vector__XXX
 SG_ MovementStatusOfRamp1 : 0|2@1+ (1,0) [0|3] "" Vector__XXX
 SG_ EnableStatusOfRamp1 : 0|2@1+ (1,0) [0|3] "" Vector__XXX
 SG_ RetractStatusOfRamp1 : 0|2@1+ (1,0) [0|3] "" Vector__XXX
 SG_ MaxCrankAttemptsPerStartAttempt : 0|8@1+ (1,0) [0|250] "" Vector__XXX
 SG_ CommandedEngIntakeManifoldPress : 0|16@1+ (0.125,0) [0|8031.875] "kPa" Vector__XXX
 SG_ EngCrnkcsBrtherOilSeparatorSpeed : 0|16@1+ (1,0) [0|64255] "rpm" Vector__XXX
 SG_ EngExhstGsRcirculation1Valve2Pos : 0|16@1+ (0.0025,0) [0|160.6375] "%" Vector__XXX
 SG_ EngExhstGsRecirculation1ValvePos : 0|16@1+ (0.0025,0) [0|160.6375] "%" Vector__XXX
 SG_ EngExhstGsRcrcltn1ClrIntkGsAbsPr : 0|16@1+ (0.5,0) [0|32127.5] "kPa" Vector__XXX
 SG_ EngExhstGsRcrcltn1ClerIntakeTemp : 0|16@1+ (0.03125,-273) [-273|1734.96875] "deg C" Vector__XXX
 SG_ EngExhstGsRcrcltn1ClerEfficiency : 0|8@1+ (1,0) [0|100] "%" Vector__XXX
 SG_ EngExhstGsRcrculation1Valve2Ctrl : 0|16@1+ (1,0) [0|160.6375] "%" Vector__XXX
 SG_ EngIntkVlvActtionOilPressForCyl4 : 0|16@1+ (0.1,0) [0|6425.5] "kPa" Vector__XXX
 SG_ EngIntkVlvActtionOilPressForCyl3 : 0|16@1+ (0.1,0) [0|6425.5] "kPa" Vector__XXX
 SG_ EngIntkVlvActtionOilPressForCyl2 : 0|16@1+ (0.1,0) [0|6425.5] "kPa" Vector__XXX
 SG_ EngIntkVlvActtionOilPressForCyl1 : 0|16@1+ (0.1,0) [0|6425.5] "kPa" Vector__XXX
 SG_ EngIntkVlvActtionOilPressForCyl8 : 0|16@1+ (0.1,0) [0|6425.5] "kPa" Vector__XXX
 SG_ EngIntkVlvActtionOilPressForCyl7 : 0|16@1+ (0.1,0) [0|6425.5] "kPa" Vector__XXX
 SG_ EngIntkVlvActtionOilPressForCyl6 : 0|16@1+ (0.1,0) [0|6425.5] "kPa" Vector__XXX
 SG_ EngIntkVlvActtionOilPressForCyl5 : 0|16@1+ (0.1,0) [0|6425.5] "kPa" Vector__XXX
 SG_ EngIntkVlvActtonOilPressForCyl12 : 0|16@1+ (0.1,0) [0|6425.5] "kPa" Vector__XXX
 SG_ EngIntkVlvActtonOilPressForCyl11 : 0|16@1+ (0.1,0) [0|6425.5] "kPa" Vector__XXX
 SG_ EngIntkVlvActtonOilPressForCyl10 : 0|16@1+ (0.1,0) [0|6425.5] "kPa" Vector__XXX
 SG_ EngIntkVlvActtionOilPressForCyl9 : 0|16@1+ (0.1,0) [0|6425.5] "kPa" Vector__XXX
 SG_ EngIntkVlvActtonOilPressForCyl16 : 0|16@1+ (0.1,0) [0|6425.5] "kPa" Vector__XXX
 SG_ EngIntkVlvActtonOilPressForCyl15 : 0|16@1+ (0.1,0) [0|6425.5] "kPa" Vector__XXX
 SG_ EngIntkVlvActtonOilPressForCyl14 : 0|16@1+ (0.1,0) [0|6425.5] "kPa" Vector__XXX
 SG_ EngIntkVlvActtonOilPressForCyl13 : 0|16@1+ (0.1,0) [0|6425.5] "kPa" Vector__XXX
 SG_ EngIntkVlvActtonOilPressForCyl20 : 0|16@1+ (0.1,0) [0|6425.5] "kPa" Vector__XXX
 SG_ EngIntkVlvActtonOilPressForCyl19 : 0|16@1+ (0.1,0) [0|6425.5] "kPa" Vector__XXX
 SG_ EngIntkVlvActtonOilPressForCyl18 : 0|16@1+ (0.1,0) [0|6425.5] "kPa" Vector__XXX
 SG_ EngIntkVlvActtonOilPressForCyl17 : 0|16@1+ (0.1,0) [0|6425.5] "kPa" Vector__XXX
 SG_ EGR1CoolerBypassActuatorPostion : 0|8@1+ (0.4,0) [0|100] "%" Vector__XXX
 SG_ EngSparkPlug4 : 0|16@1+ (1,0) [0|64255] "Volts" Vector__XXX
 SG_ EngSparkPlug3 : 0|16@1+ (1,0) [0|64255] "Volts" Vector__XXX
 SG_ EngSparkPlug2 : 0|16@1+ (1,0) [0|64255] "Volts" Vector__XXX
 SG_ EngSparkPlug1 : 0|16@1+ (1,0) [0|64255] "Volts" Vector__XXX
 SG_ EngSparkPlug8 : 0|16@1+ (1,0) [0|64255] "Volts" Vector__XXX
 SG_ EngSparkPlug7 : 0|16@1+ (1,0) [0|64255] "Volts" Vector__XXX
 SG_ EngSparkPlug6 : 0|16@1+ (1,0) [0|64255] "Volts" Vector__XXX
 SG_ EngSparkPlug5 : 0|16@1+ (1,0) [0|64255] "Volts" Vector__XXX
 SG_ EngSparkPlug12 : 0|16@1+ (1,0) [0|64255] "Volts" Vector__XXX
 SG_ EngSparkPlug11 : 0|16@1+ (1,0) [0|64255] "Volts" Vector__XXX
 SG_ EngSparkPlug10 : 0|16@1+ (1,0) [0|64255] "Volts" Vector__XXX
 SG_ EngSparkPlug9 : 0|16@1+ (1,0) [0|64255] "Volts" Vector__XXX
 SG_ EngSparkPlug16 : 0|16@1+ (1,0) [0|64255] "Volts" Vector__XXX
 SG_ EngSparkPlug15 : 0|16@1+ (1,0) [0|64255] "Volts" Vector__XXX
 SG_ EngSparkPlug14 : 0|16@1+ (1,0) [0|64255] "Volts" Vector__XXX
 SG_ EngSparkPlug13 : 0|16@1+ (1,0) [0|64255] "Volts" Vector__XXX
 SG_ EngSparkPlug20 : 0|16@1+ (1,0) [0|64255] "Volts" Vector__XXX
 SG_ EngSparkPlug19 : 0|16@1+ (1,0) [0|64255] "Volts" Vector__XXX
 SG_ EngSparkPlug18 : 0|16@1+ (1,0) [0|64255] "Volts" Vector__XXX
 SG_ EngSparkPlug17 : 0|16@1+ (1,0) [0|64255] "Volts" Vector__XXX
 SG_ EngSparkPlug24 : 0|16@1+ (1,0) [0|64255] "Volts" Vector__XXX
 SG_ EngSparkPlug23 : 0|16@1+ (1,0) [0|64255] "Volts" Vector__XXX
 SG_ EngSparkPlug22 : 0|16@1+ (1,0) [0|64255] "Volts" Vector__XXX
 SG_ EngSparkPlug21 : 0|16@1+ (1,0) [0|64255] "Volts" Vector__XXX
 SG_ LaneDepartureWarningEnableCmd : 0|2@1+ (1,0) [0|3] "" Vector__XXX
 SG_ J2012DTCOccurrenceCount : 0|7@1+ (1,0) [0|127] "" Vector__XXX
 SG_ J2012DTCStatus : 0|1@1+ (1,0) [0|1] "" Vector__XXX
 SG_ J2012DTC : 0|40@1+ (1,0) [0|255] "per byte" Vector__XXX
 SG_ NumberOfJ2012DTCs : 0|8@1+ (1,0) [0|250] "" Vector__XXX
 SG_ MessageChecksum : 0|4@1+ (1,0) [0|15] "" Vector__XXX
 SG_ MessageCounter : 0|4@1+ (1,0) [0|15] "" Vector__XXX
 SG_ SteerAngleSensorCalibrated : 0|2@1+ (1,0) [0|3] "" Vector__XXX
 SG_ SteerAngleSensorActiveMode : 0|2@1+ (1,0) [0|3] "" Vector__XXX
 SG_ SteerWheelAngleRange : 0|16@1+ (0.00097654657225119,-31.374) [-31.374|31.374] "rad" Vector__XXX
 SG_ SteerWheelAngleRangeCounterType : 0|2@1+ (1,0) [0|3] "" Vector__XXX
 SG_ SteerWheelAngleRangeCounter : 0|6@1+ (1,-32) [-32|29] "ranges" Vector__XXX
 SG_ SteerWheelAngle : 0|16@1+ (0.00097654657225119,-31.374) [-31.374|31.374] "rad" Vector__XXX
 SG_ Aftrtrtmnt1SCRCtlystCnvrsnEffcnc : 0|8@1+ (0.4,0) [0|100] "%" Vector__XXX
 SG_ Aftrtrtmnt1SCRCmmnddCtlystRgntCn : 0|16@1+ (1,0) [0|3212.75] "L/h" Vector__XXX
 SG_ Aftrtrtmnt1SCRAvrgCtlystRgntCnsm : 0|16@1+ (0.05,0) [0|3212.75] "L/h" Vector__XXX
 SG_ Aftrtrtmnt1DslExhstFldTnkLwLvlIn : 0|16@1+ (1,0) [0|64255] "km" Vector__XXX
 SG_ TransferCaseStatus : 0|3@1+ (1,0) [0|7] "" Vector__XXX
 SG_ TransOilLifeRemaining : 0|8@1+ (0.4,0) [0|100] "%" Vector__XXX
 SG_ TrnsTorqueConverterOilOutletTemp : 0|16@1+ (0.03125,-273) [-273|1734.96875] "deg C" Vector__XXX
 SG_ TransOverheatIndicator : 0|2@1+ (1,0) [0|3] "" Vector__XXX
 SG_ TransOilLevelSwitch : 0|2@1+ (1,0) [0|3] "" Vector__XXX
 SG_ TransOilFilterRestrictionSwitch : 0|2@1+ (1,0) [0|3] "" Vector__XXX
 SG_ VehicleRoll : 0|16@1+ (0.0078124659559567,-200) [-200|301.99] "deg" Vector__XXX
 SG_ TotalEngCruiseTime : 0|32@1+ (0.05,0) [0|210554060.75] "hr" Vector__XXX
 SG_ TotalDriveAverageLoadFactor : 0|8@1+ (0.4,0) [0|100] "%" Vector__XXX
 SG_ TripDriveAverageLoadFactor : 0|8@1+ (0.4,0) [0|100] "%" Vector__XXX
 SG_ TripAverageEngSpeed : 0|16@1+ (0.125,0) [0|8031.875] "rpm" Vector__XXX
 SG_ TripMaxEngSpeed : 0|16@1+ (0.125,0) [0|8031.875] "rpm" Vector__XXX
 SG_ LandLevelingSystemEnableStatus : 0|2@1+ (1,0) [0|3] "" Vector__XXX
 SG_ BladeCtrlModeRight : 0|4@1+ (1,0) [0|15] "" Vector__XXX
 SG_ BladeCtrlModeLeft : 0|4@1+ (1,0) [0|15] "" Vector__XXX
 SG_ BladeCtrlMode : 0|8@1+ (1,0) [0|255] "" Vector__XXX
 SG_ BladeDurationAndDirection : 0|16@1+ (1,-3276.8) [-3276.8|3148.7] "sec" Vector__XXX
 SG_ EngActualIgntTiming : 0|16@1+ (1,-200) [-200|301.99] "deg" Vector__XXX
 SG_ EngDesiredIgntTiming3 : 0|16@1+ (1,-200) [-200|301.99] "deg" Vector__XXX
 SG_ EngDesiredIgntTiming2 : 0|16@1+ (1,-200) [-200|301.99] "deg" Vector__XXX
 SG_ EngDesiredIgntTiming1 : 0|16@1+ (1,-200) [-200|301.99] "deg" Vector__XXX
 SG_ EngCyl20IgntTiming : 0|16@1+ (1,-200) [-200|301.99] "deg" Vector__XXX
 SG_ EngCyl19IgntTiming : 0|16@1+ (1,-200) [-200|301.99] "deg" Vector__XXX
 SG_ EngCyl18IgntTiming : 0|16@1+ (1,-200) [-200|301.99] "deg" Vector__XXX
 SG_ EngCyl17IgntTiming : 0|16@1+ (1,-200) [-200|301.99] "deg" Vector__XXX
 SG_ EngCyl16IgntTiming : 0|16@1+ (1,-200) [-200|301.99] "deg" Vector__XXX
 SG_ EngCyl15IgntTiming : 0|16@1+ (1,-200) [-200|301.99] "deg" Vector__XXX
 SG_ EngCyl14IgntTiming : 0|16@1+ (1,-200) [-200|301.99] "deg" Vector__XXX
 SG_ EngCyl13IgntTiming : 0|16@1+ (1,-200) [-200|301.99] "deg" Vector__XXX
 SG_ EngCyl12IgntTiming : 0|16@1+ (1,-200) [-200|301.99] "deg" Vector__XXX
 SG_ EngCyl11IgntTiming : 0|16@1+ (1,-200) [-200|301.99] "deg" Vector__XXX
 SG_ EngCyl10IgntTiming : 0|16@1+ (1,-200) [-200|301.99] "deg" Vector__XXX
 SG_ EngCyl9IgntTiming : 0|16@1+ (1,-200) [-200|301.99] "deg" Vector__XXX
 SG_ EngCyl8IgntTiming : 0|16@1+ (1,-200) [-200|301.99] "deg" Vector__XXX
 SG_ EngCyl7IgntTiming : 0|16@1+ (1,-200) [-200|301.99] "deg" Vector__XXX
 SG_ EngCyl6IgntTiming : 0|16@1+ (1,-200) [-200|301.99] "deg" Vector__XXX
 SG_ EngCyl5IgntTiming : 0|16@1+ (1,-200) [-200|301.99] "deg" Vector__XXX
 SG_ EngCyl4IgntTiming : 0|16@1+ (1,-200) [-200|301.99] "deg" Vector__XXX
 SG_ EngCyl3IgntTiming : 0|16@1+ (1,-200) [-200|301.99] "deg" Vector__XXX
 SG_ EngCyl2IgntTiming : 0|16@1+ (1,-200) [-200|301.99] "deg" Vector__XXX
 SG_ EngCyl1IgntTiming : 0|16@1+ (1,-200) [-200|301.99] "deg" Vector__XXX
 SG_ EngCyl20IgntTransSecondOutput : 0|8@1+ (1,-125) [-125|125] "%" Vector__XXX
 SG_ EngCyl19IgntTransSecondOutput : 0|8@1+ (1,-125) [-125|125] "%" Vector__XXX
 SG_ EngCyl18IgntTransSecondOutput : 0|8@1+ (1,-125) [-125|125] "%" Vector__XXX
 SG_ EngCyl17IgntTransSecondOutput : 0|8@1+ (1,-125) [-125|125] "%" Vector__XXX
 SG_ EngCyl16IgntTransSecondOutput : 0|8@1+ (1,-125) [-125|125] "%" Vector__XXX
 SG_ EngCyl15IgntTransSecondOutput : 0|8@1+ (1,-125) [-125|125] "%" Vector__XXX
 SG_ EngCyl14IgntTransSecondOutput : 0|8@1+ (1,-125) [-125|125] "%" Vector__XXX
 SG_ EngCyl13IgntTransSecondOutput : 0|8@1+ (1,-125) [-125|125] "%" Vector__XXX
 SG_ EngCyl12IgntTransSecondOutput : 0|8@1+ (1,-125) [-125|125] "%" Vector__XXX
 SG_ EngCyl11IgntTransSecondOutput : 0|8@1+ (1,-125) [-125|125] "%" Vector__XXX
 SG_ EngCyl10IgntTransSecondOutput : 0|8@1+ (1,-125) [-125|125] "%" Vector__XXX
 SG_ EngCyl9IgntTransSecondOutput : 0|8@1+ (1,-125) [-125|125] "%" Vector__XXX
 SG_ EngCyl8IgntTransSecondOutput : 0|8@1+ (1,-125) [-125|125] "%" Vector__XXX
 SG_ EngCyl7IgntTransSecondOutput : 0|8@1+ (1,-125) [-125|125] "%" Vector__XXX
 SG_ EngCyl6IgntTransSecondOutput : 0|8@1+ (1,-125) [-125|125] "%" Vector__XXX
 SG_ EngCyl5IgntTransSecondOutput : 0|8@1+ (1,-125) [-125|125] "%" Vector__XXX
 SG_ EngCyl4IgntTransSecondOutput : 0|8@1+ (1,-125) [-125|125] "%" Vector__XXX
 SG_ EngCyl3IgntTransSecondOutput : 0|8@1+ (1,-125) [-125|125] "%" Vector__XXX
 SG_ EngCyl2IgntTransSecondOutput : 0|8@1+ (1,-125) [-125|125] "%" Vector__XXX
 SG_ EngCyl1IgntTransSecondOutput : 0|8@1+ (1,-125) [-125|125] "%" Vector__XXX
 SG_ EngOprtrPrmryIntrmdtSpdSlctState : 0|4@1+ (1,0) [0|15] "" Vector__XXX
 SG_ EngOprtrPrmryIntrmdteSpeedSelect : 0|4@1+ (1,0) [0|15] "" Vector__XXX
 SG_ EngTotalIdleHours : 0|32@1+ (0.05,0) [0|210554060.75] "hr" Vector__XXX
 SG_ EngTotalIdleFuelUsed : 0|32@1+ (0.5,0) [0|2105540607.5] "L" Vector__XXX
 SG_ EngIntakeManifold6Temp : 0|8@1+ (1,-40) [-40|210] "deg C" Vector__XXX
 SG_ EngIntakeManifold5Temp : 0|8@1+ (1,-40) [-40|210] "deg C" Vector__XXX
 SG_ EngIntakeManifold4Temp : 0|8@1+ (1,-40) [-40|210] "deg C" Vector__XXX
 SG_ EngIntakeManifold3Temp : 0|8@1+ (1,-40) [-40|210] "deg C" Vector__XXX
 SG_ EngIntakeManifold2Temp : 0|8@1+ (1,-40) [-40|210] "deg C" Vector__XXX
 SG_ EngTurbo4BoostPress : 0|16@1+ (0.125,0) [0|8031.875] "kPa" Vector__XXX
 SG_ EngTurbo3BoostPress : 0|16@1+ (0.125,0) [0|8031.875] "kPa" Vector__XXX
 SG_ EngTurbo2BoostPress : 0|16@1+ (0.125,0) [0|8031.875] "kPa" Vector__XXX
 SG_ EngTurbo1BoostPress : 0|16@1+ (0.125,0) [0|8031.875] "kPa" Vector__XXX
 SG_ EngIntakeManifold2AbsPress : 0|8@1+ (2,0) [0|500] "kPa" Vector__XXX
 SG_ EngIntakeManifold1AbsPress : 0|16@1+ (0.1,0) [0|6425.5] "kPa" Vector__XXX
 SG_ EngIntakeManifold1AbsPress : 0|8@1+ (2,0) [0|500] "kPa" Vector__XXX
 SG_ EngIntakeManifold2Press : 0|8@1+ (2,0) [0|500] "kPa" Vector__XXX
 SG_ EngAirFilter4DiffPress : 0|8@1+ (0.05,0) [0|12.5] "kPa" Vector__XXX
 SG_ EngAirFilter3DiffPress : 0|8@1+ (0.05,0) [0|12.5] "kPa" Vector__XXX
 SG_ EngAirFilter2DiffPress : 0|8@1+ (0.05,0) [0|12.5] "kPa" Vector__XXX
 SG_ EngCoolantFilterDiffPress : 0|8@1+ (0.5,0) [0|125] "kPa" Vector__XXX
 SG_ EngExhaustGasTemp : 0|16@1+ (0.03125,-273) [-273|1734.96875] "deg C" Vector__XXX
 SG_ EngAirFilter1DiffPress : 0|8@1+ (0.05,0) [0|12.5] "kPa" Vector__XXX
 SG_ EngIntakeManifold1Temp : 0|8@1+ (1,-40) [-40|210] "deg C" Vector__XXX
 SG_ EngIntakeManifold1Press : 0|8@1+ (2,0) [0|500] "kPa" Vector__XXX
 SG_ EngDslPrtculateFilterIntakePress : 0|8@1+ (0.5,0) [0|125] "kPa" Vector__XXX
 SG_ EngAirIntakePress : 0|8@1+ (2,0) [0|500] "kPa" Vector__XXX
 SG_ CabHeatingZone : 0|2@1+ (1,0) [0|3] "" Vector__XXX
 SG_ EngHeatingZone : 0|2@1+ (1,0) [0|3] "" Vector__XXX
 SG_ CabVentilation : 0|2@1+ (1,0) [0|3] "" Vector__XXX
 SG_ AuxHeaterWaterPumpStatus : 0|2@1+ (1,0) [0|3] "" Vector__XXX
 SG_ AuxHeaterMode : 0|4@1+ (1,0) [0|15] "" Vector__XXX
 SG_ AuxHeaterOutputPowerPercent : 0|8@1+ (0.4,0) [0|100] "%" Vector__XXX
 SG_ AuxHeaterInputAirTemp : 0|8@1+ (1,-40) [-40|210] "deg C" Vector__XXX
 SG_ AuxHeaterOutputCoolantTemp : 0|8@1+ (1,-40) [-40|210] "deg C" Vector__XXX
 SG_ FireApparatusPumpEngagement : 0|2@1+ (1,0) [0|3] "" Vector__XXX
 SG_ EngHydPressGovernorSwitch : 0|2@1+ (1,0) [0|3] "" Vector__XXX
 SG_ EngHydPressGovernorModeIndicator : 0|2@1+ (1,0) [0|3] "" Vector__XXX
 SG_ HydPress : 0|16@1+ (2,0) [0|128510] "kPa" Vector__XXX
 SG_ EngTotalRevolutions : 0|32@1+ (1000,0) [0|4211081215000] "r" Vector__XXX
 SG_ EngTotalHoursOfOperation : 0|32@1+ (0.05,0) [0|210554060.75] "hr" Vector__XXX
 SG_ HydBrakeFluidLevelSwitch : 0|2@1+ (1,0) [0|3] "" Vector__XXX
 SG_ HydBrakeSystemAudibleWarningCmd : 0|2@1+ (1,0) [0|3] "" Vector__XXX
 SG_ HydBrakePressSupplyStateCircuit2 : 0|2@1+ (1,0) [0|3] "" Vector__XXX
 SG_ HydBrakePressSupplyStateCircuit1 : 0|2@1+ (1,0) [0|3] "" Vector__XXX
 SG_ HydBrkePressWarningStateCircuit2 : 0|2@1+ (1,0) [0|3] "" Vector__XXX
 SG_ HydBrkePressWarningStateCircuit1 : 0|2@1+ (1,0) [0|3] "" Vector__XXX
 SG_ HydBrakePressCircuit2 : 0|8@1+ (0.1,0) [0|25] "MPa" Vector__XXX
 SG_ HydBrakePressCircuit1 : 0|8@1+ (0.1,0) [0|25] "MPa" Vector__XXX
 SG_ TripDriveFuelEconomy : 0|16@1+ (0.0019531553964672,0) [0|125.5] "km/kg" Vector__XXX
 SG_ TripCruiseFuelUsed : 0|32@1+ (0.5,0) [0|2105540607.5] "kg" Vector__XXX
 SG_ TripVehicleIdleFuelUsed : 0|32@1+ (0.5,0) [0|2105540607.5] "kg" Vector__XXX
 SG_ TripPTOGovernorNonmovingFuelUsed : 0|32@1+ (0.5,0) [0|2105540607.5] "kg" Vector__XXX
 SG_ TripPTOGovernorMovingFuelUsed : 0|32@1+ (0.5,0) [0|2105540607.5] "kg" Vector__XXX
 SG_ TripDriveFuelUsed : 0|32@1+ (0.5,0) [0|2105540607.5] "kg" Vector__XXX
 SG_ EngFuelValve1OutletAbsPress : 0|16@1+ (0.1,0) [0|6425.5] "kPa" Vector__XXX
 SG_ EngAirToFuelDiffPress : 0|16@1+ (0.1,0) [0|6425.5] "kPa" Vector__XXX
 SG_ EngFuelValveDiffPress : 0|16@1+ (0.1,0) [0|6425.5] "kPa" Vector__XXX
 SG_ EngFuelValve1IntakeAbsPress : 0|16@1+ (0.1,0) [0|6425.5] "kPa" Vector__XXX
 SG_ EngRequestedFuelValve2Pos : 0|8@1+ (1,0) [0|100] "%" Vector__XXX
 SG_ EngRequestedFuelValve1Pos : 0|8@1+ (1,0) [0|100] "%" Vector__XXX
 SG_ EngFuelValve2Pos : 0|8@1+ (0.4,0) [0|100] "%" Vector__XXX
 SG_ EngFuelValve1Pos : 0|8@1+ (0.4,0) [0|100] "%" Vector__XXX
 SG_ EngFuelFlowRate2 : 0|16@1+ (0.1,0) [0|6425.5] "m^3/h" Vector__XXX
 SG_ EngFuelFlowRate1 : 0|16@1+ (0.1,0) [0|6425.5] "m^3/h" Vector__XXX
 SG_ EngFuelSpecificGravity : 0|16@1+ (1,0) [0|6.4255] "" Vector__XXX
 SG_ TripAverageFuelRate : 0|16@1+ (0.05,0) [0|3212.75] "kg/h" Vector__XXX
 SG_ TotalEngPTOGovernorFuelUsed : 0|32@1+ (0.5,0) [0|2105540607.5] "kg" Vector__XXX
 SG_ SpecificHeatRatio : 0|16@1+ (1,0) [0|64.255] "" Vector__XXX
 SG_ TotalFuelUsed : 0|32@1+ (0.5,0) [0|2105540607.5] "kg" Vector__XXX
 SG_ TripFuel : 0|32@1+ (0.5,0) [0|2105540607.5] "kg" Vector__XXX
 SG_ SensorSupplyVoltage6 : 0|16@1+ (0.05,0) [0|3212.75] "V" Vector__XXX
 SG_ SensorSupplyVoltage5 : 0|16@1+ (0.05,0) [0|3212.75] "V" Vector__XXX
 SG_ SensorSupplyVoltage8 : 0|16@1+ (0.05,0) [0|3212.75] "V" Vector__XXX
 SG_ SensorSupplyVoltage7 : 0|16@1+ (0.05,0) [0|3212.75] "V" Vector__XXX
 SG_ SensorSupplyVoltage4 : 0|16@1+ (0.05,0) [0|3212.75] "V" Vector__XXX
 SG_ SensorSupplyVoltage3 : 0|16@1+ (0.05,0) [0|3212.75] "V" Vector__XXX
 SG_ SensorSupplyVoltage2 : 0|16@1+ (0.05,0) [0|3212.75] "V" Vector__XXX
 SG_ SensorSupplyVoltage1 : 0|16@1+ (0.05,0) [0|3212.75] "V" Vector__XXX
 SG_ AtLeastOnePTOEngaged : 0|2@1+ (1,0) [0|3] "" Vector__XXX
 SG_ EnggmntSttsPTOEngAccessoryDrive2 : 0|2@1+ (1,0) [0|3] "" Vector__XXX
 SG_ EnggmntSttsPTOEngAccessoryDrive1 : 0|2@1+ (1,0) [0|3] "" Vector__XXX
 SG_ EngagementStatusPTOEngFlywheel : 0|2@1+ (1,0) [0|3] "" Vector__XXX
 SG_ EnggmntStatusTransInputShaftPTO1 : 0|2@1+ (1,0) [0|3] "" Vector__XXX
 SG_ EnggmntStatusTransInputShaftPTO2 : 0|2@1+ (1,0) [0|3] "" Vector__XXX
 SG_ EnggmntStatusTransOutputShaftPTO : 0|2@1+ (1,0) [0|3] "" Vector__XXX
 SG_ EnggmntSttsTrnsfrCsOtputShaftPTO : 0|2@1+ (1,0) [0|3] "" Vector__XXX
 SG_ EnggmntCnsntPTOEngAccssoryDrive2 : 0|2@1+ (1,0) [0|3] "" Vector__XXX
 SG_ EnggmntCnsntPTOEngAccssoryDrive1 : 0|2@1+ (1,0) [0|3] "" Vector__XXX
 SG_ EngagementConsentPTOEngFlywheel : 0|2@1+ (1,0) [0|3] "" Vector__XXX
 SG_ EnggmntCnsentTransInputShaftPTO1 : 0|2@1+ (1,0) [0|3] "" Vector__XXX
 SG_ EnggmntCnsentTransInputShaftPTO2 : 0|2@1+ (1,0) [0|3] "" Vector__XXX
 SG_ EnggmntCnsentTransOutputShaftPTO : 0|2@1+ (1,0) [0|3] "" Vector__XXX
 SG_ EnggmntCnsntTrnsfrCsOtptShaftPTO : 0|2@1+ (1,0) [0|3] "" Vector__XXX
 SG_ EnbleSwitchPTOEngAccessoryDrive2 : 0|2@1+ (1,0) [0|3] "" Vector__XXX
 SG_ EnbleSwitchPTOEngAccessoryDrive1 : 0|2@1+ (1,0) [0|3] "" Vector__XXX
 SG_ EnableSwitchPTOEngFlywheel : 0|2@1+ (1,0) [0|3] "" Vector__XXX
 SG_ EnableSwitchTransInputShaftPTO1 : 0|2@1+ (1,0) [0|3] "" Vector__XXX
 SG_ EnableSwitchTransInputShaftPTO2 : 0|2@1+ (1,0) [0|3] "" Vector__XXX
 SG_ EnableSwitchTransOutputShaftPTO : 0|2@1+ (1,0) [0|3] "" Vector__XXX
 SG_ EnblSwtchTrnsfrCseOutputShaftPTO : 0|2@1+ (1,0) [0|3] "" Vector__XXX
 SG_ EngFuelValve2OutletAbsPress : 0|16@1+ (0.1,0) [0|6425.5] "kPa" Vector__XXX
 SG_ EngFuelTemp2 : 0|8@1+ (1,-40) [-40|210] "deg C" Vector__XXX
 SG_ EngGas2MassFlowRate : 0|16@1+ (0.05,0) [0|3212.75] "kg/h" Vector__XXX
 SG_ EngFuelValve2IntakeAbsPress : 0|16@1+ (0.1,0) [0|6425.5] "kPa" Vector__XXX
 SG_ EngCentrifugalOilFilterSpeed : 0|16@1+ (4,0) [0|257020] "rpm" Vector__XXX
 SG_ EngCoolantPumpDiffPress : 0|8@1+ (1.64,-7) [-7|403] "kPa" Vector__XXX
 SG_ EngChargeAirCooler2IntakePress : 0|8@1+ (2,0) [0|500] "kPa" Vector__XXX
 SG_ EngChargeAirCooler1IntakePress : 0|8@1+ (2,0) [0|500] "kPa" Vector__XXX
 SG_ EngIntercoolerCoolantLevel : 0|8@1+ (0.4,0) [0|100] "%" Vector__XXX
 SG_ EngChargeAirCoolerOutletPress : 0|8@1+ (2,0) [0|500] "kPa" Vector__XXX
 SG_ EngAftercoolerCoolantLevel : 0|8@1+ (0.4,0) [0|100] "%" Vector__XXX
 SG_ EngVriableGeometryTurboActuator1 : 0|8@1+ (1,0) [0|100] "%" Vector__XXX
 SG_ EngTrbCmprssrBypssActtr1TmpSttus : 0|3@1+ (1,0) [0|7] "" Vector__XXX
 SG_ EngTrbCmprssrBypssActtr1PrlmnryF : 0|5@1+ (1,0) [0|31] "" Vector__XXX
 SG_ EngTrbCmprssorBypassActuator2Cmd : 0|16@1+ (1,0) [0|160.6375] "%" Vector__XXX
 SG_ EngTrbCmprssorBypassActuator1Pos : 0|8@1+ (0.4,0) [0|100] "%" Vector__XXX
 SG_ EngTrbCmprssorBypassActuator1Cmd : 0|16@1+ (1,0) [0|160.6375] "%" Vector__XXX
 SG_ EngDsrdTrbCmprssrBypssActtor1Pos : 0|8@1+ (0.4,0) [0|100] "%" Vector__XXX
 SG_ EnableStatusOfDoor10 : 0|2@1+ (1,0) [0|3] "" Vector__XXX
 SG_ OpenStatusOfDoor10 : 0|2@1+ (1,0) [0|3] "" Vector__XXX
 SG_ LockStatusOfDoor10 : 0|2@1+ (1,0) [0|3] "" Vector__XXX
 SG_ EnableStatusOfDoor9 : 0|2@1+ (1,0) [0|3] "" Vector__XXX
 SG_ OpenStatusOfDoor9 : 0|2@1+ (1,0) [0|3] "" Vector__XXX
 SG_ LockStatusOfDoor9 : 0|2@1+ (1,0) [0|3] "" Vector__XXX
 SG_ EnableStatusOfDoor8 : 0|2@1+ (1,0) [0|3] "" Vector__XXX
 SG_ OpenStatusOfDoor8 : 0|2@1+ (1,0) [0|3] "" Vector__XXX
 SG_ LockStatusOfDoor8 : 0|2@1+ (1,0) [0|3] "" Vector__XXX
 SG_ EnableStatusOfDoor7 : 0|2@1+ (1,0) [0|3] "" Vector__XXX
 SG_ OpenStatusOfDoor7 : 0|2@1+ (1,0) [0|3] "" Vector__XXX
 SG_ LockStatusOfDoor7 : 0|2@1+ (1,0) [0|3] "" Vector__XXX
 SG_ EnableStatusOfDoor6 : 0|2@1+ (1,0) [0|3] "" Vector__XXX
 SG_ OpenStatusOfDoor6 : 0|2@1+ (1,0) [0|3] "" Vector__XXX
 SG_ LockStatusOfDoor6 : 0|2@1+ (1,0) [0|3] "" Vector__XXX
 SG_ EnableStatusOfDoor5 : 0|2@1+ (1,0) [0|3] "" Vector__XXX
 SG_ OpenStatusOfDoor5 : 0|2@1+ (1,0) [0|3] "" Vector__XXX
 SG_ LockStatusOfDoor5 : 0|2@1+ (1,0) [0|3] "" Vector__XXX
 SG_ EnableStatusOfDoor4 : 0|2@1+ (1,0) [0|3] "" Vector__XXX
 SG_ OpenStatusOfDoor4 : 0|2@1+ (1,0) [0|3] "" Vector__XXX
 SG_ LockStatusOfDoor4 : 0|2@1+ (1,0) [0|3] "" Vector__XXX
 SG_ EnableStatusOfDoor3 : 0|2@1+ (1,0) [0|3] "" Vector__XXX
 SG_ OpenStatusOfDoor3 : 0|2@1+ (1,0) [0|3] "" Vector__XXX
 SG_ LockStatusOfDoor3 : 0|2@1+ (1,0) [0|3] "" Vector__XXX
 SG_ EnableStatusOfDoor2 : 0|2@1+ (1,0) [0|3] "" Vector__XXX
 SG_ OpenStatusOfDoor2 : 0|2@1+ (1,0) [0|3] "" Vector__XXX
 SG_ LockStatusOfDoor2 : 0|2@1+ (1,0) [0|3] "" Vector__XXX
 SG_ EnableStatusOfDoor1 : 0|2@1+ (1,0) [0|3] "" Vector__XXX
 SG_ OpenStatusOfDoor1 : 0|2@1+ (1,0) [0|3] "" Vector__XXX
 SG_ LockStatusOfDoor1 : 0|2@1+ (1,0) [0|3] "" Vector__XXX
 SG_ Aftrtrtmnt1SCRCtlystRgntTmp2Prlm : 0|5@1+ (1,0) [0|31] "" Vector__XXX
 SG_ Aftrtrtmnt1SCRCtlystRgntPrprtsPr : 0|5@1+ (1,0) [0|31] "" Vector__XXX
 SG_ Aftrtrtmnt1SCRCtlystRgntCndctvty : 0|8@1+ (5,0) [0|1250] "microSiemens/mm" Vector__XXX
 SG_ Aftrtrtmnt1SCRCtlystRgntCncntrtn : 0|8@1+ (0.25,0) [0|62.5] "%" Vector__XXX
 SG_ Aftrtrtmnt1SCRCtalystReagentType : 0|4@1+ (1,0) [0|15] "" Vector__XXX
 SG_ Aftrtrtmnt1SCRCtlystReagentTemp2 : 0|8@1+ (1,-40) [-40|210] "deg C" Vector__XXX
 SG_ RqdGnrtrAvrgLneLineACRMSVoltage : 0|32@1+ (0.0078125,0) [0|32899071] "V" Vector__XXX
 SG_ MessageChecksum : 0|4@1+ (1,0) [0|15] "" Vector__XXX
 SG_ MessageCounter : 0|4@1+ (1,0) [0|15] "" Vector__XXX
 SG_ TripCruiseFuelUsed : 0|32@1+ (0.5,0) [0|2105540607.5] "L" Vector__XXX
 SG_ TripVehicleIdleFuelUsed : 0|32@1+ (0.5,0) [0|2105540607.5] "L" Vector__XXX
 SG_ TripDriveFuelUsed : 0|32@1+ (0.5,0) [0|2105540607.5] "L" Vector__XXX
 SG_ TripPTOGovernorNonmovingFuelUsed : 0|32@1+ (0.5,0) [0|2105540607.5] "L" Vector__XXX
 SG_ TripPTOGovernorMovingFuelUsed : 0|32@1+ (0.5,0) [0|2105540607.5] "L" Vector__XXX
 SG_ TripDriveFuelEconomy : 0|16@1+ (0.0019531553964672,0) [0|125.5] "km/L" Vector__XXX
 SG_ TripAverageFuelRate : 0|16@1+ (0.05,0) [0|3212.75] "L/h" Vector__XXX
 SG_ TotalEngPTOGovernorFuelUsed : 0|32@1+ (0.5,0) [0|2105540607.5] "L" Vector__XXX
 SG_ FailureModeIdentifier1 : 0|5@1+ (1,0) [0|0] "" Vector__XXX
 SG_ SPN1High : 0|3@1+ (1,0) [0|7] "" Vector__XXX
 SG_ SPN1 : 0|16@1+ (1,0) [0|65536] "" Vector__XXX
 SG_ FailureModeIdentifier1 : 0|5@1+ (1,0) [0|0] "" Vector__XXX
 SG_ SPN1High : 0|3@1+ (1,0) [0|7] "" Vector__XXX
 SG_ SPN1 : 0|16@1+ (1,0) [0|65536] "" Vector__XXX
 SG_ SPN1High : 0|3@1+ (1,0) [0|7] "" Vector__XXX
 SG_ SPN1 : 0|16@1+ (1,0) [0|65536] "" Vector__XXX
 SG_ FailureModeIdentifier1 : 0|5@1+ (1,0) [0|0] "" Vector__XXX
 SG_ DieselParticulateFilterStatus : 0|1@1- (1,0) [0|0] "" Vector__XXX
 SG_ EngIntakeManifold1Press : 0|8@1+ (2,0) [0|500] "kPa" Vector__XXX
 SG_ SPN1 : 0|16@1+ (1,0) [0|65536] "" Vector__XXX
 SG_ SPN1High : 0|3@1+ (1,0) [0|7] "" Vector__XXX
 SG_ FailureModeIdentifier1 : 0|5@1+ (1,0) [0|0] "" Vector__XXX

CM_ SG_ 3221225472 Jystck10GrpXAxsLvrRghtPstvPsStts "Reports when the current joystick grip position is on the positive travel side (forward, right, clockwise, up) relative to the";
CM_ SG_ 3221225472 Jystck10GrpXAxsLvrLftNgtvPsSttus "Reports when the current joystick grip position is on the negative travel side (back, left, counterclockwise, down) relative";
CM_ SG_ 3221225472 Jystck10GrpXAxisNeutralPosStatus "Reports when the current joystick grip position is in the neutral position for that axis of travel. The neutral position";
CM_ SG_ 3221225472 EngFuelFilterIntakeAbsPress "Absolute pressure of fuel at the intake of the fuel filter (suction side) located between the fuel tank and the fuel supply";
CM_ SG_ 3221225472 EngExhstGsRcrcltn1OutletAbsPress "EGR outlet absolute pressure is measured after the EGR 1 valve. See SPN 5019 for 1 byte resolution.";
CM_ SG_ 3221225472 EngExhstGsRcrcltn1IntakeAbsPress "EGR intake absolute pressure measured before the EGR 1 valve.";
CM_ SG_ 3221225472 EngExhstGsRcrcltn2IntakeAbsPress "EGR intake absolute pressure measured before the EGR 2 valve.";
CM_ SG_ 3221225472 EngExhstGsRcrcltn2OutletAbsPress "Absolute Pressure immediately after the EGR2 valve";
CM_ SG_ 3221225472 EngExhstGsRcrclation2IntakePress "EGR2 intake gauge pressure is measured after EGR2 cooler and before EGR2 valve";
CM_ SG_ 3221225472 EngExhstGsRcirculation2DiffPress "Differential Pressure across the Exhaust Gas Recirculation 2 (EGR2) system.";
CM_ SG_ 3221225472 CmmndedEngFuelInjectionCtrlPress "Provides the commanded set point value for the engine fuel injection control pressure.";
CM_ SG_ 3221225472 CommandedEngFuelRailPress "Provides the commanded set point value for the engine fuel rail pressure";
CM_ SG_ 3221225472 EngExhstGsRcirculation2Valve2Pos "The position of the second exhaust gas recirculation valve of EGR 2 expressed as a percentage of full travel. 0% means";
CM_ SG_ 3221225472 EngExhstGsRecirculation2ValvePos "Position of EGR2 valve expressed as a percentage of full travel. 0% means the valve is closed and no exhaust gas is";
CM_ SG_ 3221225472 EngExhstGsRcrculation2Valve2Ctrl "Desired percentage of maximum Exhaust Gas Recirculation 2 (EGR2) valve 2 opening. 0% means the valve is closed.";
CM_ SG_ 3221225472 EngExhstGsRcirculation2ValveCtrl "Desired percentage of maximum Exhaust Gas Recirculation 2 (EGR2) valve opening. 0% means the valve is closed.";
CM_ SG_ 3221225472 EGR2CoolerBypassActuatorPos "EGR2 Cooler Bypass Actuator position, where 0% = Fully Closed (no gas flowing through the bypass), and 100% = Fully";
CM_ SG_ 3221225472 EngExhstGsRcrcltn2ClerEfficiency "Exhaust Gas Recirculation 2 cooler efficiency is an indication of the cooler’s ability to reduce the temperature of the";
CM_ SG_ 3221225472 EngExhstGsRcrcltn2ClrIntkGsAbsPr "Exhaust Gas Recirculation 2 gas absolute pressure is measured at EGR2 cooler intake. See SPN 5253 for EGR2";
CM_ SG_ 3221225472 EngExhstGsRcrcltn2ClerIntakeTemp "Exhaust Gas Recirculation 2 (EGR2) Temperature measured at EGR2 cooler intake. See SPN 5255 for Engine EGR2";
CM_ SG_ 3221225472 EngFrctnPrcentTorqueAtIdlePoint7 "The static portion of the friction torque at speed point 7 (SPN 533) of the engine torque map in the engine configuration";
CM_ SG_ 3221225472 EngFrctnPrcentTorqueAtIdlePoint6 "For engine configuration map modes 1 and 2, this is the static portion of the friction torque at speed point 6 (SPN 532) of";
CM_ SG_ 3221225472 EngFrctnPrcentTorqueAtIdlePoint5 "The static portion of the friction torque at speed point 5 (SPN 531) of the engine torque map in the engine configuration";
CM_ SG_ 3221225472 EngFrctnPrcentTorqueAtIdlePoint4 "The static portion of the friction torque at speed point 4 (SPN 530) of the engine torque map in the engine configuration";
CM_ SG_ 3221225472 EngFrctnPrcentTorqueAtIdlePoint3 "The static portion of the friction torque at speed point 3 (SPN 529) of the engine torque map in the engine configuration";
CM_ SG_ 3221225472 EngFrctnPrcentTorqueAtIdlePoint2 "The static portion of the friction torque at speed point 2 (SPN 528) of the engine torque map in the engine configuration";
CM_ SG_ 3221225472 EngFrctnPrcentTorqueAtIdlePoint1 "The static portion of the friction torque at speed point 1 (SPN 188) of the engine torque map in the engine configuration";
CM_ SG_ 3221225472 DslPrtcltFltrActvRgnrtnFrcdSttus "Indicates the forced execution status of diesel particulate filter regeneration.";
CM_ SG_ 3221225472 ExhaustSystemHighTempLampCmd "Command to control the exhaust system high temperature lamp. This lamp indicates that the exhaust system";
CM_ SG_ 3221225472 DslPrtcltFltrAtmtcActvRgnrtnIntt "Indicates the configuration of diesel particulate filter active regeneration automatic initiation.";
CM_ SG_ 3221225472 DslPrtcltFltrActvRgnrtnInhbtdDTV "Speed";
CM_ SG_ 3221225472 DslPrtcltFltrActvRgnrtnInhbtdDTE "Indicates the state of diesel particulate filter active regeneration inhibition due to the engine not being warmed up.";
CM_ SG_ 3221225472 DslPrtcltFltrActvRgnrtnInhb_0000 "Indicates the state of diesel particulate filter active regeneration inhibition due to a permanent system lockout.";
CM_ SG_ 3221225472 DslPrtcltFltrActvRgnrtnInhbtdDTT "Indicates the state of diesel particulate filter active regeneration inhibition due to a temporary system lockout.";
CM_ SG_ 3221225472 DslPrtcltFltrActvRgnrtnInhbtdDTS "Indicates the state of diesel particulate filter active regeneration inhibition due to a system timeout.Indicates the state of diesel particulate filter active regeneration inhibition due to a system fault being active.Indicates the state of diesel particulate filter active regeneration inhibition due to the service brake being active.";
CM_ SG_ 3221225472 DslPrtcltFltrActvRgnrtnInhbtdDTL "Indicates the state of diesel particulate filter active regeneration inhibition due to the exhaust gas temperature being too";
CM_ SG_ 3221225472 DslPrtcltFltrActvRgnrtnInhb_0001 "Indicates the state of diesel particulate filter active regeneration inhibition due to the parking brake being not set.";
CM_ SG_ 3221225472 DslPrtcltFltrActvRgnrtnInhb_0002 "Speed";
CM_ SG_ 3221225472 DslPrtcltFltrActvRgnrtnInhbtdDTO "Indicates the state of diesel particulate filter active regeneration inhibition due to the transmission being out of neutral.";
CM_ SG_ 3221225472 DslPrtcltFltrActvRgnrtnInhbtdDTA "Indicates the state of diesel particulate filter active regeneration inhibition due to the accelerator pedal being off idle.";
CM_ SG_ 3221225472 DslPrtcltFltrActvRgnrtnInhbtdDTP "Indicates the state of diesel particulate filter active regeneration inhibition due to the PTO being active.";
CM_ SG_ 3221225472 DslPrtcltFltrActvRgnrtnInhbtdDTC "Indicates the state of diesel particulate filter active regeneration inhibition due to the clutch being disengaged.";
CM_ SG_ 3221225472 DslPrtcltFltrActvRgnrtnInhbtdDTI "Indicates the state of diesel particulate filter active regeneration inhibition due to the Diesel Particulate Filter Regeneration";
CM_ SG_ 3221225472 DslPrtcltFltrActvRgnrtnInhbtdStt "Indicates the state of diesel particulate filter active regeneration inhibition.";
CM_ SG_ 3221225472 DieselParticulateFilterStatus "Indicates the state of the diesel particulate filter regeneration need and urgency.";
CM_ SG_ 3221225472 DslPrtcltFltrActvRgnrationStatus "Indicates the state of diesel particulate filter active regeneration.";
CM_ SG_ 3221225472 DslPrtcltFltrPssvRgnrationStatus "Indicates the state of diesel particulate filter passive regeneration.";
CM_ SG_ 3221225472 DieselParticulateFilterLampCmd "Command to control the diesel particulate filter lamp.";
CM_ SG_ 3221225472 DslPrtculateFilter2SootSignalMin "Minimum output signal level of the current soot measurement from diesel particulate filter 2 soot sensor. This is a";
CM_ SG_ 3221225472 DslPrtculateFilter2SootSignalMax "Maximum output signal level of the current soot measurement from diesel particulate filter 2 soot sensor. This is a";
CM_ SG_ 3221225472 DslPrtcltFltr2StSgnlStndrdDvtion "Standard deviation of the soot measurement from diesel particulate filter 2 soot sensor.";
CM_ SG_ 3221225472 DslPrtcltFltr2StSnsrPrlminaryFMI "Used to identify the applicable J1939-73 FMI detected in the soot sensor signal by the manufacturer’s sensor control";
CM_ SG_ 3221225472 DslPrtcltFilter2MedianSootSignal "Median output signal level from diesel particulate filter 2 soot sensor.";
CM_ SG_ 3221225472 DslPrtclateFilter2MeanSootSignal "Mean output signal level from diesel particulate filter 2 soot sensor.";
CM_ SG_ 3221225472 DslParticulateFilter2SootDensity "Soot density in diesel particulate filter 2.";
CM_ SG_ 3221225472 DieselParticulateFilter2SootMass "Soot mass in diesel particulate filter 2.";
CM_ SG_ 3221225472 DslPrtculateFilter1SootSignalMin "Minimum output signal level of the current soot measurement from diesel particulate filter 1 soot sensor. This is a";
CM_ SG_ 3221225472 DslPrtculateFilter1SootSignalMax "Maximum output signal level of the current soot measurement from diesel particulate filter 1 soot sensor. This is a";
CM_ SG_ 3221225472 DslPrtcltFltr1StSgnlStndrdDvtion "Standard deviation of the soot measurement from diesel particulate filter 1 soot sensor.";
CM_ SG_ 3221225472 DslPrtcltFltr1StSnsrPrlminaryFMI "Used to identify the applicable J1939-73 FMI detected in the soot sensor signal by the manufacturer’s sensor control";
CM_ SG_ 3221225472 DslPrtcltFilter1MedianSootSignal "Median output signal level from diesel particulate filter 1 soot sensor.";
CM_ SG_ 3221225472 DslPrtclateFilter1MeanSootSignal "Mean output signal level from diesel particulate filter 1 soot sensor.";
CM_ SG_ 3221225472 DslParticulateFilter1SootDensity "Soot density in diesel particulate filter 1.";
CM_ SG_ 3221225472 DieselParticulateFilter1SootMass "Soot mass in diesel particulate filter 1.";
CM_ SG_ 3221225472 VehicleBatteryChargingLampData "This parameter provides measured data from the Vehicle Battery Charging Lamp.";
CM_ SG_ 3221225472 VehicleHVACRecirculationLampData "This parameter provides measured data from the Vehicle HVAC Recirculation Lamp.";
CM_ SG_ 3221225472 VehicleAirPressLowLampData "This parameter provides measured data from the Vehicle Air Pressure Low Lamp.";
CM_ SG_ 3221225472 VehicleFuelLevelLowLampData "This parameter provides measured data from theVehicle Fuel Level Low Lamp.";
CM_ SG_ 3221225472 VehicleBatteryVoltageLowLampData "This parameter provides measured data from the Vehicle Battery Voltage Low Lamp.";
CM_ SG_ 3221225472 EngWaitToStartLampData "This parameter provides measured data from the Engine Wait To Start Lamp. See SPN 1081 for the command.";
CM_ SG_ 3221225472 EngFuelFilterRestrictedLampData "Command signal directly controlling the Vehicle Fuel Filter Restricted Lamp.";
CM_ SG_ 3221225472 EngAirFilterRestrictionLampData "This parameter provides measured data from the Engine Air Filter Restriction Lamp.";
CM_ SG_ 3221225472 EngIdleManagementActiveLampData "This parameter provides measured data from the Engine Idle Management Active Lamp.";
CM_ SG_ 3221225472 EngCoolantLevelLowLampData "This parameter provides measured data from the Engine Coolant Level Low Lamp.";
CM_ SG_ 3221225472 EngCoolantTempHighLampData "This parameter provides measured data from the Engine Coolant Temperature High Lamp.";
CM_ SG_ 3221225472 EngOilPressLowLampData "This parameter provides measured data from the Engine Oil Pressure Low Lamp.";
CM_ SG_ 3221225472 CmprssnBrkEnblSwtchIndctrLmpData "This parameter provides measured data from the Compression Brake Enable Switch Indicator Lamp.";
CM_ SG_ 3221225472 EngBrakeActiveLampData "This parameter provides measured data from the Engine Brake Active Lamp.";
CM_ SG_ 3221225472 OBDMalfunctionIndicatorLampData "This parameter provides measured data from the OBD Malfunction Indicator Lamp.";
CM_ SG_ 3221225472 EngRedStopLampData "This parameter provides measured data from the Engine Red Stop Lamp.";
CM_ SG_ 3221225472 EngAmberWarningLampData "This parameter provides measured data from the Engine Amber Warning Lamp.";
CM_ SG_ 3221225472 EngProtectLampData "This parameter provides measured data from the Engine Protect Lamp.";
CM_ SG_ 3221225472 VehicleBatteryChargingLampCmd "Command signal directly controlling the Vehicle Battery Charging Lamp.";
CM_ SG_ 3221225472 VehicleHVACRecirculationLampCmd "Command signal directly controlling the Vehicle HVAC Recirculation Lamp.";
CM_ SG_ 3221225472 VehicleAirPressLowLampCmd "Command signal directly controlling the Vehicle Air Pressure Low Lamp.";
CM_ SG_ 3221225472 VehicleFuelLevelLowLampCmd "Command signal directly controlling the Vehicle Fuel Level Low Lamp.";
CM_ SG_ 3221225472 VehicleBatteryVoltageLowLampCmd "Command signal directly controlling the Vehicle Battery Voltage Low Lamp.";
CM_ SG_ 3221225472 DTCTimeUntilDerate "This timer provides the number of hours the malfunction has until the OBD required derate will occur";
CM_ SG_ 3221225472 DTCTotalPreviouslyActiveTime "This timer provides the number of hours the NOx malfunction has been confirmed and previously active";
CM_ SG_ 3221225472 DTCTotalActiveTime "This timer provides the total number of hours the DTC has been confirmed and active";
CM_ SG_ 3221225472 FailureModeIdentifier1 "The FMI defines the type of failure detected in the subsystem identified by an SPN.The FMI defines the type of failure detected in the subsystem identified by an SPN.The FMI defines the type of failure detected in the subsystem identified by an SPN.The FMI defines the type of failure detected in the subsystem identified by an SPN.The FMI defines the type of failure detected in the subsystem identified by an SPN.";
CM_ SG_ 3221225472 SPN1High "SPN #1 (Conversion Version 4)SPN #1 (Conversion Version 4)SPN #1 (Conversion Version 4)SPN #1 (Conversion Version 4)SPN #1 (Conversion Version 4)";
CM_ SG_ 3221225472 SPN1 "SPN #1 (Conversion Version 4)SPN #1 (Conversion Version 4)SPN #1 (Conversion Version 4)SPN #1 (Conversion Version 4)SPN #1 (Conversion Version 4)";
CM_ SG_ 3221225472 TextDisplayIndex "Used for overwriting consecutive bytes of a displayed string when byte 1 \"Text Display Instructions\" state is set for";
CM_ SG_ 3221225472 TextDisplayInstructions "This parameter describes the status for the display how to show the information.";
CM_ SG_ 3221225472 RetractStatusOfRamp5 "Retract status of ramp at doorway 5, counting from front to back on the vehicle.";
CM_ SG_ 3221225472 RetractStatusOfRamp4 "Retract status of ramp at doorway 4, counting from front to back on the vehicle.";
CM_ SG_ 3221225472 MovementStatusOfRamp5 "Movement status of ramp at doorway 5, counting from front to back on the vehicle.";
CM_ SG_ 3221225472 MovementStatusOfRamp4 "Movement status of ramp at doorway 4, counting from front to back on the vehicle.";
CM_ SG_ 3221225472 EnableStatusOfRamp5 "Enable status of ramp at doorway 5, counting from front to back on the vehicle.";
CM_ SG_ 3221225472 EnableStatusOfRamp4 "Enable status of ramp at doorway 4, counting from front to back on the vehicle.";
CM_ SG_ 3221225472 MovementStatusOfRamp3 "Movement status of ramp at doorway 3, counting from front to back on the vehicle.";
CM_ SG_ 3221225472 EnableStatusOfRamp3 "Enable status of ramp at doorway 3, counting from front to back on the vehicle.";
CM_ SG_ 3221225472 RetractStatusOfRamp3 "Retract status of ramp at doorway 3, counting from front to back on the vehicle.";
CM_ SG_ 3221225472 MovementStatusOfRamp2 "Movement status of ramp at doorway 2, counting from front to back on the vehicle.";
CM_ SG_ 3221225472 EnableStatusOfRamp2 "Enable status of ramp at doorway 2, counting from front to back on the vehicle.";
CM_ SG_ 3221225472 RetractStatusOfRamp2 "Retract status of ramp at doorway 2, counting from front to back on the vehicle.";
CM_ SG_ 3221225472 MovementStatusOfRamp1 "Movement status of ramp at doorway 1, counting from front to back on the vehicle.";
CM_ SG_ 3221225472 EnableStatusOfRamp1 "Enable status of ramp at doorway 1, counting from front to back on the vehicle.";
CM_ SG_ 3221225472 RetractStatusOfRamp1 "Retract status of ramp at doorway 1, counting from front to back on the vehicle.";
CM_ SG_ 3221225472 MaxCrankAttemptsPerStartAttempt "The number of cranking cycles that will be performed before ending the start attempt. This is intended to be used in";
CM_ SG_ 3221225472 CommandedEngIntakeManifoldPress "Provides the commanded set point value for the engine intake manifold pressure.";
CM_ SG_ 3221225472 EngCrnkcsBrtherOilSeparatorSpeed "The speed of a rotating (centrifugal) crankcase oil separator.";
CM_ SG_ 3221225472 EngExhstGsRcirculation1Valve2Pos "The position of the second exhaust gas recirculation valve expressed as a percentage of full travel. Zero percent means";
CM_ SG_ 3221225472 EngExhstGsRecirculation1ValvePos "The position of the exhaust gas recirculation valve expressed as a percentage of full travel. Zero percent means the valve";
CM_ SG_ 3221225472 EngExhstGsRcrcltn1ClrIntkGsAbsPr "Exhaust Gas Recirculation gas absolute pressure is measured at the EGR cooler intake. See SPN 3358 for EGR";
CM_ SG_ 3221225472 EngExhstGsRcrcltn1ClerIntakeTemp "Exhaust Gas Recirculation (EGR) Temperature measured at the EGR cooler intake. See SPN 412 for Engine EGR";
CM_ SG_ 3221225472 EngExhstGsRcrcltn1ClerEfficiency "Exhaust Gas Recirculation cooler efficiency is an indication of the cooler’s ability to reduce the temperature of the exhaust";
CM_ SG_ 3221225472 EngExhstGsRcrculation1Valve2Ctrl "Desired percentage of maximum Exhaust Gas Recirculation (EGR) valve opening for valve 2. 0% means valve is closed.";
CM_ SG_ 3221225472 EngIntkVlvActtionOilPressForCyl4 "The gage pressure of the oil in the hydraulic accumulator that powers the engine intake valve for cylinder #4.";
CM_ SG_ 3221225472 EngIntkVlvActtionOilPressForCyl3 "The gage pressure of the oil in the hydraulic accumulator that powers the engine intake valve for cylinder #3.";
CM_ SG_ 3221225472 EngIntkVlvActtionOilPressForCyl2 "The gage pressure of the oil in the hydraulic accumulator that powers the engine intake valve for cylinder #2.";
CM_ SG_ 3221225472 EngIntkVlvActtionOilPressForCyl1 "The gage pressure of the oil in the hydraulic accumulator that powers the engine intake valve for cylinder #1.";
CM_ SG_ 3221225472 EngIntkVlvActtionOilPressForCyl8 "The gage pressure of the oil in the hydraulic accumulator that powers the engine intake valve for cylinder #8.";
CM_ SG_ 3221225472 EngIntkVlvActtionOilPressForCyl7 "The gage pressure of the oil in the hydraulic accumulator that powers the engine intake valve for cylinder #7.";
CM_ SG_ 3221225472 EngIntkVlvActtionOilPressForCyl6 "The gage pressure of the oil in the hydraulic accumulator that powers the engine intake valve for cylinder #6.";
CM_ SG_ 3221225472 EngIntkVlvActtionOilPressForCyl5 "The gage pressure of the oil in the hydraulic accumulator that powers the engine intake valve for cylinder #5.";
CM_ SG_ 3221225472 EngIntkVlvActtonOilPressForCyl12 "The gage pressure of the oil in the hydraulic accumulator that powers the engine intake valve for cylinder #12.";
CM_ SG_ 3221225472 EngIntkVlvActtonOilPressForCyl11 "The gage pressure of the oil in the hydraulic accumulator that powers the engine intake valve for cylinder #11.";
CM_ SG_ 3221225472 EngIntkVlvActtonOilPressForCyl10 "The gage pressure of the oil in the hydraulic accumulator that powers the engine intake valve for cylinder #10.";
CM_ SG_ 3221225472 EngIntkVlvActtionOilPressForCyl9 "The gage pressure of the oil in the hydraulic accumulator that powers the engine intake valve for cylinder #9.";
CM_ SG_ 3221225472 EngIntkVlvActtonOilPressForCyl16 "The gage pressure of the oil in the hydraulic accumulator that powers the engine intake valve for cylinder #16.";
CM_ SG_ 3221225472 EngIntkVlvActtonOilPressForCyl15 "The gage pressure of the oil in the hydraulic accumulator that powers the engine intake valve for cylinder #15.";
CM_ SG_ 3221225472 EngIntkVlvActtonOilPressForCyl14 "The gage pressure of the oil in the hydraulic accumulator that powers the engine intake valve for cylinder #14.";
CM_ SG_ 3221225472 EngIntkVlvActtonOilPressForCyl13 "The gage pressure of the oil in the hydraulic accumulator that powers the engine intake valve for cylinder #13.";
CM_ SG_ 3221225472 EngIntkVlvActtonOilPressForCyl20 "The gage pressure of the oil in the hydraulic accumulator that powers the engine intake valve for cylinder #20.";
CM_ SG_ 3221225472 EngIntkVlvActtonOilPressForCyl19 "The gage pressure of the oil in the hydraulic accumulator that powers the engine intake valve for cylinder #19.";
CM_ SG_ 3221225472 EngIntkVlvActtonOilPressForCyl18 "The gage pressure of the oil in the hydraulic accumulator that powers the engine intake valve for cylinder #18.";
CM_ SG_ 3221225472 EngIntkVlvActtonOilPressForCyl17 "The gage pressure of the oil in the hydraulic accumulator that powers the engine intake valve for cylinder #17.";
CM_ SG_ 3221225472 EGR1CoolerBypassActuatorPostion "The parameter gives the % open of the EGR Cooler Bypass Actuator, where 0% = Fully Closed (no gas flowing through";
CM_ SG_ 3221225472 EngSparkPlug4 "The measured voltage of the spark event on Cylinder #4";
CM_ SG_ 3221225472 EngSparkPlug3 "The measured voltage of the spark event on Cylinder #3";
CM_ SG_ 3221225472 EngSparkPlug2 "The measured voltage of the spark event on Cylinder #2";
CM_ SG_ 3221225472 EngSparkPlug1 "The measured voltage of the spark event on Cylinder #1";
CM_ SG_ 3221225472 EngSparkPlug8 "The measured voltage of the spark event on Cylinder #8";
CM_ SG_ 3221225472 EngSparkPlug7 "The measured voltage of the spark event on Cylinder #7";
CM_ SG_ 3221225472 EngSparkPlug6 "The measured voltage of the spark event on Cylinder #6";
CM_ SG_ 3221225472 EngSparkPlug5 "The measured voltage of the spark event on Cylinder #5";
CM_ SG_ 3221225472 EngSparkPlug12 "The measured voltage of the spark event on Cylinder #12";
CM_ SG_ 3221225472 EngSparkPlug11 "The measured voltage of the spark event on Cylinder #11";
CM_ SG_ 3221225472 EngSparkPlug10 "The measured voltage of the spark event on Cylinder #10";
CM_ SG_ 3221225472 EngSparkPlug9 "The measured voltage of the spark event on Cylinder #9";
CM_ SG_ 3221225472 EngSparkPlug16 "The measured voltage of the spark event on Cylinder #16";
CM_ SG_ 3221225472 EngSparkPlug15 "The measured voltage of the spark event on Cylinder #15";
CM_ SG_ 3221225472 EngSparkPlug14 "The measured voltage of the spark event on Cylinder #14";
CM_ SG_ 3221225472 EngSparkPlug13 "The measured voltage of the spark event on Cylinder #13";
CM_ SG_ 3221225472 EngSparkPlug20 "The measured voltage of the spark event on Cylinder #20";
CM_ SG_ 3221225472 EngSparkPlug19 "The measured voltage of the spark event on Cylinder #19";
CM_ SG_ 3221225472 EngSparkPlug18 "The measured voltage of the spark event on Cylinder #18";
CM_ SG_ 3221225472 EngSparkPlug17 "The measured voltage of the spark event on Cylinder #17";
CM_ SG_ 3221225472 EngSparkPlug24 "The measured voltage of the spark event on Cylinder #24";
CM_ SG_ 3221225472 EngSparkPlug23 "The measured voltage of the spark event on Cylinder #23";
CM_ SG_ 3221225472 EngSparkPlug22 "The measured voltage of the spark event on Cylinder #22";
CM_ SG_ 3221225472 EngSparkPlug21 "The measured voltage of the spark event on Cylinder #21";
CM_ SG_ 3221225472 LaneDepartureWarningEnableCmd "Command to enable/disable Lane Departure Indication";
CM_ SG_ 3221225472 J2012DTCOccurrenceCount "Number of occurrences of the respective SAE J2012 DTC being conveyed.";
CM_ SG_ 3221225472 J2012DTCStatus "Indicates if the respective SAE J2012 DTC is active or previously active.";
CM_ SG_ 3221225472 J2012DTC "Five character ASCII SAE J2012 DTC, sent most significant byte first.";
CM_ SG_ 3221225472 NumberOfJ2012DTCs "The number J2012 DTCs being conveyed in PGN 64906. If the value of this parameter is zero, the device broadcasting";
CM_ SG_ 3221225472 MessageChecksum "The message checksum is used to verify the signal path from the demanding device to the steering controller. TheThe message checksum is used to verify the signal path from the transmitting device to the receiving device.";
CM_ SG_ 3221225472 MessageCounter "The message counter is to verify the signal path from the demanding device to the steering controller. The support of thisThe message counter is used to detect situations where the transmitting ECU malfunction repeats the same frame all the";
CM_ SG_ 3221225472 SteerAngleSensorCalibrated "This signal indicates the calibration status of the steering angle sensor.";
CM_ SG_ 3221225472 SteerAngleSensorActiveMode "This signal indicates the operational mode of the steering angle sensor.";
CM_ SG_ 3221225472 SteerWheelAngleRange "The signal indicates the range of the steering wheel angle the sensor element is capable to measure. The steering wheel";
CM_ SG_ 3221225472 SteerWheelAngleRangeCounterType "The signal indicates whether the steering wheel angle sensor is capable of absolute measuring of the number of steering";
CM_ SG_ 3221225472 SteerWheelAngleRangeCounter "The signal indicates the number of steering wheel angle range overflows if the operating range of steering wheel is";
CM_ SG_ 3221225472 SteerWheelAngle "The main operator`s steering wheel angle (on the steering column, not the actual wheel angle). The vehicle being steered";
CM_ SG_ 3221225472 Aftrtrtmnt1SCRCtlystCnvrsnEffcnc "The SCR catalyst conversion efficiency percentage. Calculated as 100 times the catalyst intake NOx minus the catalyst";
CM_ SG_ 3221225472 Aftrtrtmnt1SCRCmmnddCtlystRgntCn "This parameter transmits the amount of reagent that the emissions control system has requested to be used, averaged";
CM_ SG_ 3221225472 Aftrtrtmnt1SCRAvrgCtlystRgntCnsm "Measured use of reagent by a Selective Catalytic Reduction system for exhaust emission control, averaged over the";
CM_ SG_ 3221225472 Aftrtrtmnt1DslExhstFldTnkLwLvlIn "The distance traveled while diesel exhaust fluid is low/empty or driver warning/inducement strategy is active. Note:";
CM_ SG_ 3221225472 TransferCaseStatus "This parameter describes the feedback from the transfer case controller . Used by instrument clusters, tachographs,";
CM_ SG_ 3221225472 TransOilLifeRemaining "Signal which indicates the actual oil life remaining in percent. 100% means the transmission oil is brand new, and 0%";
CM_ SG_ 3221225472 TrnsTorqueConverterOilOutletTemp "Temperature of transmission torque converter outlet oil.";
CM_ SG_ 3221225472 TransOverheatIndicator "Signal from transmission indicating that its fluid temperature is above normal acceptable limits, and as a result,";
CM_ SG_ 3221225472 TransOilLevelSwitch "This switch indicates whether transmission oil level is full or empty.";
CM_ SG_ 3221225472 TransOilFilterRestrictionSwitch "This switch indicates whether the transmission oil filter is clogged.";
CM_ SG_ 3221225472 VehicleRoll "This parameter indicates the roll in degrees from level. Facing the direction of travel a tip to the left would be indicated by";
CM_ SG_ 3221225472 TotalEngCruiseTime "Total time that the engine has operated in the cruise hold state, excluding time in accelerator override, over the life of the";
CM_ SG_ 3221225472 TotalDriveAverageLoadFactor "Average engine load factor while engine speed is greater than zero, vehicle speed is greater than or equal to 2 km/h, and";
CM_ SG_ 3221225472 TripDriveAverageLoadFactor "Average engine load factor while engine speed is greater than zero, vehicle speed is greater than or equal to 2 km/h, and";
CM_ SG_ 3221225472 TripAverageEngSpeed "Average speed of the engine since the last trip reset.";
CM_ SG_ 3221225472 TripMaxEngSpeed "Maximum engine speed achieved since the last trip reset.";
CM_ SG_ 3221225472 LandLevelingSystemEnableStatus "Communicate the enable/disable status of the Land Leveling System.";
CM_ SG_ 3221225472 BladeCtrlModeRight "Indicate if the land leveling system's automatic control is active or inactive for the elevation sensor on the right side of the";
CM_ SG_ 3221225472 BladeCtrlModeLeft "Indicate if the land leveling system's automatic control is active or inactive for the elevation sensor on the left side of the";
CM_ SG_ 3221225472 BladeCtrlMode "Allows the user to select the type of blade control for the land leveling system.";
CM_ SG_ 3221225472 BladeDurationAndDirection "Used to indicate the duration and direction that the land leveling system blade moves.";
CM_ SG_ 3221225472 EngActualIgntTiming "The actual ignition timing at the current engine conditions. This parameter may or may not be equal to one of the desired";
CM_ SG_ 3221225472 EngDesiredIgntTiming3 "A programmable timing value specific to the engine’s application. Factors affecting this value include both fuel type and";
CM_ SG_ 3221225472 EngDesiredIgntTiming2 "A programmable timing value specific to the engine’s application. Factors affecting this value include both fuel type and";
CM_ SG_ 3221225472 EngDesiredIgntTiming1 "A programmable timing value specific to the engine’s application. Factors affecting this value include both fuel type and";
CM_ SG_ 3221225472 EngCyl20IgntTiming "The ignition timing of the cylinder.";
CM_ SG_ 3221225472 EngCyl19IgntTiming "The ignition timing of the cylinder.";
CM_ SG_ 3221225472 EngCyl18IgntTiming "The ignition timing of the cylinder.";
CM_ SG_ 3221225472 EngCyl17IgntTiming "The ignition timing of the cylinder.";
CM_ SG_ 3221225472 EngCyl16IgntTiming "The ignition timing of the cylinder.";
CM_ SG_ 3221225472 EngCyl15IgntTiming "The ignition timing of the cylinder.";
CM_ SG_ 3221225472 EngCyl14IgntTiming "The ignition timing of the cylinder.";
CM_ SG_ 3221225472 EngCyl13IgntTiming "The ignition timing of the cylinder.";
CM_ SG_ 3221225472 EngCyl12IgntTiming "The ignition timing of the cylinder.";
CM_ SG_ 3221225472 EngCyl11IgntTiming "The ignition timing of the cylinder.";
CM_ SG_ 3221225472 EngCyl10IgntTiming "The ignition timing of the cylinder.";
CM_ SG_ 3221225472 EngCyl9IgntTiming "The ignition timing of the cylinder.";
CM_ SG_ 3221225472 EngCyl8IgntTiming "The ignition timing of the cylinder.";
CM_ SG_ 3221225472 EngCyl7IgntTiming "The ignition timing of the cylinder.";
CM_ SG_ 3221225472 EngCyl6IgntTiming "The ignition timing of the cylinder.";
CM_ SG_ 3221225472 EngCyl5IgntTiming "The ignition timing of the cylinder.";
CM_ SG_ 3221225472 EngCyl4IgntTiming "The ignition timing of the cylinder.";
CM_ SG_ 3221225472 EngCyl3IgntTiming "The ignition timing of the cylinder.";
CM_ SG_ 3221225472 EngCyl2IgntTiming "The ignition timing of the cylinder.";
CM_ SG_ 3221225472 EngCyl1IgntTiming "The ignition timing of the cylinder.";
CM_ SG_ 3221225472 EngCyl20IgntTransSecondOutput "This parameter indicates the relative intensity of the secondary output voltage of the ignition transformer.";
CM_ SG_ 3221225472 EngCyl19IgntTransSecondOutput "This parameter indicates the relative intensity of the secondary output voltage of the ignition transformer.";
CM_ SG_ 3221225472 EngCyl18IgntTransSecondOutput "This parameter indicates the relative intensity of the secondary output voltage of the ignition transformer.";
CM_ SG_ 3221225472 EngCyl17IgntTransSecondOutput "This parameter indicates the relative intensity of the secondary output voltage of the ignition transformer.";
CM_ SG_ 3221225472 EngCyl16IgntTransSecondOutput "This parameter indicates the relative intensity of the secondary output voltage of the ignition transformer.";
CM_ SG_ 3221225472 EngCyl15IgntTransSecondOutput "This parameter indicates the relative intensity of the secondary output voltage of the ignition transformer.";
CM_ SG_ 3221225472 EngCyl14IgntTransSecondOutput "This parameter indicates the relative intensity of the secondary output voltage of the ignition transformer.";
CM_ SG_ 3221225472 EngCyl13IgntTransSecondOutput "This parameter indicates the relative intensity of the secondary output voltage of the ignition transformer.";
CM_ SG_ 3221225472 EngCyl12IgntTransSecondOutput "This parameter indicates the relative intensity of the secondary output voltage of the ignition transformer.";
CM_ SG_ 3221225472 EngCyl11IgntTransSecondOutput "This parameter indicates the relative intensity of the secondary output voltage of the ignition transformer.";
CM_ SG_ 3221225472 EngCyl10IgntTransSecondOutput "This parameter indicates the relative intensity of the secondary output voltage of the ignition transformer.";
CM_ SG_ 3221225472 EngCyl9IgntTransSecondOutput "This parameter indicates the relative intensity of the secondary output voltage of the ignition transformer.";
CM_ SG_ 3221225472 EngCyl8IgntTransSecondOutput "This parameter indicates the relative intensity of the secondary output voltage of the ignition transformer.";
CM_ SG_ 3221225472 EngCyl7IgntTransSecondOutput "This parameter indicates the relative intensity of the secondary output voltage of the ignition transformer.";
CM_ SG_ 3221225472 EngCyl6IgntTransSecondOutput "This parameter indicates the relative intensity of the secondary output voltage of the ignition transformer.";
CM_ SG_ 3221225472 EngCyl5IgntTransSecondOutput "This parameter indicates the relative intensity of the secondary output voltage of the ignition transformer.";
CM_ SG_ 3221225472 EngCyl4IgntTransSecondOutput "This parameter indicates the relative intensity of the secondary output voltage of the ignition transformer.";
CM_ SG_ 3221225472 EngCyl3IgntTransSecondOutput "This parameter indicates the relative intensity of the secondary output voltage of the ignition transformer.";
CM_ SG_ 3221225472 EngCyl2IgntTransSecondOutput "This parameter indicates the relative intensity of the secondary output voltage of the ignition transformer.";
CM_ SG_ 3221225472 EngCyl1IgntTransSecondOutput "This parameter indicates the relative intensity of the secondary output voltage of the ignition transformer.";
CM_ SG_ 3221225472 EngOprtrPrmryIntrmdtSpdSlctState "13 preprogrammed intermediate speed control settings are available for the controlling ECM to select. If no speed setting";
CM_ SG_ 3221225472 EngOprtrPrmryIntrmdteSpeedSelect "Allows the operator to select one of 13 preprogrammed Intermediate Speed Control settings. If no speed setting is";
CM_ SG_ 3221225472 EngTotalIdleHours "Accumulated time of operation of the engine while under idle conditions.";
CM_ SG_ 3221225472 EngTotalIdleFuelUsed "Accumulated amount of fuel used during vehicle operation while under idle conditions.";
CM_ SG_ 3221225472 EngIntakeManifold6Temp "Temperature of pre-combustion air found in intake manifold number 6 of engine air supply system.";
CM_ SG_ 3221225472 EngIntakeManifold5Temp "Temperature of pre-combustion air found in intake manifold number 5 of engine air supply system.";
CM_ SG_ 3221225472 EngIntakeManifold4Temp "Temperature of pre-combustion air found in intake manifold of engine air supply system.";
CM_ SG_ 3221225472 EngIntakeManifold3Temp "Temperature of pre-combustion air found in intake manifold of engine air supply system.";
CM_ SG_ 3221225472 EngIntakeManifold2Temp "Temperature of pre-combustion air found in intake manifold of engine air supply system.";
CM_ SG_ 3221225472 EngTurbo4BoostPress "Gage pressure of air measured downstream of the compressor discharge side of the turbocharger. See also SPN 102";
CM_ SG_ 3221225472 EngTurbo3BoostPress "Gage pressure of air measured downstream of the compressor discharge side of the turbocharger. See also SPN 102";
CM_ SG_ 3221225472 EngTurbo2BoostPress "Gage pressure of air measured downstream of the compressor discharge side of the turbocharger. See also SPN 102";
CM_ SG_ 3221225472 EngTurbo1BoostPress "Gage pressure of air measured downstream of the compressor discharge side of the turbocharger. See also SPN 102";
CM_ SG_ 3221225472 EngIntakeManifold2AbsPress "The absolute pressure measurement of the air intake manifold for bank 2 or the second air intake manifold. If there are";
CM_ SG_ 3221225472 EngIntakeManifold1AbsPress "The absolute pressure measurement of the air intake manifold. If there are multiple air pressure sensors in the intakeThe absolute pressure measurement of the air intake manifold. If there are multiple air pressure sensors in the intake";
CM_ SG_ 3221225472 EngIntakeManifold2Press "The gage pressure measurement of the air intake manifold for bank #2 or the second air intake manifold. If there are";
CM_ SG_ 3221225472 EngAirFilter4DiffPress "Change in engine air system pressure, measured across the fourth air filter, due to the filter and any accumulation of solid";
CM_ SG_ 3221225472 EngAirFilter3DiffPress "Change in engine air system pressure, measured across the third air filter, due to the filter and any accumulation of solid";
CM_ SG_ 3221225472 EngAirFilter2DiffPress "Change in engine air system pressure, measured across the second air filter, due to the filter and any accumulation of";
CM_ SG_ 3221225472 EngCoolantFilterDiffPress "Change in coolant pressure, measured across the filter, due to the filter and any accumulation of solid or semisolid matter";
CM_ SG_ 3221225472 EngExhaustGasTemp "Temperature of combustion byproducts leaving the engine. See SPNs 2433 and 2434 for engines with more than one";
CM_ SG_ 3221225472 EngAirFilter1DiffPress "Change in engine air system pressure, measured across the filter, due to the filter and any accumulation of solid foreign";
CM_ SG_ 3221225472 EngIntakeManifold1Temp "Temperature of pre-combustion air found in intake manifold of engine air supply system.";
CM_ SG_ 3221225472 EngIntakeManifold1Press "The gage pressure measurement of the air intake manifold. If there are multiple air pressure sensors in the intake stream,The gage pressure measurement of the air intake manifold. If there are multiple air pressure sensors in the intake stream,";
CM_ SG_ 3221225472 EngDslPrtculateFilterIntakePress "Exhaust back pressure as a result of particle accumulation on filter media placed in the exhaust stream. See SPN 3609";
CM_ SG_ 3221225472 EngAirIntakePress "Absolute air pressure at input port to intake manifold or air box.";
CM_ SG_ 3221225472 CabHeatingZone "Parameter indicating whether the cab zone is being heated.";
CM_ SG_ 3221225472 EngHeatingZone "Parameter indicating whether the engine zone is being heated.";
CM_ SG_ 3221225472 CabVentilation "Indicates whether the cab is being ventilated or not.";
CM_ SG_ 3221225472 AuxHeaterWaterPumpStatus "Parameter indicating whether the auxiliary heater water pump is running";
CM_ SG_ 3221225472 AuxHeaterMode "State of the auxiliary heater";
CM_ SG_ 3221225472 AuxHeaterOutputPowerPercent "Current auxiliary heater output power, relative to the auxiliary heater maximum output power.";
CM_ SG_ 3221225472 AuxHeaterInputAirTemp "Temperature of the input air in an auxiliary heater system.";
CM_ SG_ 3221225472 AuxHeaterOutputCoolantTemp "Temperature of the auxiliary heater output coolant (I.e. water in a water heater system.)";
CM_ SG_ 3221225472 FireApparatusPumpEngagement "The measured status of the pump used to provide water in fire fighting apparatus for distribution of water through water";
CM_ SG_ 3221225472 EngHydPressGovernorSwitch "Switch that sets the mode of hydraulic governor";
CM_ SG_ 3221225472 EngHydPressGovernorModeIndicator "Mode for governor operation is hydraulic pressure control.";
CM_ SG_ 3221225472 HydPress "Hydraulic pressure measured at the output of the hydraulic pump.";
CM_ SG_ 3221225472 EngTotalRevolutions "Accumulated number of revolutions of engine crankshaft during its operation.";
CM_ SG_ 3221225472 EngTotalHoursOfOperation "Accumulated time of operation of engine.";
CM_ SG_ 3221225472 HydBrakeFluidLevelSwitch "Signal which indicates whether the hydraulic fluid level in the reservoir(s) is sufficient.";
CM_ SG_ 3221225472 HydBrakeSystemAudibleWarningCmd "Signal which commands an audible warning by the hydraulic braking system.";
CM_ SG_ 3221225472 HydBrakePressSupplyStateCircuit2 "Signal which indicates whether the hydraulic brake pressure supply of circuit 2 is reliable; that is, able to support";
CM_ SG_ 3221225472 HydBrakePressSupplyStateCircuit1 "Signal which indicates whether the hydraulic brake pressure supply of circuit 1 is reliable; that is, able to support";
CM_ SG_ 3221225472 HydBrkePressWarningStateCircuit2 "Signal which indicates whether the hydraulic brake pressure of circuit 2 is below the warning level";
CM_ SG_ 3221225472 HydBrkePressWarningStateCircuit1 "Signal which indicates whether the hydraulic brake pressure of circuit 1 is below the warning level";
CM_ SG_ 3221225472 HydBrakePressCircuit2 "Gage hydraulic pressure in circuit 2 of the hydraulic brake system";
CM_ SG_ 3221225472 HydBrakePressCircuit1 "Gage hydraulic pressure in circuit 1 of the hydraulic brake system";
CM_ SG_ 3221225472 TripDriveFuelEconomy "Trip drive fuel economy is equal to the distance traveled by vehicle in the drive state (engine speed greater than zero,Trip drive fuel economy is equal to the distance traveled by vehicle in the drive state (engine speed greater than zero,";
CM_ SG_ 3221225472 TripCruiseFuelUsed "Total fuel consumed while the engine is in the cruise hold state since the last trip reset. If both cruise control and VSLTotal fuel consumed while the engine is in the cruise hold state since the last trip reset. If both cruise control and VSL";
CM_ SG_ 3221225472 TripVehicleIdleFuelUsed "Total fuel consumed while neither the PTO or remote PTO governors are active, the engine speed is greater than zero,Total fuel consumed while neither the PTO or remote PTO governor is in the hold state, the engine speed is greater than";
CM_ SG_ 3221225472 TripPTOGovernorNonmovingFuelUsed "Total fuel consumed while the PTO or remote PTO governors are in the hold state, the engine speed is greater than zero,Total fuel consumed while either the PTO or remote PTO governors are in the hold state, the engine speed is greater";
CM_ SG_ 3221225472 TripPTOGovernorMovingFuelUsed "Total fuel consumed while the PTO or remote PTO governors are in the hold state, the engine speed is greater than zero,Total fuel consumed while either the PTO or remote PTO governors are in the hold state, the engine speed is greater";
CM_ SG_ 3221225472 TripDriveFuelUsed "Total fuel consumed while the engine speed is greater than zero, vehicle speed is greater than or equal to 2 km/h, andTotal fuel consumed while the engine speed is greater than zero, vehicle speed is greater than or equal to 2 km/h, and";
CM_ SG_ 3221225472 EngFuelValve1OutletAbsPress "Absolute Pressure of gas on outlet side of the first or only fuel system control valve. See SPN 3469 for the second fuel";
CM_ SG_ 3221225472 EngAirToFuelDiffPress "The differential pressure between the gaseous fuel and the air intake manifold.";
CM_ SG_ 3221225472 EngFuelValveDiffPress "The differential pressure between the intake and the outlet of a gaseous fuel valve.";
CM_ SG_ 3221225472 EngFuelValve1IntakeAbsPress "The absolute pressure of gas on the intake side of the first system control valve. See SPN 3466 for Engine Fuel Valve 2.";
CM_ SG_ 3221225472 EngRequestedFuelValve2Pos "The requested position of a gaseous fuel valve 2 that is metering the fuel flow to the engine, as requested by the Engine";
CM_ SG_ 3221225472 EngRequestedFuelValve1Pos "The requested position of a gaseous fuel valve 1 that is metering the fuel flow to the engine.";
CM_ SG_ 3221225472 EngFuelValve2Pos "The position of a gaseous fuel valve that is metering the fuel flow to the engine. 0% indicates no fuel flow through valve";
CM_ SG_ 3221225472 EngFuelValve1Pos "The position of a gaseous fuel valve that is metering the fuel flow to the engine. 0% indicates no fuel flow through valve";
CM_ SG_ 3221225472 EngFuelFlowRate2 "The rate at which the fuel is flowing through a fuel valve.";
CM_ SG_ 3221225472 EngFuelFlowRate1 "The rate at which the fuel is flowing through a fuel valve.";
CM_ SG_ 3221225472 EngFuelSpecificGravity "This parameter conveys the specific gravity of the gaseous fuel being used by the engine. The specific gravity of the fuel";
CM_ SG_ 3221225472 TripAverageFuelRate "Average fuel rate, equal to trip fuel divided by trip time while the engine speed is above zero, since the last trip reset. ThisAverage fuel rate, equal to trip fuel divided by trip time while the engine speed is above zero, since the last trip reset. This";
CM_ SG_ 3221225472 TotalEngPTOGovernorFuelUsed "Total fuel used while the PTO or remote PTO governors are in the hold state and engine speed is above zero, over theTotal fuel used while the PTO or remote PTO governors are in the hold state and engine speed is above zero, over the";
CM_ SG_ 3221225472 SpecificHeatRatio "The specific heat ratio of the fuel.";
CM_ SG_ 3221225472 TotalFuelUsed "Total fuel consumed (trip drive fuel + trip PTO governor moving fuel + trip PTO governor non-moving fuel + trip idle fuel)";
CM_ SG_ 3221225472 TripFuel "Total fuel consumed (trip drive fuel + trip PTO governor moving fuel + trip PTO governor non-moving fuel + trip idle fuel)";
CM_ SG_ 3221225472 SensorSupplyVoltage6 "Sensor ECU supply voltage 6";
CM_ SG_ 3221225472 SensorSupplyVoltage5 "Sensor ECU supply voltage 5";
CM_ SG_ 3221225472 SensorSupplyVoltage8 "Sensor ECU supply voltage 8";
CM_ SG_ 3221225472 SensorSupplyVoltage7 "Sensor ECU supply voltage 7";
CM_ SG_ 3221225472 SensorSupplyVoltage4 "Sensor ECU supply voltage 4";
CM_ SG_ 3221225472 SensorSupplyVoltage3 "Sensor ECU supply voltage 3";
CM_ SG_ 3221225472 SensorSupplyVoltage2 "Sensor ECU supply voltage 2";
CM_ SG_ 3221225472 SensorSupplyVoltage1 "Sensor ECU supply voltage 1";
CM_ SG_ 3221225472 AtLeastOnePTOEngaged "Indicates that at least one PTO is engaged";
CM_ SG_ 3221225472 EnggmntSttsPTOEngAccessoryDrive2 "Engagement status of the PTO engine accessory drive 2";
CM_ SG_ 3221225472 EnggmntSttsPTOEngAccessoryDrive1 "Engagement status of the PTO engine accessory drive 1";
CM_ SG_ 3221225472 EngagementStatusPTOEngFlywheel "Engagement status of the PTO Engine Flywheel";
CM_ SG_ 3221225472 EnggmntStatusTransInputShaftPTO1 "Reports if this specific PTO drive is engaged. This parameter should be broadcast only by the controller(s) receiving";
CM_ SG_ 3221225472 EnggmntStatusTransInputShaftPTO2 "Reports if this specific PTO drive is engaged. This parameter should be broadcast only by the controller(s) receiving";
CM_ SG_ 3221225472 EnggmntStatusTransOutputShaftPTO "Reports if this specific PTO drive is engaged. This parameter should be broadcast only by the controller(s) receiving";
CM_ SG_ 3221225472 EnggmntSttsTrnsfrCsOtputShaftPTO "Reports if this specific PTO drive is engaged. This parameter should be broadcast only by the controller(s) receiving";
CM_ SG_ 3221225472 EnggmntCnsntPTOEngAccssoryDrive2 "Engagement Consent status for the PTO engine accessory drive 2";
CM_ SG_ 3221225472 EnggmntCnsntPTOEngAccssoryDrive1 "Engagement consent status for the PTO engine accessory drive 1";
CM_ SG_ 3221225472 EngagementConsentPTOEngFlywheel "Engagement Consent status for the PTO Engine Flywheel";
CM_ SG_ 3221225472 EnggmntCnsentTransInputShaftPTO1 "Status of the transmission controller’s consent to engage the first or sole PTO drive mounted on the transmission case.";
CM_ SG_ 3221225472 EnggmntCnsentTransInputShaftPTO2 "Status of the transmission controller’s consent to engage the second PTO drive mounted on the transmission case. The";
CM_ SG_ 3221225472 EnggmntCnsentTransOutputShaftPTO "Status of the transmission controller’s consent to engage the PTO drive connected to the transmission output shaft. The";
CM_ SG_ 3221225472 EnggmntCnsntTrnsfrCsOtptShaftPTO "Status of the transmission controller’s consent to engage the PTO drive connected to the transfer case output shaft. The";
CM_ SG_ 3221225472 EnbleSwitchPTOEngAccessoryDrive2 "Status of the PTO engine accessory drive 2 enable switch";
CM_ SG_ 3221225472 EnbleSwitchPTOEngAccessoryDrive1 "Status of the PTO engine accessory drive 1 enable switch";
CM_ SG_ 3221225472 EnableSwitchPTOEngFlywheel "Status of the PTO Engine Flywheel enable switch";
CM_ SG_ 3221225472 EnableSwitchTransInputShaftPTO1 "Status of the operator’s switch or other input which indicates the desire for engaging the first PTO drive mounted on the";
CM_ SG_ 3221225472 EnableSwitchTransInputShaftPTO2 "Status of the operator’s switch or other input which indicates the desire for engaging the second PTO drive mounted on";
CM_ SG_ 3221225472 EnableSwitchTransOutputShaftPTO "Status of the operator’s switch or other input which indicates the desire for engaging the PTO drive mounted on the";
CM_ SG_ 3221225472 EnblSwtchTrnsfrCseOutputShaftPTO "Status of the operator’s switch or other input which indicates the desire for engaging the PTO drive mounted on the output";
CM_ SG_ 3221225472 EngFuelValve2OutletAbsPress "Absolute pressure of gas on outlet side of the second fuel system control valve. See SPN 2980 for the first or only fuel";
CM_ SG_ 3221225472 EngFuelTemp2 "Temperature 2 of fuel (or gas). See SPN 174 for fuel temperature 1.";
CM_ SG_ 3221225472 EngGas2MassFlowRate "Gas mass flow rate delivered to an engine through its second fuel control system, using standard convention for";
CM_ SG_ 3221225472 EngFuelValve2IntakeAbsPress "Absolute pressure of gas on intake side of the second fuel system control valve, using standard convention for";
CM_ SG_ 3221225472 EngCentrifugalOilFilterSpeed "The speed of a rotating (centrifugal) engine oil filter.";
CM_ SG_ 3221225472 EngCoolantPumpDiffPress "The differential pressure measured across the input and output of the engine coolant pump.";
CM_ SG_ 3221225472 EngChargeAirCooler2IntakePress "Pressure of air at intake to 2nd charge air cooler, from multiple first stage turbochargers being cooled and feeding multiple";
CM_ SG_ 3221225472 EngChargeAirCooler1IntakePress "Pressure of air at intake to 1st or only charge air cooler, from multiple first stage turbochargers being cooled and feeding";
CM_ SG_ 3221225472 EngIntercoolerCoolantLevel "Ratio of volume of liquid found in an engine intercooler cooling system to total engine intercooler cooling system volume.";
CM_ SG_ 3221225472 EngChargeAirCoolerOutletPress "Measures pressure of air at outlet from charge air cooler";
CM_ SG_ 3221225472 EngAftercoolerCoolantLevel "Ratio of aftercooler coolant system volume of liquid to total cooling system volume. The engine aftercooler coolant level";
CM_ SG_ 3221225472 EngVriableGeometryTurboActuator1 "Actuator that controls the variable geometry turbocharger geometry.The control command to the actuator, normalized to";
CM_ SG_ 3221225472 EngTrbCmprssrBypssActtr1TmpSttus "Used to identify the status of the Engine Turbocharger Compresssor Bypass Actuator 1 drive circuitry temperature.";
CM_ SG_ 3221225472 EngTrbCmprssrBypssActtr1PrlmnryF "Used to identify the appplicable J1939-73 FMI detected in the Engine Turbocharger Compressor Bypass Actuator 1 by";
CM_ SG_ 3221225472 EngTrbCmprssorBypassActuator2Cmd "The command to a compressor bypass actuator 2, normalized to percent, where 0% nominally represents fully closed and";
CM_ SG_ 3221225472 EngTrbCmprssorBypassActuator1Pos "Measures the position of the turbocharger compressor bypass actuator, where 0% represents bypass fully closed and";
CM_ SG_ 3221225472 EngTrbCmprssorBypassActuator1Cmd "The command to a compressor bypass actuator, normalized to percent, where 0% nominally represents fully closed and";
CM_ SG_ 3221225472 EngDsrdTrbCmprssrBypssActtor1Pos "The requested position of the Engine Turbocharger Compressor Bypass actuator by the engine ECM, where 0%";
CM_ SG_ 3221225472 EnableStatusOfDoor10 "Enable status of bus door 10. Enabled means the bus doors are able to be automatically opened or closed.";
CM_ SG_ 3221225472 OpenStatusOfDoor10 "Open status of bus door 10";
CM_ SG_ 3221225472 LockStatusOfDoor10 "Lock status of bus door 10";
CM_ SG_ 3221225472 EnableStatusOfDoor9 "Enable status of bus door 9. Enabled means the bus doors are able to be automatically opened or closed.";
CM_ SG_ 3221225472 OpenStatusOfDoor9 "Open status of bus door 9";
CM_ SG_ 3221225472 LockStatusOfDoor9 "Lock status of bus door 9";
CM_ SG_ 3221225472 EnableStatusOfDoor8 "Enable status of bus door 8. Enabled means the bus doors are able to be automatically opened or closed.";
CM_ SG_ 3221225472 OpenStatusOfDoor8 "Open status of bus door 8";
CM_ SG_ 3221225472 LockStatusOfDoor8 "Lock status of bus door 8";
CM_ SG_ 3221225472 EnableStatusOfDoor7 "Enable status of bus door 7. Enabled means the bus doors are able to be automatically opened or closed.";
CM_ SG_ 3221225472 OpenStatusOfDoor7 "Open status of bus door 7";
CM_ SG_ 3221225472 LockStatusOfDoor7 "Lock status of bus door 7";
CM_ SG_ 3221225472 EnableStatusOfDoor6 "Enable status of bus door 6. Enabled means the bus doors are able to be automatically opened or closed.";
CM_ SG_ 3221225472 OpenStatusOfDoor6 "Open status of bus door 6";
CM_ SG_ 3221225472 LockStatusOfDoor6 "Lock status of bus door 6";
CM_ SG_ 3221225472 EnableStatusOfDoor5 "Enable status of bus door 5. Enabled means the bus doors are able to be automatically opened or closed.";
CM_ SG_ 3221225472 OpenStatusOfDoor5 "Open status of bus door 5";
CM_ SG_ 3221225472 LockStatusOfDoor5 "Lock status of bus door 5";
CM_ SG_ 3221225472 EnableStatusOfDoor4 "Enable status of bus door 4. Enabled means the bus doors are able to be automatically opened or closed.";
CM_ SG_ 3221225472 OpenStatusOfDoor4 "Open status of bus door 4";
CM_ SG_ 3221225472 LockStatusOfDoor4 "Lock status of bus door 4";
CM_ SG_ 3221225472 EnableStatusOfDoor3 "Enable status of bus door 3. Enabled means the bus doors are able to be automatically opened or closed.";
CM_ SG_ 3221225472 OpenStatusOfDoor3 "Open status of bus door 3";
CM_ SG_ 3221225472 LockStatusOfDoor3 "Lock status of bus door 3";
CM_ SG_ 3221225472 EnableStatusOfDoor2 "Enable status of bus door 2. Enabled means the bus doors are able to be automatically opened or closed.";
CM_ SG_ 3221225472 OpenStatusOfDoor2 "Open status of bus door 2";
CM_ SG_ 3221225472 LockStatusOfDoor2 "Lock status of bus door 2";
CM_ SG_ 3221225472 EnableStatusOfDoor1 "Enable status of bus door 1. Enabled means the bus doors are able to be automatically opened or closed.";
CM_ SG_ 3221225472 OpenStatusOfDoor1 "Open status of bus door 1";
CM_ SG_ 3221225472 LockStatusOfDoor1 "Lock status of bus door 1";
CM_ SG_ 3221225472 Aftrtrtmnt1SCRCtlystRgntTmp2Prlm "Used to identify the applicable J1939-73 FMI that applies to the most significant failure of the catalyst temperature sensor.";
CM_ SG_ 3221225472 Aftrtrtmnt1SCRCtlystRgntPrprtsPr "Used to identify the applicable J1939-73 FMI that applies to the most significant failure of the catalyst reagent properties";
CM_ SG_ 3221225472 Aftrtrtmnt1SCRCtlystRgntCndctvty "A measure of the conductivity of the reagent or fluid at the sensor. The conductivity is an indication of the reagent's";
CM_ SG_ 3221225472 Aftrtrtmnt1SCRCtlystRgntCncntrtn "A measure of the concentration of urea in water. Zero percent means that the tank contains no urea. A 32.5% value";
CM_ SG_ 3221225472 Aftrtrtmnt1SCRCtalystReagentType "This parameter indicates what reagent is in the tank. A value of 0011 indicates uncontaminated Diesel Exhaust Fluid.";
CM_ SG_ 3221225472 Aftrtrtmnt1SCRCtlystReagentTemp2 "Temperature of the catalyst reagent at the device measuring reagent quality";
CM_ SG_ 3221225472 RqdGnrtrAvrgLneLineACRMSVoltage "The requested average AC RMS voltage to be delivered by the generator.";
BA_DEF_ SG_  "SigType" ENUM  "Default","Range","RangeSigned","ASCII","Discrete","Control","ReferencePGN","DTC","StringDelimiter","StringLength","StringLengthControl";
BA_DEF_ SG_  "GenSigStartValue" INT 0 10000;
BA_DEF_ SG_  "GenSigSendType" ENUM  "Cyclic","OnWrite","reserved","OnChange","reserved","reserved","reserved","NoSigSendType";
BA_DEF_ SG_  "GenSigILSupport" ENUM  "Yes","No";
BA_DEF_ SG_  "GenSigEVName" STRING ;
BA_DEF_ SG_  "SPN" INT 0 524287;
BA_DEF_ SG_  "SAEDocument" STRING ;
BA_DEF_ BO_  "GenMsgILSupport" ENUM  "Yes","No";
BA_DEF_ BO_  "GenMsgRequestable" INT 0 1;
BA_DEF_ BO_  "GenMsgSendType" ENUM  "cyclic","reserved","cyclicIfActive","reserved","reserved","reserved","reserved","reserved","noMsgSendType";
BA_DEF_ BO_  "VFrameFormat" ENUM  "StandardCAN","ExtendedCAN","reserved","J1939PG";
BA_DEF_ BO_  "SingleFrame" INT 0 1;
BA_DEF_ BO_  "GenMsgCycleTime" INT 0 3600000;
BA_DEF_ BO_  "SAE_Document" STRING ;
BA_DEF_ SG_  "SystemSignalLongSymbol" STRING ;
BA_DEF_DEF_  "SigType" "Default";
BA_DEF_DEF_  "GenSigStartValue" 0;
BA_DEF_DEF_  "GenSigSendType" "NoSigSendType";
BA_DEF_DEF_  "GenSigILSupport" "Yes";
BA_DEF_DEF_  "GenSigEVName" "Env@Nodename_@Signame";
BA_DEF_DEF_  "SPN" 0;
BA_DEF_DEF_  "SAEDocument" "";
BA_DEF_DEF_  "GenMsgILSupport" "Yes";
BA_DEF_DEF_  "GenMsgRequestable" 1;
BA_DEF_DEF_  "GenMsgSendType" "noMsgSendType";
BA_DEF_DEF_  "VFrameFormat" "J1939PG";
BA_DEF_DEF_  "SingleFrame" 1;
BA_DEF_DEF_  "GenMsgCycleTime" 0;
BA_DEF_DEF_  "SAE_Document" "";
BA_DEF_DEF_  "SystemSignalLongSymbol" "";
BA_ "SAEDocument" SG_ 3221225472 Jystck10GrpXAxsLvrRghtPstvPsStts "J1939-71";
BA_ "SPN" SG_ 3221225472 Jystck10GrpXAxsLvrRghtPstvPsStts 4737;
BA_ "SigType" SG_ 3221225472 Jystck10GrpXAxsLvrRghtPstvPsStts 4;
BA_ "SAEDocument" SG_ 3221225472 Jystck10GrpXAxsLvrLftNgtvPsSttus "J1939-71";
BA_ "SPN" SG_ 3221225472 Jystck10GrpXAxsLvrLftNgtvPsSttus 4736;
BA_ "SigType" SG_ 3221225472 Jystck10GrpXAxsLvrLftNgtvPsSttus 4;
BA_ "SAEDocument" SG_ 3221225472 Jystck10GrpXAxisNeutralPosStatus "J1939-71";
BA_ "SPN" SG_ 3221225472 Jystck10GrpXAxisNeutralPosStatus 4735;
BA_ "SigType" SG_ 3221225472 Jystck10GrpXAxisNeutralPosStatus 4;
BA_ "SAEDocument" SG_ 3221225472 EngFuelFilterIntakeAbsPress "J1939-71";
BA_ "SPN" SG_ 3221225472 EngFuelFilterIntakeAbsPress 5417;
BA_ "SigType" SG_ 3221225472 EngFuelFilterIntakeAbsPress 1;
BA_ "SAEDocument" SG_ 3221225472 EngExhstGsRcrcltn1OutletAbsPress "J1939-71";
BA_ "SPN" SG_ 3221225472 EngExhstGsRcrcltn1OutletAbsPress 5431;
BA_ "SigType" SG_ 3221225472 EngExhstGsRcrcltn1OutletAbsPress 1;
BA_ "SAEDocument" SG_ 3221225472 EngExhstGsRcrcltn1IntakeAbsPress "J1939-71";
BA_ "SPN" SG_ 3221225472 EngExhstGsRcrcltn1IntakeAbsPress 5430;
BA_ "SigType" SG_ 3221225472 EngExhstGsRcrcltn1IntakeAbsPress 1;
BA_ "SAEDocument" SG_ 3221225472 EngExhstGsRcrcltn2IntakeAbsPress "J1939-71";
BA_ "SPN" SG_ 3221225472 EngExhstGsRcrcltn2IntakeAbsPress 5429;
BA_ "SigType" SG_ 3221225472 EngExhstGsRcrcltn2IntakeAbsPress 1;
BA_ "SAEDocument" SG_ 3221225472 EngExhstGsRcrcltn2OutletAbsPress "J1939-71";
BA_ "SPN" SG_ 3221225472 EngExhstGsRcrcltn2OutletAbsPress 5254;
BA_ "SigType" SG_ 3221225472 EngExhstGsRcrcltn2OutletAbsPress 1;
BA_ "SAEDocument" SG_ 3221225472 EngExhstGsRcrclation2IntakePress "J1939-71";
BA_ "SPN" SG_ 3221225472 EngExhstGsRcrclation2IntakePress 5253;
BA_ "SigType" SG_ 3221225472 EngExhstGsRcrclation2IntakePress 1;
BA_ "SAEDocument" SG_ 3221225472 EngExhstGsRcirculation2DiffPress "J1939-71";
BA_ "SPN" SG_ 3221225472 EngExhstGsRcirculation2DiffPress 5252;
BA_ "SigType" SG_ 3221225472 EngExhstGsRcirculation2DiffPress 1;
BA_ "SAEDocument" SG_ 3221225472 CmmndedEngFuelInjectionCtrlPress "J1939-71";
BA_ "SPN" SG_ 3221225472 CmmndedEngFuelInjectionCtrlPress 5314;
BA_ "SigType" SG_ 3221225472 CmmndedEngFuelInjectionCtrlPress 1;
BA_ "SAEDocument" SG_ 3221225472 CommandedEngFuelRailPress "J1939-71";
BA_ "SPN" SG_ 3221225472 CommandedEngFuelRailPress 5313;
BA_ "SigType" SG_ 3221225472 CommandedEngFuelRailPress 1;
BA_ "SAEDocument" SG_ 3221225472 EngExhstGsRcirculation2Valve2Pos "J1939-71";
BA_ "SPN" SG_ 3221225472 EngExhstGsRcirculation2Valve2Pos 5263;
BA_ "SigType" SG_ 3221225472 EngExhstGsRcirculation2Valve2Pos 1;
BA_ "SAEDocument" SG_ 3221225472 EngExhstGsRecirculation2ValvePos "J1939-71";
BA_ "SPN" SG_ 3221225472 EngExhstGsRecirculation2ValvePos 5262;
BA_ "SigType" SG_ 3221225472 EngExhstGsRecirculation2ValvePos 1;
BA_ "SAEDocument" SG_ 3221225472 EngExhstGsRcrculation2Valve2Ctrl "J1939-71";
BA_ "SPN" SG_ 3221225472 EngExhstGsRcrculation2Valve2Ctrl 5265;
BA_ "SigType" SG_ 3221225472 EngExhstGsRcrculation2Valve2Ctrl 1;
BA_ "SAEDocument" SG_ 3221225472 EngExhstGsRcirculation2ValveCtrl "J1939-71";
BA_ "SPN" SG_ 3221225472 EngExhstGsRcirculation2ValveCtrl 5264;
BA_ "SigType" SG_ 3221225472 EngExhstGsRcirculation2ValveCtrl 1;
BA_ "SAEDocument" SG_ 3221225472 EGR2CoolerBypassActuatorPos "J1939-71";
BA_ "SPN" SG_ 3221225472 EGR2CoolerBypassActuatorPos 5261;
BA_ "SigType" SG_ 3221225472 EGR2CoolerBypassActuatorPos 1;
BA_ "SAEDocument" SG_ 3221225472 EngExhstGsRcrcltn2ClerEfficiency "J1939-71";
BA_ "SPN" SG_ 3221225472 EngExhstGsRcrcltn2ClerEfficiency 5260;
BA_ "SigType" SG_ 3221225472 EngExhstGsRcrcltn2ClerEfficiency 1;
BA_ "SAEDocument" SG_ 3221225472 EngExhstGsRcrcltn2ClrIntkGsAbsPr "J1939-71";
BA_ "SPN" SG_ 3221225472 EngExhstGsRcrcltn2ClrIntkGsAbsPr 5259;
BA_ "SigType" SG_ 3221225472 EngExhstGsRcrcltn2ClrIntkGsAbsPr 1;
BA_ "SAEDocument" SG_ 3221225472 EngExhstGsRcrcltn2ClerIntakeTemp "J1939-71";
BA_ "SPN" SG_ 3221225472 EngExhstGsRcrcltn2ClerIntakeTemp 5258;
BA_ "SigType" SG_ 3221225472 EngExhstGsRcrcltn2ClerIntakeTemp 1;
BA_ "SAEDocument" SG_ 3221225472 EngFrctnPrcentTorqueAtIdlePoint7 "J1939-71";
BA_ "SPN" SG_ 3221225472 EngFrctnPrcentTorqueAtIdlePoint7 5477;
BA_ "SigType" SG_ 3221225472 EngFrctnPrcentTorqueAtIdlePoint7 1;
BA_ "SAEDocument" SG_ 3221225472 EngFrctnPrcentTorqueAtIdlePoint6 "J1939-71";
BA_ "SPN" SG_ 3221225472 EngFrctnPrcentTorqueAtIdlePoint6 5476;
BA_ "SigType" SG_ 3221225472 EngFrctnPrcentTorqueAtIdlePoint6 1;
BA_ "SAEDocument" SG_ 3221225472 EngFrctnPrcentTorqueAtIdlePoint5 "J1939-71";
BA_ "SPN" SG_ 3221225472 EngFrctnPrcentTorqueAtIdlePoint5 5475;
BA_ "SigType" SG_ 3221225472 EngFrctnPrcentTorqueAtIdlePoint5 1;
BA_ "SAEDocument" SG_ 3221225472 EngFrctnPrcentTorqueAtIdlePoint4 "J1939-71";
BA_ "SPN" SG_ 3221225472 EngFrctnPrcentTorqueAtIdlePoint4 5474;
BA_ "SigType" SG_ 3221225472 EngFrctnPrcentTorqueAtIdlePoint4 1;
BA_ "SAEDocument" SG_ 3221225472 EngFrctnPrcentTorqueAtIdlePoint3 "J1939-71";
BA_ "SPN" SG_ 3221225472 EngFrctnPrcentTorqueAtIdlePoint3 5473;
BA_ "SigType" SG_ 3221225472 EngFrctnPrcentTorqueAtIdlePoint3 1;
BA_ "SAEDocument" SG_ 3221225472 EngFrctnPrcentTorqueAtIdlePoint2 "J1939-71";
BA_ "SPN" SG_ 3221225472 EngFrctnPrcentTorqueAtIdlePoint2 5472;
BA_ "SigType" SG_ 3221225472 EngFrctnPrcentTorqueAtIdlePoint2 1;
BA_ "SAEDocument" SG_ 3221225472 EngFrctnPrcentTorqueAtIdlePoint1 "J1939-71";
BA_ "SPN" SG_ 3221225472 EngFrctnPrcentTorqueAtIdlePoint1 5471;
BA_ "SigType" SG_ 3221225472 EngFrctnPrcentTorqueAtIdlePoint1 1;
BA_ "SAEDocument" SG_ 3221225472 DslPrtcltFltrActvRgnrtnFrcdSttus "J1939-71";
BA_ "SPN" SG_ 3221225472 DslPrtcltFltrActvRgnrtnFrcdSttus 4175;
BA_ "SAEDocument" SG_ 3221225472 ExhaustSystemHighTempLampCmd "J1939-71";
BA_ "SPN" SG_ 3221225472 ExhaustSystemHighTempLampCmd 3698;
BA_ "SAEDocument" SG_ 3221225472 DslPrtcltFltrAtmtcActvRgnrtnIntt "J1939-71";
BA_ "SPN" SG_ 3221225472 DslPrtcltFltrAtmtcActvRgnrtnIntt 3718;
BA_ "SigType" SG_ 3221225472 DslPrtcltFltrAtmtcActvRgnrtnIntt 5;
BA_ "SAEDocument" SG_ 3221225472 DslPrtcltFltrActvRgnrtnInhbtdDTV "J1939-71";
BA_ "SPN" SG_ 3221225472 DslPrtcltFltrActvRgnrtnInhbtdDTV 3717;
BA_ "SigType" SG_ 3221225472 DslPrtcltFltrActvRgnrtnInhbtdDTV 4;
BA_ "SystemSignalLongSymbol" SG_ 3221225472 DslPrtcltFltrActvRgnrtnInhbtdDTV "DslPrtcltFltrActvRgnrtnInhbtdDTVhclSpdBlwAllwd";
BA_ "SAEDocument" SG_ 3221225472 DslPrtcltFltrActvRgnrtnInhbtdDTE "J1939-71";
BA_ "SPN" SG_ 3221225472 DslPrtcltFltrActvRgnrtnInhbtdDTE 3716;
BA_ "SigType" SG_ 3221225472 DslPrtcltFltrActvRgnrtnInhbtdDTE 4;
BA_ "SystemSignalLongSymbol" SG_ 3221225472 DslPrtcltFltrActvRgnrtnInhbtdDTE "DslPrtcltFltrActvRgnrtnInhbtdDTEngNtWrmdUp";
BA_ "SAEDocument" SG_ 3221225472 DslPrtcltFltrActvRgnrtnInhb_0000 "J1939-71";
BA_ "SPN" SG_ 3221225472 DslPrtcltFltrActvRgnrtnInhb_0000 3715;
BA_ "SigType" SG_ 3221225472 DslPrtcltFltrActvRgnrtnInhb_0000 4;
BA_ "SystemSignalLongSymbol" SG_ 3221225472 DslPrtcltFltrActvRgnrtnInhb_0000 "DslPrtcltFltrActvRgnrtnInhbtdDTPrmnntSystmLckt";
BA_ "SAEDocument" SG_ 3221225472 DslPrtcltFltrActvRgnrtnInhbtdDTT "J1939-71";
BA_ "SPN" SG_ 3221225472 DslPrtcltFltrActvRgnrtnInhbtdDTT 3714;
BA_ "SigType" SG_ 3221225472 DslPrtcltFltrActvRgnrtnInhbtdDTT 5;
BA_ "SAEDocument" SG_ 3221225472 DslPrtcltFltrActvRgnrtnInhbtdDTS "J1939-71";
BA_ "SPN" SG_ 3221225472 DslPrtcltFltrActvRgnrtnInhbtdDTS 3705;
BA_ "SigType" SG_ 3221225472 DslPrtcltFltrActvRgnrtnInhbtdDTS 5;
BA_ "SAEDocument" SG_ 3221225472 DslPrtcltFltrActvRgnrtnInhbtdDTL "J1939-71";
BA_ "SPN" SG_ 3221225472 DslPrtcltFltrActvRgnrtnInhbtdDTL 3711;
BA_ "SigType" SG_ 3221225472 DslPrtcltFltrActvRgnrtnInhbtdDTL 4;
BA_ "SAEDocument" SG_ 3221225472 DslPrtcltFltrActvRgnrtnInhb_0001 "J1939-71";
BA_ "SPN" SG_ 3221225472 DslPrtcltFltrActvRgnrtnInhb_0001 3710;
BA_ "SigType" SG_ 3221225472 DslPrtcltFltrActvRgnrtnInhb_0001 4;
BA_ "SystemSignalLongSymbol" SG_ 3221225472 DslPrtcltFltrActvRgnrtnInhb_0001 "DslPrtcltFltrActvRgnrtnInhbtdDTPrkngBrkNtSt";
BA_ "SAEDocument" SG_ 3221225472 DslPrtcltFltrActvRgnrtnInhb_0002 "J1939-71";
BA_ "SPN" SG_ 3221225472 DslPrtcltFltrActvRgnrtnInhb_0002 3709;
BA_ "SigType" SG_ 3221225472 DslPrtcltFltrActvRgnrtnInhb_0002 4;
BA_ "SystemSignalLongSymbol" SG_ 3221225472 DslPrtcltFltrActvRgnrtnInhb_0002 "DslPrtcltFltrActvRgnrtnInhbtdDTVhclSpdAbvAllwd";
BA_ "SAEDocument" SG_ 3221225472 DslPrtcltFltrActvRgnrtnInhbtdDTO "J1939-71";
BA_ "SPN" SG_ 3221225472 DslPrtcltFltrActvRgnrtnInhbtdDTO 3708;
BA_ "SigType" SG_ 3221225472 DslPrtcltFltrActvRgnrtnInhbtdDTO 4;
BA_ "SystemSignalLongSymbol" SG_ 3221225472 DslPrtcltFltrActvRgnrtnInhbtdDTO "DslPrtcltFltrActvRgnrtnInhbtdDTOtOfNtrl";
BA_ "SAEDocument" SG_ 3221225472 DslPrtcltFltrActvRgnrtnInhbtdDTA "J1939-71";
BA_ "SPN" SG_ 3221225472 DslPrtcltFltrActvRgnrtnInhbtdDTA 3707;
BA_ "SigType" SG_ 3221225472 DslPrtcltFltrActvRgnrtnInhbtdDTA 5;
BA_ "SAEDocument" SG_ 3221225472 DslPrtcltFltrActvRgnrtnInhbtdDTP "J1939-71";
BA_ "SPN" SG_ 3221225472 DslPrtcltFltrActvRgnrtnInhbtdDTP 3706;
BA_ "SigType" SG_ 3221225472 DslPrtcltFltrActvRgnrtnInhbtdDTP 5;
BA_ "SAEDocument" SG_ 3221225472 DslPrtcltFltrActvRgnrtnInhbtdDTC "J1939-71";
BA_ "SPN" SG_ 3221225472 DslPrtcltFltrActvRgnrtnInhbtdDTC 3704;
BA_ "SigType" SG_ 3221225472 DslPrtcltFltrActvRgnrtnInhbtdDTC 5;
BA_ "SAEDocument" SG_ 3221225472 DslPrtcltFltrActvRgnrtnInhbtdDTI "J1939-71";
BA_ "SPN" SG_ 3221225472 DslPrtcltFltrActvRgnrtnInhbtdDTI 3703;
BA_ "SigType" SG_ 3221225472 DslPrtcltFltrActvRgnrtnInhbtdDTI 5;
BA_ "SAEDocument" SG_ 3221225472 DslPrtcltFltrActvRgnrtnInhbtdStt "J1939-71";
BA_ "SPN" SG_ 3221225472 DslPrtcltFltrActvRgnrtnInhbtdStt 3702;
BA_ "SigType" SG_ 3221225472 DslPrtcltFltrActvRgnrtnInhbtdStt 5;
BA_ "SAEDocument" SG_ 3221225472 DieselParticulateFilterStatus "J1939-71";
BA_ "SPN" SG_ 3221225472 DieselParticulateFilterStatus 3701;
BA_ "SAEDocument" SG_ 3221225472 DslPrtcltFltrActvRgnrationStatus "J1939-71";
BA_ "SPN" SG_ 3221225472 DslPrtcltFltrActvRgnrationStatus 3700;
BA_ "SigType" SG_ 3221225472 DslPrtcltFltrActvRgnrationStatus 5;
BA_ "SAEDocument" SG_ 3221225472 DslPrtcltFltrPssvRgnrationStatus "J1939-71";
BA_ "SPN" SG_ 3221225472 DslPrtcltFltrPssvRgnrationStatus 3699;
BA_ "SigType" SG_ 3221225472 DslPrtcltFltrPssvRgnrationStatus 5;
BA_ "SAEDocument" SG_ 3221225472 DieselParticulateFilterLampCmd "J1939-71";
BA_ "SPN" SG_ 3221225472 DieselParticulateFilterLampCmd 3697;
BA_ "SAEDocument" SG_ 3221225472 DslPrtculateFilter2SootSignalMin "J1939-71";
BA_ "SPN" SG_ 3221225472 DslPrtculateFilter2SootSignalMin 5271;
BA_ "SigType" SG_ 3221225472 DslPrtculateFilter2SootSignalMin 1;
BA_ "SAEDocument" SG_ 3221225472 DslPrtculateFilter2SootSignalMax "J1939-71";
BA_ "SPN" SG_ 3221225472 DslPrtculateFilter2SootSignalMax 5270;
BA_ "SigType" SG_ 3221225472 DslPrtculateFilter2SootSignalMax 1;
BA_ "SAEDocument" SG_ 3221225472 DslPrtcltFltr2StSgnlStndrdDvtion "J1939-71";
BA_ "SPN" SG_ 3221225472 DslPrtcltFltr2StSgnlStndrdDvtion 5269;
BA_ "SigType" SG_ 3221225472 DslPrtcltFltr2StSgnlStndrdDvtion 1;
BA_ "SAEDocument" SG_ 3221225472 DslPrtcltFltr2StSnsrPrlminaryFMI "J1939-71";
BA_ "SPN" SG_ 3221225472 DslPrtcltFltr2StSnsrPrlminaryFMI 4790;
BA_ "SAEDocument" SG_ 3221225472 DslPrtcltFilter2MedianSootSignal "J1939-71";
BA_ "SPN" SG_ 3221225472 DslPrtcltFilter2MedianSootSignal 4789;
BA_ "SigType" SG_ 3221225472 DslPrtcltFilter2MedianSootSignal 1;
BA_ "SAEDocument" SG_ 3221225472 DslPrtclateFilter2MeanSootSignal "J1939-71";
BA_ "SPN" SG_ 3221225472 DslPrtclateFilter2MeanSootSignal 4788;
BA_ "SigType" SG_ 3221225472 DslPrtclateFilter2MeanSootSignal 1;
BA_ "SAEDocument" SG_ 3221225472 DslParticulateFilter2SootDensity "J1939-71";
BA_ "SPN" SG_ 3221225472 DslParticulateFilter2SootDensity 4787;
BA_ "SigType" SG_ 3221225472 DslParticulateFilter2SootDensity 1;
BA_ "SAEDocument" SG_ 3221225472 DieselParticulateFilter2SootMass "J1939-71";
BA_ "SPN" SG_ 3221225472 DieselParticulateFilter2SootMass 4786;
BA_ "SigType" SG_ 3221225472 DieselParticulateFilter2SootMass 1;
BA_ "SAEDocument" SG_ 3221225472 DslPrtculateFilter1SootSignalMin "J1939-71";
BA_ "SPN" SG_ 3221225472 DslPrtculateFilter1SootSignalMin 5268;
BA_ "SigType" SG_ 3221225472 DslPrtculateFilter1SootSignalMin 1;
BA_ "SAEDocument" SG_ 3221225472 DslPrtculateFilter1SootSignalMax "J1939-71";
BA_ "SPN" SG_ 3221225472 DslPrtculateFilter1SootSignalMax 5267;
BA_ "SigType" SG_ 3221225472 DslPrtculateFilter1SootSignalMax 1;
BA_ "SAEDocument" SG_ 3221225472 DslPrtcltFltr1StSgnlStndrdDvtion "J1939-71";
BA_ "SPN" SG_ 3221225472 DslPrtcltFltr1StSgnlStndrdDvtion 5266;
BA_ "SigType" SG_ 3221225472 DslPrtcltFltr1StSgnlStndrdDvtion 1;
BA_ "SAEDocument" SG_ 3221225472 DslPrtcltFltr1StSnsrPrlminaryFMI "J1939-71";
BA_ "SPN" SG_ 3221225472 DslPrtcltFltr1StSnsrPrlminaryFMI 4785;
BA_ "SAEDocument" SG_ 3221225472 DslPrtcltFilter1MedianSootSignal "J1939-71";
BA_ "SPN" SG_ 3221225472 DslPrtcltFilter1MedianSootSignal 4784;
BA_ "SigType" SG_ 3221225472 DslPrtcltFilter1MedianSootSignal 1;
BA_ "SAEDocument" SG_ 3221225472 DslPrtclateFilter1MeanSootSignal "J1939-71";
BA_ "SPN" SG_ 3221225472 DslPrtclateFilter1MeanSootSignal 4783;
BA_ "SigType" SG_ 3221225472 DslPrtclateFilter1MeanSootSignal 1;
BA_ "SAEDocument" SG_ 3221225472 DslParticulateFilter1SootDensity "J1939-71";
BA_ "SPN" SG_ 3221225472 DslParticulateFilter1SootDensity 4782;
BA_ "SigType" SG_ 3221225472 DslParticulateFilter1SootDensity 1;
BA_ "SAEDocument" SG_ 3221225472 DieselParticulateFilter1SootMass "J1939-71";
BA_ "SPN" SG_ 3221225472 DieselParticulateFilter1SootMass 4781;
BA_ "SigType" SG_ 3221225472 DieselParticulateFilter1SootMass 1;
BA_ "SAEDocument" SG_ 3221225472 VehicleBatteryChargingLampData "J1939-71";
BA_ "SPN" SG_ 3221225472 VehicleBatteryChargingLampData 5108;
BA_ "SigType" SG_ 3221225472 VehicleBatteryChargingLampData 4;
BA_ "SAEDocument" SG_ 3221225472 VehicleHVACRecirculationLampData "J1939-71";
BA_ "SPN" SG_ 3221225472 VehicleHVACRecirculationLampData 5107;
BA_ "SigType" SG_ 3221225472 VehicleHVACRecirculationLampData 4;
BA_ "SAEDocument" SG_ 3221225472 VehicleAirPressLowLampData "J1939-71";
BA_ "SPN" SG_ 3221225472 VehicleAirPressLowLampData 5106;
BA_ "SigType" SG_ 3221225472 VehicleAirPressLowLampData 4;
BA_ "SAEDocument" SG_ 3221225472 VehicleFuelLevelLowLampData "J1939-71";
BA_ "SPN" SG_ 3221225472 VehicleFuelLevelLowLampData 5105;
BA_ "SigType" SG_ 3221225472 VehicleFuelLevelLowLampData 4;
BA_ "SAEDocument" SG_ 3221225472 VehicleBatteryVoltageLowLampData "J1939-71";
BA_ "SPN" SG_ 3221225472 VehicleBatteryVoltageLowLampData 5104;
BA_ "SigType" SG_ 3221225472 VehicleBatteryVoltageLowLampData 4;
BA_ "SAEDocument" SG_ 3221225472 EngWaitToStartLampData "J1939-71";
BA_ "SPN" SG_ 3221225472 EngWaitToStartLampData 5416;
BA_ "SigType" SG_ 3221225472 EngWaitToStartLampData 4;
BA_ "SAEDocument" SG_ 3221225472 EngFuelFilterRestrictedLampData "J1939-71";
BA_ "SPN" SG_ 3221225472 EngFuelFilterRestrictedLampData 5470;
BA_ "SigType" SG_ 3221225472 EngFuelFilterRestrictedLampData 5;
BA_ "SAEDocument" SG_ 3221225472 EngAirFilterRestrictionLampData "J1939-71";
BA_ "SPN" SG_ 3221225472 EngAirFilterRestrictionLampData 5103;
BA_ "SigType" SG_ 3221225472 EngAirFilterRestrictionLampData 4;
BA_ "SAEDocument" SG_ 3221225472 EngIdleManagementActiveLampData "J1939-71";
BA_ "SPN" SG_ 3221225472 EngIdleManagementActiveLampData 5102;
BA_ "SigType" SG_ 3221225472 EngIdleManagementActiveLampData 4;
BA_ "SAEDocument" SG_ 3221225472 EngCoolantLevelLowLampData "J1939-71";
BA_ "SPN" SG_ 3221225472 EngCoolantLevelLowLampData 5101;
BA_ "SigType" SG_ 3221225472 EngCoolantLevelLowLampData 4;
BA_ "SAEDocument" SG_ 3221225472 EngCoolantTempHighLampData "J1939-71";
BA_ "SPN" SG_ 3221225472 EngCoolantTempHighLampData 5100;
BA_ "SigType" SG_ 3221225472 EngCoolantTempHighLampData 4;
BA_ "SAEDocument" SG_ 3221225472 EngOilPressLowLampData "J1939-71";
BA_ "SPN" SG_ 3221225472 EngOilPressLowLampData 5099;
BA_ "SigType" SG_ 3221225472 EngOilPressLowLampData 4;
BA_ "SAEDocument" SG_ 3221225472 CmprssnBrkEnblSwtchIndctrLmpData "J1939-71";
BA_ "SPN" SG_ 3221225472 CmprssnBrkEnblSwtchIndctrLmpData 5098;
BA_ "SigType" SG_ 3221225472 CmprssnBrkEnblSwtchIndctrLmpData 4;
BA_ "SAEDocument" SG_ 3221225472 EngBrakeActiveLampData "J1939-71";
BA_ "SPN" SG_ 3221225472 EngBrakeActiveLampData 5097;
BA_ "SigType" SG_ 3221225472 EngBrakeActiveLampData 4;
BA_ "SAEDocument" SG_ 3221225472 OBDMalfunctionIndicatorLampData "J1939-71";
BA_ "SPN" SG_ 3221225472 OBDMalfunctionIndicatorLampData 5096;
BA_ "SigType" SG_ 3221225472 OBDMalfunctionIndicatorLampData 4;
BA_ "SAEDocument" SG_ 3221225472 EngRedStopLampData "J1939-71";
BA_ "SPN" SG_ 3221225472 EngRedStopLampData 5095;
BA_ "SigType" SG_ 3221225472 EngRedStopLampData 4;
BA_ "SAEDocument" SG_ 3221225472 EngAmberWarningLampData "J1939-71";
BA_ "SPN" SG_ 3221225472 EngAmberWarningLampData 5094;
BA_ "SigType" SG_ 3221225472 EngAmberWarningLampData 4;
BA_ "SAEDocument" SG_ 3221225472 EngProtectLampData "J1939-71";
BA_ "SPN" SG_ 3221225472 EngProtectLampData 5093;
BA_ "SigType" SG_ 3221225472 EngProtectLampData 4;
BA_ "SAEDocument" SG_ 3221225472 VehicleBatteryChargingLampCmd "J1939-71";
BA_ "SPN" SG_ 3221225472 VehicleBatteryChargingLampCmd 5091;
BA_ "SigType" SG_ 3221225472 VehicleBatteryChargingLampCmd 5;
BA_ "SAEDocument" SG_ 3221225472 VehicleHVACRecirculationLampCmd "J1939-71";
BA_ "SPN" SG_ 3221225472 VehicleHVACRecirculationLampCmd 5090;
BA_ "SigType" SG_ 3221225472 VehicleHVACRecirculationLampCmd 5;
BA_ "SAEDocument" SG_ 3221225472 VehicleAirPressLowLampCmd "J1939-71";
BA_ "SPN" SG_ 3221225472 VehicleAirPressLowLampCmd 5089;
BA_ "SigType" SG_ 3221225472 VehicleAirPressLowLampCmd 5;
BA_ "SAEDocument" SG_ 3221225472 VehicleFuelLevelLowLampCmd "J1939-71";
BA_ "SPN" SG_ 3221225472 VehicleFuelLevelLowLampCmd 5088;
BA_ "SigType" SG_ 3221225472 VehicleFuelLevelLowLampCmd 5;
BA_ "SAEDocument" SG_ 3221225472 VehicleBatteryVoltageLowLampCmd "J1939-71";
BA_ "SPN" SG_ 3221225472 VehicleBatteryVoltageLowLampCmd 5087;
BA_ "SigType" SG_ 3221225472 VehicleBatteryVoltageLowLampCmd 5;
BA_ "SAEDocument" SG_ 3221225472 DTCTimeUntilDerate "J1939_73";
BA_ "SPN" SG_ 3221225472 DTCTimeUntilDerate 4123;
BA_ "SigType" SG_ 3221225472 DTCTimeUntilDerate 1;
BA_ "SAEDocument" SG_ 3221225472 DTCTotalPreviouslyActiveTime "J1939_73";
BA_ "SPN" SG_ 3221225472 DTCTotalPreviouslyActiveTime 4122;
BA_ "SigType" SG_ 3221225472 DTCTotalPreviouslyActiveTime 1;
BA_ "SAEDocument" SG_ 3221225472 DTCTotalActiveTime "J1939_73";
BA_ "SPN" SG_ 3221225472 DTCTotalActiveTime 4121;
BA_ "SigType" SG_ 3221225472 DTCTotalActiveTime 1;
BA_ "SAEDocument" SG_ 3221225472 FailureModeIdentifier1 "J1939-73";
BA_ "SPN" SG_ 3221225472 FailureModeIdentifier1 1215;
BA_ "SAEDocument" SG_ 3221225472 SPN1High "J1939-73";
BA_ "SAEDocument" SG_ 3221225472 SPN1 "J1939-73";
BA_ "SPN" SG_ 3221225472 SPN1 1214;
BA_ "SAEDocument" SG_ 3221225472 TextDisplayIndex "J1939-71";
BA_ "SPN" SG_ 3221225472 TextDisplayIndex 3614;
BA_ "SAEDocument" SG_ 3221225472 TextDisplayInstructions "J1939-71";
BA_ "SPN" SG_ 3221225472 TextDisplayInstructions 3613;
BA_ "SAEDocument" SG_ 3221225472 RetractStatusOfRamp5 "J1939-71";
BA_ "SPN" SG_ 3221225472 RetractStatusOfRamp5 4457;
BA_ "SigType" SG_ 3221225472 RetractStatusOfRamp5 5;
BA_ "SAEDocument" SG_ 3221225472 RetractStatusOfRamp4 "J1939-71";
BA_ "SPN" SG_ 3221225472 RetractStatusOfRamp4 4454;
BA_ "SigType" SG_ 3221225472 RetractStatusOfRamp4 5;
BA_ "SAEDocument" SG_ 3221225472 MovementStatusOfRamp5 "J1939-71";
BA_ "SPN" SG_ 3221225472 MovementStatusOfRamp5 4459;
BA_ "SigType" SG_ 3221225472 MovementStatusOfRamp5 5;
BA_ "SAEDocument" SG_ 3221225472 MovementStatusOfRamp4 "J1939-71";
BA_ "SPN" SG_ 3221225472 MovementStatusOfRamp4 4456;
BA_ "SigType" SG_ 3221225472 MovementStatusOfRamp4 5;
BA_ "SAEDocument" SG_ 3221225472 EnableStatusOfRamp5 "J1939-71";
BA_ "SPN" SG_ 3221225472 EnableStatusOfRamp5 4458;
BA_ "SigType" SG_ 3221225472 EnableStatusOfRamp5 5;
BA_ "SAEDocument" SG_ 3221225472 EnableStatusOfRamp4 "J1939-71";
BA_ "SPN" SG_ 3221225472 EnableStatusOfRamp4 4455;
BA_ "SigType" SG_ 3221225472 EnableStatusOfRamp4 5;
BA_ "SAEDocument" SG_ 3221225472 MovementStatusOfRamp3 "J1939-71";
BA_ "SPN" SG_ 3221225472 MovementStatusOfRamp3 3818;
BA_ "SigType" SG_ 3221225472 MovementStatusOfRamp3 5;
BA_ "SAEDocument" SG_ 3221225472 EnableStatusOfRamp3 "J1939-71";
BA_ "SPN" SG_ 3221225472 EnableStatusOfRamp3 3817;
BA_ "SigType" SG_ 3221225472 EnableStatusOfRamp3 5;
BA_ "SAEDocument" SG_ 3221225472 RetractStatusOfRamp3 "J1939-71";
BA_ "SPN" SG_ 3221225472 RetractStatusOfRamp3 3816;
BA_ "SigType" SG_ 3221225472 RetractStatusOfRamp3 5;
BA_ "SAEDocument" SG_ 3221225472 MovementStatusOfRamp2 "J1939-71";
BA_ "SPN" SG_ 3221225472 MovementStatusOfRamp2 3815;
BA_ "SigType" SG_ 3221225472 MovementStatusOfRamp2 5;
BA_ "SAEDocument" SG_ 3221225472 EnableStatusOfRamp2 "J1939-71";
BA_ "SPN" SG_ 3221225472 EnableStatusOfRamp2 3814;
BA_ "SigType" SG_ 3221225472 EnableStatusOfRamp2 5;
BA_ "SAEDocument" SG_ 3221225472 RetractStatusOfRamp2 "J1939-71";
BA_ "SPN" SG_ 3221225472 RetractStatusOfRamp2 3813;
BA_ "SigType" SG_ 3221225472 RetractStatusOfRamp2 5;
BA_ "SAEDocument" SG_ 3221225472 MovementStatusOfRamp1 "J1939-71";
BA_ "SPN" SG_ 3221225472 MovementStatusOfRamp1 3812;
BA_ "SigType" SG_ 3221225472 MovementStatusOfRamp1 5;
BA_ "SAEDocument" SG_ 3221225472 EnableStatusOfRamp1 "J1939-71";
BA_ "SPN" SG_ 3221225472 EnableStatusOfRamp1 3811;
BA_ "SigType" SG_ 3221225472 EnableStatusOfRamp1 5;
BA_ "SAEDocument" SG_ 3221225472 RetractStatusOfRamp1 "J1939-71";
BA_ "SPN" SG_ 3221225472 RetractStatusOfRamp1 3810;
BA_ "SigType" SG_ 3221225472 RetractStatusOfRamp1 5;
BA_ "SAEDocument" SG_ 3221225472 MaxCrankAttemptsPerStartAttempt "J1939-71";
BA_ "SPN" SG_ 3221225472 MaxCrankAttemptsPerStartAttempt 3670;
BA_ "SAEDocument" SG_ 3221225472 CommandedEngIntakeManifoldPress "J1939-71";
BA_ "SPN" SG_ 3221225472 CommandedEngIntakeManifoldPress 5312;
BA_ "SigType" SG_ 3221225472 CommandedEngIntakeManifoldPress 1;
BA_ "SAEDocument" SG_ 3221225472 EngCrnkcsBrtherOilSeparatorSpeed "J1939-71";
BA_ "SPN" SG_ 3221225472 EngCrnkcsBrtherOilSeparatorSpeed 5444;
BA_ "SigType" SG_ 3221225472 EngCrnkcsBrtherOilSeparatorSpeed 1;
BA_ "SAEDocument" SG_ 3221225472 EngExhstGsRcirculation1Valve2Pos "J1939-71";
BA_ "SPN" SG_ 3221225472 EngExhstGsRcirculation1Valve2Pos 3822;
BA_ "SigType" SG_ 3221225472 EngExhstGsRcirculation1Valve2Pos 1;
BA_ "SAEDocument" SG_ 3221225472 EngExhstGsRecirculation1ValvePos "J1939-71";
BA_ "SPN" SG_ 3221225472 EngExhstGsRecirculation1ValvePos 27;
BA_ "SigType" SG_ 3221225472 EngExhstGsRecirculation1ValvePos 1;
BA_ "SAEDocument" SG_ 3221225472 EngExhstGsRcrcltn1ClrIntkGsAbsPr "J1939-71";
BA_ "SPN" SG_ 3221225472 EngExhstGsRcrcltn1ClrIntkGsAbsPr 4751;
BA_ "SigType" SG_ 3221225472 EngExhstGsRcrcltn1ClrIntkGsAbsPr 1;
BA_ "SAEDocument" SG_ 3221225472 EngExhstGsRcrcltn1ClerIntakeTemp "J1939-71";
BA_ "SPN" SG_ 3221225472 EngExhstGsRcrcltn1ClerIntakeTemp 4750;
BA_ "SigType" SG_ 3221225472 EngExhstGsRcrcltn1ClerIntakeTemp 1;
BA_ "SAEDocument" SG_ 3221225472 EngExhstGsRcrcltn1ClerEfficiency "J1939-71";
BA_ "SPN" SG_ 3221225472 EngExhstGsRcrcltn1ClerEfficiency 4752;
BA_ "SAEDocument" SG_ 3221225472 EngExhstGsRcrculation1Valve2Ctrl "J1939-71";
BA_ "SPN" SG_ 3221225472 EngExhstGsRcrculation1Valve2Ctrl 3821;
BA_ "SAEDocument" SG_ 3221225472 EngIntkVlvActtionOilPressForCyl4 "J1939-71";
BA_ "SPN" SG_ 3221225472 EngIntkVlvActtionOilPressForCyl4 3627;
BA_ "SigType" SG_ 3221225472 EngIntkVlvActtionOilPressForCyl4 1;
BA_ "SAEDocument" SG_ 3221225472 EngIntkVlvActtionOilPressForCyl3 "J1939-71";
BA_ "SPN" SG_ 3221225472 EngIntkVlvActtionOilPressForCyl3 3626;
BA_ "SigType" SG_ 3221225472 EngIntkVlvActtionOilPressForCyl3 1;
BA_ "SAEDocument" SG_ 3221225472 EngIntkVlvActtionOilPressForCyl2 "J1939-71";
BA_ "SPN" SG_ 3221225472 EngIntkVlvActtionOilPressForCyl2 3625;
BA_ "SigType" SG_ 3221225472 EngIntkVlvActtionOilPressForCyl2 1;
BA_ "SAEDocument" SG_ 3221225472 EngIntkVlvActtionOilPressForCyl1 "J1939-71";
BA_ "SPN" SG_ 3221225472 EngIntkVlvActtionOilPressForCyl1 3624;
BA_ "SigType" SG_ 3221225472 EngIntkVlvActtionOilPressForCyl1 1;
BA_ "SAEDocument" SG_ 3221225472 EngIntkVlvActtionOilPressForCyl8 "J1939-71";
BA_ "SPN" SG_ 3221225472 EngIntkVlvActtionOilPressForCyl8 3631;
BA_ "SigType" SG_ 3221225472 EngIntkVlvActtionOilPressForCyl8 1;
BA_ "SAEDocument" SG_ 3221225472 EngIntkVlvActtionOilPressForCyl7 "J1939-71";
BA_ "SPN" SG_ 3221225472 EngIntkVlvActtionOilPressForCyl7 3630;
BA_ "SigType" SG_ 3221225472 EngIntkVlvActtionOilPressForCyl7 1;
BA_ "SAEDocument" SG_ 3221225472 EngIntkVlvActtionOilPressForCyl6 "J1939-71";
BA_ "SPN" SG_ 3221225472 EngIntkVlvActtionOilPressForCyl6 3629;
BA_ "SigType" SG_ 3221225472 EngIntkVlvActtionOilPressForCyl6 1;
BA_ "SAEDocument" SG_ 3221225472 EngIntkVlvActtionOilPressForCyl5 "J1939-71";
BA_ "SPN" SG_ 3221225472 EngIntkVlvActtionOilPressForCyl5 3628;
BA_ "SigType" SG_ 3221225472 EngIntkVlvActtionOilPressForCyl5 1;
BA_ "SAEDocument" SG_ 3221225472 EngIntkVlvActtonOilPressForCyl12 "J1939-71";
BA_ "SPN" SG_ 3221225472 EngIntkVlvActtonOilPressForCyl12 3635;
BA_ "SigType" SG_ 3221225472 EngIntkVlvActtonOilPressForCyl12 1;
BA_ "SAEDocument" SG_ 3221225472 EngIntkVlvActtonOilPressForCyl11 "J1939-71";
BA_ "SPN" SG_ 3221225472 EngIntkVlvActtonOilPressForCyl11 3634;
BA_ "SigType" SG_ 3221225472 EngIntkVlvActtonOilPressForCyl11 1;
BA_ "SAEDocument" SG_ 3221225472 EngIntkVlvActtonOilPressForCyl10 "J1939-71";
BA_ "SPN" SG_ 3221225472 EngIntkVlvActtonOilPressForCyl10 3633;
BA_ "SigType" SG_ 3221225472 EngIntkVlvActtonOilPressForCyl10 1;
BA_ "SAEDocument" SG_ 3221225472 EngIntkVlvActtionOilPressForCyl9 "J1939-71";
BA_ "SPN" SG_ 3221225472 EngIntkVlvActtionOilPressForCyl9 3632;
BA_ "SigType" SG_ 3221225472 EngIntkVlvActtionOilPressForCyl9 1;
BA_ "SAEDocument" SG_ 3221225472 EngIntkVlvActtonOilPressForCyl16 "J1939-71";
BA_ "SPN" SG_ 3221225472 EngIntkVlvActtonOilPressForCyl16 3639;
BA_ "SigType" SG_ 3221225472 EngIntkVlvActtonOilPressForCyl16 1;
BA_ "SAEDocument" SG_ 3221225472 EngIntkVlvActtonOilPressForCyl15 "J1939-71";
BA_ "SPN" SG_ 3221225472 EngIntkVlvActtonOilPressForCyl15 3638;
BA_ "SigType" SG_ 3221225472 EngIntkVlvActtonOilPressForCyl15 1;
BA_ "SAEDocument" SG_ 3221225472 EngIntkVlvActtonOilPressForCyl14 "J1939-71";
BA_ "SPN" SG_ 3221225472 EngIntkVlvActtonOilPressForCyl14 3637;
BA_ "SigType" SG_ 3221225472 EngIntkVlvActtonOilPressForCyl14 1;
BA_ "SAEDocument" SG_ 3221225472 EngIntkVlvActtonOilPressForCyl13 "J1939-71";
BA_ "SPN" SG_ 3221225472 EngIntkVlvActtonOilPressForCyl13 3636;
BA_ "SigType" SG_ 3221225472 EngIntkVlvActtonOilPressForCyl13 1;
BA_ "SAEDocument" SG_ 3221225472 EngIntkVlvActtonOilPressForCyl20 "J1939-71";
BA_ "SPN" SG_ 3221225472 EngIntkVlvActtonOilPressForCyl20 3643;
BA_ "SigType" SG_ 3221225472 EngIntkVlvActtonOilPressForCyl20 1;
BA_ "SAEDocument" SG_ 3221225472 EngIntkVlvActtonOilPressForCyl19 "J1939-71";
BA_ "SPN" SG_ 3221225472 EngIntkVlvActtonOilPressForCyl19 3642;
BA_ "SigType" SG_ 3221225472 EngIntkVlvActtonOilPressForCyl19 1;
BA_ "SAEDocument" SG_ 3221225472 EngIntkVlvActtonOilPressForCyl18 "J1939-71";
BA_ "SPN" SG_ 3221225472 EngIntkVlvActtonOilPressForCyl18 3641;
BA_ "SigType" SG_ 3221225472 EngIntkVlvActtonOilPressForCyl18 1;
BA_ "SAEDocument" SG_ 3221225472 EngIntkVlvActtonOilPressForCyl17 "J1939-71";
BA_ "SPN" SG_ 3221225472 EngIntkVlvActtonOilPressForCyl17 3640;
BA_ "SigType" SG_ 3221225472 EngIntkVlvActtonOilPressForCyl17 1;
BA_ "SAEDocument" SG_ 3221225472 EGR1CoolerBypassActuatorPostion "J1939-71";
BA_ "SPN" SG_ 3221225472 EGR1CoolerBypassActuatorPostion 3672;
BA_ "SigType" SG_ 3221225472 EGR1CoolerBypassActuatorPostion 1;
BA_ "SAEDocument" SG_ 3221225472 EngSparkPlug4 "J1939-71";
BA_ "SPN" SG_ 3221225472 EngSparkPlug4 1297;
BA_ "SigType" SG_ 3221225472 EngSparkPlug4 1;
BA_ "SAEDocument" SG_ 3221225472 EngSparkPlug3 "J1939-71";
BA_ "SPN" SG_ 3221225472 EngSparkPlug3 1296;
BA_ "SigType" SG_ 3221225472 EngSparkPlug3 1;
BA_ "SAEDocument" SG_ 3221225472 EngSparkPlug2 "J1939-71";
BA_ "SPN" SG_ 3221225472 EngSparkPlug2 1295;
BA_ "SigType" SG_ 3221225472 EngSparkPlug2 1;
BA_ "SAEDocument" SG_ 3221225472 EngSparkPlug1 "J1939-71";
BA_ "SPN" SG_ 3221225472 EngSparkPlug1 1294;
BA_ "SigType" SG_ 3221225472 EngSparkPlug1 1;
BA_ "SAEDocument" SG_ 3221225472 EngSparkPlug8 "J1939-71";
BA_ "SPN" SG_ 3221225472 EngSparkPlug8 1301;
BA_ "SigType" SG_ 3221225472 EngSparkPlug8 1;
BA_ "SAEDocument" SG_ 3221225472 EngSparkPlug7 "J1939-71";
BA_ "SPN" SG_ 3221225472 EngSparkPlug7 1300;
BA_ "SigType" SG_ 3221225472 EngSparkPlug7 1;
BA_ "SAEDocument" SG_ 3221225472 EngSparkPlug6 "J1939-71";
BA_ "SPN" SG_ 3221225472 EngSparkPlug6 1299;
BA_ "SigType" SG_ 3221225472 EngSparkPlug6 1;
BA_ "SAEDocument" SG_ 3221225472 EngSparkPlug5 "J1939-71";
BA_ "SPN" SG_ 3221225472 EngSparkPlug5 1298;
BA_ "SigType" SG_ 3221225472 EngSparkPlug5 1;
BA_ "SAEDocument" SG_ 3221225472 EngSparkPlug12 "J1939-71";
BA_ "SPN" SG_ 3221225472 EngSparkPlug12 1305;
BA_ "SigType" SG_ 3221225472 EngSparkPlug12 1;
BA_ "SAEDocument" SG_ 3221225472 EngSparkPlug11 "J1939-71";
BA_ "SPN" SG_ 3221225472 EngSparkPlug11 1304;
BA_ "SigType" SG_ 3221225472 EngSparkPlug11 1;
BA_ "SAEDocument" SG_ 3221225472 EngSparkPlug10 "J1939-71";
BA_ "SPN" SG_ 3221225472 EngSparkPlug10 1303;
BA_ "SigType" SG_ 3221225472 EngSparkPlug10 1;
BA_ "SAEDocument" SG_ 3221225472 EngSparkPlug9 "J1939-71";
BA_ "SPN" SG_ 3221225472 EngSparkPlug9 1302;
BA_ "SigType" SG_ 3221225472 EngSparkPlug9 1;
BA_ "SAEDocument" SG_ 3221225472 EngSparkPlug16 "J1939-71";
BA_ "SPN" SG_ 3221225472 EngSparkPlug16 1309;
BA_ "SigType" SG_ 3221225472 EngSparkPlug16 1;
BA_ "SAEDocument" SG_ 3221225472 EngSparkPlug15 "J1939-71";
BA_ "SPN" SG_ 3221225472 EngSparkPlug15 1308;
BA_ "SigType" SG_ 3221225472 EngSparkPlug15 1;
BA_ "SAEDocument" SG_ 3221225472 EngSparkPlug14 "J1939-71";
BA_ "SPN" SG_ 3221225472 EngSparkPlug14 1307;
BA_ "SigType" SG_ 3221225472 EngSparkPlug14 1;
BA_ "SAEDocument" SG_ 3221225472 EngSparkPlug13 "J1939-71";
BA_ "SPN" SG_ 3221225472 EngSparkPlug13 1306;
BA_ "SigType" SG_ 3221225472 EngSparkPlug13 1;
BA_ "SAEDocument" SG_ 3221225472 EngSparkPlug20 "J1939-71";
BA_ "SPN" SG_ 3221225472 EngSparkPlug20 1313;
BA_ "SigType" SG_ 3221225472 EngSparkPlug20 1;
BA_ "SAEDocument" SG_ 3221225472 EngSparkPlug19 "J1939-71";
BA_ "SPN" SG_ 3221225472 EngSparkPlug19 1312;
BA_ "SigType" SG_ 3221225472 EngSparkPlug19 1;
BA_ "SAEDocument" SG_ 3221225472 EngSparkPlug18 "J1939-71";
BA_ "SPN" SG_ 3221225472 EngSparkPlug18 1311;
BA_ "SigType" SG_ 3221225472 EngSparkPlug18 1;
BA_ "SAEDocument" SG_ 3221225472 EngSparkPlug17 "J1939-71";
BA_ "SPN" SG_ 3221225472 EngSparkPlug17 1310;
BA_ "SigType" SG_ 3221225472 EngSparkPlug17 1;
BA_ "SAEDocument" SG_ 3221225472 EngSparkPlug24 "J1939-71";
BA_ "SPN" SG_ 3221225472 EngSparkPlug24 1317;
BA_ "SigType" SG_ 3221225472 EngSparkPlug24 1;
BA_ "SAEDocument" SG_ 3221225472 EngSparkPlug23 "J1939-71";
BA_ "SPN" SG_ 3221225472 EngSparkPlug23 1316;
BA_ "SigType" SG_ 3221225472 EngSparkPlug23 1;
BA_ "SAEDocument" SG_ 3221225472 EngSparkPlug22 "J1939-71";
BA_ "SPN" SG_ 3221225472 EngSparkPlug22 1315;
BA_ "SigType" SG_ 3221225472 EngSparkPlug22 1;
BA_ "SAEDocument" SG_ 3221225472 EngSparkPlug21 "J1939-71";
BA_ "SPN" SG_ 3221225472 EngSparkPlug21 1314;
BA_ "SigType" SG_ 3221225472 EngSparkPlug21 1;
BA_ "SAEDocument" SG_ 3221225472 LaneDepartureWarningEnableCmd "J1939-71";
BA_ "SPN" SG_ 3221225472 LaneDepartureWarningEnableCmd 3564;
BA_ "SigType" SG_ 3221225472 LaneDepartureWarningEnableCmd 5;
BA_ "SAEDocument" SG_ 3221225472 J2012DTCOccurrenceCount "J1939-71";
BA_ "SPN" SG_ 3221225472 J2012DTCOccurrenceCount 3622;
BA_ "SAEDocument" SG_ 3221225472 J2012DTCStatus "J1939-71";
BA_ "SPN" SG_ 3221225472 J2012DTCStatus 3621;
BA_ "SAEDocument" SG_ 3221225472 J2012DTC "J1939-71";
BA_ "SPN" SG_ 3221225472 J2012DTC 3620;
BA_ "SAEDocument" SG_ 3221225472 NumberOfJ2012DTCs "J1939-71";
BA_ "SPN" SG_ 3221225472 NumberOfJ2012DTCs 3619;
BA_ "SigType" SG_ 3221225472 NumberOfJ2012DTCs 1;
BA_ "SAEDocument" SG_ 3221225472 MessageChecksum "J1939-71";
BA_ "SPN" SG_ 3221225472 MessageChecksum 4207;
BA_ "SAEDocument" SG_ 3221225472 MessageCounter "J1939-71";
BA_ "SPN" SG_ 3221225472 MessageCounter 4206;
BA_ "SAEDocument" SG_ 3221225472 SteerAngleSensorCalibrated "J1939-71";
BA_ "SPN" SG_ 3221225472 SteerAngleSensorCalibrated 3688;
BA_ "SigType" SG_ 3221225472 SteerAngleSensorCalibrated 5;
BA_ "SAEDocument" SG_ 3221225472 SteerAngleSensorActiveMode "J1939-71";
BA_ "SPN" SG_ 3221225472 SteerAngleSensorActiveMode 3687;
BA_ "SigType" SG_ 3221225472 SteerAngleSensorActiveMode 5;
BA_ "SAEDocument" SG_ 3221225472 SteerWheelAngleRange "J1939-71";
BA_ "SPN" SG_ 3221225472 SteerWheelAngleRange 3686;
BA_ "SigType" SG_ 3221225472 SteerWheelAngleRange 1;
BA_ "SAEDocument" SG_ 3221225472 SteerWheelAngleRangeCounterType "J1939-71";
BA_ "SPN" SG_ 3221225472 SteerWheelAngleRangeCounterType 3685;
BA_ "SigType" SG_ 3221225472 SteerWheelAngleRangeCounterType 5;
BA_ "SAEDocument" SG_ 3221225472 SteerWheelAngleRangeCounter "J1939-71";
BA_ "SPN" SG_ 3221225472 SteerWheelAngleRangeCounter 3684;
BA_ "SAEDocument" SG_ 3221225472 SteerWheelAngle "J1939-71";
BA_ "SPN" SG_ 3221225472 SteerWheelAngle 3683;
BA_ "SigType" SG_ 3221225472 SteerWheelAngle 1;
BA_ "SAEDocument" SG_ 3221225472 Aftrtrtmnt1SCRCtlystCnvrsnEffcnc "J1939-71";
BA_ "SPN" SG_ 3221225472 Aftrtrtmnt1SCRCtlystCnvrsnEffcnc 4364;
BA_ "SigType" SG_ 3221225472 Aftrtrtmnt1SCRCtlystCnvrsnEffcnc 1;
BA_ "SAEDocument" SG_ 3221225472 Aftrtrtmnt1SCRCmmnddCtlystRgntCn "J1939-71";
BA_ "SPN" SG_ 3221225472 Aftrtrtmnt1SCRCmmnddCtlystRgntCn 3828;
BA_ "SAEDocument" SG_ 3221225472 Aftrtrtmnt1SCRAvrgCtlystRgntCnsm "J1939-71";
BA_ "SPN" SG_ 3221225472 Aftrtrtmnt1SCRAvrgCtlystRgntCnsm 3826;
BA_ "SigType" SG_ 3221225472 Aftrtrtmnt1SCRAvrgCtlystRgntCnsm 1;
BA_ "SAEDocument" SG_ 3221225472 Aftrtrtmnt1DslExhstFldTnkLwLvlIn "J1939-71";
BA_ "SPN" SG_ 3221225472 Aftrtrtmnt1DslExhstFldTnkLwLvlIn 5463;
BA_ "SigType" SG_ 3221225472 Aftrtrtmnt1DslExhstFldTnkLwLvlIn 1;
BA_ "SAEDocument" SG_ 3221225472 TransferCaseStatus "J1939-71";
BA_ "SPN" SG_ 3221225472 TransferCaseStatus 3645;
BA_ "SAEDocument" SG_ 3221225472 TransOilLifeRemaining "J1939-71";
BA_ "SPN" SG_ 3221225472 TransOilLifeRemaining 4177;
BA_ "SigType" SG_ 3221225472 TransOilLifeRemaining 1;
BA_ "SAEDocument" SG_ 3221225472 TrnsTorqueConverterOilOutletTemp "J1939-71";
BA_ "SPN" SG_ 3221225472 TrnsTorqueConverterOilOutletTemp 3823;
BA_ "SigType" SG_ 3221225472 TrnsTorqueConverterOilOutletTemp 1;
BA_ "SAEDocument" SG_ 3221225472 TransOverheatIndicator "J1939-71";
BA_ "SPN" SG_ 3221225472 TransOverheatIndicator 5345;
BA_ "SigType" SG_ 3221225472 TransOverheatIndicator 5;
BA_ "SAEDocument" SG_ 3221225472 TransOilLevelSwitch "J1939-71";
BA_ "SPN" SG_ 3221225472 TransOilLevelSwitch 3533;
BA_ "SigType" SG_ 3221225472 TransOilLevelSwitch 5;
BA_ "SAEDocument" SG_ 3221225472 TransOilFilterRestrictionSwitch "J1939-71";
BA_ "SPN" SG_ 3221225472 TransOilFilterRestrictionSwitch 3359;
BA_ "SigType" SG_ 3221225472 TransOilFilterRestrictionSwitch 5;
BA_ "SAEDocument" SG_ 3221225472 VehicleRoll "J1939-71";
BA_ "SPN" SG_ 3221225472 VehicleRoll 3623;
BA_ "SigType" SG_ 3221225472 VehicleRoll 1;
BA_ "SAEDocument" SG_ 3221225472 TotalEngCruiseTime "J1939-71";
BA_ "SPN" SG_ 3221225472 TotalEngCruiseTime 1017;
BA_ "SigType" SG_ 3221225472 TotalEngCruiseTime 1;
BA_ "SAEDocument" SG_ 3221225472 TotalDriveAverageLoadFactor "J1939-71";
BA_ "SPN" SG_ 3221225472 TotalDriveAverageLoadFactor 1016;
BA_ "SigType" SG_ 3221225472 TotalDriveAverageLoadFactor 1;
BA_ "SAEDocument" SG_ 3221225472 TripDriveAverageLoadFactor "J1939-71";
BA_ "SPN" SG_ 3221225472 TripDriveAverageLoadFactor 1015;
BA_ "SigType" SG_ 3221225472 TripDriveAverageLoadFactor 1;
BA_ "SAEDocument" SG_ 3221225472 TripAverageEngSpeed "J1939-71";
BA_ "SPN" SG_ 3221225472 TripAverageEngSpeed 1014;
BA_ "SigType" SG_ 3221225472 TripAverageEngSpeed 1;
BA_ "SAEDocument" SG_ 3221225472 TripMaxEngSpeed "J1939-71";
BA_ "SPN" SG_ 3221225472 TripMaxEngSpeed 1013;
BA_ "SigType" SG_ 3221225472 TripMaxEngSpeed 1;
BA_ "SAEDocument" SG_ 3221225472 LandLevelingSystemEnableStatus "J1939-71";
BA_ "SPN" SG_ 3221225472 LandLevelingSystemEnableStatus 5409;
BA_ "SigType" SG_ 3221225472 LandLevelingSystemEnableStatus 5;
BA_ "SAEDocument" SG_ 3221225472 BladeCtrlModeRight "J1939-71";
BA_ "SPN" SG_ 3221225472 BladeCtrlModeRight 5408;
BA_ "SAEDocument" SG_ 3221225472 BladeCtrlModeLeft "J1939-71";
BA_ "SPN" SG_ 3221225472 BladeCtrlModeLeft 5407;
BA_ "SAEDocument" SG_ 3221225472 BladeCtrlMode "J1939-71";
BA_ "SPN" SG_ 3221225472 BladeCtrlMode 1578;
BA_ "SAEDocument" SG_ 3221225472 BladeDurationAndDirection "J1939-71";
BA_ "SPN" SG_ 3221225472 BladeDurationAndDirection 1577;
BA_ "SAEDocument" SG_ 3221225472 EngActualIgntTiming "J1939-71";
BA_ "SPN" SG_ 3221225472 EngActualIgntTiming 1436;
BA_ "SAEDocument" SG_ 3221225472 EngDesiredIgntTiming3 "J1939-71";
BA_ "SPN" SG_ 3221225472 EngDesiredIgntTiming3 1435;
BA_ "SAEDocument" SG_ 3221225472 EngDesiredIgntTiming2 "J1939-71";
BA_ "SPN" SG_ 3221225472 EngDesiredIgntTiming2 1434;
BA_ "SAEDocument" SG_ 3221225472 EngDesiredIgntTiming1 "J1939-71";
BA_ "SPN" SG_ 3221225472 EngDesiredIgntTiming1 1433;
BA_ "SAEDocument" SG_ 3221225472 EngCyl20IgntTiming "J1939-71";
BA_ "SPN" SG_ 3221225472 EngCyl20IgntTiming 1432;
BA_ "SAEDocument" SG_ 3221225472 EngCyl19IgntTiming "J1939-71";
BA_ "SPN" SG_ 3221225472 EngCyl19IgntTiming 1431;
BA_ "SAEDocument" SG_ 3221225472 EngCyl18IgntTiming "J1939-71";
BA_ "SPN" SG_ 3221225472 EngCyl18IgntTiming 1430;
BA_ "SAEDocument" SG_ 3221225472 EngCyl17IgntTiming "J1939-71";
BA_ "SPN" SG_ 3221225472 EngCyl17IgntTiming 1429;
BA_ "SAEDocument" SG_ 3221225472 EngCyl16IgntTiming "J1939-71";
BA_ "SPN" SG_ 3221225472 EngCyl16IgntTiming 1428;
BA_ "SAEDocument" SG_ 3221225472 EngCyl15IgntTiming "J1939-71";
BA_ "SPN" SG_ 3221225472 EngCyl15IgntTiming 1427;
BA_ "SAEDocument" SG_ 3221225472 EngCyl14IgntTiming "J1939-71";
BA_ "SPN" SG_ 3221225472 EngCyl14IgntTiming 1426;
BA_ "SAEDocument" SG_ 3221225472 EngCyl13IgntTiming "J1939-71";
BA_ "SPN" SG_ 3221225472 EngCyl13IgntTiming 1425;
BA_ "SAEDocument" SG_ 3221225472 EngCyl12IgntTiming "J1939-71";
BA_ "SPN" SG_ 3221225472 EngCyl12IgntTiming 1424;
BA_ "SAEDocument" SG_ 3221225472 EngCyl11IgntTiming "J1939-71";
BA_ "SPN" SG_ 3221225472 EngCyl11IgntTiming 1423;
BA_ "SAEDocument" SG_ 3221225472 EngCyl10IgntTiming "J1939-71";
BA_ "SPN" SG_ 3221225472 EngCyl10IgntTiming 1422;
BA_ "SAEDocument" SG_ 3221225472 EngCyl9IgntTiming "J1939-71";
BA_ "SPN" SG_ 3221225472 EngCyl9IgntTiming 1421;
BA_ "SAEDocument" SG_ 3221225472 EngCyl8IgntTiming "J1939-71";
BA_ "SPN" SG_ 3221225472 EngCyl8IgntTiming 1420;
BA_ "SAEDocument" SG_ 3221225472 EngCyl7IgntTiming "J1939-71";
BA_ "SPN" SG_ 3221225472 EngCyl7IgntTiming 1419;
BA_ "SAEDocument" SG_ 3221225472 EngCyl6IgntTiming "J1939-71";
BA_ "SPN" SG_ 3221225472 EngCyl6IgntTiming 1418;
BA_ "SAEDocument" SG_ 3221225472 EngCyl5IgntTiming "J1939-71";
BA_ "SPN" SG_ 3221225472 EngCyl5IgntTiming 1417;
BA_ "SAEDocument" SG_ 3221225472 EngCyl4IgntTiming "J1939-71";
BA_ "SPN" SG_ 3221225472 EngCyl4IgntTiming 1416;
BA_ "SAEDocument" SG_ 3221225472 EngCyl3IgntTiming "J1939-71";
BA_ "SPN" SG_ 3221225472 EngCyl3IgntTiming 1415;
BA_ "SAEDocument" SG_ 3221225472 EngCyl2IgntTiming "J1939-71";
BA_ "SPN" SG_ 3221225472 EngCyl2IgntTiming 1414;
BA_ "SAEDocument" SG_ 3221225472 EngCyl1IgntTiming "J1939-71";
BA_ "SPN" SG_ 3221225472 EngCyl1IgntTiming 1413;
BA_ "SAEDocument" SG_ 3221225472 EngCyl20IgntTransSecondOutput "J1939-71";
BA_ "SPN" SG_ 3221225472 EngCyl20IgntTransSecondOutput 1412;
BA_ "SigType" SG_ 3221225472 EngCyl20IgntTransSecondOutput 1;
BA_ "SAEDocument" SG_ 3221225472 EngCyl19IgntTransSecondOutput "J1939-71";
BA_ "SPN" SG_ 3221225472 EngCyl19IgntTransSecondOutput 1411;
BA_ "SigType" SG_ 3221225472 EngCyl19IgntTransSecondOutput 1;
BA_ "SAEDocument" SG_ 3221225472 EngCyl18IgntTransSecondOutput "J1939-71";
BA_ "SPN" SG_ 3221225472 EngCyl18IgntTransSecondOutput 1410;
BA_ "SigType" SG_ 3221225472 EngCyl18IgntTransSecondOutput 1;
BA_ "SAEDocument" SG_ 3221225472 EngCyl17IgntTransSecondOutput "J1939-71";
BA_ "SPN" SG_ 3221225472 EngCyl17IgntTransSecondOutput 1409;
BA_ "SigType" SG_ 3221225472 EngCyl17IgntTransSecondOutput 1;
BA_ "SAEDocument" SG_ 3221225472 EngCyl16IgntTransSecondOutput "J1939-71";
BA_ "SPN" SG_ 3221225472 EngCyl16IgntTransSecondOutput 1408;
BA_ "SigType" SG_ 3221225472 EngCyl16IgntTransSecondOutput 1;
BA_ "SAEDocument" SG_ 3221225472 EngCyl15IgntTransSecondOutput "J1939-71";
BA_ "SPN" SG_ 3221225472 EngCyl15IgntTransSecondOutput 1407;
BA_ "SigType" SG_ 3221225472 EngCyl15IgntTransSecondOutput 1;
BA_ "SAEDocument" SG_ 3221225472 EngCyl14IgntTransSecondOutput "J1939-71";
BA_ "SPN" SG_ 3221225472 EngCyl14IgntTransSecondOutput 1406;
BA_ "SigType" SG_ 3221225472 EngCyl14IgntTransSecondOutput 1;
BA_ "SAEDocument" SG_ 3221225472 EngCyl13IgntTransSecondOutput "J1939-71";
BA_ "SPN" SG_ 3221225472 EngCyl13IgntTransSecondOutput 1405;
BA_ "SigType" SG_ 3221225472 EngCyl13IgntTransSecondOutput 1;
BA_ "SAEDocument" SG_ 3221225472 EngCyl12IgntTransSecondOutput "J1939-71";
BA_ "SPN" SG_ 3221225472 EngCyl12IgntTransSecondOutput 1404;
BA_ "SigType" SG_ 3221225472 EngCyl12IgntTransSecondOutput 1;
BA_ "SAEDocument" SG_ 3221225472 EngCyl11IgntTransSecondOutput "J1939-71";
BA_ "SPN" SG_ 3221225472 EngCyl11IgntTransSecondOutput 1403;
BA_ "SigType" SG_ 3221225472 EngCyl11IgntTransSecondOutput 1;
BA_ "SAEDocument" SG_ 3221225472 EngCyl10IgntTransSecondOutput "J1939-71";
BA_ "SPN" SG_ 3221225472 EngCyl10IgntTransSecondOutput 1402;
BA_ "SigType" SG_ 3221225472 EngCyl10IgntTransSecondOutput 1;
BA_ "SAEDocument" SG_ 3221225472 EngCyl9IgntTransSecondOutput "J1939-71";
BA_ "SPN" SG_ 3221225472 EngCyl9IgntTransSecondOutput 1401;
BA_ "SigType" SG_ 3221225472 EngCyl9IgntTransSecondOutput 1;
BA_ "SAEDocument" SG_ 3221225472 EngCyl8IgntTransSecondOutput "J1939-71";
BA_ "SPN" SG_ 3221225472 EngCyl8IgntTransSecondOutput 1400;
BA_ "SigType" SG_ 3221225472 EngCyl8IgntTransSecondOutput 1;
BA_ "SAEDocument" SG_ 3221225472 EngCyl7IgntTransSecondOutput "J1939-71";
BA_ "SPN" SG_ 3221225472 EngCyl7IgntTransSecondOutput 1399;
BA_ "SigType" SG_ 3221225472 EngCyl7IgntTransSecondOutput 1;
BA_ "SAEDocument" SG_ 3221225472 EngCyl6IgntTransSecondOutput "J1939-71";
BA_ "SPN" SG_ 3221225472 EngCyl6IgntTransSecondOutput 1398;
BA_ "SigType" SG_ 3221225472 EngCyl6IgntTransSecondOutput 1;
BA_ "SAEDocument" SG_ 3221225472 EngCyl5IgntTransSecondOutput "J1939-71";
BA_ "SPN" SG_ 3221225472 EngCyl5IgntTransSecondOutput 1397;
BA_ "SigType" SG_ 3221225472 EngCyl5IgntTransSecondOutput 1;
BA_ "SAEDocument" SG_ 3221225472 EngCyl4IgntTransSecondOutput "J1939-71";
BA_ "SPN" SG_ 3221225472 EngCyl4IgntTransSecondOutput 1396;
BA_ "SigType" SG_ 3221225472 EngCyl4IgntTransSecondOutput 1;
BA_ "SAEDocument" SG_ 3221225472 EngCyl3IgntTransSecondOutput "J1939-71";
BA_ "SPN" SG_ 3221225472 EngCyl3IgntTransSecondOutput 1395;
BA_ "SigType" SG_ 3221225472 EngCyl3IgntTransSecondOutput 1;
BA_ "SAEDocument" SG_ 3221225472 EngCyl2IgntTransSecondOutput "J1939-71";
BA_ "SPN" SG_ 3221225472 EngCyl2IgntTransSecondOutput 1394;
BA_ "SigType" SG_ 3221225472 EngCyl2IgntTransSecondOutput 1;
BA_ "SAEDocument" SG_ 3221225472 EngCyl1IgntTransSecondOutput "J1939-71";
BA_ "SPN" SG_ 3221225472 EngCyl1IgntTransSecondOutput 1393;
BA_ "SigType" SG_ 3221225472 EngCyl1IgntTransSecondOutput 1;
BA_ "SAEDocument" SG_ 3221225472 EngOprtrPrmryIntrmdtSpdSlctState "J1939-71";
BA_ "SPN" SG_ 3221225472 EngOprtrPrmryIntrmdtSpdSlctState 2892;
BA_ "SAEDocument" SG_ 3221225472 EngOprtrPrmryIntrmdteSpeedSelect "J1939-71";
BA_ "SPN" SG_ 3221225472 EngOprtrPrmryIntrmdteSpeedSelect 2880;
BA_ "SAEDocument" SG_ 3221225472 EngTotalIdleHours "J1939-71";
BA_ "SPN" SG_ 3221225472 EngTotalIdleHours 235;
BA_ "SigType" SG_ 3221225472 EngTotalIdleHours 1;
BA_ "SAEDocument" SG_ 3221225472 EngTotalIdleFuelUsed "J1939-71";
BA_ "SPN" SG_ 3221225472 EngTotalIdleFuelUsed 236;
BA_ "SigType" SG_ 3221225472 EngTotalIdleFuelUsed 1;
BA_ "SAEDocument" SG_ 3221225472 EngIntakeManifold6Temp "J1939-71";
BA_ "SPN" SG_ 3221225472 EngIntakeManifold6Temp 1803;
BA_ "SigType" SG_ 3221225472 EngIntakeManifold6Temp 1;
BA_ "SAEDocument" SG_ 3221225472 EngIntakeManifold5Temp "J1939-71";
BA_ "SPN" SG_ 3221225472 EngIntakeManifold5Temp 1802;
BA_ "SigType" SG_ 3221225472 EngIntakeManifold5Temp 1;
BA_ "SAEDocument" SG_ 3221225472 EngIntakeManifold4Temp "J1939-71";
BA_ "SPN" SG_ 3221225472 EngIntakeManifold4Temp 1133;
BA_ "SigType" SG_ 3221225472 EngIntakeManifold4Temp 1;
BA_ "SAEDocument" SG_ 3221225472 EngIntakeManifold3Temp "J1939-71";
BA_ "SPN" SG_ 3221225472 EngIntakeManifold3Temp 1132;
BA_ "SigType" SG_ 3221225472 EngIntakeManifold3Temp 1;
BA_ "SAEDocument" SG_ 3221225472 EngIntakeManifold2Temp "J1939-71";
BA_ "SPN" SG_ 3221225472 EngIntakeManifold2Temp 1131;
BA_ "SigType" SG_ 3221225472 EngIntakeManifold2Temp 1;
BA_ "SAEDocument" SG_ 3221225472 EngTurbo4BoostPress "J1939-71";
BA_ "SPN" SG_ 3221225472 EngTurbo4BoostPress 1130;
BA_ "SigType" SG_ 3221225472 EngTurbo4BoostPress 1;
BA_ "SAEDocument" SG_ 3221225472 EngTurbo3BoostPress "J1939-71";
BA_ "SPN" SG_ 3221225472 EngTurbo3BoostPress 1129;
BA_ "SigType" SG_ 3221225472 EngTurbo3BoostPress 1;
BA_ "SAEDocument" SG_ 3221225472 EngTurbo2BoostPress "J1939-71";
BA_ "SPN" SG_ 3221225472 EngTurbo2BoostPress 1128;
BA_ "SigType" SG_ 3221225472 EngTurbo2BoostPress 1;
BA_ "SAEDocument" SG_ 3221225472 EngTurbo1BoostPress "J1939-71";
BA_ "SPN" SG_ 3221225472 EngTurbo1BoostPress 1127;
BA_ "SigType" SG_ 3221225472 EngTurbo1BoostPress 1;
BA_ "SAEDocument" SG_ 3221225472 EngIntakeManifold2AbsPress "J1939-71";
BA_ "SPN" SG_ 3221225472 EngIntakeManifold2AbsPress 5422;
BA_ "SigType" SG_ 3221225472 EngIntakeManifold2AbsPress 1;
BA_ "SAEDocument" SG_ 3221225472 EngIntakeManifold1AbsPress "J1939-71";
BA_ "SPN" SG_ 3221225472 EngIntakeManifold1AbsPress 3563;
BA_ "SigType" SG_ 3221225472 EngIntakeManifold1AbsPress 1;
BA_ "SAEDocument" SG_ 3221225472 EngIntakeManifold2Press "J1939-71";
BA_ "SPN" SG_ 3221225472 EngIntakeManifold2Press 3562;
BA_ "SigType" SG_ 3221225472 EngIntakeManifold2Press 1;
BA_ "SAEDocument" SG_ 3221225472 EngAirFilter4DiffPress "J1939-71";
BA_ "SPN" SG_ 3221225472 EngAirFilter4DiffPress 2811;
BA_ "SigType" SG_ 3221225472 EngAirFilter4DiffPress 1;
BA_ "SAEDocument" SG_ 3221225472 EngAirFilter3DiffPress "J1939-71";
BA_ "SPN" SG_ 3221225472 EngAirFilter3DiffPress 2810;
BA_ "SigType" SG_ 3221225472 EngAirFilter3DiffPress 1;
BA_ "SAEDocument" SG_ 3221225472 EngAirFilter2DiffPress "J1939-71";
BA_ "SPN" SG_ 3221225472 EngAirFilter2DiffPress 2809;
BA_ "SigType" SG_ 3221225472 EngAirFilter2DiffPress 1;
BA_ "SAEDocument" SG_ 3221225472 EngCoolantFilterDiffPress "J1939-71";
BA_ "SPN" SG_ 3221225472 EngCoolantFilterDiffPress 112;
BA_ "SigType" SG_ 3221225472 EngCoolantFilterDiffPress 1;
BA_ "SAEDocument" SG_ 3221225472 EngExhaustGasTemp "J1939-71";
BA_ "SPN" SG_ 3221225472 EngExhaustGasTemp 173;
BA_ "SigType" SG_ 3221225472 EngExhaustGasTemp 1;
BA_ "SAEDocument" SG_ 3221225472 EngAirFilter1DiffPress "J1939-71";
BA_ "SPN" SG_ 3221225472 EngAirFilter1DiffPress 107;
BA_ "SigType" SG_ 3221225472 EngAirFilter1DiffPress 1;
BA_ "SAEDocument" SG_ 3221225472 EngIntakeManifold1Temp "J1939-71";
BA_ "SPN" SG_ 3221225472 EngIntakeManifold1Temp 105;
BA_ "SigType" SG_ 3221225472 EngIntakeManifold1Temp 1;
BA_ "SAEDocument" SG_ 3221225472 EngIntakeManifold1Press "J1939-71";
BA_ "SPN" SG_ 3221225472 EngIntakeManifold1Press 102;
BA_ "SigType" SG_ 3221225472 EngIntakeManifold1Press 1;
BA_ "SAEDocument" SG_ 3221225472 EngDslPrtculateFilterIntakePress "J1939-71";
BA_ "SPN" SG_ 3221225472 EngDslPrtculateFilterIntakePress 81;
BA_ "SigType" SG_ 3221225472 EngDslPrtculateFilterIntakePress 1;
BA_ "SAEDocument" SG_ 3221225472 EngAirIntakePress "J1939-71";
BA_ "SPN" SG_ 3221225472 EngAirIntakePress 106;
BA_ "SigType" SG_ 3221225472 EngAirIntakePress 1;
BA_ "SAEDocument" SG_ 3221225472 CabHeatingZone "J1939-71";
BA_ "SPN" SG_ 3221225472 CabHeatingZone 1680;
BA_ "SigType" SG_ 3221225472 CabHeatingZone 5;
BA_ "SAEDocument" SG_ 3221225472 EngHeatingZone "J1939-71";
BA_ "SPN" SG_ 3221225472 EngHeatingZone 1679;
BA_ "SigType" SG_ 3221225472 EngHeatingZone 5;
BA_ "SAEDocument" SG_ 3221225472 CabVentilation "J1939-71";
BA_ "SPN" SG_ 3221225472 CabVentilation 1678;
BA_ "SigType" SG_ 3221225472 CabVentilation 5;
BA_ "SAEDocument" SG_ 3221225472 AuxHeaterWaterPumpStatus "J1939-71";
BA_ "SPN" SG_ 3221225472 AuxHeaterWaterPumpStatus 1676;
BA_ "SigType" SG_ 3221225472 AuxHeaterWaterPumpStatus 5;
BA_ "SAEDocument" SG_ 3221225472 AuxHeaterMode "J1939-71";
BA_ "SPN" SG_ 3221225472 AuxHeaterMode 1677;
BA_ "SAEDocument" SG_ 3221225472 AuxHeaterOutputPowerPercent "J1939-71";
BA_ "SPN" SG_ 3221225472 AuxHeaterOutputPowerPercent 1689;
BA_ "SigType" SG_ 3221225472 AuxHeaterOutputPowerPercent 1;
BA_ "SAEDocument" SG_ 3221225472 AuxHeaterInputAirTemp "J1939-71";
BA_ "SPN" SG_ 3221225472 AuxHeaterInputAirTemp 1688;
BA_ "SigType" SG_ 3221225472 AuxHeaterInputAirTemp 1;
BA_ "SAEDocument" SG_ 3221225472 AuxHeaterOutputCoolantTemp "J1939-71";
BA_ "SPN" SG_ 3221225472 AuxHeaterOutputCoolantTemp 1687;
BA_ "SigType" SG_ 3221225472 AuxHeaterOutputCoolantTemp 1;
BA_ "SAEDocument" SG_ 3221225472 FireApparatusPumpEngagement "J1939-71";
BA_ "SPN" SG_ 3221225472 FireApparatusPumpEngagement 2599;
BA_ "SigType" SG_ 3221225472 FireApparatusPumpEngagement 4;
BA_ "SAEDocument" SG_ 3221225472 EngHydPressGovernorSwitch "J1939-71";
BA_ "SPN" SG_ 3221225472 EngHydPressGovernorSwitch 1764;
BA_ "SigType" SG_ 3221225472 EngHydPressGovernorSwitch 4;
BA_ "SAEDocument" SG_ 3221225472 EngHydPressGovernorModeIndicator "J1939-71";
BA_ "SPN" SG_ 3221225472 EngHydPressGovernorModeIndicator 1763;
BA_ "SigType" SG_ 3221225472 EngHydPressGovernorModeIndicator 5;
BA_ "SAEDocument" SG_ 3221225472 HydPress "J1939-71";
BA_ "SPN" SG_ 3221225472 HydPress 1762;
BA_ "SigType" SG_ 3221225472 HydPress 1;
BA_ "SAEDocument" SG_ 3221225472 EngTotalRevolutions "J1939-71";
BA_ "SPN" SG_ 3221225472 EngTotalRevolutions 249;
BA_ "SigType" SG_ 3221225472 EngTotalRevolutions 1;
BA_ "SAEDocument" SG_ 3221225472 EngTotalHoursOfOperation "J1939-71";
BA_ "SPN" SG_ 3221225472 EngTotalHoursOfOperation 247;
BA_ "SigType" SG_ 3221225472 EngTotalHoursOfOperation 1;
BA_ "SAEDocument" SG_ 3221225472 HydBrakeFluidLevelSwitch "J1939-71";
BA_ "SPN" SG_ 3221225472 HydBrakeFluidLevelSwitch 2931;
BA_ "SigType" SG_ 3221225472 HydBrakeFluidLevelSwitch 4;
BA_ "SAEDocument" SG_ 3221225472 HydBrakeSystemAudibleWarningCmd "J1939-71";
BA_ "SPN" SG_ 3221225472 HydBrakeSystemAudibleWarningCmd 2930;
BA_ "SigType" SG_ 3221225472 HydBrakeSystemAudibleWarningCmd 5;
BA_ "SAEDocument" SG_ 3221225472 HydBrakePressSupplyStateCircuit2 "J1939-71";
BA_ "SPN" SG_ 3221225472 HydBrakePressSupplyStateCircuit2 2583;
BA_ "SigType" SG_ 3221225472 HydBrakePressSupplyStateCircuit2 4;
BA_ "SAEDocument" SG_ 3221225472 HydBrakePressSupplyStateCircuit1 "J1939-71";
BA_ "SPN" SG_ 3221225472 HydBrakePressSupplyStateCircuit1 2582;
BA_ "SigType" SG_ 3221225472 HydBrakePressSupplyStateCircuit1 4;
BA_ "SAEDocument" SG_ 3221225472 HydBrkePressWarningStateCircuit2 "J1939-71";
BA_ "SPN" SG_ 3221225472 HydBrkePressWarningStateCircuit2 2585;
BA_ "SigType" SG_ 3221225472 HydBrkePressWarningStateCircuit2 4;
BA_ "SAEDocument" SG_ 3221225472 HydBrkePressWarningStateCircuit1 "J1939-71";
BA_ "SPN" SG_ 3221225472 HydBrkePressWarningStateCircuit1 2584;
BA_ "SigType" SG_ 3221225472 HydBrkePressWarningStateCircuit1 4;
BA_ "SAEDocument" SG_ 3221225472 HydBrakePressCircuit2 "J1939-71";
BA_ "SPN" SG_ 3221225472 HydBrakePressCircuit2 2581;
BA_ "SigType" SG_ 3221225472 HydBrakePressCircuit2 1;
BA_ "SAEDocument" SG_ 3221225472 HydBrakePressCircuit1 "J1939-71";
BA_ "SPN" SG_ 3221225472 HydBrakePressCircuit1 2580;
BA_ "SigType" SG_ 3221225472 HydBrakePressCircuit1 1;
BA_ "SAEDocument" SG_ 3221225472 TripDriveFuelEconomy "J1939-71";
BA_ "SPN" SG_ 3221225472 TripDriveFuelEconomy 1006;
BA_ "SigType" SG_ 3221225472 TripDriveFuelEconomy 1;
BA_ "SAEDocument" SG_ 3221225472 TripCruiseFuelUsed "J1939-71";
BA_ "SPN" SG_ 3221225472 TripCruiseFuelUsed 1005;
BA_ "SigType" SG_ 3221225472 TripCruiseFuelUsed 1;
BA_ "SAEDocument" SG_ 3221225472 TripVehicleIdleFuelUsed "J1939-71";
BA_ "SPN" SG_ 3221225472 TripVehicleIdleFuelUsed 1004;
BA_ "SigType" SG_ 3221225472 TripVehicleIdleFuelUsed 1;
BA_ "SAEDocument" SG_ 3221225472 TripPTOGovernorNonmovingFuelUsed "J1939-71";
BA_ "SPN" SG_ 3221225472 TripPTOGovernorNonmovingFuelUsed 1003;
BA_ "SigType" SG_ 3221225472 TripPTOGovernorNonmovingFuelUsed 1;
BA_ "SAEDocument" SG_ 3221225472 TripPTOGovernorMovingFuelUsed "J1939-71";
BA_ "SPN" SG_ 3221225472 TripPTOGovernorMovingFuelUsed 1002;
BA_ "SigType" SG_ 3221225472 TripPTOGovernorMovingFuelUsed 1;
BA_ "SAEDocument" SG_ 3221225472 TripDriveFuelUsed "J1939-71";
BA_ "SPN" SG_ 3221225472 TripDriveFuelUsed 1001;
BA_ "SigType" SG_ 3221225472 TripDriveFuelUsed 1;
BA_ "SAEDocument" SG_ 3221225472 EngFuelValve1OutletAbsPress "J1939-71";
BA_ "SPN" SG_ 3221225472 EngFuelValve1OutletAbsPress 2980;
BA_ "SigType" SG_ 3221225472 EngFuelValve1OutletAbsPress 1;
BA_ "SAEDocument" SG_ 3221225472 EngAirToFuelDiffPress "J1939-71";
BA_ "SPN" SG_ 3221225472 EngAirToFuelDiffPress 1392;
BA_ "SigType" SG_ 3221225472 EngAirToFuelDiffPress 1;
BA_ "SAEDocument" SG_ 3221225472 EngFuelValveDiffPress "J1939-71";
BA_ "SPN" SG_ 3221225472 EngFuelValveDiffPress 1391;
BA_ "SigType" SG_ 3221225472 EngFuelValveDiffPress 1;
BA_ "SAEDocument" SG_ 3221225472 EngFuelValve1IntakeAbsPress "J1939-71";
BA_ "SPN" SG_ 3221225472 EngFuelValve1IntakeAbsPress 1390;
BA_ "SigType" SG_ 3221225472 EngFuelValve1IntakeAbsPress 1;
BA_ "SAEDocument" SG_ 3221225472 EngRequestedFuelValve2Pos "J1939-71";
BA_ "SPN" SG_ 3221225472 EngRequestedFuelValve2Pos 1766;
BA_ "SAEDocument" SG_ 3221225472 EngRequestedFuelValve1Pos "J1939-71";
BA_ "SPN" SG_ 3221225472 EngRequestedFuelValve1Pos 1765;
BA_ "SAEDocument" SG_ 3221225472 EngFuelValve2Pos "J1939-71";
BA_ "SPN" SG_ 3221225472 EngFuelValve2Pos 1443;
BA_ "SigType" SG_ 3221225472 EngFuelValve2Pos 1;
BA_ "SAEDocument" SG_ 3221225472 EngFuelValve1Pos "J1939-71";
BA_ "SPN" SG_ 3221225472 EngFuelValve1Pos 1442;
BA_ "SigType" SG_ 3221225472 EngFuelValve1Pos 1;
BA_ "SAEDocument" SG_ 3221225472 EngFuelFlowRate2 "J1939-71";
BA_ "SPN" SG_ 3221225472 EngFuelFlowRate2 1441;
BA_ "SigType" SG_ 3221225472 EngFuelFlowRate2 1;
BA_ "SAEDocument" SG_ 3221225472 EngFuelFlowRate1 "J1939-71";
BA_ "SPN" SG_ 3221225472 EngFuelFlowRate1 1440;
BA_ "SigType" SG_ 3221225472 EngFuelFlowRate1 1;
BA_ "SAEDocument" SG_ 3221225472 EngFuelSpecificGravity "J1939-71";
BA_ "SPN" SG_ 3221225472 EngFuelSpecificGravity 1389;
BA_ "SAEDocument" SG_ 3221225472 TripAverageFuelRate "J1939-71";
BA_ "SPN" SG_ 3221225472 TripAverageFuelRate 1029;
BA_ "SigType" SG_ 3221225472 TripAverageFuelRate 1;
BA_ "SAEDocument" SG_ 3221225472 TotalEngPTOGovernorFuelUsed "J1939-71";
BA_ "SPN" SG_ 3221225472 TotalEngPTOGovernorFuelUsed 1028;
BA_ "SigType" SG_ 3221225472 TotalEngPTOGovernorFuelUsed 1;
BA_ "SAEDocument" SG_ 3221225472 SpecificHeatRatio "J1939-71";
BA_ "SPN" SG_ 3221225472 SpecificHeatRatio 1767;
BA_ "SAEDocument" SG_ 3221225472 TotalFuelUsed "J1939-71";
BA_ "SPN" SG_ 3221225472 TotalFuelUsed 1040;
BA_ "SigType" SG_ 3221225472 TotalFuelUsed 1;
BA_ "SAEDocument" SG_ 3221225472 TripFuel "J1939-71";
BA_ "SPN" SG_ 3221225472 TripFuel 1039;
BA_ "SigType" SG_ 3221225472 TripFuel 1;
BA_ "SAEDocument" SG_ 3221225472 SensorSupplyVoltage6 "J1939-71";
BA_ "SPN" SG_ 3221225472 SensorSupplyVoltage6 3514;
BA_ "SigType" SG_ 3221225472 SensorSupplyVoltage6 1;
BA_ "SAEDocument" SG_ 3221225472 SensorSupplyVoltage5 "J1939-71";
BA_ "SPN" SG_ 3221225472 SensorSupplyVoltage5 3513;
BA_ "SigType" SG_ 3221225472 SensorSupplyVoltage5 1;
BA_ "SAEDocument" SG_ 3221225472 SensorSupplyVoltage8 "J1939-71";
BA_ "SPN" SG_ 3221225472 SensorSupplyVoltage8 5126;
BA_ "SigType" SG_ 3221225472 SensorSupplyVoltage8 1;
BA_ "SAEDocument" SG_ 3221225472 SensorSupplyVoltage7 "J1939-71";
BA_ "SPN" SG_ 3221225472 SensorSupplyVoltage7 5125;
BA_ "SigType" SG_ 3221225472 SensorSupplyVoltage7 1;
BA_ "SAEDocument" SG_ 3221225472 SensorSupplyVoltage4 "J1939-71";
BA_ "SPN" SG_ 3221225472 SensorSupplyVoltage4 3512;
BA_ "SigType" SG_ 3221225472 SensorSupplyVoltage4 1;
BA_ "SAEDocument" SG_ 3221225472 SensorSupplyVoltage3 "J1939-71";
BA_ "SPN" SG_ 3221225472 SensorSupplyVoltage3 3511;
BA_ "SigType" SG_ 3221225472 SensorSupplyVoltage3 1;
BA_ "SAEDocument" SG_ 3221225472 SensorSupplyVoltage2 "J1939-71";
BA_ "SPN" SG_ 3221225472 SensorSupplyVoltage2 3510;
BA_ "SigType" SG_ 3221225472 SensorSupplyVoltage2 1;
BA_ "SAEDocument" SG_ 3221225472 SensorSupplyVoltage1 "J1939-71";
BA_ "SPN" SG_ 3221225472 SensorSupplyVoltage1 3509;
BA_ "SigType" SG_ 3221225472 SensorSupplyVoltage1 1;
BA_ "SAEDocument" SG_ 3221225472 AtLeastOnePTOEngaged "J1939-71";
BA_ "SPN" SG_ 3221225472 AtLeastOnePTOEngaged 3948;
BA_ "SigType" SG_ 3221225472 AtLeastOnePTOEngaged 5;
BA_ "SAEDocument" SG_ 3221225472 EnggmntSttsPTOEngAccessoryDrive2 "J1939-71";
BA_ "SPN" SG_ 3221225472 EnggmntSttsPTOEngAccessoryDrive2 3947;
BA_ "SigType" SG_ 3221225472 EnggmntSttsPTOEngAccessoryDrive2 5;
BA_ "SAEDocument" SG_ 3221225472 EnggmntSttsPTOEngAccessoryDrive1 "J1939-71";
BA_ "SPN" SG_ 3221225472 EnggmntSttsPTOEngAccessoryDrive1 3944;
BA_ "SigType" SG_ 3221225472 EnggmntSttsPTOEngAccessoryDrive1 5;
BA_ "SAEDocument" SG_ 3221225472 EngagementStatusPTOEngFlywheel "J1939-71";
BA_ "SPN" SG_ 3221225472 EngagementStatusPTOEngFlywheel 3941;
BA_ "SigType" SG_ 3221225472 EngagementStatusPTOEngFlywheel 5;
BA_ "SAEDocument" SG_ 3221225472 EnggmntStatusTransInputShaftPTO1 "J1939-71";
BA_ "SPN" SG_ 3221225472 EnggmntStatusTransInputShaftPTO1 3460;
BA_ "SigType" SG_ 3221225472 EnggmntStatusTransInputShaftPTO1 5;
BA_ "SAEDocument" SG_ 3221225472 EnggmntStatusTransInputShaftPTO2 "J1939-71";
BA_ "SPN" SG_ 3221225472 EnggmntStatusTransInputShaftPTO2 3461;
BA_ "SigType" SG_ 3221225472 EnggmntStatusTransInputShaftPTO2 5;
BA_ "SAEDocument" SG_ 3221225472 EnggmntStatusTransOutputShaftPTO "J1939-71";
BA_ "SPN" SG_ 3221225472 EnggmntStatusTransOutputShaftPTO 3462;
BA_ "SigType" SG_ 3221225472 EnggmntStatusTransOutputShaftPTO 5;
BA_ "SAEDocument" SG_ 3221225472 EnggmntSttsTrnsfrCsOtputShaftPTO "J1939-71";
BA_ "SPN" SG_ 3221225472 EnggmntSttsTrnsfrCsOtputShaftPTO 3463;
BA_ "SigType" SG_ 3221225472 EnggmntSttsTrnsfrCsOtputShaftPTO 5;
BA_ "SAEDocument" SG_ 3221225472 EnggmntCnsntPTOEngAccssoryDrive2 "J1939-71";
BA_ "SPN" SG_ 3221225472 EnggmntCnsntPTOEngAccssoryDrive2 3946;
BA_ "SigType" SG_ 3221225472 EnggmntCnsntPTOEngAccssoryDrive2 5;
BA_ "SAEDocument" SG_ 3221225472 EnggmntCnsntPTOEngAccssoryDrive1 "J1939-71";
BA_ "SPN" SG_ 3221225472 EnggmntCnsntPTOEngAccssoryDrive1 3943;
BA_ "SigType" SG_ 3221225472 EnggmntCnsntPTOEngAccssoryDrive1 5;
BA_ "SAEDocument" SG_ 3221225472 EngagementConsentPTOEngFlywheel "J1939-71";
BA_ "SPN" SG_ 3221225472 EngagementConsentPTOEngFlywheel 3940;
BA_ "SigType" SG_ 3221225472 EngagementConsentPTOEngFlywheel 5;
BA_ "SAEDocument" SG_ 3221225472 EnggmntCnsentTransInputShaftPTO1 "J1939-71";
BA_ "SPN" SG_ 3221225472 EnggmntCnsentTransInputShaftPTO1 3456;
BA_ "SigType" SG_ 3221225472 EnggmntCnsentTransInputShaftPTO1 5;
BA_ "SAEDocument" SG_ 3221225472 EnggmntCnsentTransInputShaftPTO2 "J1939-71";
BA_ "SPN" SG_ 3221225472 EnggmntCnsentTransInputShaftPTO2 3457;
BA_ "SigType" SG_ 3221225472 EnggmntCnsentTransInputShaftPTO2 5;
BA_ "SAEDocument" SG_ 3221225472 EnggmntCnsentTransOutputShaftPTO "J1939-71";
BA_ "SPN" SG_ 3221225472 EnggmntCnsentTransOutputShaftPTO 3458;
BA_ "SigType" SG_ 3221225472 EnggmntCnsentTransOutputShaftPTO 5;
BA_ "SAEDocument" SG_ 3221225472 EnggmntCnsntTrnsfrCsOtptShaftPTO "J1939-71";
BA_ "SPN" SG_ 3221225472 EnggmntCnsntTrnsfrCsOtptShaftPTO 3459;
BA_ "SigType" SG_ 3221225472 EnggmntCnsntTrnsfrCsOtptShaftPTO 5;
BA_ "SAEDocument" SG_ 3221225472 EnbleSwitchPTOEngAccessoryDrive2 "J1939-71";
BA_ "SPN" SG_ 3221225472 EnbleSwitchPTOEngAccessoryDrive2 3945;
BA_ "SigType" SG_ 3221225472 EnbleSwitchPTOEngAccessoryDrive2 5;
BA_ "SAEDocument" SG_ 3221225472 EnbleSwitchPTOEngAccessoryDrive1 "J1939-71";
BA_ "SPN" SG_ 3221225472 EnbleSwitchPTOEngAccessoryDrive1 3942;
BA_ "SigType" SG_ 3221225472 EnbleSwitchPTOEngAccessoryDrive1 5;
BA_ "SAEDocument" SG_ 3221225472 EnableSwitchPTOEngFlywheel "J1939-71";
BA_ "SPN" SG_ 3221225472 EnableSwitchPTOEngFlywheel 3939;
BA_ "SigType" SG_ 3221225472 EnableSwitchPTOEngFlywheel 5;
BA_ "SAEDocument" SG_ 3221225472 EnableSwitchTransInputShaftPTO1 "J1939-71";
BA_ "SPN" SG_ 3221225472 EnableSwitchTransInputShaftPTO1 3452;
BA_ "SigType" SG_ 3221225472 EnableSwitchTransInputShaftPTO1 5;
BA_ "SAEDocument" SG_ 3221225472 EnableSwitchTransInputShaftPTO2 "J1939-71";
BA_ "SPN" SG_ 3221225472 EnableSwitchTransInputShaftPTO2 3453;
BA_ "SigType" SG_ 3221225472 EnableSwitchTransInputShaftPTO2 5;
BA_ "SAEDocument" SG_ 3221225472 EnableSwitchTransOutputShaftPTO "J1939-71";
BA_ "SPN" SG_ 3221225472 EnableSwitchTransOutputShaftPTO 3454;
BA_ "SigType" SG_ 3221225472 EnableSwitchTransOutputShaftPTO 5;
BA_ "SAEDocument" SG_ 3221225472 EnblSwtchTrnsfrCseOutputShaftPTO "J1939-71";
BA_ "SPN" SG_ 3221225472 EnblSwtchTrnsfrCseOutputShaftPTO 3455;
BA_ "SigType" SG_ 3221225472 EnblSwtchTrnsfrCseOutputShaftPTO 5;
BA_ "SAEDocument" SG_ 3221225472 EngFuelValve2OutletAbsPress "J1939-71";
BA_ "SPN" SG_ 3221225472 EngFuelValve2OutletAbsPress 3469;
BA_ "SigType" SG_ 3221225472 EngFuelValve2OutletAbsPress 1;
BA_ "SAEDocument" SG_ 3221225472 EngFuelTemp2 "J1939-71";
BA_ "SPN" SG_ 3221225472 EngFuelTemp2 3468;
BA_ "SigType" SG_ 3221225472 EngFuelTemp2 1;
BA_ "SAEDocument" SG_ 3221225472 EngGas2MassFlowRate "J1939-71";
BA_ "SPN" SG_ 3221225472 EngGas2MassFlowRate 3467;
BA_ "SigType" SG_ 3221225472 EngGas2MassFlowRate 1;
BA_ "SAEDocument" SG_ 3221225472 EngFuelValve2IntakeAbsPress "J1939-71";
BA_ "SPN" SG_ 3221225472 EngFuelValve2IntakeAbsPress 3466;
BA_ "SigType" SG_ 3221225472 EngFuelValve2IntakeAbsPress 1;
BA_ "SAEDocument" SG_ 3221225472 EngCentrifugalOilFilterSpeed "J1939-71";
BA_ "SPN" SG_ 3221225472 EngCentrifugalOilFilterSpeed 3343;
BA_ "SigType" SG_ 3221225472 EngCentrifugalOilFilterSpeed 1;
BA_ "SAEDocument" SG_ 3221225472 EngCoolantPumpDiffPress "J1939-71";
BA_ "SPN" SG_ 3221225472 EngCoolantPumpDiffPress 3342;
BA_ "SigType" SG_ 3221225472 EngCoolantPumpDiffPress 1;
BA_ "SAEDocument" SG_ 3221225472 EngChargeAirCooler2IntakePress "J1939-71";
BA_ "SPN" SG_ 3221225472 EngChargeAirCooler2IntakePress 3341;
BA_ "SigType" SG_ 3221225472 EngChargeAirCooler2IntakePress 1;
BA_ "SAEDocument" SG_ 3221225472 EngChargeAirCooler1IntakePress "J1939-71";
BA_ "SPN" SG_ 3221225472 EngChargeAirCooler1IntakePress 3340;
BA_ "SigType" SG_ 3221225472 EngChargeAirCooler1IntakePress 1;
BA_ "SAEDocument" SG_ 3221225472 EngIntercoolerCoolantLevel "J1939-71";
BA_ "SPN" SG_ 3221225472 EngIntercoolerCoolantLevel 3668;
BA_ "SigType" SG_ 3221225472 EngIntercoolerCoolantLevel 1;
BA_ "SAEDocument" SG_ 3221225472 EngChargeAirCoolerOutletPress "J1939-71";
BA_ "SPN" SG_ 3221225472 EngChargeAirCoolerOutletPress 2631;
BA_ "SigType" SG_ 3221225472 EngChargeAirCoolerOutletPress 1;
BA_ "SAEDocument" SG_ 3221225472 EngAftercoolerCoolantLevel "J1939-71";
BA_ "SPN" SG_ 3221225472 EngAftercoolerCoolantLevel 3676;
BA_ "SigType" SG_ 3221225472 EngAftercoolerCoolantLevel 1;
BA_ "SAEDocument" SG_ 3221225472 EngVriableGeometryTurboActuator1 "J1939-71";
BA_ "SPN" SG_ 3221225472 EngVriableGeometryTurboActuator1 641;
BA_ "SAEDocument" SG_ 3221225472 EngTrbCmprssrBypssActtr1TmpSttus "J1939-71";
BA_ "SPN" SG_ 3221225472 EngTrbCmprssrBypssActtr1TmpSttus 5368;
BA_ "SAEDocument" SG_ 3221225472 EngTrbCmprssrBypssActtr1PrlmnryF "J1939-71";
BA_ "SPN" SG_ 3221225472 EngTrbCmprssrBypssActtr1PrlmnryF 5367;
BA_ "SAEDocument" SG_ 3221225472 EngTrbCmprssorBypassActuator2Cmd "J1939-71";
BA_ "SPN" SG_ 3221225472 EngTrbCmprssorBypassActuator2Cmd 5369;
BA_ "SAEDocument" SG_ 3221225472 EngTrbCmprssorBypassActuator1Pos "J1939-71";
BA_ "SPN" SG_ 3221225472 EngTrbCmprssorBypassActuator1Pos 3675;
BA_ "SigType" SG_ 3221225472 EngTrbCmprssorBypassActuator1Pos 1;
BA_ "SAEDocument" SG_ 3221225472 EngTrbCmprssorBypassActuator1Cmd "J1939-71";
BA_ "SPN" SG_ 3221225472 EngTrbCmprssorBypassActuator1Cmd 3470;
BA_ "SAEDocument" SG_ 3221225472 EngDsrdTrbCmprssrBypssActtor1Pos "J1939-71";
BA_ "SPN" SG_ 3221225472 EngDsrdTrbCmprssrBypssActtor1Pos 5366;
BA_ "SigType" SG_ 3221225472 EngDsrdTrbCmprssrBypssActtor1Pos 1;
BA_ "SAEDocument" SG_ 3221225472 EnableStatusOfDoor10 "J1939-71";
BA_ "SPN" SG_ 3221225472 EnableStatusOfDoor10 3441;
BA_ "SigType" SG_ 3221225472 EnableStatusOfDoor10 4;
BA_ "SAEDocument" SG_ 3221225472 OpenStatusOfDoor10 "J1939-71";
BA_ "SPN" SG_ 3221225472 OpenStatusOfDoor10 3440;
BA_ "SigType" SG_ 3221225472 OpenStatusOfDoor10 4;
BA_ "SAEDocument" SG_ 3221225472 LockStatusOfDoor10 "J1939-71";
BA_ "SPN" SG_ 3221225472 LockStatusOfDoor10 3439;
BA_ "SigType" SG_ 3221225472 LockStatusOfDoor10 4;
BA_ "SAEDocument" SG_ 3221225472 EnableStatusOfDoor9 "J1939-71";
BA_ "SPN" SG_ 3221225472 EnableStatusOfDoor9 3438;
BA_ "SigType" SG_ 3221225472 EnableStatusOfDoor9 4;
BA_ "SAEDocument" SG_ 3221225472 OpenStatusOfDoor9 "J1939-71";
BA_ "SPN" SG_ 3221225472 OpenStatusOfDoor9 3437;
BA_ "SigType" SG_ 3221225472 OpenStatusOfDoor9 4;
BA_ "SAEDocument" SG_ 3221225472 LockStatusOfDoor9 "J1939-71";
BA_ "SPN" SG_ 3221225472 LockStatusOfDoor9 3436;
BA_ "SigType" SG_ 3221225472 LockStatusOfDoor9 4;
BA_ "SAEDocument" SG_ 3221225472 EnableStatusOfDoor8 "J1939-71";
BA_ "SPN" SG_ 3221225472 EnableStatusOfDoor8 3435;
BA_ "SigType" SG_ 3221225472 EnableStatusOfDoor8 4;
BA_ "SAEDocument" SG_ 3221225472 OpenStatusOfDoor8 "J1939-71";
BA_ "SPN" SG_ 3221225472 OpenStatusOfDoor8 3434;
BA_ "SigType" SG_ 3221225472 OpenStatusOfDoor8 4;
BA_ "SAEDocument" SG_ 3221225472 LockStatusOfDoor8 "J1939-71";
BA_ "SPN" SG_ 3221225472 LockStatusOfDoor8 3433;
BA_ "SigType" SG_ 3221225472 LockStatusOfDoor8 4;
BA_ "SAEDocument" SG_ 3221225472 EnableStatusOfDoor7 "J1939-71";
BA_ "SPN" SG_ 3221225472 EnableStatusOfDoor7 3432;
BA_ "SigType" SG_ 3221225472 EnableStatusOfDoor7 4;
BA_ "SAEDocument" SG_ 3221225472 OpenStatusOfDoor7 "J1939-71";
BA_ "SPN" SG_ 3221225472 OpenStatusOfDoor7 3431;
BA_ "SigType" SG_ 3221225472 OpenStatusOfDoor7 4;
BA_ "SAEDocument" SG_ 3221225472 LockStatusOfDoor7 "J1939-71";
BA_ "SPN" SG_ 3221225472 LockStatusOfDoor7 3430;
BA_ "SigType" SG_ 3221225472 LockStatusOfDoor7 4;
BA_ "SAEDocument" SG_ 3221225472 EnableStatusOfDoor6 "J1939-71";
BA_ "SPN" SG_ 3221225472 EnableStatusOfDoor6 3429;
BA_ "SigType" SG_ 3221225472 EnableStatusOfDoor6 4;
BA_ "SAEDocument" SG_ 3221225472 OpenStatusOfDoor6 "J1939-71";
BA_ "SPN" SG_ 3221225472 OpenStatusOfDoor6 3428;
BA_ "SigType" SG_ 3221225472 OpenStatusOfDoor6 4;
BA_ "SAEDocument" SG_ 3221225472 LockStatusOfDoor6 "J1939-71";
BA_ "SPN" SG_ 3221225472 LockStatusOfDoor6 3427;
BA_ "SigType" SG_ 3221225472 LockStatusOfDoor6 4;
BA_ "SAEDocument" SG_ 3221225472 EnableStatusOfDoor5 "J1939-71";
BA_ "SPN" SG_ 3221225472 EnableStatusOfDoor5 3426;
BA_ "SigType" SG_ 3221225472 EnableStatusOfDoor5 4;
BA_ "SAEDocument" SG_ 3221225472 OpenStatusOfDoor5 "J1939-71";
BA_ "SPN" SG_ 3221225472 OpenStatusOfDoor5 3425;
BA_ "SigType" SG_ 3221225472 OpenStatusOfDoor5 4;
BA_ "SAEDocument" SG_ 3221225472 LockStatusOfDoor5 "J1939-71";
BA_ "SPN" SG_ 3221225472 LockStatusOfDoor5 3424;
BA_ "SigType" SG_ 3221225472 LockStatusOfDoor5 4;
BA_ "SAEDocument" SG_ 3221225472 EnableStatusOfDoor4 "J1939-71";
BA_ "SPN" SG_ 3221225472 EnableStatusOfDoor4 3423;
BA_ "SigType" SG_ 3221225472 EnableStatusOfDoor4 4;
BA_ "SAEDocument" SG_ 3221225472 OpenStatusOfDoor4 "J1939-71";
BA_ "SPN" SG_ 3221225472 OpenStatusOfDoor4 3422;
BA_ "SigType" SG_ 3221225472 OpenStatusOfDoor4 4;
BA_ "SAEDocument" SG_ 3221225472 LockStatusOfDoor4 "J1939-71";
BA_ "SPN" SG_ 3221225472 LockStatusOfDoor4 3421;
BA_ "SigType" SG_ 3221225472 LockStatusOfDoor4 4;
BA_ "SAEDocument" SG_ 3221225472 EnableStatusOfDoor3 "J1939-71";
BA_ "SPN" SG_ 3221225472 EnableStatusOfDoor3 3420;
BA_ "SigType" SG_ 3221225472 EnableStatusOfDoor3 4;
BA_ "SAEDocument" SG_ 3221225472 OpenStatusOfDoor3 "J1939-71";
BA_ "SPN" SG_ 3221225472 OpenStatusOfDoor3 3419;
BA_ "SigType" SG_ 3221225472 OpenStatusOfDoor3 4;
BA_ "SAEDocument" SG_ 3221225472 LockStatusOfDoor3 "J1939-71";
BA_ "SPN" SG_ 3221225472 LockStatusOfDoor3 3418;
BA_ "SigType" SG_ 3221225472 LockStatusOfDoor3 4;
BA_ "SAEDocument" SG_ 3221225472 EnableStatusOfDoor2 "J1939-71";
BA_ "SPN" SG_ 3221225472 EnableStatusOfDoor2 3417;
BA_ "SigType" SG_ 3221225472 EnableStatusOfDoor2 4;
BA_ "SAEDocument" SG_ 3221225472 OpenStatusOfDoor2 "J1939-71";
BA_ "SPN" SG_ 3221225472 OpenStatusOfDoor2 3416;
BA_ "SigType" SG_ 3221225472 OpenStatusOfDoor2 4;
BA_ "SAEDocument" SG_ 3221225472 LockStatusOfDoor2 "J1939-71";
BA_ "SPN" SG_ 3221225472 LockStatusOfDoor2 3415;
BA_ "SigType" SG_ 3221225472 LockStatusOfDoor2 4;
BA_ "SAEDocument" SG_ 3221225472 EnableStatusOfDoor1 "J1939-71";
BA_ "SPN" SG_ 3221225472 EnableStatusOfDoor1 3414;
BA_ "SigType" SG_ 3221225472 EnableStatusOfDoor1 4;
BA_ "SAEDocument" SG_ 3221225472 OpenStatusOfDoor1 "J1939-71";
BA_ "SPN" SG_ 3221225472 OpenStatusOfDoor1 3413;
BA_ "SigType" SG_ 3221225472 OpenStatusOfDoor1 4;
BA_ "SAEDocument" SG_ 3221225472 LockStatusOfDoor1 "J1939-71";
BA_ "SPN" SG_ 3221225472 LockStatusOfDoor1 3412;
BA_ "SigType" SG_ 3221225472 LockStatusOfDoor1 4;
BA_ "SAEDocument" SG_ 3221225472 Aftrtrtmnt1SCRCtlystRgntTmp2Prlm "J1939-71";
BA_ "SPN" SG_ 3221225472 Aftrtrtmnt1SCRCtlystRgntTmp2Prlm 3519;
BA_ "SAEDocument" SG_ 3221225472 Aftrtrtmnt1SCRCtlystRgntPrprtsPr "J1939-71";
BA_ "SPN" SG_ 3221225472 Aftrtrtmnt1SCRCtlystRgntPrprtsPr 3520;
BA_ "SAEDocument" SG_ 3221225472 Aftrtrtmnt1SCRCtlystRgntCndctvty "J1939-71";
BA_ "SPN" SG_ 3221225472 Aftrtrtmnt1SCRCtlystRgntCndctvty 3518;
BA_ "SigType" SG_ 3221225472 Aftrtrtmnt1SCRCtlystRgntCndctvty 1;
BA_ "SAEDocument" SG_ 3221225472 Aftrtrtmnt1SCRCtlystRgntCncntrtn "J1939-71";
BA_ "SPN" SG_ 3221225472 Aftrtrtmnt1SCRCtlystRgntCncntrtn 3516;
BA_ "SigType" SG_ 3221225472 Aftrtrtmnt1SCRCtlystRgntCncntrtn 1;
BA_ "SAEDocument" SG_ 3221225472 Aftrtrtmnt1SCRCtalystReagentType "J1939-71";
BA_ "SPN" SG_ 3221225472 Aftrtrtmnt1SCRCtalystReagentType 3521;
BA_ "SAEDocument" SG_ 3221225472 Aftrtrtmnt1SCRCtlystReagentTemp2 "J1939-71";
BA_ "SPN" SG_ 3221225472 Aftrtrtmnt1SCRCtlystReagentTemp2 3515;
BA_ "SigType" SG_ 3221225472 Aftrtrtmnt1SCRCtlystReagentTemp2 1;
BA_ "SAEDocument" SG_ 3221225472 RqdGnrtrAvrgLneLineACRMSVoltage "J1939-75";
BA_ "SPN" SG_ 3221225472 RqdGnrtrAvrgLneLineACRMSVoltage 3386;
BA_ "SigType" SG_ 3221225472 RqdGnrtrAvrgLneLineACRMSVoltage 1;
VAL_ 3221225472 Jystck10GrpXAxsLvrRghtPstvPsStts 3 "Not Available" 2 "Error Indicator" 1 "On positive side of Neutral" 0 "Not on Positive side of Neutral" ;
VAL_ 3221225472 Jystck10GrpXAxsLvrLftNgtvPsSttus 3 "Not Available" 2 "Error Indicator" 1 "On negative side of Neutral" 0 "Not on negative side of Neutral" ;
VAL_ 3221225472 Jystck10GrpXAxisNeutralPosStatus 3 "Not Available" 2 "Error Indicator" 1 "In Neutral Position" 0 "Not in Neutral Position" ;
VAL_ 3221225472 DslPrtcltFltrActvRgnrtnFrcdSttus 5 "Reserved for SAE Assignment" 4 "Reserved for SAE Assignment" 7 "not available" 6 "Reserved for SAE Assignment" 2 "Active  Forced by Service Tool" 3 "Reserved for SAE Assignment" 1 "Active  Forced by Switch See SPN 3696" 0 "Not Active" ;
VAL_ 3221225472 ExhaustSystemHighTempLampCmd 7 "not available" 6 "reserved for SAE assignment" 1 "On  solid" 0 "Off" 5 "reserved for SAE assignment" 4 "reserved for SAE assignment" 3 "reserved for SAE assignment" 2 "reserved for SAE assignment" ;
VAL_ 3221225472 DslPrtcltFltrAtmtcActvRgnrtnIntt 3 "not available" 2 "reserved for SAE assignment" 1 "enabled" 0 "not enabled" ;
VAL_ 3221225472 DslPrtcltFltrActvRgnrtnInhbtdDTV 3 "notAvailable" 2 "reservedForSAEAssignment" 1 "inhibited" 0 "notInhibited" ;
VAL_ 3221225472 DslPrtcltFltrActvRgnrtnInhbtdDTE 3 "notAvailable" 2 "reservedForSAEAssignment" 1 "inhibited" 0 "notInhibited" ;
VAL_ 3221225472 DslPrtcltFltrActvRgnrtnInhb_0000 3 "notAvailable" 2 "reservedForSAEAssignment" 1 "inhibited" 0 "notInhibited" ;
VAL_ 3221225472 DslPrtcltFltrActvRgnrtnInhbtdDTT 3 "not available" 2 "reserved for SAE assignment" 1 "inhibited" 0 "not inhibited" ;
VAL_ 3221225472 DslPrtcltFltrActvRgnrtnInhbtdDTS 3 "not available" 2 "reserved for SAE assignment" 1 "inhibited" 0 "not inhibited" ;
VAL_ 3221225472 DslPrtcltFltrActvRgnrtnInhbtdDTL 3 "not available" 2 "reserved for SAE assignment" 1 "inhibited" 0 "not inhibited" ;
VAL_ 3221225472 DslPrtcltFltrActvRgnrtnInhb_0001 3 "notAvailable" 2 "reservedForSAEAssignment" 1 "inhibited" 0 "notInhibited" ;
VAL_ 3221225472 DslPrtcltFltrActvRgnrtnInhb_0002 3 "notAvailable" 2 "reservedForSAEAssignment" 1 "inhibited" 0 "notInhibited" ;
VAL_ 3221225472 DslPrtcltFltrActvRgnrtnInhbtdDTO 3 "notAvailable" 2 "reservedForSAEAssignment" 1 "inhibited" 0 "notInhibited" ;
VAL_ 3221225472 DslPrtcltFltrActvRgnrtnInhbtdDTA 3 "not available" 2 "reserved for SAE assignment" 1 "inhibited" 0 "not inhibited" ;
VAL_ 3221225472 DslPrtcltFltrActvRgnrtnInhbtdDTP 3 "not available" 2 "reserved for SAE assignment" 1 "inhibited" 0 "not inhibited" ;
VAL_ 3221225472 DslPrtcltFltrActvRgnrtnInhbtdDTC 3 "not available" 2 "reserved for SAE assignment" 1 "inhibited" 0 "not inhibited" ;
VAL_ 3221225472 DslPrtcltFltrActvRgnrtnInhbtdDTI 3 "not available" 2 "reserved for SAE assignment" 1 "inhibited" 0 "not inhibited" ;
VAL_ 3221225472 DslPrtcltFltrActvRgnrtnInhbtdStt 3 "not available" 2 "reserved for SAE assignment" 1 "inhibited" 0 "not inhibited" ;
VAL_ 3221225472 DieselParticulateFilterStatus 7 "not available" 6 "reserved for SAE assignment" 3 "Regeneration needed  highest level" 2 "Regeneration needed  moderate level" 1 "Regeneration needed  lowest level" 0 "Regeneration not needed" 5 "reserved for SAE assignment" 4 "reserved for SAE assignment" ;
VAL_ 3221225472 DslPrtcltFltrActvRgnrationStatus 3 "not available" 2 "regeneration needed  automatically initiated active regeneration imminent" 1 "active" 0 "not active" ;
VAL_ 3221225472 DslPrtcltFltrPssvRgnrationStatus 3 "not available" 2 "reserved for SAE assignment" 1 "active" 0 "not active" ;
VAL_ 3221225472 DieselParticulateFilterLampCmd 7 "not available" 4 "On  fast blink 1 HZ" 6 "reserved for SAE assignment" 1 "On  solid" 0 "Off" 5 "reserved for SAE assignment" 3 "reserved for SAE assignment" 2 "reserved for SAE assignment" ;
VAL_ 3221225472 VehicleBatteryChargingLampData 3 "Not available" 2 "Error" 1 "Lamp activated On" 0 "Lamp deactivated Off" ;
VAL_ 3221225472 VehicleHVACRecirculationLampData 3 "Not available" 2 "Error" 1 "Lamp activated On" 0 "Lamp deactivated Off" ;
VAL_ 3221225472 VehicleAirPressLowLampData 3 "Not available" 2 "Error" 1 "Lamp activated On" 0 "Lamp deactivated Off" ;
VAL_ 3221225472 VehicleFuelLevelLowLampData 3 "Not available" 2 "Error" 1 "Lamp activated On" 0 "Lamp deactivated Off" ;
VAL_ 3221225472 VehicleBatteryVoltageLowLampData 3 "Not available" 2 "Error" 1 "Lamp activated On" 0 "Lamp deactivated Off" ;
VAL_ 3221225472 EngWaitToStartLampData 3 "Not available" 2 "Error" 1 "Lamp active" 0 "Lamp deactive" ;
VAL_ 3221225472 EngFuelFilterRestrictedLampData 3 "Not available" 2 "Error" 1 "Lamp activated On" 0 "Lamp deactivated Off" ;
VAL_ 3221225472 EngAirFilterRestrictionLampData 3 "Not available" 2 "Error" 1 "Lamp activated On" 0 "Lamp deactivated Off" ;
VAL_ 3221225472 EngIdleManagementActiveLampData 3 "Not available" 2 "Error" 1 "Lamp activated On" 0 "Lamp deactivated Off" ;
VAL_ 3221225472 EngCoolantLevelLowLampData 3 "Not available" 2 "Error" 1 "Lamp activated On" 0 "Lamp deactivated Off" ;
VAL_ 3221225472 EngCoolantTempHighLampData 3 "Not available" 2 "Error" 1 "Lamp activated On" 0 "Lamp deactivated Off" ;
VAL_ 3221225472 EngOilPressLowLampData 3 "Not available" 2 "Error" 1 "Lamp activated On" 0 "Lamp deactivated Off" ;
VAL_ 3221225472 CmprssnBrkEnblSwtchIndctrLmpData 3 "Not available" 2 "Error" 1 "Lamp activated On" 0 "Lamp deactivated Off" ;
VAL_ 3221225472 EngBrakeActiveLampData 3 "Not available" 2 "Error" 1 "Lamp activated On" 0 "Lamp deactivated Off" ;
VAL_ 3221225472 OBDMalfunctionIndicatorLampData 3 "Not available" 2 "Error" 1 "Lamp activated On" 0 "Lamp deactivated Off" ;
VAL_ 3221225472 EngRedStopLampData 3 "Not available" 2 "Error" 1 "Lamp activated On" 0 "Lamp deactivated Off" ;
VAL_ 3221225472 EngAmberWarningLampData 3 "Not available" 2 "Error" 1 "Lamp activated On" 0 "Lamp deactivated Off" ;
VAL_ 3221225472 EngProtectLampData 3 "Not available" 2 "Error" 1 "Lamp activated On" 0 "Lamp deactivated Off" ;
VAL_ 3221225472 VehicleBatteryChargingLampCmd 3 "Not available" 2 "Reserved" 1 "Lamp On" 0 "Lamp Off" ;
VAL_ 3221225472 VehicleHVACRecirculationLampCmd 3 "Not available" 2 "Reserved" 1 "Lamp On" 0 "Lamp Off" ;
VAL_ 3221225472 VehicleAirPressLowLampCmd 3 "Not available" 2 "Reserved" 1 "Lamp On" 0 "Lamp Off" ;
VAL_ 3221225472 VehicleFuelLevelLowLampCmd 3 "Not available" 2 "Reserved" 1 "Lamp On" 0 "Lamp Off" ;
VAL_ 3221225472 VehicleBatteryVoltageLowLampCmd 3 "Not available" 2 "Reserved" 1 "Lamp On" 0 "Lamp Off" ;
VAL_ 3221225472 FailureModeIdentifier1 31 "Not available" 19 "Received network data in error" 18 "Below normal (moderately severe)" 17 "Below normal (least severe)" 16 "Above normal (moderately severe)" 15 "Above normal (least severe)" 14 "Special intstructions" 13 "Out of calibration" 12 "Bad intelligent device" 11 "Root cause not known" 10 "Abnormal rate of change" 9 "Abnormal update rate" 8 "Abnormal frequency" 7 "Mechanical system not responding" 6 "Current above normal" 5 "Current below normal" 4 "Voltage below normal" 3 "Voltage above normal" 2 "Data erratic" 1 "Below normal (most severe)" 0 "Above normal (most severe)" ;
VAL_ 3221225472 TextDisplayInstructions 6 "Blink substring" 15 "Not applicable" 1 "Hold display  The presently displayed information should be retained" 0 "Clear display  The displayed information should be deleted or not displayed any more" 5 "Highlight substring" 4 "Overwrite substring  A portion of the presently displayed information is to be overwritten with the transmitted" 3 "Overwrite display  The presently displayed information is to be overwritten with the transmitted information" 2 "Append at end of display  The transmitted information should be displayed at the end of the presently displayed" ;
VAL_ 3221225472 RetractStatusOfRamp5 2 "error" 1 "ramp extended" 0 "ramp retracted" 3 "not available" ;
VAL_ 3221225472 RetractStatusOfRamp4 3 "not available" 2 "error" 1 "ramp extended" 0 "ramp retracted" ;
VAL_ 3221225472 MovementStatusOfRamp5 3 "not available" 2 "error" 1 "ramp being moved" 0 "ramp not being moved" ;
VAL_ 3221225472 MovementStatusOfRamp4 3 "not available" 2 "error" 1 "ramp being moved" 0 "ramp not being moved" ;
VAL_ 3221225472 EnableStatusOfRamp5 3 "not available" 2 "error" 1 "ramp enabled" 0 "ramp disabled" ;
VAL_ 3221225472 EnableStatusOfRamp4 3 "not available" 2 "error" 1 "ramp enabled" 0 "ramp disabled" ;
VAL_ 3221225472 MovementStatusOfRamp3 3 "not available" 2 "error" 1 "ramp being moved" 0 "ramp not being moved" ;
VAL_ 3221225472 EnableStatusOfRamp3 3 "not available" 2 "error" 1 "ramp enabled" 0 "ramp disabled" ;
VAL_ 3221225472 RetractStatusOfRamp3 3 "not available" 2 "error" 1 "ramp extended" 0 "ramp retracted" ;
VAL_ 3221225472 MovementStatusOfRamp2 3 "not available" 2 "error" 1 "ramp being moved" 0 "ramp not being moved" ;
VAL_ 3221225472 EnableStatusOfRamp2 3 "not available" 2 "error" 1 "ramp enabled" 0 "ramp disabled" ;
VAL_ 3221225472 RetractStatusOfRamp2 3 "not available" 2 "error" 1 "ramp extended" 0 "ramp retracted" ;
VAL_ 3221225472 MovementStatusOfRamp1 3 "not available" 2 "error" 1 "ramp being moved" 0 "ramp not being moved" ;
VAL_ 3221225472 EnableStatusOfRamp1 3 "not available" 2 "error" 1 "ramp enabled" 0 "ramp disabled" ;
VAL_ 3221225472 RetractStatusOfRamp1 3 "not available" 2 "error" 1 "ramp extended" 0 "ramp retracted" ;
VAL_ 3221225472 LaneDepartureWarningEnableCmd 3 "Dont care" 2 "Reserved" 1 "Enable Lane Departure Warning" 0 "Disable Lane Departure Warning" ;
VAL_ 3221225472 SteerAngleSensorCalibrated 3 "Not available" 2 "Reserved" 1 "SAS calibrated" 0 "SAS not calibrated" ;
VAL_ 3221225472 SteerAngleSensorActiveMode 3 "Not available" 2 "Reserved" 1 "Normal mode active" 0 "Programming mode active" ;
VAL_ 3221225472 SteerWheelAngleRangeCounterType 3 "signal not available" 2 "not defined" 1 "absolute number of counts" 0 "relative number of counts" ;
VAL_ 3221225472 TransferCaseStatus 7 "not available" 3 "2 wheel low or Off Highway Range" 0 "2 wheel high normal or On Highway Range" 6 "error" 5 "Transfer Case Shift in Progress or gear not confirmed" 4 "4 wheel low or Off Highway Range" 2 "neutral" 1 "4 wheel high normal or On Highway Range" ;
VAL_ 3221225472 TransOverheatIndicator 3 "Not available" 2 "Transmission Overheat Indicator is flashing" 1 "Transmission Overheat Indicator is on continuously" 0 "Transmission Overheat Indicator is off" ;
VAL_ 3221225472 TransOilLevelSwitch 3 "Not available" 2 "Error" 1 "Full or not empty" 0 "Empty" ;
VAL_ 3221225472 TransOilFilterRestrictionSwitch 3 "Not available" 2 "Error" 1 "Restriction exists on oil filter" 0 "No restriction" ;
VAL_ 3221225472 LandLevelingSystemEnableStatus 3 "Not available / Not installed" 2 "Error" 0 "Disabled" ;
VAL_ 3221225472 BladeCtrlModeRight 15 "Not Available" 14 "Error" 2 "Inactive Auto" 1 "Auto" 0 "Manual" ;
VAL_ 3221225472 BladeCtrlModeLeft 15 "Not Available" 14 "Error" 2 "Inactive Auto" 1 "Auto" 0 "Manual" ;
VAL_ 3221225472 BladeCtrlMode 2 "Inactive automatic mode" 1 "Automatic mode" 0 "Manual mode" ;
VAL_ 3221225472 EngOprtrPrmryIntrmdtSpdSlctState 15 "not available" 14 "SAE reserved" 1 "thru 1101  Control state is ISC Setting 1 thru 13 in sequential order" 0 "Control state is ISC functionality is not requested engine operates normally" ;
VAL_ 3221225472 EngOprtrPrmryIntrmdteSpeedSelect 15 "not available" 14 "error condition" 1 "thru 1101  indicates that the ISC Setting 1 thru 13 in sequential order is selected" 0 "indicates that the ISC functionality is not requested engine operates normally" ;
VAL_ 3221225472 CabHeatingZone 3 "Not available" 2 "Reserved" 1 "Cab heating zone on" 0 "Cab heating zone off" ;
VAL_ 3221225472 EngHeatingZone 3 "Not available" 2 "Reserved" 1 "Engine heating zone on" 0 "Engine heating zone off" ;
VAL_ 3221225472 CabVentilation 3 "Not available" 2 "Reserved" 1 "Cab is ventilated" 0 "Cab not ventilated" ;
VAL_ 3221225472 AuxHeaterWaterPumpStatus 3 "Not available" 2 "Reserved" 1 "Water Pump is running" 0 "Water Pump is not running" ;
VAL_ 3221225472 AuxHeaterMode 15 "Not available" 14 "Error" 3 "Normal mode" 2 "Economy mode" 1 "Off due to ADR per European Regulations for Transport of hazardous materials" 0 "Heater not active" ;
VAL_ 3221225472 FireApparatusPumpEngagement 3 "Not available or not installed" 2 "Error" 1 "Pump engaged" 0 "Pump not engaged" ;
VAL_ 3221225472 EngHydPressGovernorSwitch 3 "Not Available" 2 "Error Indicator" 1 "Pressure Mode Active" 0 "Pressure Mode Inactive" ;
VAL_ 3221225472 EngHydPressGovernorModeIndicator 3 "Not Available" 2 "Error Indicator" 1 "Enabled" 0 "Disabled" ;
VAL_ 3221225472 HydBrakeFluidLevelSwitch 3 "Not available" 2 "Error indicator" 1 "Fluid level is sufficient" 0 "Fluid level is not sufficient" ;
VAL_ 3221225472 HydBrakeSystemAudibleWarningCmd 3 "Dont care" 2 "Reserved" 1 "Audible warning on" 0 "Audible warning off" ;
VAL_ 3221225472 HydBrakePressSupplyStateCircuit2 3 "Not available" 2 "Error indicator" 1 "Supply is reliable" 0 "Supply is not reliable" ;
VAL_ 3221225472 HydBrakePressSupplyStateCircuit1 3 "Not available" 2 "Error indicator" 1 "Supply is reliable" 0 "Supply is not reliable" ;
VAL_ 3221225472 HydBrkePressWarningStateCircuit2 3 "Not available" 2 "Error indicator" 1 "Pressure level below warning level" 0 "Pressure level sufficient" ;
VAL_ 3221225472 HydBrkePressWarningStateCircuit1 3 "Not available" 2 "Error indicator" 1 "Pressure level below warning level" 0 "Pressure level sufficient" ;
VAL_ 3221225472 AtLeastOnePTOEngaged 3 "Not available" 2 "Error" 1 "At least one PTO drive is engaged" 0 "No PTO drive is engaged" ;
VAL_ 3221225472 EnggmntSttsPTOEngAccessoryDrive2 3 "Not available" 2 "Error" 1 "Drive engaged" 0 "Drive not engaged" ;
VAL_ 3221225472 EnggmntSttsPTOEngAccessoryDrive1 3 "Not available" 2 "Error" 1 "Drive engaged" 0 "Drive not engaged" ;
VAL_ 3221225472 EngagementStatusPTOEngFlywheel 3 "Not available" 2 "Error" 1 "Drive engaged" 0 "Drive not engaged" ;
VAL_ 3221225472 EnggmntStatusTransInputShaftPTO1 3 "Not available" 2 "Error" 1 "Drive is engaged" 0 "Drive not engaged" ;
VAL_ 3221225472 EnggmntStatusTransInputShaftPTO2 3 "Not available" 2 "Error" 1 "Drive is engaged" 0 "Drive not engaged" ;
VAL_ 3221225472 EnggmntStatusTransOutputShaftPTO 3 "Not available" 2 "Error" 1 "Drive is engaged" 0 "Drive not engaged" ;
VAL_ 3221225472 EnggmntSttsTrnsfrCsOtputShaftPTO 3 "Not available" 2 "Error" 1 "Drive is engaged" 0 "Drive not engaged" ;
VAL_ 3221225472 EnggmntCnsntPTOEngAccssoryDrive2 3 "Not available" 2 "Error" 1 "Consent given  PTO drive may be engaged" 0 "Consent not given  PTO drive may not be engaged" ;
VAL_ 3221225472 EnggmntCnsntPTOEngAccssoryDrive1 3 "Not available" 2 "Error" 1 "Consent given  PTO drive may be engaged" 0 "Consent not given  PTO drive may not be engaged" ;
VAL_ 3221225472 EngagementConsentPTOEngFlywheel 3 "Not available" 2 "Error" 1 "Consent given  PTO drive may be engaged" 0 "Consent not given  PTO drive may not be engaged" ;
VAL_ 3221225472 EnggmntCnsentTransInputShaftPTO1 3 "Not available" 2 "Error" 1 "Consent given  PTO drive may be engaged" 0 "Consent not given  PTO drive should not be engaged" ;
VAL_ 3221225472 EnggmntCnsentTransInputShaftPTO2 3 "Not available" 2 "Error" 1 "Consent given  PTO drive may be engaged" 0 "Consent not given  PTO drive should not be engaged" ;
VAL_ 3221225472 EnggmntCnsentTransOutputShaftPTO 3 "Not available" 2 "Error" 1 "Consent given  PTO drive may be engaged" 0 "Consent not given  PTO drive should not be engaged" ;
VAL_ 3221225472 EnggmntCnsntTrnsfrCsOtptShaftPTO 3 "Not available" 2 "Error" 1 "Consent given  PTO drive may be engaged" 0 "Consent not given  PTO drive should not be engaged" ;
VAL_ 3221225472 EnbleSwitchPTOEngAccessoryDrive2 3 "Not available" 2 "Error" 1 "Enable switch on  PTO operation desired" 0 "Enable switch off  PTO operation not desired" ;
VAL_ 3221225472 EnbleSwitchPTOEngAccessoryDrive1 3 "Not available" 2 "Error" 1 "Enable switch on  PTO operation desired" 0 "Enable switch off  PTO operation not desired" ;
VAL_ 3221225472 EnableSwitchPTOEngFlywheel 3 "Not available" 2 "Error" 1 "Enable switch on  PTO operation desired" 0 "Enable switch off  PTO operation not desired" ;
VAL_ 3221225472 EnableSwitchTransInputShaftPTO1 3 "Not available" 2 "Error" 1 "Enable switch off  PTO operation desired" 0 "Enable switch off  PTO operation not desired" ;
VAL_ 3221225472 EnableSwitchTransInputShaftPTO2 3 "Not available" 2 "Error" 1 "Enable switch off  PTO operation desired" 0 "Enable switch off  PTO operation not desired" ;
VAL_ 3221225472 EnableSwitchTransOutputShaftPTO 3 "Not available" 2 "Error" 1 "Enable switch off  PTO operation desired" 0 "Enable switch off  PTO operation not desired" ;
VAL_ 3221225472 EnblSwtchTrnsfrCseOutputShaftPTO 3 "Not available" 2 "Error" 1 "Enable switch off  PTO operation desired" 0 "Enable switch off  PTO operation not desired" ;
VAL_ 3221225472 EngTrbCmprssrBypssActtr1TmpSttus 7 "Not available" 6 "Error" 5 "Not Defined" 4 "Low Most severe" 3 "Low Least severe" 2 "In Range" 1 "High Least severe" 0 "High Most severe" ;
VAL_ 3221225472 EnableStatusOfDoor10 3 "not available" 2 "error" 1 "door enabled" 0 "door disabled" ;
VAL_ 3221225472 OpenStatusOfDoor10 3 "not available" 2 "error" 1 "door opened" 0 "door closed" ;
VAL_ 3221225472 LockStatusOfDoor10 3 "not available" 2 "error" 1 "locked" 0 "unlocked" ;
VAL_ 3221225472 EnableStatusOfDoor9 3 "not available" 2 "error" 1 "door enabled" 0 "door disabled" ;
VAL_ 3221225472 OpenStatusOfDoor9 3 "not available" 2 "error" 1 "door opened" 0 "door closed" ;
VAL_ 3221225472 LockStatusOfDoor9 3 "not available" 2 "error" 1 "locked" 0 "unlocked" ;
VAL_ 3221225472 EnableStatusOfDoor8 3 "not available" 2 "error" 1 "door enabled" 0 "door disabled" ;
VAL_ 3221225472 OpenStatusOfDoor8 3 "not available" 2 "error" 1 "door opened" 0 "door closed" ;
VAL_ 3221225472 LockStatusOfDoor8 3 "not available" 2 "error" 1 "locked" 0 "unlocked" ;
VAL_ 3221225472 EnableStatusOfDoor7 3 "not available" 2 "error" 1 "door enabled" 0 "door disabled" ;
VAL_ 3221225472 OpenStatusOfDoor7 3 "not available" 2 "error" 1 "door opened" 0 "door closed" ;
VAL_ 3221225472 LockStatusOfDoor7 3 "not available" 2 "error" 1 "locked" 0 "unlocked" ;
VAL_ 3221225472 EnableStatusOfDoor6 3 "not available" 2 "error" 1 "door enabled" 0 "door disabled" ;
VAL_ 3221225472 OpenStatusOfDoor6 3 "not available" 2 "error" 1 "door opened" 0 "door closed" ;
VAL_ 3221225472 LockStatusOfDoor6 3 "not available" 2 "error" 1 "locked" 0 "unlocked" ;
VAL_ 3221225472 EnableStatusOfDoor5 3 "not available" 2 "error" 1 "door enabled" 0 "door disabled" ;
VAL_ 3221225472 OpenStatusOfDoor5 3 "not available" 2 "error" 1 "door opened" 0 "door closed" ;
VAL_ 3221225472 LockStatusOfDoor5 3 "not available" 2 "error" 1 "locked" 0 "unlocked" ;
VAL_ 3221225472 EnableStatusOfDoor4 3 "not available" 2 "error" 1 "door enabled" 0 "door disabled" ;
VAL_ 3221225472 OpenStatusOfDoor4 3 "not available" 2 "error" 1 "door opened" 0 "door closed" ;
VAL_ 3221225472 LockStatusOfDoor4 3 "not available" 2 "error" 1 "locked" 0 "unlocked" ;
VAL_ 3221225472 EnableStatusOfDoor3 3 "not available" 2 "error" 1 "door enabled" 0 "door disabled" ;
VAL_ 3221225472 OpenStatusOfDoor3 3 "not available" 2 "error" 1 "door opened" 0 "door closed" ;
VAL_ 3221225472 LockStatusOfDoor3 3 "not available" 2 "error" 1 "locked" 0 "unlocked" ;
VAL_ 3221225472 EnableStatusOfDoor2 3 "not available" 2 "error" 1 "door enabled" 0 "door disabled" ;
VAL_ 3221225472 OpenStatusOfDoor2 3 "not available" 2 "error" 1 "door opened" 0 "door closed" ;
VAL_ 3221225472 LockStatusOfDoor2 3 "not available" 2 "error" 1 "locked" 0 "unlocked" ;
VAL_ 3221225472 EnableStatusOfDoor1 3 "not available" 2 "error" 1 "door enabled" 0 "door disabled" ;
VAL_ 3221225472 OpenStatusOfDoor1 3 "not available" 2 "error" 1 "door opened" 0 "door closed" ;
VAL_ 3221225472 LockStatusOfDoor1 3 "not available" 2 "error" 1 "locked" 0 "unlocked" ;
VAL_ 3221225472 Aftrtrtmnt1SCRCtalystReagentType 15 "Not available" 14 "Error detected with urea reagent type detection" 13 "Not able to determine catalyst reagent type type unknown" 5 "to 1100  Reserved for SAE assignment" 3 "Catalyst reagent is proper mixture" 2 "Catalyst reagent is diesel" 1 "Catalyst reagent is urea concentration too low" 0 "Catalyst reagent is urea concentration too high" ;
