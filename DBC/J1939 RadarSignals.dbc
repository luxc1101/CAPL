VERSION ""

NS_ :

BS_:

BU_: Turbocharger OnBoardDataLogger OffBoardDiagnosticTool2 OffBoardDiagnosticTool1 FileServer ParkingBrakeController SeatControl2 FanDriveController SteeringColumnUnit CommunicationUnitRadio CommunicationUnitSatellite CommunicationUnitCellular PropulsionBatteryCharger ChassisController2 ChassisController1 EngineValveControl AuxiliaryHeater2 AuxiliaryHeater1 ClutchUnit RampControl InformationSystem1 SuspensionSystemController2 OilSensor VehicleDynamicStability ExhaustEmissionController TransmissionDisplay2 TransmissionDisplay1 ClimateControl2 WaterPumpController RearAxleSteeringController LightingOperatorControl SeatController1 IgnitionController2 IgnitionController1 TirePressureController CabController2 CabController1 PneumaticSystemController SuspensionSystemController1 HydraulicPumpController EnduranceBrakingSystem RetarderExhaustEngine2 OnBoardDiagnosticUnit HeadwayController RetarderExhaustEngine1 CabDisplay1 ManagementComputer VirtualTerminal OffVehicleGateway PowerTakeOffFront HitchControl AuxiliaryValveControl BodyController TractorTrailerBridge1 StarterSystem ElectricalSystem VehicleSecurity VehicleNavigation AerodynamicControl ElectricalChargingSystem ClimateControl1 TripRecorder InstrumentCluster SuspensionDriveAxle2 SuspensionDriveAxle1 SuspensionSteerAxle SteeringController FuelSystem CruiseControl RetarderDriveline RetarderEngine BrakesDriveAxle2 BrakesDriveAxle1 BrakesSystemController BrakesSteerAxle AxleDrive2 AxleDrive1 AxleSteering PowerTakeOff ShiftConsoleSecondary ShiftConsolePrimary Transmission2 Transmission1 Engine2 Engine1

BO_ 3221225472 VECTOR__INDEPENDENT_SIG_MSG: 0 Vector__XXX
 SG_ CTIWheelEndElectricalFault_12 : 0|2@1+ (1,0) [0|3] "" Vector__XXX
 SG_ CTIWheelEndElectricalFault_11 : 0|2@1+ (1,0) [0|3] "" Vector__XXX
 SG_ CTIWheelEndElectricalFault_10 : 0|2@1+ (1,0) [0|3] "" Vector__XXX
 SG_ CTIWheelEndElectricalFault_01 : 0|2@1+ (1,0) [0|3] "" Vector__XXX
 SG_ CTITireStatus_33 : 0|2@1+ (1,0) [0|3] "" Vector__XXX
 SG_ CTITireStatus_32 : 0|2@1+ (1,0) [0|3] "" Vector__XXX
 SG_ CTITireStatus_31 : 0|2@1+ (1,0) [0|3] "" Vector__XXX
 SG_ CTITireStatus_30 : 0|2@1+ (1,0) [0|3] "" Vector__XXX
 SG_ CTITireStatus_23 : 0|2@1+ (1,0) [0|3] "" Vector__XXX
 SG_ CTITireStatus_22 : 0|2@1+ (1,0) [0|3] "" Vector__XXX
 SG_ CTITireStatus_21 : 0|2@1+ (1,0) [0|3] "" Vector__XXX
 SG_ CTITireStatus_20 : 0|2@1+ (1,0) [0|3] "" Vector__XXX
 SG_ CTITireStatus_13 : 0|2@1+ (1,0) [0|3] "" Vector__XXX
 SG_ CTITireStatus_12 : 0|2@1+ (1,0) [0|3] "" Vector__XXX
 SG_ CTITireStatus_11 : 0|2@1+ (1,0) [0|3] "" Vector__XXX
 SG_ CTITireStatus_10 : 0|2@1+ (1,0) [0|3] "" Vector__XXX
 SG_ CTITireStatus_01 : 0|2@1+ (1,0) [0|3] "" Vector__XXX
 SG_ TireTemp_11 : 0|16@1+ (0.03125,-273) [-273|1735] "°C" Vector__XXX
 SG_ TireTemp_33 : 0|16@1+ (0.03125,-273) [-273|1735] "°C" Vector__XXX
 SG_ TireTemp_32 : 0|16@1+ (0.03125,-273) [-273|1735] "°C" Vector__XXX
 SG_ TireTemp_31 : 0|16@1+ (0.03125,-273) [-273|1735] "°C" Vector__XXX
 SG_ TireTemp_30 : 0|16@1+ (0.03125,-273) [-273|1735] "°C" Vector__XXX
 SG_ TireTemp_23 : 0|16@1+ (0.03125,-273) [-273|1735] "°C" Vector__XXX
 SG_ TireTemp_22 : 0|16@1+ (0.03125,-273) [-273|1735] "°C" Vector__XXX
 SG_ TireTemp_21 : 0|16@1+ (0.03125,-273) [-273|1735] "°C" Vector__XXX
 SG_ TireTemp_20 : 0|16@1+ (0.03125,-273) [-273|1735] "°C" Vector__XXX
 SG_ TireTemp_13 : 0|16@1+ (0.03125,-273) [-273|1735] "°C" Vector__XXX
 SG_ TireTemp_12 : 0|16@1+ (0.03125,-273) [-273|1735] "°C" Vector__XXX
 SG_ TireTemp_10 : 0|16@1+ (0.03125,-273) [-273|1735] "°C" Vector__XXX
 SG_ TireTemp_01 : 0|16@1+ (0.03125,-273) [-273|1735] "°C" Vector__XXX
 SG_ TireTemp_00 : 0|16@1+ (0.03125,-273) [-273|1735] "°C" Vector__XXX
 SG_ TirePressThresholdDetection_33 : 0|3@1+ (1,0) [0|7] "" Vector__XXX
 SG_ TirePressThresholdDetection_32 : 0|3@1+ (1,0) [0|7] "" Vector__XXX
 SG_ TirePressThresholdDetection_31 : 0|3@1+ (1,0) [0|7] "" Vector__XXX
 SG_ TirePressThresholdDetection_30 : 0|3@1+ (1,0) [0|7] "" Vector__XXX
 SG_ TirePressThresholdDetection_23 : 0|3@1+ (1,0) [0|7] "" Vector__XXX
 SG_ TirePressThresholdDetection_22 : 0|3@1+ (1,0) [0|7] "" Vector__XXX
 SG_ TirePressThresholdDetection_21 : 0|3@1+ (1,0) [0|7] "" Vector__XXX
 SG_ TirePressThresholdDetection_20 : 0|3@1+ (1,0) [0|7] "" Vector__XXX
 SG_ TirePressThresholdDetection_00 : 0|3@1+ (1,0) [0|7] "" Vector__XXX
 SG_ TirePress_01 : 0|8@1+ (4,0) [0|1000] "kPa" Vector__XXX
 SG_ TirePress_00 : 0|8@1+ (4,0) [0|1000] "kPa" Vector__XXX
 SG_ CTIWheelSensorStatus_00 : 0|2@1+ (1,0) [0|3] "" Vector__XXX
 SG_ CTIWheelEndElectricalFault_00 : 0|2@1+ (1,0) [0|3] "" Vector__XXX
 SG_ CTITireStatus_00 : 0|2@1+ (1,0) [0|3] "" Vector__XXX
 SG_ TripFanOnTimeDueToAManualSwitch : 0|32@1+ (0.05,0) [0|210554060.75] "hr" Vector__XXX
 SG_ TripFanOnTime : 0|32@1+ (0.05,0) [0|210554060.75] "hr" Vector__XXX
 SG_ TripFanOnTimeDueToTheA_CSystem : 0|32@1+ (0.05,0) [0|210554060.75] "hr" Vector__XXX
 SG_ TripFanOnTimeDueToTheEngSystem : 0|32@1+ (0.05,0) [0|210554060.75] "hr" Vector__XXX
 SG_ TripDistanceInTopGear : 0|32@1+ (0.12500000000594,0) [0|526385151.9] "km" Vector__XXX
 SG_ TripGearDownDistance : 0|32@1+ (0.12500000000594,0) [0|526385151.9] "km" Vector__XXX
 SG_ TripDistanceOnVSL : 0|32@1+ (0.12500000000594,0) [0|526385151.9] "km" Vector__XXX
 SG_ AdjustLocalHourOffset : 0|8@1+ (1,-125) [-125|125] "hr" Vector__XXX
 SG_ AdjustLocalMinuteOffset : 0|8@1+ (1,-125) [-125|125] "mins" Vector__XXX
 SG_ AdjustYear : 0|8@1+ (1,1985) [1985|2235] "years" Vector__XXX
 SG_ AdjustDay : 0|8@1+ (0.25,0) [0|62.5] "days" Vector__XXX
 SG_ AdjustMonth : 0|8@1+ (1,0) [0|250] "months" Vector__XXX
 SG_ AdjustHours : 0|8@1+ (1,0) [0|250] "hr" Vector__XXX
 SG_ AdjustMinutes : 0|8@1+ (1,0) [0|250] "mins" Vector__XXX
 SG_ AdjustSeconds : 0|8@1+ (0.25,0) [0|62.5] "s" Vector__XXX
 SG_ LocalHourOffset : 0|8@1+ (1,-125) [-125|125] "hr" Vector__XXX
 SG_ LocalMinuteOffset : 0|8@1+ (1,-125) [-125|125] "mins" Vector__XXX
 SG_ Year : 0|8@1+ (1,1985) [1985|2235] "years" Vector__XXX
 SG_ Day : 0|8@1+ (0.25,0) [0|62.5] "days" Vector__XXX
 SG_ Month : 0|8@1+ (1,0) [0|250] "months" Vector__XXX
 SG_ Hours : 0|8@1+ (1,0) [0|250] "hr" Vector__XXX
 SG_ Minutes : 0|8@1+ (1,0) [0|250] "mins" Vector__XXX
 SG_ Seconds : 0|8@1+ (0.25,0) [0|62.5] "s" Vector__XXX
 SG_ EngDsrdTrboWastegateActuator2Pos : 0|8@1+ (1,0) [0|100] "%" Vector__XXX
 SG_ EngTrbWstgateActuator1TempStatus : 0|3@1+ (1,0) [0|7] "" Vector__XXX
 SG_ EngTrbWstgtActtor1PreliminaryFMI : 0|5@1+ (1,0) [0|31] "" Vector__XXX
 SG_ EngDsrdTrboWastegateActuator1Pos : 0|8@1+ (1,0) [0|100] "%" Vector__XXX
 SG_ EngTrbWstgteActuatorCtrlAirPress : 0|8@1+ (4,0) [0|1000] "kPa" Vector__XXX
 SG_ EngTurboWastegateActuator4Pos : 0|8@1+ (0.4,0) [0|100] "%" Vector__XXX
 SG_ EngTurboWastegateActuator3Pos : 0|8@1+ (0.4,0) [0|100] "%" Vector__XXX
 SG_ EngTurboWastegateActuator2Pos : 0|8@1+ (0.4,0) [0|100] "%" Vector__XXX
 SG_ EngTurboWastegateActuator1Pos : 0|8@1+ (0.4,0) [0|100] "%" Vector__XXX
 SG_ EngTurbo4CompressorOutletTemp : 0|16@1+ (0.03125,-273) [-273|1734.96875] "deg C" Vector__XXX
 SG_ EngTurbo3CompressorOutletTemp : 0|16@1+ (0.03125,-273) [-273|1734.96875] "deg C" Vector__XXX
 SG_ EngTurbo2CompressorOutletTemp : 0|16@1+ (0.03125,-273) [-273|1734.96875] "deg C" Vector__XXX
 SG_ EngTurbo1CompressorOutletTemp : 0|16@1+ (0.03125,-273) [-273|1734.96875] "deg C" Vector__XXX
 SG_ EngTurbo4TurbineOutletTemp : 0|16@1+ (0.03125,-273) [-273|1734.96875] "deg C" Vector__XXX
 SG_ EngTurbo3TurbineOutletTemp : 0|16@1+ (0.03125,-273) [-273|1734.96875] "deg C" Vector__XXX
 SG_ EngTurbo2TurbineOutletTemp : 0|16@1+ (0.03125,-273) [-273|1734.96875] "deg C" Vector__XXX
 SG_ EngTurbo1TurbineOutletTemp : 0|16@1+ (0.03125,-273) [-273|1734.96875] "deg C" Vector__XXX
 SG_ EngTurbo4TurbineIntakeTemp : 0|16@1+ (0.03125,-273) [-273|1734.96875] "deg C" Vector__XXX
 SG_ EngTurbo3TurbineIntakeTemp : 0|16@1+ (0.03125,-273) [-273|1734.96875] "deg C" Vector__XXX
 SG_ EngTurbo2TurbineIntakeTemp : 0|16@1+ (0.03125,-273) [-273|1734.96875] "deg C" Vector__XXX
 SG_ EngTurbo1TurbineIntakeTemp : 0|16@1+ (0.03125,-273) [-273|1734.96875] "deg C" Vector__XXX
 SG_ EngTurbo4CompressorIntakePress : 0|16@1+ (0.0078124659559567,-250) [-250|251.99] "kPa" Vector__XXX
 SG_ EngTurbo3CompressorIntakePress : 0|16@1+ (0.0078124659559567,-250) [-250|251.99] "kPa" Vector__XXX
 SG_ EngTurbo2CompressorIntakePress : 0|16@1+ (0.0078124659559567,-250) [-250|251.99] "kPa" Vector__XXX
 SG_ EngTurbo1CompressorIntakePress : 0|16@1+ (0.0078124659559567,-250) [-250|251.99] "kPa" Vector__XXX
 SG_ EngTurbo4CompressorIntakeTemp : 0|16@1+ (0.03125,-273) [-273|1734.96875] "deg C" Vector__XXX
 SG_ EngTurbo3CompressorIntakeTemp : 0|16@1+ (0.03125,-273) [-273|1734.96875] "deg C" Vector__XXX
 SG_ EngTurbo2CompressorIntakeTemp : 0|16@1+ (0.03125,-273) [-273|1734.96875] "deg C" Vector__XXX
 SG_ EngTurbo1CompressorIntakeTemp : 0|16@1+ (0.03125,-273) [-273|1734.96875] "deg C" Vector__XXX
 SG_ EngTurbo4Speed : 0|16@1+ (4,0) [0|257020] "rpm" Vector__XXX
 SG_ EngTurbo3Speed : 0|16@1+ (4,0) [0|257020] "rpm" Vector__XXX
 SG_ EngTurbo2Speed : 0|16@1+ (4,0) [0|257020] "rpm" Vector__XXX
 SG_ EngTurboLubeOilPress2 : 0|8@1+ (4,0) [0|1000] "kPa" Vector__XXX
 SG_ TransTorqueLimit : 0|16@1+ (1,0) [0|64255] "Nm" Vector__XXX
 SG_ TransGearRatio : 0|16@1+ (0.001,0) [0|64.255] "" Vector__XXX
 SG_ NumberOfForwardGearRatios : 0|8@1+ (1,0) [0|250] "" Vector__XXX
 SG_ NumberOfReverseGearRatios : 0|8@1+ (1,0) [0|250] "" Vector__XXX
 SG_ TransMode8 : 0|2@1+ (1,0) [0|3] "" Vector__XXX
 SG_ TransMode7 : 0|2@1+ (1,0) [0|3] "" Vector__XXX
 SG_ TransMode6 : 0|2@1+ (1,0) [0|3] "" Vector__XXX
 SG_ TransMode5 : 0|2@1+ (1,0) [0|3] "" Vector__XXX
 SG_ TrnsShftSlectorDisplayModeSwitch : 0|2@1+ (1,0) [0|3] "" Vector__XXX
 SG_ TransRequestedLaunchGear : 0|4@1+ (1,0) [0|15] "" Vector__XXX
 SG_ TransMode4 : 0|2@1+ (1,0) [0|3] "" Vector__XXX
 SG_ TransMode3 : 0|2@1+ (1,0) [0|3] "" Vector__XXX
 SG_ TransMode2 : 0|2@1+ (1,0) [0|3] "" Vector__XXX
 SG_ TransMode1 : 0|2@1+ (1,0) [0|3] "" Vector__XXX
 SG_ DisengageDiffLockRqCentralRear : 0|2@1+ (1,0) [0|3] "" Vector__XXX
 SG_ DisengageDiffLockRqCentralFront : 0|2@1+ (1,0) [0|3] "" Vector__XXX
 SG_ DisengageDiffLockRqCentral : 0|2@1+ (1,0) [0|3] "" Vector__XXX
 SG_ DisengageDiffLockRqRearAxle2 : 0|2@1+ (1,0) [0|3] "" Vector__XXX
 SG_ DisengageDiffLockRqRearAxle1 : 0|2@1+ (1,0) [0|3] "" Vector__XXX
 SG_ DisengageDiffLockRqFrontAxle2 : 0|2@1+ (1,0) [0|3] "" Vector__XXX
 SG_ DisengageDiffLockRqFrontAxle1 : 0|2@1+ (1,0) [0|3] "" Vector__XXX
 SG_ TransRequestedGear : 0|8@1+ (1,-125) [-125|125] "" Vector__XXX
 SG_ RequestedPercentClutchSlip : 0|8@1+ (1,0) [0|100] "%" Vector__XXX
 SG_ TransReverseGearShiftInhibitRq : 0|2@1+ (1,0) [0|3] "" Vector__XXX
 SG_ DisengageDrivelineRq : 0|2@1+ (1,0) [0|3] "" Vector__XXX
 SG_ TrnsTrqeConverterLockupDisableRq : 0|2@1+ (1,0) [0|3] "" Vector__XXX
 SG_ TransGearShiftInhibitRq : 0|2@1+ (1,0) [0|3] "" Vector__XXX
 SG_ EngTurboOilLevelSwitch : 0|2@1+ (1,0) [0|3] "" Vector__XXX
 SG_ EngTurbo1Speed : 0|16@1+ (4,0) [0|257020] "rpm" Vector__XXX
 SG_ EngTurboLubeOilPress1 : 0|8@1+ (4,0) [0|1000] "kPa" Vector__XXX
 SG_ EngTotalAverageFuelEconomy : 0|16@1+ (0.0019531553964672,0) [0|125.5] "km/L" Vector__XXX
 SG_ EngTotalAverageFuelRate : 0|16@1+ (0.05,0) [0|3212.75] "L/h" Vector__XXX
 SG_ AirSuspensionSupplyPressRq : 0|8@1+ (1,0) [0|2000] "kPa" Vector__XXX
 SG_ AuxEquipmentSupplyPressRq : 0|8@1+ (1,0) [0|2000] "kPa" Vector__XXX
 SG_ ServiceBrakeAirPressRqCircuit2 : 0|8@1+ (1,0) [0|2000] "kPa" Vector__XXX
 SG_ ServiceBrakeAirPressRqCircuit1 : 0|8@1+ (1,0) [0|2000] "kPa" Vector__XXX
 SG_ ParkingAnd_orTrailerAirPressRq : 0|8@1+ (1,0) [0|2000] "kPa" Vector__XXX
 SG_ PneumaticSupplyPressRq : 0|8@1+ (1,0) [0|2000] "kPa" Vector__XXX
 SG_ EngExtlShutdownAirSupplyPress : 0|16@1+ (0.5,0) [0|32127.5] "kPa" Vector__XXX
 SG_ NmbrOfSftwreIdentificationFields : 0|8@1+ (1,0) [0|250] "steps" Vector__XXX
 SG_ SoftwareIdentification : 0|8@1+ (1.02,0) [0|255] "per byte" Vector__XXX
 SG_ PTOShutdownHasShutdownEng : 0|2@1+ (1,0) [0|3] "" Vector__XXX
 SG_ EngAirShutoffStatus : 0|2@1+ (1,0) [0|3] "" Vector__XXX
 SG_ EngOverspeedTest : 0|2@1+ (1,0) [0|3] "" Vector__XXX
 SG_ EngAirShutoffCmdStatus : 0|2@1+ (1,0) [0|3] "" Vector__XXX
 SG_ EngAlarmOutputCmdStatus : 0|2@1+ (1,0) [0|3] "" Vector__XXX
 SG_ EngAlarmAcknowledge : 0|2@1+ (1,0) [0|3] "" Vector__XXX
 SG_ EngProtectionSystemConfig : 0|2@1+ (1,0) [0|3] "" Vector__XXX
 SG_ EngProtectionSystemTimerState : 0|2@1+ (1,0) [0|3] "" Vector__XXX
 SG_ EngProtectionSystemTimerOverride : 0|2@1+ (1,0) [0|3] "" Vector__XXX
 SG_ EngPrtctnSystmApprachingShutdown : 0|2@1+ (1,0) [0|3] "" Vector__XXX
 SG_ EngPrtectionSystemHasShutdownEng : 0|2@1+ (1,0) [0|3] "" Vector__XXX
 SG_ EngWaitToStartLamp : 0|2@1+ (1,0) [0|3] "" Vector__XXX
 SG_ RefrigerantHighPressSwitch : 0|2@1+ (1,0) [0|3] "" Vector__XXX
 SG_ RefrigerantLowPressSwitch : 0|2@1+ (1,0) [0|3] "" Vector__XXX
 SG_ A_CHighPressFanSwitch : 0|2@1+ (1,0) [0|3] "" Vector__XXX
 SG_ EngIdleShutdownTimerFunction : 0|2@1+ (1,0) [0|3] "" Vector__XXX
 SG_ EngIdleShutdownTimerState : 0|2@1+ (1,0) [0|3] "" Vector__XXX
 SG_ EngIdleShutdownTimerOverride : 0|2@1+ (1,0) [0|3] "" Vector__XXX
 SG_ EngIdleShutdownDriverAlertMode : 0|2@1+ (1,0) [0|3] "" Vector__XXX
 SG_ EngIdleShutdownHasShutdownEng : 0|2@1+ (1,0) [0|3] "" Vector__XXX
 SG_ VehicleSystem5 : 0|7@1+ (1,0) [0|127] "" Vector__XXX
 SG_ VehicleSystem4 : 0|7@1+ (1,0) [0|127] "" Vector__XXX
 SG_ VehicleSystem3 : 0|7@1+ (1,0) [0|127] "" Vector__XXX
 SG_ VehicleSystem2 : 0|7@1+ (1,0) [0|127] "" Vector__XXX
 SG_ VehicleSystem1 : 0|7@1+ (1,0) [0|127] "" Vector__XXX
 SG_ ArbitraryAddressCapable : 0|1@1+ (1,0) [0|1] "" Vector__XXX
 SG_ IndustryGroup : 0|3@1+ (1,0) [0|7] "" Vector__XXX
 SG_ VehicleSystemInstance : 0|4@1+ (1,0) [0|15] "" Vector__XXX
 SG_ VehicleSystem : 0|7@1+ (1,0) [0|127] "" Vector__XXX
 SG_ ECUInstance : 0|3@1+ (1,0) [0|7] "" Vector__XXX
 SG_ FunctionInstance : 0|5@1+ (1,0) [0|31] "" Vector__XXX
 SG_ Function : 0|8@1+ (1,0) [0|255] "" Vector__XXX
 SG_ ManufacturerCode : 0|11@1+ (1,0) [0|2047] "" Vector__XXX
 SG_ IdentityNumber : 0|21@1+ (1,0) [0|2097152] "" Vector__XXX
 SG_ SrviceDelay_OperationalTimeBased : 0|16@1+ (1,-32127) [-32127|32128] "hr" Vector__XXX
 SG_ ServiceComponentIdentification : 0|8@1+ (1,0) [0|250] "ID" Vector__XXX
 SG_ ServiceDelay_CalendarTimeBased : 0|8@1+ (1,-125) [-125|125] "weeks" Vector__XXX
 SG_ ServiceComponentIdentification : 0|8@1+ (1,0) [0|250] "ID" Vector__XXX
 SG_ ServiceDistance : 0|16@1+ (5,-160635) [-160635|160640] "km" Vector__XXX
 SG_ ServiceComponentIdentification : 0|8@1+ (1,0) [0|250] "ID" Vector__XXX
 SG_ TimeSinceLastService : 0|16@1+ (1,-32127) [-32127|32128] "hr" Vector__XXX
 SG_ ServiceComponentIdentification : 0|8@1+ (1,0) [0|250] "ID" Vector__XXX
 SG_ MinContinuousRetarderTorque : 0|8@1+ (1,-125) [-125|125] "%" Vector__XXX
 SG_ MaxContinuousRetarderTorque : 0|8@1+ (1,-125) [-125|125] "%" Vector__XXX
 SG_ MinContinuousRetarderSpeed : 0|8@1+ (1,0) [0|8000] "rpm" Vector__XXX
 SG_ MaxContinuousRetarderSpeed : 0|8@1+ (1,0) [0|8000] "rpm" Vector__XXX
 SG_ HghLmtThrshldFrMnCntnsTrqFrmRtrd : 0|8@1+ (1,-125) [-125|125] "%" Vector__XXX
 SG_ LwLmtThrshldFrMxTrqeFromRetarder : 0|8@1+ (1,-125) [-125|125] "%" Vector__XXX
 SG_ HghLmtThrshldFrMnCntnsRPMFrmRtrd : 0|8@1+ (1,0) [0|8000] "rpm" Vector__XXX
 SG_ LwLmtThrshldFrMaxRPMFromRetarder : 0|8@1+ (1,0) [0|8000] "rpm" Vector__XXX
 SG_ DrvlineRetarderOverheatIndicator : 0|2@1+ (1,0) [0|3] "" Vector__XXX
 SG_ HydRetarderOilTemp : 0|8@1+ (1,-40) [-40|210] "deg C" Vector__XXX
 SG_ HydRetarderPress : 0|8@1+ (16,0) [0|4000] "kPa" Vector__XXX
 SG_ SteerStraightAheadPosReset : 0|2@1+ (1,0) [0|3] "" Vector__XXX
 SG_ EngBuildHoursReset : 0|2@1+ (1,0) [0|3] "" Vector__XXX
 SG_ ServiceComponentIdentification : 0|8@1+ (1,0) [0|250] "ID" Vector__XXX
 SG_ TripGroup2Proprietary : 0|2@1+ (1,0) [0|3] "" Vector__XXX
 SG_ TripGroup1 : 0|2@1+ (1,0) [0|3] "" Vector__XXX
 SG_ PercentTorqueAtPeakTorquePoint5 : 0|8@1+ (1,-125) [-125|125] "%" Vector__XXX
 SG_ RetarderSpeedAtPeakTorquePoint5 : 0|16@1+ (0.125,0) [0|8031.875] "rpm" Vector__XXX
 SG_ PercentTorqueAtPoint4 : 0|8@1+ (1,-125) [-125|125] "%" Vector__XXX
 SG_ RetarderSpeedAtPoint4 : 0|16@1+ (0.125,0) [0|8031.875] "rpm" Vector__XXX
 SG_ PercentTorqueAtPoint3 : 0|8@1+ (1,-125) [-125|125] "%" Vector__XXX
 SG_ RetarderSpeedAtPoint3 : 0|16@1+ (0.125,0) [0|8031.875] "rpm" Vector__XXX
 SG_ PercentTorqueAtMaxSpeedPoint2 : 0|8@1+ (1,-125) [-125|125] "%" Vector__XXX
 SG_ MaxRetarderSpeedPoint2 : 0|16@1+ (0.125,0) [0|8031.875] "rpm" Vector__XXX
 SG_ PercentTorqueAtIdlePoint1 : 0|8@1+ (1,-125) [-125|125] "%" Vector__XXX
 SG_ RetarderSpeedAtIdlePoint1 : 0|16@1+ (0.125,0) [0|8031.875] "rpm" Vector__XXX
 SG_ RetarderCtrlMethod : 0|8@1+ (1,0) [0|250] "steps" Vector__XXX
 SG_ RetarderLocation : 0|4@1+ (1,0) [0|15] "" Vector__XXX
 SG_ RetarderType : 0|4@1+ (1,0) [0|15] "" Vector__XXX
 SG_ EngOperationTimeSinceRebuild : 0|32@1+ (1,0) [0|4211081215] "s" Vector__XXX
 SG_ PowerTakeoffSetSpeed : 0|16@1+ (0.125,0) [0|8031.875] "rpm" Vector__XXX
 SG_ PowerTakeoffSpeed : 0|16@1+ (0.125,0) [0|8031.875] "rpm" Vector__XXX
 SG_ PowerTakeoffOilTemp : 0|8@1+ (1,-40) [-40|210] "deg C" Vector__XXX
 SG_ OprtrEngPTOGvrnrMmrySelectSwitch : 0|2@1+ (1,0) [0|3] "" Vector__XXX
 SG_ EngRmtPTOGvrnrVrblSpedCtrlSwitch : 0|2@1+ (1,0) [0|3] "" Vector__XXX
 SG_ EngRmtPTOGvrnrPrprgrmmdSpdCtrlSw : 0|2@1+ (1,0) [0|3] "" Vector__XXX
 SG_ EngPTOGvrnrCast_DecelerateSwitch : 0|2@1+ (1,0) [0|3] "" Vector__XXX
 SG_ EngPTOGovernorSetSwitch : 0|2@1+ (1,0) [0|3] "" Vector__XXX
 SG_ EngPTOGovernorResumeSwitch : 0|2@1+ (1,0) [0|3] "" Vector__XXX
 SG_ EngPTOGovernorEnableSwitch : 0|2@1+ (1,0) [0|3] "" Vector__XXX
 SG_ EngPTOGovernorAccelerateSwitch : 0|2@1+ (1,0) [0|3] "" Vector__XXX
 SG_ RmtPTOGvrnrPrprgrmmdSpdCtrlSwtch : 0|2@1+ (1,0) [0|3] "" Vector__XXX
 SG_ AuxInputIgnoreSwitch : 0|2@1+ (1,0) [0|3] "" Vector__XXX
 SG_ EngAltDroopAuxInputSelect : 0|4@1+ (1,0) [0|15] "" Vector__XXX
 SG_ EngAltDroopRemoteAccelSelect : 0|4@1+ (1,0) [0|15] "" Vector__XXX
 SG_ EngAltDroopAccel2Select : 0|4@1+ (1,0) [0|15] "" Vector__XXX
 SG_ EngAltDroopAccel1Select : 0|4@1+ (1,0) [0|15] "" Vector__XXX
 SG_ EngAltRatingSelect : 0|8@1+ (1.02,0) [0|255] "" Vector__XXX
 SG_ EngAltLowIdleSwitch : 0|2@1+ (1,0) [0|3] "" Vector__XXX
 SG_ EngSynchronizationSwitch : 0|2@1+ (1,0) [0|3] "" Vector__XXX
 SG_ EngAuxGovernorSwitch : 0|2@1+ (1,0) [0|3] "" Vector__XXX
 SG_ EngAltDroopAuxInputSelectState : 0|4@1+ (1,0) [0|15] "" Vector__XXX
 SG_ EngAltDropRemoteAccelSelectState : 0|4@1+ (1,0) [0|15] "" Vector__XXX
 SG_ EngAltDroopAccel2SelectState : 0|4@1+ (1,0) [0|15] "" Vector__XXX
 SG_ EngAltDroopAccel1SelectState : 0|4@1+ (1,0) [0|15] "" Vector__XXX
 SG_ EngAltRatingSelectState : 0|8@1+ (1,0) [0|255] "" Vector__XXX
 SG_ EngAltLowIdleSelectState : 0|2@1+ (1,0) [0|3] "" Vector__XXX
 SG_ EngMultiUnitSyncState : 0|2@1+ (1,0) [0|3] "" Vector__XXX
 SG_ EngAuxGovernorState : 0|2@1+ (1,0) [0|3] "" Vector__XXX
 SG_ AppliedVehicleSpeedLimit : 0|8@1+ (1,0) [0|250] "km/h" Vector__XXX
 SG_ MaxVehicleSpeedLimit7 : 0|8@1+ (1,0) [0|250] "km/h" Vector__XXX
 SG_ MaxVehicleSpeedLimit6 : 0|8@1+ (1,0) [0|250] "km/h" Vector__XXX
 SG_ MaxVehicleSpeedLimit5 : 0|8@1+ (1,0) [0|250] "km/h" Vector__XXX
 SG_ MaxVehicleSpeedLimit4 : 0|8@1+ (1,0) [0|250] "km/h" Vector__XXX
 SG_ MaxVehicleSpeedLimit3 : 0|8@1+ (1,0) [0|250] "km/h" Vector__XXX
 SG_ MaxVehicleSpeedLimit2 : 0|8@1+ (1,0) [0|250] "km/h" Vector__XXX
 SG_ MaxVehicleSpeedLimit1 : 0|8@1+ (1,0) [0|250] "km/h" Vector__XXX
 SG_ OprtrsBlackOutIntensitySelection : 0|8@1+ (1,0) [0|100] "%" Vector__XXX
 SG_ BlackOutWorkLampSelect : 0|2@1+ (1,0) [0|3] "" Vector__XXX
 SG_ NightVisionIlluminatorSelect : 0|2@1+ (1,0) [0|3] "" Vector__XXX
 SG_ BlackOutBrake_StopLampSelect : 0|2@1+ (1,0) [0|3] "" Vector__XXX
 SG_ ConvoyDrivingLampSelect : 0|2@1+ (1,0) [0|3] "" Vector__XXX
 SG_ ConvoyLampSelect : 0|2@1+ (1,0) [0|3] "" Vector__XXX
 SG_ FrontBlackOutMarkerLampSelect : 0|2@1+ (1,0) [0|3] "" Vector__XXX
 SG_ RearBlackOutMarkerSelect : 0|2@1+ (1,0) [0|3] "" Vector__XXX
 SG_ SlowVesselModeStatus : 0|2@1+ (1,0) [0|3] "" Vector__XXX
 SG_ TrollingModeStatus : 0|2@1+ (1,0) [0|3] "" Vector__XXX
 SG_ EngThrttlSynchrnzationModeStatus : 0|4@1+ (1,0) [0|15] "" Vector__XXX
 SG_ EngMainBearing11Temp : 0|16@1+ (0.03125,-273) [-273|1734.96875] "deg C" Vector__XXX
 SG_ EngMainBearing10Temp : 0|16@1+ (0.03125,-273) [-273|1734.96875] "deg C" Vector__XXX
 SG_ EngMainBearing9Temp : 0|16@1+ (0.03125,-273) [-273|1734.96875] "deg C" Vector__XXX
 SG_ EngMainBearing8Temp : 0|16@1+ (0.03125,-273) [-273|1734.96875] "deg C" Vector__XXX
 SG_ EngMainBearing7Temp : 0|16@1+ (0.03125,-273) [-273|1734.96875] "deg C" Vector__XXX
 SG_ EngMainBearing6Temp : 0|16@1+ (0.03125,-273) [-273|1734.96875] "deg C" Vector__XXX
 SG_ EngMainBearing5Temp : 0|16@1+ (0.03125,-273) [-273|1734.96875] "deg C" Vector__XXX
 SG_ EngMainBearing4Temp : 0|16@1+ (0.03125,-273) [-273|1734.96875] "deg C" Vector__XXX
 SG_ EngMainBearing3Temp : 0|16@1+ (0.03125,-273) [-273|1734.96875] "deg C" Vector__XXX
 SG_ EngMainBearing2Temp : 0|16@1+ (0.03125,-273) [-273|1734.96875] "deg C" Vector__XXX
 SG_ EngMainBearing1Temp : 0|16@1+ (0.03125,-273) [-273|1734.96875] "deg C" Vector__XXX
 SG_ DisplayDeadbands : 0|4@1+ (1,0) [0|15] "" Vector__XXX
 SG_ LEDPatternCtrl : 0|4@1+ (1,0) [0|15] "" Vector__XXX
 SG_ LEDDisplayDeadbandCtrl : 0|4@1+ (1,0) [0|15] "" Vector__XXX
 SG_ LEDDisplayModeCtrl : 0|4@1+ (1,0) [0|15] "" Vector__XXX
 SG_ LEDDisplayData1 : 0|8@1+ (1,0) [0|255] "" Vector__XXX
 SG_ LaserStrikeDataLatency : 0|16@1+ (5.12E-005,0) [0|3.289856] "s" Vector__XXX
 SG_ LaserReceiverType : 0|8@1+ (1,0) [0|250] "" Vector__XXX
 SG_ LaserStrikeVerticalDeviation : 0|16@1+ (0.1,-3200) [-3200|3225.5] "mm" Vector__XXX
 SG_ AbsLaserStrikePos : 0|16@1+ (0.1,0) [0|6425.5] "mm" Vector__XXX
 SG_ LaserTracerInformation : 0|8@1+ (1,0) [0|255] "" Vector__XXX
 SG_ LEDDisplayData2 : 0|8@1+ (1,0) [0|255] "" Vector__XXX
 SG_ LaserTracerHorizontalDeviation : 0|8@1+ (1,0) [0|250] "%" Vector__XXX
 SG_ LaserTracerVerticalDistance : 0|16@1+ (0.1,0) [0|6425.5] "mm" Vector__XXX
 SG_ LaserTracerTargetDeviation : 0|16@1+ (0.1,-3200) [-3200|3225.5] "mm" Vector__XXX
 SG_ BldeHeightSetPointHighResolution : 0|32@1+ (1E-007,-209.7152) [-209.7152|211.3929215] "m" Vector__XXX
 SG_ ModifyLevelingSystemSetPoint : 0|16@1+ (0.1,-3200) [-3200|3225.5] "mm" Vector__XXX
 SG_ StElvtnSensor2ReferenceElevation : 0|2@1+ (1,0) [0|3] "" Vector__XXX
 SG_ StElvtnSensor1ReferenceElevation : 0|2@1+ (1,0) [0|3] "" Vector__XXX
 SG_ SdshftDsrdBldeOffsetOperatorCtrl : 0|4@1+ (1,0) [0|15] "" Vector__XXX
 SG_ SdshiftBladeCtrlModeOperatorCtrl : 0|4@1+ (1,0) [0|15] "" Vector__XXX
 SG_ RghtDsredBladeOffsetOperatorCtrl : 0|4@1+ (1,0) [0|15] "" Vector__XXX
 SG_ LftDsiredBladeOffsetOperatorCtrl : 0|4@1+ (1,0) [0|15] "" Vector__XXX
 SG_ RightBladeCtrlModeOperatorCtrl : 0|4@1+ (1,0) [0|15] "" Vector__XXX
 SG_ LeftBladeCtrlModeOperatorCtrl : 0|4@1+ (1,0) [0|15] "" Vector__XXX
 SG_ BladeAutoModeCmd : 0|4@1+ (1,0) [0|15] "" Vector__XXX
 SG_ DesiredGradeOffsetSwitch : 0|4@1+ (1,0) [0|15] "" Vector__XXX
 SG_ BladeCtrlModeSwitch : 0|4@1+ (1,0) [0|0] "" Vector__XXX
 SG_ MastPos : 0|16@1+ (0.1,-3200) [-3200|3225.5] "mm" Vector__XXX
 SG_ FlexibleFuelPercentage : 0|10@1+ (1,0) [0|102] "%" Vector__XXX
 SG_ EngAverageFuelEconomy : 0|16@1+ (0.0019531553964672,0) [0|125.5] "km/L" Vector__XXX
 SG_ EngInstantaneousFuelEconomy : 0|16@1+ (0.0019531553964672,0) [0|125.5] "km/L" Vector__XXX
 SG_ EngFuelRate : 0|16@1+ (0.05,0) [0|3212.75] "L/h" Vector__XXX
 SG_ EngThrottleValve2Pos : 0|8@1+ (0.4,0) [0|100] "%" Vector__XXX
 SG_ EngThrottleValve1Pos : 0|8@1+ (0.4,0) [0|100] "%" Vector__XXX
 SG_ EngTotalFuelUsed : 0|32@1+ (0.5,0) [0|2105540607.5] "L" Vector__XXX
 SG_ EngTripFuel : 0|32@1+ (0.5,0) [0|2105540607.5] "L" Vector__XXX
 SG_ FrontWheelDriveActuatorStatus : 0|2@1+ (1,0) [0|3] "" Vector__XXX
 SG_ FMSstandardSWversionSupported : 0|32@1+ (6.0554519606908E-008,0) [0|255] "per byte" Vector__XXX
 SG_ FMSstandardRequestsSupported : 0|2@1+ (1,0) [0|3] "" Vector__XXX
 SG_ FMSstandardDiagnosticsSupported : 0|2@1+ (1,0) [0|3] "" Vector__XXX
 SG_ LnDpartureIndicationEnableStatus : 0|2@1+ (1,0) [0|3] "" Vector__XXX
 SG_ LaneTrackingStatusLeftSide : 0|2@1+ (1,0) [0|3] "" Vector__XXX
 SG_ LaneTrackingStatusRightSide : 0|2@1+ (1,0) [0|3] "" Vector__XXX
 SG_ EngFuelLeakage2 : 0|2@1+ (1,0) [0|3] "" Vector__XXX
 SG_ EngFuelLeakage1 : 0|2@1+ (1,0) [0|3] "" Vector__XXX
 SG_ FanDriveBypassCmdStatus : 0|8@1+ (1,0) [0|100] "%" Vector__XXX
 SG_ HydFanMotorPress : 0|16@1+ (0.5,0) [0|32127.5] "kPa" Vector__XXX
 SG_ FanSpeed : 0|16@1+ (0.125,0) [0|8031.875] "rpm" Vector__XXX
 SG_ FanDriveState : 0|4@1+ (1,0) [0|15] "" Vector__XXX
 SG_ EstPercentFanSpeed : 0|8@1+ (1,0) [0|100] "%" Vector__XXX
 SG_ EngTorqueLimit6AxleInput : 0|16@1+ (2,0) [0|128510] "Nm" Vector__XXX
 SG_ EngTorqueLimit5Switch : 0|16@1+ (1,0) [0|64255] "Nm" Vector__XXX
 SG_ EngTorqueLimit4Trans : 0|16@1+ (1,0) [0|64255] "Nm" Vector__XXX
 SG_ EngTorqueLimit3Trans : 0|16@1+ (1,0) [0|64255] "Nm" Vector__XXX
 SG_ TransGearRatio3 : 0|16@1+ (0.01,0) [0|642.55] "" Vector__XXX
 SG_ EngTorqueLimit2Trans : 0|16@1+ (1,0) [0|64255] "Nm" Vector__XXX
 SG_ TransGearRatio2 : 0|16@1+ (0.01,0) [0|642.55] "" Vector__XXX
 SG_ EngTorqueLimit1Trans : 0|16@1+ (1,0) [0|64255] "Nm" Vector__XXX
 SG_ TransGearRatio1 : 0|16@1+ (0.01,0) [0|642.55] "" Vector__XXX
 SG_ EngTorqueLimitFeature : 0|3@1+ (1,0) [0|7] "" Vector__XXX
 SG_ TorqueLimitingFeatureStatus : 0|2@1+ (1,0) [0|3] "" Vector__XXX
 SG_ CalibRecordDurationTime : 0|32@1+ (0.05,0) [0|210554060.75] "hr" Vector__XXX
 SG_ CalibRecordStartYear : 0|8@1+ (1,1985) [1985|2235] "years" Vector__XXX
 SG_ CalibRecordStartDay : 0|8@1+ (0.25,0) [0|62.5] "days" Vector__XXX
 SG_ CalibRecordStartMonth : 0|8@1+ (1,0) [0|250] "months" Vector__XXX
 SG_ EngPeakTorque2 : 0|16@1+ (1,0) [0|64255] "Nm" Vector__XXX
 SG_ EngPeakTorque1 : 0|16@1+ (1,0) [0|64255] "Nm" Vector__XXX
 SG_ EngPower : 0|16@1+ (0.5,0) [0|32127.5] "kW" Vector__XXX
 SG_ NumberOfEngTorqueHistoryRecords : 0|8@1+ (1,0) [0|250] "records" Vector__XXX
 SG_ TransClutch_ConverterInputSpeed : 0|16@1+ (0.125,0) [0|8031.875] "rpm" Vector__XXX
 SG_ TransTorqueConverterRatio : 0|16@1+ (0.001,0) [0|64.255] "" Vector__XXX
 SG_ TrnsRverseGearShiftInhibitStatus : 0|2@1+ (1,0) [0|3] "" Vector__XXX
 SG_ TrnsCrrentRangeDisplayBlankState : 0|2@1+ (1,0) [0|3] "" Vector__XXX
 SG_ TransWarningIndicator : 0|2@1+ (1,0) [0|3] "" Vector__XXX
 SG_ TransMode8Indicator : 0|2@1+ (1,0) [0|3] "" Vector__XXX
 SG_ TransMode7Indicator : 0|2@1+ (1,0) [0|3] "" Vector__XXX
 SG_ TransMode6Indicator : 0|2@1+ (1,0) [0|3] "" Vector__XXX
 SG_ TransMode5Indicator : 0|2@1+ (1,0) [0|3] "" Vector__XXX
 SG_ TransRequestedGearFeedback : 0|8@1+ (1,-125) [-125|125] "" Vector__XXX
 SG_ TransMode1Indicator : 0|2@1+ (1,0) [0|3] "" Vector__XXX
 SG_ TransMode2Indicator : 0|2@1+ (1,0) [0|3] "" Vector__XXX
 SG_ TransMode3Indicator : 0|2@1+ (1,0) [0|3] "" Vector__XXX
 SG_ TransMode4Indicator : 0|2@1+ (1,0) [0|3] "" Vector__XXX
 SG_ TransShiftInhibitIndicator : 0|2@1+ (1,0) [0|3] "" Vector__XXX
 SG_ TransEngCrankEnable : 0|2@1+ (1,0) [0|3] "" Vector__XXX
 SG_ ActiveShiftConsoleIndicator : 0|2@1+ (1,0) [0|3] "" Vector__XXX
 SG_ TransReadyForBrakeRelease : 0|2@1+ (1,0) [0|3] "" Vector__XXX
 SG_ TrnsRqstedRangeDisplayFlashState : 0|2@1+ (1,0) [0|3] "" Vector__XXX
 SG_ TrnsRqstedRangeDisplayBlankState : 0|2@1+ (1,0) [0|3] "" Vector__XXX
 SG_ TransServiceIndicator : 0|2@1+ (1,0) [0|3] "" Vector__XXX
 SG_ ClutchLifeRemaining : 0|8@1+ (0.4,0) [0|100] "%" Vector__XXX
 SG_ LowestPossibleGear : 0|8@1+ (1,-125) [-125|125] "" Vector__XXX
 SG_ HighestPossibleGear : 0|8@1+ (1,-125) [-125|125] "" Vector__XXX
 SG_ RecommendedGear : 0|8@1+ (1,-125) [-125|125] "" Vector__XXX
 SG_ TransForwardDirectionSwitch : 0|2@1+ (1,0) [0|3] "" Vector__XXX
 SG_ TransNeutralSwitch : 0|2@1+ (1,0) [0|3] "" Vector__XXX
 SG_ TransReverseDirectionSwitch : 0|2@1+ (1,0) [0|3] "" Vector__XXX
 SG_ TransLowRangeSenseSwitch : 0|2@1+ (1,0) [0|3] "" Vector__XXX
 SG_ TransHighRangeSenseSwitch : 0|2@1+ (1,0) [0|3] "" Vector__XXX
 SG_ TransSynchronizerBrakeValue : 0|8@1+ (0.4,0) [0|100] "%" Vector__XXX
 SG_ TransSynchronizerClutchValue : 0|8@1+ (0.4,0) [0|100] "%" Vector__XXX
 SG_ TransInertiaBrakeActuator : 0|2@1+ (1,0) [0|3] "" Vector__XXX
 SG_ TransDefuelActuator : 0|2@1+ (1,0) [0|3] "" Vector__XXX
 SG_ TransLockupClutchActuator : 0|2@1+ (1,0) [0|3] "" Vector__XXX
 SG_ TransClutchActuator : 0|2@1+ (1,0) [0|3] "" Vector__XXX
 SG_ TransSplitterIndirectActuator : 0|2@1+ (1,0) [0|3] "" Vector__XXX
 SG_ TransSplitterDirectActuator : 0|2@1+ (1,0) [0|3] "" Vector__XXX
 SG_ ArbitraryAddressCapable : 0|1@1+ (1,0) [0|1] "" Vector__XXX
 SG_ IndustryGroup : 0|3@1+ (1,0) [0|7] "" Vector__XXX
 SG_ VehicleSystemInstance : 0|4@1+ (1,0) [0|15] "" Vector__XXX
 SG_ Function : 0|8@1+ (1,0) [0|255] "" Vector__XXX
 SG_ VehicleSystem : 0|7@1+ (1,0) [0|127] "" Vector__XXX
 SG_ FunctionInstance : 0|5@1+ (1,0) [0|31] "" Vector__XXX
 SG_ ECUInstance : 0|3@1+ (1,0) [0|7] "" Vector__XXX
 SG_ ManufacturerCode : 0|11@1+ (1,0) [0|2047] "" Vector__XXX
 SG_ IdentityNumber : 0|21@1+ (1,0) [0|2097152] "" Vector__XXX
 SG_ VehicleSystem5 : 0|7@1+ (1,0) [0|127] "" Vector__XXX
 SG_ VehicleSystem4 : 0|7@1+ (1,0) [0|127] "" Vector__XXX
 SG_ VehicleSystem3 : 0|7@1+ (1,0) [0|127] "" Vector__XXX
 SG_ VehicleSystem2 : 0|7@1+ (1,0) [0|127] "" Vector__XXX
 SG_ VehicleSystem1 : 0|7@1+ (1,0) [0|127] "" Vector__XXX
 SG_ ArbitraryAddressCapable : 0|1@1+ (1,0) [0|1] "" Vector__XXX
 SG_ IndustryGroup : 0|3@1+ (1,0) [0|7] "" Vector__XXX
 SG_ VehicleSystemInstance : 0|4@1+ (1,0) [0|15] "" Vector__XXX
 SG_ Function : 0|8@1+ (1,0) [0|255] "" Vector__XXX
 SG_ FunctionInstance : 0|5@1+ (1,0) [0|31] "" Vector__XXX
 SG_ ECUInstance : 0|3@1+ (1,0) [0|7] "" Vector__XXX
 SG_ ManufacturerCode : 0|11@1+ (1,0) [0|2047] "" Vector__XXX
 SG_ IdentityNumber : 0|21@1+ (1,0) [0|2097152] "" Vector__XXX
 SG_ VehicleSystem : 0|7@1+ (1,0) [0|127] "" Vector__XXX
 SG_ VehicleSystem5 : 0|7@1+ (1,0) [0|127] "" Vector__XXX
 SG_ VehicleSystem4 : 0|7@1+ (1,0) [0|127] "" Vector__XXX
 SG_ VehicleSystem3 : 0|7@1+ (1,0) [0|127] "" Vector__XXX
 SG_ VehicleSystem2 : 0|7@1+ (1,0) [0|127] "" Vector__XXX
 SG_ VehicleSystem1 : 0|7@1+ (1,0) [0|127] "" Vector__XXX

CM_ SG_ 3221225472 CTIWheelEndElectricalFault_12 "Indicates the status of electrical fault on CTI wheel interface.";
CM_ SG_ 3221225472 CTIWheelEndElectricalFault_11 "Indicates the status of electrical fault on CTI wheel interface.";
CM_ SG_ 3221225472 CTIWheelEndElectricalFault_10 "Indicates the status of electrical fault on CTI wheel interface.";
CM_ SG_ 3221225472 CTIWheelEndElectricalFault_01 "Indicates the status of electrical fault on CTI wheel interface.";
CM_ SG_ 3221225472 CTITireStatus_33 "Indicates the status of the tire.";
CM_ SG_ 3221225472 CTITireStatus_32 "Indicates the status of the tire.";
CM_ SG_ 3221225472 CTITireStatus_31 "Indicates the status of the tire.";
CM_ SG_ 3221225472 CTITireStatus_30 "Indicates the status of the tire.";
CM_ SG_ 3221225472 CTITireStatus_23 "Indicates the status of the tire.";
CM_ SG_ 3221225472 CTITireStatus_22 "Indicates the status of the tire.";
CM_ SG_ 3221225472 CTITireStatus_21 "Indicates the status of the tire.";
CM_ SG_ 3221225472 CTITireStatus_20 "Indicates the status of the tire.";
CM_ SG_ 3221225472 CTITireStatus_13 "Indicates the status of the tire.";
CM_ SG_ 3221225472 CTITireStatus_12 "Indicates the status of the tire.";
CM_ SG_ 3221225472 CTITireStatus_11 "Indicates the status of the tire.";
CM_ SG_ 3221225472 CTITireStatus_10 "Indicates the status of the tire.";
CM_ SG_ 3221225472 CTITireStatus_01 "Indicates the status of the tire.";
CM_ SG_ 3221225472 TireTemp_11 "Temperature at the surface of the tire sidewall.";
CM_ SG_ 3221225472 TireTemp_33 "Temperature at the surface of the tire sidewall.";
CM_ SG_ 3221225472 TireTemp_32 "Temperature at the surface of the tire sidewall.";
CM_ SG_ 3221225472 TireTemp_31 "Temperature at the surface of the tire sidewall.";
CM_ SG_ 3221225472 TireTemp_30 "Temperature at the surface of the tire sidewall.";
CM_ SG_ 3221225472 TireTemp_23 "Temperature at the surface of the tire sidewall.";
CM_ SG_ 3221225472 TireTemp_22 "Temperature at the surface of the tire sidewall.";
CM_ SG_ 3221225472 TireTemp_21 "Temperature at the surface of the tire sidewall.";
CM_ SG_ 3221225472 TireTemp_20 "Temperature at the surface of the tire sidewall.";
CM_ SG_ 3221225472 TireTemp_13 "Temperature at the surface of the tire sidewall.";
CM_ SG_ 3221225472 TireTemp_12 "Temperature at the surface of the tire sidewall.";
CM_ SG_ 3221225472 TireTemp_10 "Temperature at the surface of the tire sidewall.";
CM_ SG_ 3221225472 TireTemp_01 "Temperature at the surface of the tire sidewall.";
CM_ SG_ 3221225472 TireTemp_00 "Temperature at the surface of the tire sidewall.";
CM_ SG_ 3221225472 TirePressThresholdDetection_33 "Signal indicating the pressure level of the tire.";
CM_ SG_ 3221225472 TirePressThresholdDetection_32 "Signal indicating the pressure level of the tire.";
CM_ SG_ 3221225472 TirePressThresholdDetection_31 "Signal indicating the pressure level of the tire.";
CM_ SG_ 3221225472 TirePressThresholdDetection_30 "Signal indicating the pressure level of the tire.";
CM_ SG_ 3221225472 TirePressThresholdDetection_23 "Signal indicating the pressure level of the tire.";
CM_ SG_ 3221225472 TirePressThresholdDetection_22 "Signal indicating the pressure level of the tire.";
CM_ SG_ 3221225472 TirePressThresholdDetection_21 "Signal indicating the pressure level of the tire.";
CM_ SG_ 3221225472 TirePressThresholdDetection_20 "Signal indicating the pressure level of the tire.";
CM_ SG_ 3221225472 TirePressThresholdDetection_00 "Signal indicating the pressure level of the tire.";
CM_ SG_ 3221225472 TirePress_01 "Pressure at which air is contained in cavity formed by tire and rim.";
CM_ SG_ 3221225472 TirePress_00 "Pressure at which air is contained in cavity formed by tire and rim.";
CM_ SG_ 3221225472 CTIWheelSensorStatus_00 "Indicates whether the wheel is being monitored by the CTI controller.";
CM_ SG_ 3221225472 CTIWheelEndElectricalFault_00 "Indicates the status of electrical fault on CTI wheel interface.";
CM_ SG_ 3221225472 CTITireStatus_00 "Indicates the status of the tire.";
CM_ SG_ 3221225472 TripFanOnTimeDueToAManualSwitch "Total time the fan has been on due to manual activation by the operator (i.e., excluding time on due to automatic triggers)";
CM_ SG_ 3221225472 TripFanOnTime "Total time the fan has been on (due to an automatic trigger or manual trigger) since the last trip reset. The fan could be";
CM_ SG_ 3221225472 TripFanOnTimeDueToTheA_CSystem "Total time the fan has been on due to the A/C system since the last trip reset. For the time to be accumulated against the";
CM_ SG_ 3221225472 TripFanOnTimeDueToTheEngSystem "Total time the fan has been on due to engine triggers (i.e., excluding time on due to an operator manual switch or A/C";
CM_ SG_ 3221225472 TripDistanceInTopGear "Total distance accumulated while the vehicle has operated in top gear for a calibrated minimum time since the last trip";
CM_ SG_ 3221225472 TripGearDownDistance "Total distance accumulated while the vehicle has operated in the gear which is one gear down from top gear and exceeds";
CM_ SG_ 3221225472 TripDistanceOnVSL "Total distance accumulated while the engine torque mode is road speed governing since the last trip reset.";
CM_ SG_ 3221225472 AdjustLocalHourOffset "The hour component for setting the offset between the UTC (Universal Time Coordinate) time and date and a the local";
CM_ SG_ 3221225472 AdjustLocalMinuteOffset "The minute component for setting the offset between the UTC (Universal Time Coordinate) time and date and a the local";
CM_ SG_ 3221225472 AdjustYear "The year component for setting the current calendar date. This should be reported as the year component of the current";
CM_ SG_ 3221225472 AdjustDay "The day component for setting the current calendar date. This should be reported as the day component of the current";
CM_ SG_ 3221225472 AdjustMonth "The month component for setting the current calendar date. This should be reported as the month component of the";
CM_ SG_ 3221225472 AdjustHours "The hours component for setting the current time of day. This should be reported as the hours component of the current";
CM_ SG_ 3221225472 AdjustMinutes "The minutes component for setting the current time of day. This should be reported as the minutes component of the";
CM_ SG_ 3221225472 AdjustSeconds "The seconds component for setting the current time of day. This should be reported as the seconds component of the";
CM_ SG_ 3221225472 LocalHourOffset "The hour component of the offset between the UTC (Universal Time Coordinate) time and date and a local time zone time";
CM_ SG_ 3221225472 LocalMinuteOffset "The minute component of the offset between the UTC time and date and a local time zone time and date. This is the";
CM_ SG_ 3221225472 Year "The year component of the current calendar date. This should be reported as the year component of the current date at";
CM_ SG_ 3221225472 Day "The day component of the current calendar date. This should be reported as the day component of the current date at";
CM_ SG_ 3221225472 Month "The month component of the current calendar date. This should be reported as the month component of the current date";
CM_ SG_ 3221225472 Hours "The hour component of the current time of day. This should be reported as the hour component of the current time at";
CM_ SG_ 3221225472 Minutes "The minutes component of the current time of day. This should be reported as the minutes component of the current time";
CM_ SG_ 3221225472 Seconds "The seconds component of the current time of day. This should be reported as the seconds component of the current";
CM_ SG_ 3221225472 EngDsrdTrboWastegateActuator2Pos "The Requested Valve position of the Turbocharger Wastegate Valve 2, commanded by the engine ECM. A value of 0%";
CM_ SG_ 3221225472 EngTrbWstgateActuator1TempStatus "Used to identify the status of the Engine Turbocharger Wastegate Actuator 1 drive circuitry temperature. Temperature";
CM_ SG_ 3221225472 EngTrbWstgtActtor1PreliminaryFMI "Used to identify the applicable J1939-73 FMI detected in the Engine Turbocharger Wastegate Actuator 1 by the";
CM_ SG_ 3221225472 EngDsrdTrboWastegateActuator1Pos "The Requested Valve position of the Turbocharger Wastegate Valve 1, commanded by the engine ECM. A value of 0%";
CM_ SG_ 3221225472 EngTrbWstgteActuatorCtrlAirPress "Gage pressure of the air used to control the actuator which opens and closes the wastegate valve.";
CM_ SG_ 3221225472 EngTurboWastegateActuator4Pos "Position of the wastegate drive. A value of 0% represents fully closed and a value of 100% represents fully open.";
CM_ SG_ 3221225472 EngTurboWastegateActuator3Pos "Position of the wastegate drive. A value of 0% represents fully closed and a value of 100% represents fully open.";
CM_ SG_ 3221225472 EngTurboWastegateActuator2Pos "Position of the wastegate drive. A value of 0% represents fully closed and a value of 100% represents fully open.";
CM_ SG_ 3221225472 EngTurboWastegateActuator1Pos "Position of the wastegate drive. A value of 0% represents fully closed and a value of 100% represents fully open.";
CM_ SG_ 3221225472 EngTurbo4CompressorOutletTemp "Temperature of the air exiting the turbocharger 4 compressor outlet";
CM_ SG_ 3221225472 EngTurbo3CompressorOutletTemp "Temperature of the air exiting the turbocharger 3 compressor outlet";
CM_ SG_ 3221225472 EngTurbo2CompressorOutletTemp "Temperature of the air exiting the turbocharger 2 compressor outlet";
CM_ SG_ 3221225472 EngTurbo1CompressorOutletTemp "Temperature of the air exiting the turbocharger 1 compressor outlet";
CM_ SG_ 3221225472 EngTurbo4TurbineOutletTemp "Temperature of the combustion by-products exiting the turbine side of the turbocharger.";
CM_ SG_ 3221225472 EngTurbo3TurbineOutletTemp "Temperature of the combustion by-products exiting the turbine side of the turbocharger.";
CM_ SG_ 3221225472 EngTurbo2TurbineOutletTemp "Temperature of the combustion by-products exiting the turbine side of the turbocharger.";
CM_ SG_ 3221225472 EngTurbo1TurbineOutletTemp "Temperature of the combustion by-products exiting the turbine side of the turbocharger.";
CM_ SG_ 3221225472 EngTurbo4TurbineIntakeTemp "Temperature of the combustion by-products entering the turbine side of the turbocharger.";
CM_ SG_ 3221225472 EngTurbo3TurbineIntakeTemp "Temperature of the combustion by-products entering the turbine side of the turbocharger.";
CM_ SG_ 3221225472 EngTurbo2TurbineIntakeTemp "Temperature of the combustion by-products entering the turbine side of the turbocharger.";
CM_ SG_ 3221225472 EngTurbo1TurbineIntakeTemp "Temperature of the combustion by-products entering the turbine side of the turbocharger.";
CM_ SG_ 3221225472 EngTurbo4CompressorIntakePress "Gage pressure of the air entering the compressor side of the turbocharger.";
CM_ SG_ 3221225472 EngTurbo3CompressorIntakePress "Gage pressure of the air entering the compressor side of the turbocharger.";
CM_ SG_ 3221225472 EngTurbo2CompressorIntakePress "Gage pressure of the air entering the compressor side of the turbocharger.";
CM_ SG_ 3221225472 EngTurbo1CompressorIntakePress "Gage pressure of the air entering the compressor side of the turbocharger.";
CM_ SG_ 3221225472 EngTurbo4CompressorIntakeTemp "Temperature of the air entering the compressor side of the turbocharger.";
CM_ SG_ 3221225472 EngTurbo3CompressorIntakeTemp "Temperature of the air entering the compressor side of the turbocharger.";
CM_ SG_ 3221225472 EngTurbo2CompressorIntakeTemp "Temperature of the air entering the compressor side of the turbocharger.";
CM_ SG_ 3221225472 EngTurbo1CompressorIntakeTemp "Temperature of the air entering the compressor side of the turbocharger.";
CM_ SG_ 3221225472 EngTurbo4Speed "Rotational velocity of rotor in the turbocharger.";
CM_ SG_ 3221225472 EngTurbo3Speed "Rotational velocity of rotor in the turbocharger.";
CM_ SG_ 3221225472 EngTurbo2Speed "Rotational velocity of rotor in the turbocharger.";
CM_ SG_ 3221225472 EngTurboLubeOilPress2 "Gage pressure of oil in turbocharger lubrication system.";
CM_ SG_ 3221225472 TransTorqueLimit "Parameter provided to the engine from the transmission as a torque limit to be invoked by the engine in the event that";
CM_ SG_ 3221225472 TransGearRatio "The transmission configuration describes the number of forward gears, the number of reverse gears, and the ratio of each";
CM_ SG_ 3221225472 NumberOfForwardGearRatios "Number of forward gear ratios in the transmission, provided as part of the configuration.";
CM_ SG_ 3221225472 NumberOfReverseGearRatios "Number of reverse gear ratios in the transmission, provided as part of the transmission configuration.";
CM_ SG_ 3221225472 TransMode8 "Indicates whether transmission mode 8 is enabled. Modes are manufacturer specific and are not necessarily mutually";
CM_ SG_ 3221225472 TransMode7 "Indicates whether transmission mode 7 is enabled. Modes are manufacturer specific and are not necessarily mutually";
CM_ SG_ 3221225472 TransMode6 "Indicates whether transmission mode 6 is enabled. Modes are manufacturer specific and are not necessarily mutually";
CM_ SG_ 3221225472 TransMode5 "Indicates whether transmission mode 5 is enabled. Modes are manufacturer specific and are not necessarily mutually";
CM_ SG_ 3221225472 TrnsShftSlectorDisplayModeSwitch "Status of the operator’s switch used to ‘toggle’ through multiple display modes of a shift selector display.";
CM_ SG_ 3221225472 TransRequestedLaunchGear "Initial gear for the transmission to start out in when the vehicle is launched from a standing stop, as specified by the";
CM_ SG_ 3221225472 TransMode4 "Indicates whether transmission mode 4 is enabled. Modes are manufacturer specific and are not necessarily mutually";
CM_ SG_ 3221225472 TransMode3 "Indicates whether transmission mode 3 is enabled. Modes are manufacturer specific and are not necessarily mutually";
CM_ SG_ 3221225472 TransMode2 "Indicates whether transmission mode 2 is enabled. Modes are manufacturer specific and are not necessarily mutually";
CM_ SG_ 3221225472 TransMode1 "Indicates whether transmission mode 1 is enabled. Modes are manufacturer specific and are not necessarily mutually";
CM_ SG_ 3221225472 DisengageDiffLockRqCentralRear "Command signal used to disengage the various differential locks, e.g., to allow an undistributed individual wheel control";
CM_ SG_ 3221225472 DisengageDiffLockRqCentralFront "Command signal used to disengage the various differential locks, e.g., to allow an undistributed individual wheel control";
CM_ SG_ 3221225472 DisengageDiffLockRqCentral "Command signal used to disengage the various differential locks, e.g., to allow an undistributed individual wheel control";
CM_ SG_ 3221225472 DisengageDiffLockRqRearAxle2 "Command signal used to disengage the various differential locks, e.g., to allow an undistributed individual wheel control";
CM_ SG_ 3221225472 DisengageDiffLockRqRearAxle1 "Command signal used to disengage the various differential locks, e.g., to allow an undistributed individual wheel control";
CM_ SG_ 3221225472 DisengageDiffLockRqFrontAxle2 "Command signal used to disengage the various differential locks, e.g., to allow an undistributed individual wheel control";
CM_ SG_ 3221225472 DisengageDiffLockRqFrontAxle1 "Command signal used to disengage the various differential locks, e.g., to allow an undistributed individual wheel control";
CM_ SG_ 3221225472 TransRequestedGear "Gear requested by the operator, ABS, or engine.";
CM_ SG_ 3221225472 RequestedPercentClutchSlip "Parameter which represents the percent clutch slip requested by a device.";
CM_ SG_ 3221225472 TransReverseGearShiftInhibitRq "Allows devices external to the normal transmission shift selector system to request the transmission to inhibit shifts into";
CM_ SG_ 3221225472 DisengageDrivelineRq "Command signal used to simply disengage the driveline, e.g., to prevent engine drag torque from causing high wheel slip";
CM_ SG_ 3221225472 TrnsTrqeConverterLockupDisableRq "Command signal to prevent torque converter lockup, which may cause problems in certain circumstances for ASR.";
CM_ SG_ 3221225472 TransGearShiftInhibitRq "Command signal to inhibit gear shifts.";
CM_ SG_ 3221225472 EngTurboOilLevelSwitch "Switch signal which indicates the presence of oil at the turbocharger";
CM_ SG_ 3221225472 EngTurbo1Speed "Rotational velocity of rotor in the turbocharger.";
CM_ SG_ 3221225472 EngTurboLubeOilPress1 "Gage pressure of oil in turbocharger lubrication system.";
CM_ SG_ 3221225472 EngTotalAverageFuelEconomy "Average fuel economy, equal to total vehicle distance divided by total fuel used, over the life of the engine";
CM_ SG_ 3221225472 EngTotalAverageFuelRate "Average fuel rate, equal to total fuel used divided by total engine hours, over the life of the engine";
CM_ SG_ 3221225472 AirSuspensionSupplyPressRq "Command signal to influence the pneumatic pressure in the circuit for the electronically controlled air suspension system.";
CM_ SG_ 3221225472 AuxEquipmentSupplyPressRq "Command signal to influence the pneumatic pressure in the auxiliary circuit. This parameter is the setpoint for the";
CM_ SG_ 3221225472 ServiceBrakeAirPressRqCircuit2 "Command signal to influence the pneumatic pressure in the service brake circuit or reservoir #2. This parameter is the";
CM_ SG_ 3221225472 ServiceBrakeAirPressRqCircuit1 "Command signal to influence the pneumatic pressure in the service brake circuit or reservoir #1. This parameter is the";
CM_ SG_ 3221225472 ParkingAnd_orTrailerAirPressRq "Command signal to influence the pneumatic pressure in the circuit or reservoir for the parking brake and/or the trailer";
CM_ SG_ 3221225472 PneumaticSupplyPressRq "Command signal to influence the pneumatic pressure in the main reservoir. This parameter is the setpoint for the";
CM_ SG_ 3221225472 EngExtlShutdownAirSupplyPress "Pressure of the air used to shut off the fuel supply to the engine.";
CM_ SG_ 3221225472 NmbrOfSftwreIdentificationFields "Number of software identification designators represented in the software identification parameter group.";
CM_ SG_ 3221225472 SoftwareIdentification "Software identification of an electronic module. As an example, this parameter may be represented with ASCII characters";
CM_ SG_ 3221225472 PTOShutdownHasShutdownEng "Status signal which identifies whether or not the engine has been shutdown by the PTO shutdown system.";
CM_ SG_ 3221225472 EngAirShutoffStatus "State signal which indicates the actual measured position of the Air Shutoff.";
CM_ SG_ 3221225472 EngOverspeedTest "The engine overspeed test signal as measured by the reporting ECM. Engine Overspeed Test is a mechanism to";
CM_ SG_ 3221225472 EngAirShutoffCmdStatus "State signal which indicates when the Air Shutoff driver output is being driven. Disabled means controller wants air";
CM_ SG_ 3221225472 EngAlarmOutputCmdStatus "State signal which indicates when the Alarm driver output is being driven. Not active means the Controller has no alarm";
CM_ SG_ 3221225472 EngAlarmAcknowledge "The Engine Alarm Acknowledge Input signal as measured by the reporting ECM. The Engine Alarm Acknowledge is a";
CM_ SG_ 3221225472 EngProtectionSystemConfig "Parameter which indicates the configuration of the engine shutdown system.";
CM_ SG_ 3221225472 EngProtectionSystemTimerState "Status signal which indicates the current mode of the engine protection system timer system. See Figure SPN1107_A.";
CM_ SG_ 3221225472 EngProtectionSystemTimerOverride "Status signal which indicates the status of the override feature of the engine protection system timer. See Figure";
CM_ SG_ 3221225472 EngPrtctnSystmApprachingShutdown "Status signal which indicates that engine shutdown is imminent. This engine protection signal can be a result of different";
CM_ SG_ 3221225472 EngPrtectionSystemHasShutdownEng "Status signal which indicates whether or not the engine protection system has shutdown the engine. See Figure";
CM_ SG_ 3221225472 EngWaitToStartLamp "Lamp signal which indicates that the engine is too cold to start and the operator should wait until the signal becomes";
CM_ SG_ 3221225472 RefrigerantHighPressSwitch "Switch signal which indicates the position of the high pressure switch in the coolant circuit of an air conditioning system.";
CM_ SG_ 3221225472 RefrigerantLowPressSwitch "Switch signal which indicates the position of the low pressure switch in the coolant circuit of an air conditioning system.";
CM_ SG_ 3221225472 A_CHighPressFanSwitch "Switch signal which indicates that the pressure in the coolant circuit of an air conditioning system is high and the fan may";
CM_ SG_ 3221225472 EngIdleShutdownTimerFunction "Parameter which indicates the configuration of the idle shutdown timer system.";
CM_ SG_ 3221225472 EngIdleShutdownTimerState "Status signal which indicates the current mode of operation of the idle shutdown timer system. See Figure SPN590_A.";
CM_ SG_ 3221225472 EngIdleShutdownTimerOverride "Status signal which indicates the status of the override feature of the idle shutdown timer system. See Figure SPN590_A.";
CM_ SG_ 3221225472 EngIdleShutdownDriverAlertMode "Status signal which indicates the status of the driver alert mode of the idle shutdown timer system. While the driver alert";
CM_ SG_ 3221225472 EngIdleShutdownHasShutdownEng "Status signal which identifies whether or not the engine has been shutdown by the idle shutdown timer system. See";
CM_ SG_ 3221225472 IndustryGroup "0 = Global; 
   1  = On-Highway; 
   2  = Agricultural and Forestry; 
   3  = Construction; 
   4  = Marine;
   5  = Industrial - Process
          Control - Stationary (Gen-Sets)
   6  = Reserve for SAE
   7  = Reserve for SAE0 = Global; 
   1  = On-Highway; 
   2  = Agricultural and Forestry; 
   3  = Construction; 
   4  = Marine;
   5  = Industrial - Process
          Control - Stationary (Gen-Sets)
   6  = Reserve for SAE
   7  = Reserve for SAE0 = Global; 
   1  = On-Highway; 
   2  = Agricultural and Forestry; 
   3  = Construction; 
   4  = Marine;
   5  = Industrial - Process
          Control - Stationary (Gen-Sets)
   6  = Reserve for SAE
   7  = Reserve for SAE";
CM_ SG_ 3221225472 ManufacturerCode "Assigned by NMEA 2000 CommitteeAssigned by NMEA 2000 CommitteeAssigned by NMEA 2000 Committee";
CM_ SG_ 3221225472 SrviceDelay_OperationalTimeBased "The time in vehicle operational time until the next vehicle service inspection is required. A negative value is transmitted if";
CM_ SG_ 3221225472 ServiceComponentIdentification "Identification of component needing service. See Table SPN911_A.Identification of component needing service. See Table SPN911_A.Identification of component needing service. See Table SPN911_A.Identification of component needing service. See Table SPN911_A.Identification of component needing service. See Table SPN911_A.";
CM_ SG_ 3221225472 ServiceDelay_CalendarTimeBased "The time in weeks until the next vehicle service inspection is required. A negative value is transmitted if the service";
CM_ SG_ 3221225472 ServiceDistance "The distance which can be traveled by the vehicle before the next service inspection is required. A negative distance is";
CM_ SG_ 3221225472 TimeSinceLastService "The vehicle operation time since the last service was performed. The type of service information is identified by the";
CM_ SG_ 3221225472 MinContinuousRetarderTorque "Applied limit for minimum continuous retarder torque";
CM_ SG_ 3221225472 MaxContinuousRetarderTorque "Applied limit for maximum continuous retarder torque.";
CM_ SG_ 3221225472 MinContinuousRetarderSpeed "Applied limit for minimum continuous retarder RPM";
CM_ SG_ 3221225472 MaxContinuousRetarderSpeed "Applied limit for maximum continuous retarder RPM";
CM_ SG_ 3221225472 HghLmtThrshldFrMnCntnsTrqFrmRtrd "Maximum allowable value for minimum continuous retarder torque.";
CM_ SG_ 3221225472 LwLmtThrshldFrMxTrqeFromRetarder "Minimum allowable value for maximum continuous retarder torque.";
CM_ SG_ 3221225472 HghLmtThrshldFrMnCntnsRPMFrmRtrd "Maximum allowable value for minimum continuous retarder speed";
CM_ SG_ 3221225472 LwLmtThrshldFrMaxRPMFromRetarder "Minimum allowable value for maximum continuous retarder speed";
CM_ SG_ 3221225472 DrvlineRetarderOverheatIndicator "Signal from the driveline retarder indicating that its fluid temperature is above normal acceptable limits, and as a result,";
CM_ SG_ 3221225472 HydRetarderOilTemp "Temperature of oil found in a hydraulic retarder.";
CM_ SG_ 3221225472 HydRetarderPress "Gage pressure of oil in hydraulic retarder system.";
CM_ SG_ 3221225472 SteerStraightAheadPosReset "Used to reset the straight ahead position for a steering sensor in the steering column or a steering controller's straight";
CM_ SG_ 3221225472 EngBuildHoursReset "Command signal used to reset the engine rebuild hours.";
CM_ SG_ 3221225472 TripGroup2Proprietary "Command signal used to reset proprietary parameters associated with a trip but not defined within this document.";
CM_ SG_ 3221225472 TripGroup1 "Command signal used to reset the PGNs and parameters as defined in Table SPN988_A.";
CM_ SG_ 3221225472 PercentTorqueAtPeakTorquePoint5 "The torque limit that indicates the available retarder torque which can be provided by the retarder at point 5 of the retarder";
CM_ SG_ 3221225472 RetarderSpeedAtPeakTorquePoint5 "Please reference PGN 65249";
CM_ SG_ 3221225472 PercentTorqueAtPoint4 "The torque limit that indicates the available retarder torque which can be provided by the retarder at points 3 and 4 of the";
CM_ SG_ 3221225472 RetarderSpeedAtPoint4 "Retarder speed of point 4 of the engine retarder torque map. Please reference PGN 65249.";
CM_ SG_ 3221225472 PercentTorqueAtPoint3 "The torque limit that indicates the available retarder torque which can be provided by the retarder at points 3 and 4 of the";
CM_ SG_ 3221225472 RetarderSpeedAtPoint3 "Retarder speed of point 3 of the engine retarder torque map. Please reference PGN 65249.";
CM_ SG_ 3221225472 PercentTorqueAtMaxSpeedPoint2 "The torque limit that indicates the available retarder torque which can be provided by the retarder at its maximum speed.";
CM_ SG_ 3221225472 MaxRetarderSpeedPoint2 "Maximum speed of retarder (Please reference PGN 65249).";
CM_ SG_ 3221225472 PercentTorqueAtIdlePoint1 "The torque limit that indicates the available retarder torque which can be provided by the retarder at idle speed. The data";
CM_ SG_ 3221225472 RetarderSpeedAtIdlePoint1 "Please reference PGN 65249";
CM_ SG_ 3221225472 RetarderCtrlMethod "This parameter identifies the number of steps used by the retarder.";
CM_ SG_ 3221225472 RetarderLocation "This parameter defines whether the “torque/speed curve” defined by the retarder configuration message (PGN 65249) is";
CM_ SG_ 3221225472 RetarderType "A vehicle retarder is a supplementary device to the wheel brakes for the driver to better control the vehicle. The wheel";
CM_ SG_ 3221225472 EngOperationTimeSinceRebuild "The time in engine operation since the last engine rebuild.";
CM_ SG_ 3221225472 PowerTakeoffSetSpeed "Rotational velocity selected by operator for device used to transmit engine power to auxiliary equipment.";
CM_ SG_ 3221225472 PowerTakeoffSpeed "Rotational velocity of device used to transmit engine power to auxiliary equipment.";
CM_ SG_ 3221225472 PowerTakeoffOilTemp "Temperature of lubricant in device used to transmit engine power to auxiliary equipment.";
CM_ SG_ 3221225472 OprtrEngPTOGvrnrMmrySelectSwitch "Measured state of the operator’s engine PTO governor memory select switch. This switch selects which of the two";
CM_ SG_ 3221225472 EngRmtPTOGvrnrVrblSpedCtrlSwitch "Switch signal which indicates that the remote PTO governor toggle switch is in the enabled (ON) position. If the toggle";
CM_ SG_ 3221225472 EngRmtPTOGvrnrPrprgrmmdSpdCtrlSw "Switch signal which indicates that the remote PTO governor toggle switch is in the enabled (ON) position. If the toggle";
CM_ SG_ 3221225472 EngPTOGvrnrCast_DecelerateSwitch "Switch signal of the PTO control activator which indicates that the activator is in the position to \"coast/decelerate\" the PTO";
CM_ SG_ 3221225472 EngPTOGovernorSetSwitch "Switch signal of the PTO control activator which indicates that the activator is in the position to \"set\" the engine PTO";
CM_ SG_ 3221225472 EngPTOGovernorResumeSwitch "Switch signal of the PTO control activator which indicates that the activator is in the position to \"resume\" a previously";
CM_ SG_ 3221225472 EngPTOGovernorEnableSwitch "Switch signal which indicates that the PTO governor toggle switch is in the enabled (ON) position and therefore it is";
CM_ SG_ 3221225472 EngPTOGovernorAccelerateSwitch "Switch signal of the PTO control activator which indicates that the activator is in the position to \"accelerate\" the PTO";
CM_ SG_ 3221225472 RmtPTOGvrnrPrprgrmmdSpdCtrlSwtch "Switch signal which indicates that the remote PTO governor toggle switch #2 is in the enabled (ON) position. If the toggle";
CM_ SG_ 3221225472 AuxInputIgnoreSwitch "Switch signal which overrides other switch input's ability to disable an engine's operating condition.";
CM_ SG_ 3221225472 EngAltDroopAuxInputSelect "In some off-highway applications it may be desirable to have multiple droop settings available across the range of engine";
CM_ SG_ 3221225472 EngAltDroopRemoteAccelSelect "In some off-highway applications it may be desirable to have multiple droop settings available across the range of engine";
CM_ SG_ 3221225472 EngAltDroopAccel2Select "Same description as Engine Alternate Droop Accelerator 1 Select (SPN 2881) except that the selections may apply to";
CM_ SG_ 3221225472 EngAltDroopAccel1Select "In some off-highway applications it may be desirable to have multiple droop settings available across the range of engine";
CM_ SG_ 3221225472 EngAltRatingSelect "In some off-highway applications it may be desirable to have multiple engine ratings available for selection by the";
CM_ SG_ 3221225472 EngAltLowIdleSwitch "Operator switch which selects between two low idle speeds, default and alternate.";
CM_ SG_ 3221225472 EngSynchronizationSwitch "This is the On/Off operation of the Multiple Unit Synchronization functionality. When it is enabled (i.e. On) the master";
CM_ SG_ 3221225472 EngAuxGovernorSwitch "This is the On/Off operation of the Auxiliary Governor feature switch. This feature is used to allow engine speed to be";
CM_ SG_ 3221225472 EngAltDroopAuxInputSelectState "In some off-highway applications it may be desirable to have multiple droop settings available across the range of engine";
CM_ SG_ 3221225472 EngAltDropRemoteAccelSelectState "In some off-highway applications it may be desirable to have multiple droop settings available across the range of engine";
CM_ SG_ 3221225472 EngAltDroopAccel2SelectState "In some off-highway applications it may be desirable to have multiple droop settings available across the range of engine";
CM_ SG_ 3221225472 EngAltDroopAccel1SelectState "In some off-highway applications it may be desirable to have multiple droop settings available across the range of engine";
CM_ SG_ 3221225472 EngAltRatingSelectState "In some off-highway applications it may be desirable to have multiple engine ratings available for selection by the";
CM_ SG_ 3221225472 EngAltLowIdleSelectState "In many applications, it is desirable that an alternate low idle speed setting be made available via switch input. The normal";
CM_ SG_ 3221225472 EngMultiUnitSyncState "This feature is widely used in Industry to operate multiple engines from a single command source. A master engine will";
CM_ SG_ 3221225472 EngAuxGovernorState "This is the Engine Auxiliary Governor feature. This feature is used to allow engine speed to be controlled by an auxiliary";
CM_ SG_ 3221225472 AppliedVehicleSpeedLimit "The vehicle speed limit in effect.";
CM_ SG_ 3221225472 MaxVehicleSpeedLimit7 "The highest of the seven lowest vehicle speed limits";
CM_ SG_ 3221225472 MaxVehicleSpeedLimit6 "The highest of the six lowest vehicle speed limits";
CM_ SG_ 3221225472 MaxVehicleSpeedLimit5 "The highest of the five lowest vehicle speed limits";
CM_ SG_ 3221225472 MaxVehicleSpeedLimit4 "The highest of the four lowest vehicle speed limits";
CM_ SG_ 3221225472 MaxVehicleSpeedLimit3 "The highest of the three lowest vehicle speed limits";
CM_ SG_ 3221225472 MaxVehicleSpeedLimit2 "The highest of the two lowest vehicle speed limits";
CM_ SG_ 3221225472 MaxVehicleSpeedLimit1 "The lowest Maximum Vehicle Speed Limit. This value is the similar to SPN 74. However, SPN 74 was not specifically";
CM_ SG_ 3221225472 OprtrsBlackOutIntensitySelection "Operators Selection of lamp intensity in black out mode. This parameter provides the operators selected illumination";
CM_ SG_ 3221225472 BlackOutWorkLampSelect "Black Out Work Lamp Selection";
CM_ SG_ 3221225472 NightVisionIlluminatorSelect "Night Vision Illuminator Selection";
CM_ SG_ 3221225472 BlackOutBrake_StopLampSelect "Black Out Brake/Stop Lamp Selection";
CM_ SG_ 3221225472 ConvoyDrivingLampSelect "Black Out Convoy Driving Lamp Selection";
CM_ SG_ 3221225472 ConvoyLampSelect "Black Out Convoy Lamp Selection";
CM_ SG_ 3221225472 FrontBlackOutMarkerLampSelect "Front Black Out Marker Lamp Selection";
CM_ SG_ 3221225472 RearBlackOutMarkerSelect "Rear Black Out Marker Selection";
CM_ SG_ 3221225472 SlowVesselModeStatus "The status of the Slow Vessel Mode. Slow Vessel Mode puts the engine in a lower-than-normal low idle speed during";
CM_ SG_ 3221225472 TrollingModeStatus "The status of the Trolling Mode. Trolling mode limits the top speed. Full range travel of the throttle level spans from low";
CM_ SG_ 3221225472 EngThrttlSynchrnzationModeStatus "The status of the Throttle Synchronization Mode. Throttle Synchronization Mode is used to indicate which throttle, if any,";
CM_ SG_ 3221225472 EngMainBearing11Temp "Temperature of the main bearing which supports the crankshaft of the engine.";
CM_ SG_ 3221225472 EngMainBearing10Temp "Temperature of the main bearing which supports the crankshaft of the engine.";
CM_ SG_ 3221225472 EngMainBearing9Temp "Temperature of the main bearing which supports the crankshaft of the engine.";
CM_ SG_ 3221225472 EngMainBearing8Temp "Temperature of the main bearing which supports the crankshaft of the engine.";
CM_ SG_ 3221225472 EngMainBearing7Temp "Temperature of the main bearing which supports the crankshaft of the engine.";
CM_ SG_ 3221225472 EngMainBearing6Temp "Temperature of the main bearing which supports the crankshaft of the engine.";
CM_ SG_ 3221225472 EngMainBearing5Temp "Temperature of the main bearing which supports the crankshaft of the engine.";
CM_ SG_ 3221225472 EngMainBearing4Temp "Temperature of the main bearing which supports the crankshaft of the engine.";
CM_ SG_ 3221225472 EngMainBearing3Temp "Temperature of the main bearing which supports the crankshaft of the engine.";
CM_ SG_ 3221225472 EngMainBearing2Temp "Temperature of the main bearing which supports the crankshaft of the engine.";
CM_ SG_ 3221225472 EngMainBearing1Temp "Temperature of the main bearing which supports the crankshaft of the engine.";
CM_ SG_ 3221225472 DisplayDeadbands "Sets Display Deadbands mode.";
CM_ SG_ 3221225472 LEDPatternCtrl "Sets LED Pattern control mode on laser leveling systems.";
CM_ SG_ 3221225472 LEDDisplayDeadbandCtrl "This parameter informs the system what the selected Display deadband will be.";
CM_ SG_ 3221225472 LEDDisplayModeCtrl "This parameter informs the system what the selected Display mode will be.";
CM_ SG_ 3221225472 LEDDisplayData1 "Informs display devices how to display the current vertical position.";
CM_ SG_ 3221225472 LaserStrikeDataLatency "Time from laser strike to CAN message transmission. This parameter will be reported by survey receiver type devices";
CM_ SG_ 3221225472 LaserReceiverType "Identifies which type of Laser Receiver transmitted the message.";
CM_ SG_ 3221225472 LaserStrikeVerticalDeviation "The calculated distance from the laser strike position to the current land leveling system reference point.";
CM_ SG_ 3221225472 AbsLaserStrikePos "Laser Strike location on the survey type laser receiver.";
CM_ SG_ 3221225472 LaserTracerInformation "Provides the status of the laser tracer to the operator.";
CM_ SG_ 3221225472 LEDDisplayData2 "Informs display devices how to display the current position of the laser tracer.";
CM_ SG_ 3221225472 LaserTracerHorizontalDeviation "The calculated percent deviation between the target distance and the center of the laser tracer.";
CM_ SG_ 3221225472 LaserTracerVerticalDistance "The elevation of the laser tracer sensor in a laser leveling system.";
CM_ SG_ 3221225472 LaserTracerTargetDeviation "The calculated distance for the laser target to the current laser tracer reference point.";
CM_ SG_ 3221225472 BldeHeightSetPointHighResolution "High resolution for the laser guided blade set point. The high resolution required for more accurate control and 'accurate'";
CM_ SG_ 3221225472 ModifyLevelingSystemSetPoint "Used to control and coordinate the set point for the leveling system.";
CM_ SG_ 3221225472 StElvtnSensor2ReferenceElevation "Command from a display or other external device (i.e. remote switch) to the land leveling system controller instructing the";
CM_ SG_ 3221225472 StElvtnSensor1ReferenceElevation "Command from a display or other external device (i.e. remote switch) to the land leveling system controller instructing the";
CM_ SG_ 3221225472 SdshftDsrdBldeOffsetOperatorCtrl "This parameter indicates the side-shift blade control mode operator control state the user has set for the land leveling";
CM_ SG_ 3221225472 SdshiftBladeCtrlModeOperatorCtrl "This parameter indicates the side-shift offset operator control state the user has set for the land leveling system. When an";
CM_ SG_ 3221225472 RghtDsredBladeOffsetOperatorCtrl "This parameter indicates the right blade offset operator control state the user has set for the land leveling system. The";
CM_ SG_ 3221225472 LftDsiredBladeOffsetOperatorCtrl "This parameter indicates the left blade offset operator control state the user has set for the land leveling system. The left";
CM_ SG_ 3221225472 RightBladeCtrlModeOperatorCtrl "This parameter indicates the right blade control mode operator control state the user has set for the land leveling system.";
CM_ SG_ 3221225472 LeftBladeCtrlModeOperatorCtrl "This parameter indicates the left blade control mode operator control state the user has set for the land leveling system.";
CM_ SG_ 3221225472 BladeAutoModeCmd "Allows other controllers to command to the primary control system what they think is the appropriate auto control mode to";
CM_ SG_ 3221225472 DesiredGradeOffsetSwitch "This parameter indicates the grade offset switch state the user has set for the land leveling system. The desired grade";
CM_ SG_ 3221225472 BladeCtrlModeSwitch "This parameter indicates the blade control mode switch state the user has set for the land leveling system. The switch";
CM_ SG_ 3221225472 MastPos "Used to monitor the position of the sensor attached to the land leveling mast.";
CM_ SG_ 3221225472 FlexibleFuelPercentage "Measured signal that indicates the percentage of alcohol in the fuel currently being used. 0% means no alcohol in fuel,";
CM_ SG_ 3221225472 EngAverageFuelEconomy "Average of instantaneous fuel economy for that segment of vehicle operation of interest.";
CM_ SG_ 3221225472 EngInstantaneousFuelEconomy "Current fuel economy at current vehicle velocity.";
CM_ SG_ 3221225472 EngFuelRate "Amount of fuel consumed by engine per unit of time.";
CM_ SG_ 3221225472 EngThrottleValve2Pos "The sensed position feedback of the valve, coming from a second electrical actuator for a second throttle plate, used to";
CM_ SG_ 3221225472 EngThrottleValve1Pos "The position of the valve used to regulate the supply of a fluid, usually air or fuel/air mixture, to an engine. 0% represents";
CM_ SG_ 3221225472 EngTotalFuelUsed "Accumulated amount of fuel used during vehicle operation. See SPN 5054 for alternate resolution.";
CM_ SG_ 3221225472 EngTripFuel "Fuel consumed during all or part of a journey. See SPN 5053 for alternate resolution.";
CM_ SG_ 3221225472 FrontWheelDriveActuatorStatus "Feedback on the front wheel drive actuator.";
CM_ SG_ 3221225472 FMSstandardSWversionSupported "Information that identifies which issue level of the FMS-standard document the software included in the FMS gateway";
CM_ SG_ 3221225472 FMSstandardRequestsSupported "Status signal which indicates if the FMS Vehicle Interface (FMS Gateway) will respond to requests from the FMS device";
CM_ SG_ 3221225472 FMSstandardDiagnosticsSupported "Status signal which indicates if the FMS Vehicle Interface (FMS Gateway) supports the handling of diagnostic messages";
CM_ SG_ 3221225472 LnDpartureIndicationEnableStatus "Indicates whether lane departure indication is active.";
CM_ SG_ 3221225472 LaneTrackingStatusLeftSide "Indicates whether the left side is tracking lane.";
CM_ SG_ 3221225472 LaneTrackingStatusRightSide "Indicates whether right side is tracking lane.";
CM_ SG_ 3221225472 EngFuelLeakage2 "Status signal which indicates fuel leakage in the fuel rail of the engine. Location can be either before or after the fuel";
CM_ SG_ 3221225472 EngFuelLeakage1 "Status signal which indicates fuel leakage in the fuel rail of the engine. Location can be either before or after the fuel";
CM_ SG_ 3221225472 FanDriveBypassCmdStatus "Status of the Fan Drive Bypass Command as being commanded by the ECU. The fan drive bypass diverts pump";
CM_ SG_ 3221225472 HydFanMotorPress "The hydraulic pressure used to drive the fan system, sensed before the hydraulic fan motor.";
CM_ SG_ 3221225472 FanSpeed "The speed of the fan associated with engine coolant system.";
CM_ SG_ 3221225472 FanDriveState "This parameter is used to indicate the current state or mode of operation by the fan drive.";
CM_ SG_ 3221225472 EstPercentFanSpeed "Estimated fan speed as a ratio of the fan drive (current speed) to the fully engaged fan drive (maximum fan speed). A two";
CM_ SG_ 3221225472 EngTorqueLimit6AxleInput "Limit applied to the engine output torque based on the maximum allowable axle input torque. Axle input torque is";
CM_ SG_ 3221225472 EngTorqueLimit5Switch "Limit applied to the engine output torque based on activation of an ECU switch input.";
CM_ SG_ 3221225472 EngTorqueLimit4Trans "Limit applied to the engine output torque during vehicle operation in transmission gear ratios numerically less than or";
CM_ SG_ 3221225472 EngTorqueLimit3Trans "Limit applied to the engine output torque during vehicle operation in transmission gear ratios numerically less than or";
CM_ SG_ 3221225472 TransGearRatio3 "Gear ratio value stored in the ECU that is used to define a range of transmission gears for which a limit is applied to the";
CM_ SG_ 3221225472 EngTorqueLimit2Trans "Limit applied to the engine output torque during vehicle operation in transmission gear ratios numerically less than or";
CM_ SG_ 3221225472 TransGearRatio2 "Gear ratio value stored in the ECU that is used to define a range of transmission gears for which a limit is applied to the";
CM_ SG_ 3221225472 EngTorqueLimit1Trans "Limit applied to the engine output torque during vehicle operation in transmission gear ratios numerically greater than";
CM_ SG_ 3221225472 TransGearRatio1 "Gear ratio value stored in the ECU that is used to define a range of transmission gears for which a limit is applied to the";
CM_ SG_ 3221225472 EngTorqueLimitFeature "Torque limit rating described in the current record.";
CM_ SG_ 3221225472 TorqueLimitingFeatureStatus "Status of an ECU feature which limits the torque output of the engine.";
CM_ SG_ 3221225472 CalibRecordDurationTime "Duration in hours for which the engine operated in the conditions captured in the current record.";
CM_ SG_ 3221225472 CalibRecordStartYear "Calendar year timestamp when an ECU record was established.";
CM_ SG_ 3221225472 CalibRecordStartDay "Calendar day timestamp when an ECU record was established.";
CM_ SG_ 3221225472 CalibRecordStartMonth "Calendar month timestamp when an ECU record was established.";
CM_ SG_ 3221225472 EngPeakTorque2 "Maximum torque output of the current ECU calibration when the engine operates on torque curve 2. For calibrations that";
CM_ SG_ 3221225472 EngPeakTorque1 "Maximum torque output of the current ECU calibration when the engine operates on torque curve 1. For calibrations that";
CM_ SG_ 3221225472 EngPower "Advertised engine power capability. Advertised power is what a customer will find on a sales sheet for an engine with a";
CM_ SG_ 3221225472 NumberOfEngTorqueHistoryRecords "Number of torque history records contained in the engine torque history PGN. A value of 0 is broadcast if no torque";
CM_ SG_ 3221225472 TransClutch_ConverterInputSpeed "Rotational velocity of the input to a transmission's master clutch or torque converter. In most cases the rotational velocity";
CM_ SG_ 3221225472 TransTorqueConverterRatio "Ratio of the transmissions torque converter output torque to torque converter input torque at current speed.";
CM_ SG_ 3221225472 TrnsRverseGearShiftInhibitStatus "Reflects the status of transmission reverse inhibit activity in response to requests via SPN 4242 - Transmission Reverse";
CM_ SG_ 3221225472 TrnsCrrentRangeDisplayBlankState "State signal indicating a transmission request for the display of the Transmission Current Range parameter (SPN 163) to";
CM_ SG_ 3221225472 TransWarningIndicator "Signal from transmission indicating that some aspect of its operation is not functioning correctly, and as a result,";
CM_ SG_ 3221225472 TransMode8Indicator "Indicates whether transmission mode 8 is enabled. Modes are manufacturer specific and are not necessarily mutually";
CM_ SG_ 3221225472 TransMode7Indicator "Indicates whether transmission mode 7 is enabled. Modes are manufacturer specific and are not necessarily mutually";
CM_ SG_ 3221225472 TransMode6Indicator "Indicates whether transmission mode 6 is enabled. Modes are manufacturer specific and are not necessarily mutually";
CM_ SG_ 3221225472 TransMode5Indicator "Indicates whether transmission mode 5 is enabled. Modes are manufacturer specific and are not necessarily mutually";
CM_ SG_ 3221225472 TransRequestedGearFeedback "Feedback of the SPN 525 Transmission Requested Gear input as received from the shift selector, ABS or engine via";
CM_ SG_ 3221225472 TransMode1Indicator "This state signal is the transmission’s indication that it is operating under transmission mode 1 (SPN 1852) as";
CM_ SG_ 3221225472 TransMode2Indicator "This state signal is the transmission’s indication that it is operating under transmission mode 2 (SPN 1853) as";
CM_ SG_ 3221225472 TransMode3Indicator "This state signal is the transmission’s indication that it is operating under transmission mode 3 (SPN 1854) as";
CM_ SG_ 3221225472 TransMode4Indicator "This state signal is the transmission’s indication that it is operating under transmission mode 4 (SPN 1855) as";
CM_ SG_ 3221225472 TransShiftInhibitIndicator "State signal indicating a transmission request for the Shift Inhibit Indicator to be active or inactive. The shift inhibit";
CM_ SG_ 3221225472 TransEngCrankEnable "State signal from the transmission indicating if the transmission’s status is such that engine cranking is allowed (i.e. at a";
CM_ SG_ 3221225472 ActiveShiftConsoleIndicator "Signal from transmission control unit indicating which shift console (primary or secondary) it currently considers as the";
CM_ SG_ 3221225472 TransReadyForBrakeRelease "This parameter indicates that enough torque / motive force is available at the transmission output shaft to release all the";
CM_ SG_ 3221225472 TrnsRqstedRangeDisplayFlashState "State signal indicating a transmission request for the display of the Transmission Requested Range parameter (SPN 162)";
CM_ SG_ 3221225472 TrnsRqstedRangeDisplayBlankState "State signal indicating a transmission request for the display of the Transmission Requested Range parameter (SPN162)";
CM_ SG_ 3221225472 TransServiceIndicator "Signal from transmission indicating that some aspect of the gearbox requires servicing, such as the oil, filter, clutch(es) or";
CM_ SG_ 3221225472 ClutchLifeRemaining "Signal which indicates the actual clutch life remaining in percent. One hundred percent means the clutch is brand new";
CM_ SG_ 3221225472 LowestPossibleGear "The transmission calculates this gear continuously. Together with the highest possible gear (see SPN 1115), it enables a";
CM_ SG_ 3221225472 HighestPossibleGear "The transmission calculates this gear continuously. Together with the lowest possible gear (see SPN 1114), it enables a";
CM_ SG_ 3221225472 RecommendedGear "The transmission calculates this gear continuously. In dangerous situations this gear may be selected to gain back";
CM_ SG_ 3221225472 TransForwardDirectionSwitch "Identifies the status of the switch that indicates forward direction.";
CM_ SG_ 3221225472 TransNeutralSwitch "Identifies the status of the switch that indicates neutral.";
CM_ SG_ 3221225472 TransReverseDirectionSwitch "Identifies the status of the switch that indicates reverse direction.";
CM_ SG_ 3221225472 TransLowRangeSenseSwitch "Identifies the status of the switch that represents low range.";
CM_ SG_ 3221225472 TransHighRangeSenseSwitch "Identifies the status of the switch that represents high range.";
CM_ SG_ 3221225472 TransSynchronizerBrakeValue "The current modulated value for the air supply to the synchronizer brake.";
CM_ SG_ 3221225472 TransSynchronizerClutchValue "The current modulated value for the air supply to the synchronizer clutch.";
CM_ SG_ 3221225472 TransInertiaBrakeActuator "Identifies the status of the actuator that controls the inertia brake.";
CM_ SG_ 3221225472 TransDefuelActuator "Identifies the status of the actuator that controls the engine defuel mechanism.";
CM_ SG_ 3221225472 TransLockupClutchActuator "Identifies the status of the actuator that controls the lockup clutch.";
CM_ SG_ 3221225472 TransClutchActuator "Identifies the status of the actuator that controls the clutch.";
CM_ SG_ 3221225472 TransSplitterIndirectActuator "Identifies the status of the splitter indirect actuator in the auxiliary unit.";
CM_ SG_ 3221225472 TransSplitterDirectActuator "Identifies the status of the splitter direct actuator in the auxiliary unit.";
BA_DEF_ SG_  "SigType" ENUM  "Default","Range","RangeSigned","ASCII","Discrete","Control","ReferencePGN","DTC","StringDelimiter","StringLength","StringLengthControl";
BA_DEF_ SG_  "GenSigStartValue" INT 0 10000;
BA_DEF_ SG_  "GenSigSendType" ENUM  "Cyclic","OnWrite","reserved","OnChange","reserved","reserved","reserved","NoSigSendType";
BA_DEF_ SG_  "GenSigILSupport" ENUM  "Yes","No";
BA_DEF_ SG_  "GenSigEVName" STRING ;
BA_DEF_ SG_  "SPN" INT 0 524287;
BA_DEF_ SG_  "SAEDocument" STRING ;
BA_DEF_ BO_  "GenMsgILSupport" ENUM  "Yes","No";
BA_DEF_ BO_  "GenMsgRequestable" INT 0 1;
BA_DEF_ BO_  "GenMsgSendType" ENUM  "cyclic","reserved","cyclicIfActive","reserved","reserved","reserved","reserved","reserved","noMsgSendType";
BA_DEF_ BO_  "VFrameFormat" ENUM  "StandardCAN","ExtendedCAN","reserved","J1939PG";
BA_DEF_ BO_  "SingleFrame" INT 0 1;
BA_DEF_ BO_  "GenMsgCycleTime" INT 0 3600000;
BA_DEF_ BO_  "SAE_Document" STRING ;
BA_DEF_ SG_  "SystemSignalLongSymbol" STRING ;
BA_DEF_DEF_  "SigType" "Default";
BA_DEF_DEF_  "GenSigStartValue" 0;
BA_DEF_DEF_  "GenSigSendType" "NoSigSendType";
BA_DEF_DEF_  "GenSigILSupport" "Yes";
BA_DEF_DEF_  "GenSigEVName" "Env@Nodename_@Signame";
BA_DEF_DEF_  "SPN" 0;
BA_DEF_DEF_  "SAEDocument" "";
BA_DEF_DEF_  "GenMsgILSupport" "Yes";
BA_DEF_DEF_  "GenMsgRequestable" 1;
BA_DEF_DEF_  "GenMsgSendType" "noMsgSendType";
BA_DEF_DEF_  "VFrameFormat" "J1939PG";
BA_DEF_DEF_  "SingleFrame" 1;
BA_DEF_DEF_  "GenMsgCycleTime" 0;
BA_DEF_DEF_  "SAE_Document" "";
BA_DEF_DEF_  "SystemSignalLongSymbol" "";
BA_ "SPN" SG_ 3221225472 CTIWheelEndElectricalFault_12 521212;
BA_ "SigType" SG_ 3221225472 CTIWheelEndElectricalFault_12 4;
BA_ "SPN" SG_ 3221225472 CTIWheelEndElectricalFault_11 521211;
BA_ "SigType" SG_ 3221225472 CTIWheelEndElectricalFault_11 4;
BA_ "SPN" SG_ 3221225472 CTIWheelEndElectricalFault_10 521210;
BA_ "SigType" SG_ 3221225472 CTIWheelEndElectricalFault_10 4;
BA_ "SPN" SG_ 3221225472 CTIWheelEndElectricalFault_01 521201;
BA_ "SigType" SG_ 3221225472 CTIWheelEndElectricalFault_01 4;
BA_ "SPN" SG_ 3221225472 CTITireStatus_33 521333;
BA_ "SigType" SG_ 3221225472 CTITireStatus_33 4;
BA_ "SPN" SG_ 3221225472 CTITireStatus_32 521332;
BA_ "SigType" SG_ 3221225472 CTITireStatus_32 4;
BA_ "SPN" SG_ 3221225472 CTITireStatus_31 521331;
BA_ "SigType" SG_ 3221225472 CTITireStatus_31 4;
BA_ "SPN" SG_ 3221225472 CTITireStatus_30 521330;
BA_ "SigType" SG_ 3221225472 CTITireStatus_30 4;
BA_ "SPN" SG_ 3221225472 CTITireStatus_23 521323;
BA_ "SigType" SG_ 3221225472 CTITireStatus_23 4;
BA_ "SPN" SG_ 3221225472 CTITireStatus_22 521322;
BA_ "SigType" SG_ 3221225472 CTITireStatus_22 4;
BA_ "SPN" SG_ 3221225472 CTITireStatus_21 521321;
BA_ "SigType" SG_ 3221225472 CTITireStatus_21 4;
BA_ "SPN" SG_ 3221225472 CTITireStatus_20 521320;
BA_ "SigType" SG_ 3221225472 CTITireStatus_20 4;
BA_ "SPN" SG_ 3221225472 CTITireStatus_13 521313;
BA_ "SigType" SG_ 3221225472 CTITireStatus_13 4;
BA_ "SPN" SG_ 3221225472 CTITireStatus_12 521312;
BA_ "SigType" SG_ 3221225472 CTITireStatus_12 4;
BA_ "SPN" SG_ 3221225472 CTITireStatus_11 521311;
BA_ "SigType" SG_ 3221225472 CTITireStatus_11 4;
BA_ "SPN" SG_ 3221225472 CTITireStatus_10 521310;
BA_ "SigType" SG_ 3221225472 CTITireStatus_10 4;
BA_ "SPN" SG_ 3221225472 CTITireStatus_01 521301;
BA_ "SigType" SG_ 3221225472 CTITireStatus_01 4;
BA_ "SPN" SG_ 3221225472 TireTemp_11 521111;
BA_ "SigType" SG_ 3221225472 TireTemp_11 1;
BA_ "SPN" SG_ 3221225472 TireTemp_33 521133;
BA_ "SigType" SG_ 3221225472 TireTemp_33 1;
BA_ "SPN" SG_ 3221225472 TireTemp_32 521132;
BA_ "SigType" SG_ 3221225472 TireTemp_32 1;
BA_ "SPN" SG_ 3221225472 TireTemp_31 521131;
BA_ "SigType" SG_ 3221225472 TireTemp_31 1;
BA_ "SPN" SG_ 3221225472 TireTemp_30 521130;
BA_ "SigType" SG_ 3221225472 TireTemp_30 1;
BA_ "SPN" SG_ 3221225472 TireTemp_23 521123;
BA_ "SigType" SG_ 3221225472 TireTemp_23 1;
BA_ "SPN" SG_ 3221225472 TireTemp_22 521122;
BA_ "SigType" SG_ 3221225472 TireTemp_22 1;
BA_ "SPN" SG_ 3221225472 TireTemp_21 521121;
BA_ "SigType" SG_ 3221225472 TireTemp_21 1;
BA_ "SPN" SG_ 3221225472 TireTemp_20 521120;
BA_ "SigType" SG_ 3221225472 TireTemp_20 1;
BA_ "SPN" SG_ 3221225472 TireTemp_13 521113;
BA_ "SigType" SG_ 3221225472 TireTemp_13 1;
BA_ "SPN" SG_ 3221225472 TireTemp_12 521112;
BA_ "SigType" SG_ 3221225472 TireTemp_12 1;
BA_ "SPN" SG_ 3221225472 TireTemp_10 521110;
BA_ "SigType" SG_ 3221225472 TireTemp_10 1;
BA_ "SPN" SG_ 3221225472 TireTemp_01 521101;
BA_ "SigType" SG_ 3221225472 TireTemp_01 1;
BA_ "SPN" SG_ 3221225472 TireTemp_00 521100;
BA_ "SigType" SG_ 3221225472 TireTemp_00 1;
BA_ "SPN" SG_ 3221225472 TirePressThresholdDetection_33 521633;
BA_ "SPN" SG_ 3221225472 TirePressThresholdDetection_32 521632;
BA_ "SPN" SG_ 3221225472 TirePressThresholdDetection_31 521631;
BA_ "SPN" SG_ 3221225472 TirePressThresholdDetection_30 521630;
BA_ "SPN" SG_ 3221225472 TirePressThresholdDetection_23 521623;
BA_ "SPN" SG_ 3221225472 TirePressThresholdDetection_22 521622;
BA_ "SPN" SG_ 3221225472 TirePressThresholdDetection_21 521621;
BA_ "SPN" SG_ 3221225472 TirePressThresholdDetection_20 521620;
BA_ "SPN" SG_ 3221225472 TirePressThresholdDetection_00 521600;
BA_ "SPN" SG_ 3221225472 TirePress_01 521001;
BA_ "SigType" SG_ 3221225472 TirePress_01 1;
BA_ "SPN" SG_ 3221225472 TirePress_00 521000;
BA_ "SigType" SG_ 3221225472 TirePress_00 1;
BA_ "SPN" SG_ 3221225472 CTIWheelSensorStatus_00 521400;
BA_ "SigType" SG_ 3221225472 CTIWheelSensorStatus_00 4;
BA_ "SPN" SG_ 3221225472 CTIWheelEndElectricalFault_00 521200;
BA_ "SigType" SG_ 3221225472 CTIWheelEndElectricalFault_00 4;
BA_ "SPN" SG_ 3221225472 CTITireStatus_00 521300;
BA_ "SigType" SG_ 3221225472 CTITireStatus_00 4;
BA_ "SAEDocument" SG_ 3221225472 TripFanOnTimeDueToAManualSwitch "J1939-71";
BA_ "SPN" SG_ 3221225472 TripFanOnTimeDueToAManualSwitch 996;
BA_ "SigType" SG_ 3221225472 TripFanOnTimeDueToAManualSwitch 1;
BA_ "SAEDocument" SG_ 3221225472 TripFanOnTime "J1939-71";
BA_ "SPN" SG_ 3221225472 TripFanOnTime 994;
BA_ "SigType" SG_ 3221225472 TripFanOnTime 1;
BA_ "SAEDocument" SG_ 3221225472 TripFanOnTimeDueToTheA_CSystem "J1939-71";
BA_ "SPN" SG_ 3221225472 TripFanOnTimeDueToTheA_CSystem 997;
BA_ "SigType" SG_ 3221225472 TripFanOnTimeDueToTheA_CSystem 1;
BA_ "SAEDocument" SG_ 3221225472 TripFanOnTimeDueToTheEngSystem "J1939-71";
BA_ "SPN" SG_ 3221225472 TripFanOnTimeDueToTheEngSystem 995;
BA_ "SigType" SG_ 3221225472 TripFanOnTimeDueToTheEngSystem 1;
BA_ "SAEDocument" SG_ 3221225472 TripDistanceInTopGear "J1939-71";
BA_ "SPN" SG_ 3221225472 TripDistanceInTopGear 1000;
BA_ "SigType" SG_ 3221225472 TripDistanceInTopGear 1;
BA_ "SAEDocument" SG_ 3221225472 TripGearDownDistance "J1939-71";
BA_ "SPN" SG_ 3221225472 TripGearDownDistance 999;
BA_ "SigType" SG_ 3221225472 TripGearDownDistance 1;
BA_ "SAEDocument" SG_ 3221225472 TripDistanceOnVSL "J1939-71";
BA_ "SPN" SG_ 3221225472 TripDistanceOnVSL 998;
BA_ "SigType" SG_ 3221225472 TripDistanceOnVSL 1;
BA_ "SAEDocument" SG_ 3221225472 AdjustLocalHourOffset "J1939-71";
BA_ "SPN" SG_ 3221225472 AdjustLocalHourOffset 1610;
BA_ "SigType" SG_ 3221225472 AdjustLocalHourOffset 1;
BA_ "SAEDocument" SG_ 3221225472 AdjustLocalMinuteOffset "J1939-71";
BA_ "SPN" SG_ 3221225472 AdjustLocalMinuteOffset 1609;
BA_ "SigType" SG_ 3221225472 AdjustLocalMinuteOffset 1;
BA_ "SAEDocument" SG_ 3221225472 AdjustYear "J1939-71";
BA_ "SPN" SG_ 3221225472 AdjustYear 1608;
BA_ "SigType" SG_ 3221225472 AdjustYear 1;
BA_ "SAEDocument" SG_ 3221225472 AdjustDay "J1939-71";
BA_ "SPN" SG_ 3221225472 AdjustDay 1607;
BA_ "SigType" SG_ 3221225472 AdjustDay 1;
BA_ "SAEDocument" SG_ 3221225472 AdjustMonth "J1939-71";
BA_ "SPN" SG_ 3221225472 AdjustMonth 1606;
BA_ "SigType" SG_ 3221225472 AdjustMonth 1;
BA_ "SAEDocument" SG_ 3221225472 AdjustHours "J1939-71";
BA_ "SPN" SG_ 3221225472 AdjustHours 1605;
BA_ "SigType" SG_ 3221225472 AdjustHours 1;
BA_ "SAEDocument" SG_ 3221225472 AdjustMinutes "J1939-71";
BA_ "SPN" SG_ 3221225472 AdjustMinutes 1604;
BA_ "SigType" SG_ 3221225472 AdjustMinutes 1;
BA_ "SAEDocument" SG_ 3221225472 AdjustSeconds "J1939-71";
BA_ "SPN" SG_ 3221225472 AdjustSeconds 1603;
BA_ "SigType" SG_ 3221225472 AdjustSeconds 1;
BA_ "SAEDocument" SG_ 3221225472 LocalHourOffset "J1939-71";
BA_ "SPN" SG_ 3221225472 LocalHourOffset 1602;
BA_ "SigType" SG_ 3221225472 LocalHourOffset 1;
BA_ "SAEDocument" SG_ 3221225472 LocalMinuteOffset "J1939-71";
BA_ "SPN" SG_ 3221225472 LocalMinuteOffset 1601;
BA_ "SigType" SG_ 3221225472 LocalMinuteOffset 1;
BA_ "SAEDocument" SG_ 3221225472 Year "J1939-71";
BA_ "SPN" SG_ 3221225472 Year 964;
BA_ "SigType" SG_ 3221225472 Year 1;
BA_ "SAEDocument" SG_ 3221225472 Day "J1939-71";
BA_ "SPN" SG_ 3221225472 Day 962;
BA_ "SigType" SG_ 3221225472 Day 1;
BA_ "SAEDocument" SG_ 3221225472 Month "J1939-71";
BA_ "SPN" SG_ 3221225472 Month 963;
BA_ "SigType" SG_ 3221225472 Month 1;
BA_ "SAEDocument" SG_ 3221225472 Hours "J1939-71";
BA_ "SPN" SG_ 3221225472 Hours 961;
BA_ "SigType" SG_ 3221225472 Hours 1;
BA_ "SAEDocument" SG_ 3221225472 Minutes "J1939-71";
BA_ "SPN" SG_ 3221225472 Minutes 960;
BA_ "SigType" SG_ 3221225472 Minutes 1;
BA_ "SAEDocument" SG_ 3221225472 Seconds "J1939-71";
BA_ "SPN" SG_ 3221225472 Seconds 959;
BA_ "SigType" SG_ 3221225472 Seconds 1;
BA_ "SAEDocument" SG_ 3221225472 EngDsrdTrboWastegateActuator2Pos "J1939-71";
BA_ "SPN" SG_ 3221225472 EngDsrdTrboWastegateActuator2Pos 5373;
BA_ "SAEDocument" SG_ 3221225472 EngTrbWstgateActuator1TempStatus "J1939-71";
BA_ "SPN" SG_ 3221225472 EngTrbWstgateActuator1TempStatus 5372;
BA_ "SAEDocument" SG_ 3221225472 EngTrbWstgtActtor1PreliminaryFMI "J1939-71";
BA_ "SPN" SG_ 3221225472 EngTrbWstgtActtor1PreliminaryFMI 5371;
BA_ "SAEDocument" SG_ 3221225472 EngDsrdTrboWastegateActuator1Pos "J1939-71";
BA_ "SPN" SG_ 3221225472 EngDsrdTrboWastegateActuator1Pos 5370;
BA_ "SAEDocument" SG_ 3221225472 EngTrbWstgteActuatorCtrlAirPress "J1939-71";
BA_ "SPN" SG_ 3221225472 EngTrbWstgteActuatorCtrlAirPress 1192;
BA_ "SigType" SG_ 3221225472 EngTrbWstgteActuatorCtrlAirPress 1;
BA_ "SAEDocument" SG_ 3221225472 EngTurboWastegateActuator4Pos "J1939-71";
BA_ "SPN" SG_ 3221225472 EngTurboWastegateActuator4Pos 1191;
BA_ "SigType" SG_ 3221225472 EngTurboWastegateActuator4Pos 1;
BA_ "SAEDocument" SG_ 3221225472 EngTurboWastegateActuator3Pos "J1939-71";
BA_ "SPN" SG_ 3221225472 EngTurboWastegateActuator3Pos 1190;
BA_ "SigType" SG_ 3221225472 EngTurboWastegateActuator3Pos 1;
BA_ "SAEDocument" SG_ 3221225472 EngTurboWastegateActuator2Pos "J1939-71";
BA_ "SPN" SG_ 3221225472 EngTurboWastegateActuator2Pos 1189;
BA_ "SigType" SG_ 3221225472 EngTurboWastegateActuator2Pos 1;
BA_ "SAEDocument" SG_ 3221225472 EngTurboWastegateActuator1Pos "J1939-71";
BA_ "SPN" SG_ 3221225472 EngTurboWastegateActuator1Pos 1188;
BA_ "SigType" SG_ 3221225472 EngTurboWastegateActuator1Pos 1;
BA_ "SAEDocument" SG_ 3221225472 EngTurbo4CompressorOutletTemp "J1939-71";
BA_ "SPN" SG_ 3221225472 EngTurbo4CompressorOutletTemp 2801;
BA_ "SigType" SG_ 3221225472 EngTurbo4CompressorOutletTemp 1;
BA_ "SAEDocument" SG_ 3221225472 EngTurbo3CompressorOutletTemp "J1939-71";
BA_ "SPN" SG_ 3221225472 EngTurbo3CompressorOutletTemp 2800;
BA_ "SigType" SG_ 3221225472 EngTurbo3CompressorOutletTemp 1;
BA_ "SAEDocument" SG_ 3221225472 EngTurbo2CompressorOutletTemp "J1939-71";
BA_ "SPN" SG_ 3221225472 EngTurbo2CompressorOutletTemp 2799;
BA_ "SigType" SG_ 3221225472 EngTurbo2CompressorOutletTemp 1;
BA_ "SAEDocument" SG_ 3221225472 EngTurbo1CompressorOutletTemp "J1939-71";
BA_ "SPN" SG_ 3221225472 EngTurbo1CompressorOutletTemp 2629;
BA_ "SigType" SG_ 3221225472 EngTurbo1CompressorOutletTemp 1;
BA_ "SAEDocument" SG_ 3221225472 EngTurbo4TurbineOutletTemp "J1939-71";
BA_ "SPN" SG_ 3221225472 EngTurbo4TurbineOutletTemp 1187;
BA_ "SigType" SG_ 3221225472 EngTurbo4TurbineOutletTemp 1;
BA_ "SAEDocument" SG_ 3221225472 EngTurbo3TurbineOutletTemp "J1939-71";
BA_ "SPN" SG_ 3221225472 EngTurbo3TurbineOutletTemp 1186;
BA_ "SigType" SG_ 3221225472 EngTurbo3TurbineOutletTemp 1;
BA_ "SAEDocument" SG_ 3221225472 EngTurbo2TurbineOutletTemp "J1939-71";
BA_ "SPN" SG_ 3221225472 EngTurbo2TurbineOutletTemp 1185;
BA_ "SigType" SG_ 3221225472 EngTurbo2TurbineOutletTemp 1;
BA_ "SAEDocument" SG_ 3221225472 EngTurbo1TurbineOutletTemp "J1939-71";
BA_ "SPN" SG_ 3221225472 EngTurbo1TurbineOutletTemp 1184;
BA_ "SigType" SG_ 3221225472 EngTurbo1TurbineOutletTemp 1;
BA_ "SAEDocument" SG_ 3221225472 EngTurbo4TurbineIntakeTemp "J1939-71";
BA_ "SPN" SG_ 3221225472 EngTurbo4TurbineIntakeTemp 1183;
BA_ "SigType" SG_ 3221225472 EngTurbo4TurbineIntakeTemp 1;
BA_ "SAEDocument" SG_ 3221225472 EngTurbo3TurbineIntakeTemp "J1939-71";
BA_ "SPN" SG_ 3221225472 EngTurbo3TurbineIntakeTemp 1182;
BA_ "SigType" SG_ 3221225472 EngTurbo3TurbineIntakeTemp 1;
BA_ "SAEDocument" SG_ 3221225472 EngTurbo2TurbineIntakeTemp "J1939-71";
BA_ "SPN" SG_ 3221225472 EngTurbo2TurbineIntakeTemp 1181;
BA_ "SigType" SG_ 3221225472 EngTurbo2TurbineIntakeTemp 1;
BA_ "SAEDocument" SG_ 3221225472 EngTurbo1TurbineIntakeTemp "J1939-71";
BA_ "SPN" SG_ 3221225472 EngTurbo1TurbineIntakeTemp 1180;
BA_ "SigType" SG_ 3221225472 EngTurbo1TurbineIntakeTemp 1;
BA_ "SAEDocument" SG_ 3221225472 EngTurbo4CompressorIntakePress "J1939-71";
BA_ "SPN" SG_ 3221225472 EngTurbo4CompressorIntakePress 1179;
BA_ "SigType" SG_ 3221225472 EngTurbo4CompressorIntakePress 1;
BA_ "SAEDocument" SG_ 3221225472 EngTurbo3CompressorIntakePress "J1939-71";
BA_ "SPN" SG_ 3221225472 EngTurbo3CompressorIntakePress 1178;
BA_ "SigType" SG_ 3221225472 EngTurbo3CompressorIntakePress 1;
BA_ "SAEDocument" SG_ 3221225472 EngTurbo2CompressorIntakePress "J1939-71";
BA_ "SPN" SG_ 3221225472 EngTurbo2CompressorIntakePress 1177;
BA_ "SigType" SG_ 3221225472 EngTurbo2CompressorIntakePress 1;
BA_ "SAEDocument" SG_ 3221225472 EngTurbo1CompressorIntakePress "J1939-71";
BA_ "SPN" SG_ 3221225472 EngTurbo1CompressorIntakePress 1176;
BA_ "SigType" SG_ 3221225472 EngTurbo1CompressorIntakePress 1;
BA_ "SAEDocument" SG_ 3221225472 EngTurbo4CompressorIntakeTemp "J1939-71";
BA_ "SPN" SG_ 3221225472 EngTurbo4CompressorIntakeTemp 1175;
BA_ "SigType" SG_ 3221225472 EngTurbo4CompressorIntakeTemp 1;
BA_ "SAEDocument" SG_ 3221225472 EngTurbo3CompressorIntakeTemp "J1939-71";
BA_ "SPN" SG_ 3221225472 EngTurbo3CompressorIntakeTemp 1174;
BA_ "SigType" SG_ 3221225472 EngTurbo3CompressorIntakeTemp 1;
BA_ "SAEDocument" SG_ 3221225472 EngTurbo2CompressorIntakeTemp "J1939-71";
BA_ "SPN" SG_ 3221225472 EngTurbo2CompressorIntakeTemp 1173;
BA_ "SigType" SG_ 3221225472 EngTurbo2CompressorIntakeTemp 1;
BA_ "SAEDocument" SG_ 3221225472 EngTurbo1CompressorIntakeTemp "J1939-71";
BA_ "SPN" SG_ 3221225472 EngTurbo1CompressorIntakeTemp 1172;
BA_ "SigType" SG_ 3221225472 EngTurbo1CompressorIntakeTemp 1;
BA_ "SAEDocument" SG_ 3221225472 EngTurbo4Speed "J1939-71";
BA_ "SPN" SG_ 3221225472 EngTurbo4Speed 1171;
BA_ "SigType" SG_ 3221225472 EngTurbo4Speed 1;
BA_ "SAEDocument" SG_ 3221225472 EngTurbo3Speed "J1939-71";
BA_ "SPN" SG_ 3221225472 EngTurbo3Speed 1170;
BA_ "SigType" SG_ 3221225472 EngTurbo3Speed 1;
BA_ "SAEDocument" SG_ 3221225472 EngTurbo2Speed "J1939-71";
BA_ "SPN" SG_ 3221225472 EngTurbo2Speed 1169;
BA_ "SigType" SG_ 3221225472 EngTurbo2Speed 1;
BA_ "SAEDocument" SG_ 3221225472 EngTurboLubeOilPress2 "J1939-71";
BA_ "SPN" SG_ 3221225472 EngTurboLubeOilPress2 1168;
BA_ "SigType" SG_ 3221225472 EngTurboLubeOilPress2 1;
BA_ "SAEDocument" SG_ 3221225472 TransTorqueLimit "J1939-71";
BA_ "SPN" SG_ 3221225472 TransTorqueLimit 1845;
BA_ "SigType" SG_ 3221225472 TransTorqueLimit 1;
BA_ "SAEDocument" SG_ 3221225472 TransGearRatio "J1939-71";
BA_ "SPN" SG_ 3221225472 TransGearRatio 581;
BA_ "SigType" SG_ 3221225472 TransGearRatio 1;
BA_ "SAEDocument" SG_ 3221225472 NumberOfForwardGearRatios "J1939-71";
BA_ "SPN" SG_ 3221225472 NumberOfForwardGearRatios 957;
BA_ "SigType" SG_ 3221225472 NumberOfForwardGearRatios 1;
BA_ "SAEDocument" SG_ 3221225472 NumberOfReverseGearRatios "J1939-71";
BA_ "SPN" SG_ 3221225472 NumberOfReverseGearRatios 958;
BA_ "SigType" SG_ 3221225472 NumberOfReverseGearRatios 1;
BA_ "SAEDocument" SG_ 3221225472 TransMode8 "J1939-71";
BA_ "SPN" SG_ 3221225472 TransMode8 4249;
BA_ "SigType" SG_ 3221225472 TransMode8 5;
BA_ "SAEDocument" SG_ 3221225472 TransMode7 "J1939-71";
BA_ "SPN" SG_ 3221225472 TransMode7 4248;
BA_ "SigType" SG_ 3221225472 TransMode7 5;
BA_ "SAEDocument" SG_ 3221225472 TransMode6 "J1939-71";
BA_ "SPN" SG_ 3221225472 TransMode6 4247;
BA_ "SigType" SG_ 3221225472 TransMode6 5;
BA_ "SAEDocument" SG_ 3221225472 TransMode5 "J1939-71";
BA_ "SPN" SG_ 3221225472 TransMode5 4246;
BA_ "SigType" SG_ 3221225472 TransMode5 5;
BA_ "SAEDocument" SG_ 3221225472 TrnsShftSlectorDisplayModeSwitch "J1939-71";
BA_ "SPN" SG_ 3221225472 TrnsShftSlectorDisplayModeSwitch 2985;
BA_ "SigType" SG_ 3221225472 TrnsShftSlectorDisplayModeSwitch 4;
BA_ "SAEDocument" SG_ 3221225472 TransRequestedLaunchGear "J1939-71";
BA_ "SPN" SG_ 3221225472 TransRequestedLaunchGear 4255;
BA_ "SAEDocument" SG_ 3221225472 TransMode4 "J1939-71";
BA_ "SPN" SG_ 3221225472 TransMode4 1855;
BA_ "SigType" SG_ 3221225472 TransMode4 5;
BA_ "SAEDocument" SG_ 3221225472 TransMode3 "J1939-71";
BA_ "SPN" SG_ 3221225472 TransMode3 1854;
BA_ "SigType" SG_ 3221225472 TransMode3 5;
BA_ "SAEDocument" SG_ 3221225472 TransMode2 "J1939-71";
BA_ "SPN" SG_ 3221225472 TransMode2 1853;
BA_ "SigType" SG_ 3221225472 TransMode2 5;
BA_ "SAEDocument" SG_ 3221225472 TransMode1 "J1939-71";
BA_ "SPN" SG_ 3221225472 TransMode1 1852;
BA_ "SigType" SG_ 3221225472 TransMode1 5;
BA_ "SAEDocument" SG_ 3221225472 DisengageDiffLockRqCentralRear "J1939-71";
BA_ "SPN" SG_ 3221225472 DisengageDiffLockRqCentralRear 691;
BA_ "SigType" SG_ 3221225472 DisengageDiffLockRqCentralRear 5;
BA_ "SAEDocument" SG_ 3221225472 DisengageDiffLockRqCentralFront "J1939-71";
BA_ "SPN" SG_ 3221225472 DisengageDiffLockRqCentralFront 690;
BA_ "SigType" SG_ 3221225472 DisengageDiffLockRqCentralFront 5;
BA_ "SAEDocument" SG_ 3221225472 DisengageDiffLockRqCentral "J1939-71";
BA_ "SPN" SG_ 3221225472 DisengageDiffLockRqCentral 689;
BA_ "SigType" SG_ 3221225472 DisengageDiffLockRqCentral 5;
BA_ "SAEDocument" SG_ 3221225472 DisengageDiffLockRqRearAxle2 "J1939-71";
BA_ "SPN" SG_ 3221225472 DisengageDiffLockRqRearAxle2 688;
BA_ "SigType" SG_ 3221225472 DisengageDiffLockRqRearAxle2 5;
BA_ "SAEDocument" SG_ 3221225472 DisengageDiffLockRqRearAxle1 "J1939-71";
BA_ "SPN" SG_ 3221225472 DisengageDiffLockRqRearAxle1 687;
BA_ "SigType" SG_ 3221225472 DisengageDiffLockRqRearAxle1 5;
BA_ "SAEDocument" SG_ 3221225472 DisengageDiffLockRqFrontAxle2 "J1939-71";
BA_ "SPN" SG_ 3221225472 DisengageDiffLockRqFrontAxle2 686;
BA_ "SigType" SG_ 3221225472 DisengageDiffLockRqFrontAxle2 5;
BA_ "SAEDocument" SG_ 3221225472 DisengageDiffLockRqFrontAxle1 "J1939-71";
BA_ "SPN" SG_ 3221225472 DisengageDiffLockRqFrontAxle1 685;
BA_ "SigType" SG_ 3221225472 DisengageDiffLockRqFrontAxle1 5;
BA_ "SAEDocument" SG_ 3221225472 TransRequestedGear "J1939-71";
BA_ "SPN" SG_ 3221225472 TransRequestedGear 525;
BA_ "SAEDocument" SG_ 3221225472 RequestedPercentClutchSlip "J1939-71";
BA_ "SPN" SG_ 3221225472 RequestedPercentClutchSlip 684;
BA_ "SAEDocument" SG_ 3221225472 TransReverseGearShiftInhibitRq "J1939-71";
BA_ "SPN" SG_ 3221225472 TransReverseGearShiftInhibitRq 4242;
BA_ "SigType" SG_ 3221225472 TransReverseGearShiftInhibitRq 5;
BA_ "SAEDocument" SG_ 3221225472 DisengageDrivelineRq "J1939-71";
BA_ "SPN" SG_ 3221225472 DisengageDrivelineRq 683;
BA_ "SigType" SG_ 3221225472 DisengageDrivelineRq 5;
BA_ "SAEDocument" SG_ 3221225472 TrnsTrqeConverterLockupDisableRq "J1939-71";
BA_ "SPN" SG_ 3221225472 TrnsTrqeConverterLockupDisableRq 682;
BA_ "SigType" SG_ 3221225472 TrnsTrqeConverterLockupDisableRq 5;
BA_ "SAEDocument" SG_ 3221225472 TransGearShiftInhibitRq "J1939-71";
BA_ "SPN" SG_ 3221225472 TransGearShiftInhibitRq 681;
BA_ "SigType" SG_ 3221225472 TransGearShiftInhibitRq 5;
BA_ "SAEDocument" SG_ 3221225472 EngTurboOilLevelSwitch "J1939-71";
BA_ "SPN" SG_ 3221225472 EngTurboOilLevelSwitch 1665;
BA_ "SigType" SG_ 3221225472 EngTurboOilLevelSwitch 4;
BA_ "SAEDocument" SG_ 3221225472 EngTurbo1Speed "J1939-71";
BA_ "SPN" SG_ 3221225472 EngTurbo1Speed 103;
BA_ "SigType" SG_ 3221225472 EngTurbo1Speed 1;
BA_ "SAEDocument" SG_ 3221225472 EngTurboLubeOilPress1 "J1939-71";
BA_ "SPN" SG_ 3221225472 EngTurboLubeOilPress1 104;
BA_ "SigType" SG_ 3221225472 EngTurboLubeOilPress1 1;
BA_ "SAEDocument" SG_ 3221225472 EngTotalAverageFuelEconomy "J1939-71";
BA_ "SPN" SG_ 3221225472 EngTotalAverageFuelEconomy 1835;
BA_ "SigType" SG_ 3221225472 EngTotalAverageFuelEconomy 1;
BA_ "SAEDocument" SG_ 3221225472 EngTotalAverageFuelRate "J1939-71";
BA_ "SPN" SG_ 3221225472 EngTotalAverageFuelRate 1834;
BA_ "SigType" SG_ 3221225472 EngTotalAverageFuelRate 1;
BA_ "SAEDocument" SG_ 3221225472 AirSuspensionSupplyPressRq "J1939-71";
BA_ "SPN" SG_ 3221225472 AirSuspensionSupplyPressRq 2608;
BA_ "SAEDocument" SG_ 3221225472 AuxEquipmentSupplyPressRq "J1939-71";
BA_ "SPN" SG_ 3221225472 AuxEquipmentSupplyPressRq 2607;
BA_ "SAEDocument" SG_ 3221225472 ServiceBrakeAirPressRqCircuit2 "J1939-71";
BA_ "SPN" SG_ 3221225472 ServiceBrakeAirPressRqCircuit2 2606;
BA_ "SAEDocument" SG_ 3221225472 ServiceBrakeAirPressRqCircuit1 "J1939-71";
BA_ "SPN" SG_ 3221225472 ServiceBrakeAirPressRqCircuit1 2605;
BA_ "SAEDocument" SG_ 3221225472 ParkingAnd_orTrailerAirPressRq "J1939-71";
BA_ "SPN" SG_ 3221225472 ParkingAnd_orTrailerAirPressRq 2604;
BA_ "SAEDocument" SG_ 3221225472 PneumaticSupplyPressRq "J1939-71";
BA_ "SPN" SG_ 3221225472 PneumaticSupplyPressRq 2603;
BA_ "SAEDocument" SG_ 3221225472 EngExtlShutdownAirSupplyPress "J1939-71";
BA_ "SPN" SG_ 3221225472 EngExtlShutdownAirSupplyPress 1320;
BA_ "SigType" SG_ 3221225472 EngExtlShutdownAirSupplyPress 1;
BA_ "SAEDocument" SG_ 3221225472 NmbrOfSftwreIdentificationFields "J1939-71";
BA_ "SPN" SG_ 3221225472 NmbrOfSftwreIdentificationFields 965;
BA_ "SigType" SG_ 3221225472 NmbrOfSftwreIdentificationFields 1;
BA_ "SAEDocument" SG_ 3221225472 SoftwareIdentification "J1939-71";
BA_ "SPN" SG_ 3221225472 SoftwareIdentification 234;
BA_ "SigType" SG_ 3221225472 SoftwareIdentification 1;
BA_ "SAEDocument" SG_ 3221225472 PTOShutdownHasShutdownEng "J1939-71";
BA_ "SPN" SG_ 3221225472 PTOShutdownHasShutdownEng 5404;
BA_ "SigType" SG_ 3221225472 PTOShutdownHasShutdownEng 5;
BA_ "SAEDocument" SG_ 3221225472 EngAirShutoffStatus "J1939-71";
BA_ "SPN" SG_ 3221225472 EngAirShutoffStatus 3667;
BA_ "SigType" SG_ 3221225472 EngAirShutoffStatus 5;
BA_ "SAEDocument" SG_ 3221225472 EngOverspeedTest "J1939-71";
BA_ "SPN" SG_ 3221225472 EngOverspeedTest 2812;
BA_ "SigType" SG_ 3221225472 EngOverspeedTest 4;
BA_ "SAEDocument" SG_ 3221225472 EngAirShutoffCmdStatus "J1939-71";
BA_ "SPN" SG_ 3221225472 EngAirShutoffCmdStatus 2813;
BA_ "SigType" SG_ 3221225472 EngAirShutoffCmdStatus 5;
BA_ "SAEDocument" SG_ 3221225472 EngAlarmOutputCmdStatus "J1939-71";
BA_ "SPN" SG_ 3221225472 EngAlarmOutputCmdStatus 2814;
BA_ "SigType" SG_ 3221225472 EngAlarmOutputCmdStatus 5;
BA_ "SAEDocument" SG_ 3221225472 EngAlarmAcknowledge "J1939-71";
BA_ "SPN" SG_ 3221225472 EngAlarmAcknowledge 2815;
BA_ "SigType" SG_ 3221225472 EngAlarmAcknowledge 4;
BA_ "SAEDocument" SG_ 3221225472 EngProtectionSystemConfig "J1939-71";
BA_ "SPN" SG_ 3221225472 EngProtectionSystemConfig 1111;
BA_ "SigType" SG_ 3221225472 EngProtectionSystemConfig 5;
BA_ "SAEDocument" SG_ 3221225472 EngProtectionSystemTimerState "J1939-71";
BA_ "SPN" SG_ 3221225472 EngProtectionSystemTimerState 1107;
BA_ "SigType" SG_ 3221225472 EngProtectionSystemTimerState 5;
BA_ "SAEDocument" SG_ 3221225472 EngProtectionSystemTimerOverride "J1939-71";
BA_ "SPN" SG_ 3221225472 EngProtectionSystemTimerOverride 1108;
BA_ "SigType" SG_ 3221225472 EngProtectionSystemTimerOverride 5;
BA_ "SAEDocument" SG_ 3221225472 EngPrtctnSystmApprachingShutdown "J1939-71";
BA_ "SPN" SG_ 3221225472 EngPrtctnSystmApprachingShutdown 1109;
BA_ "SigType" SG_ 3221225472 EngPrtctnSystmApprachingShutdown 5;
BA_ "SAEDocument" SG_ 3221225472 EngPrtectionSystemHasShutdownEng "J1939-71";
BA_ "SPN" SG_ 3221225472 EngPrtectionSystemHasShutdownEng 1110;
BA_ "SigType" SG_ 3221225472 EngPrtectionSystemHasShutdownEng 5;
BA_ "SAEDocument" SG_ 3221225472 EngWaitToStartLamp "J1939-71";
BA_ "SPN" SG_ 3221225472 EngWaitToStartLamp 1081;
BA_ "SigType" SG_ 3221225472 EngWaitToStartLamp 5;
BA_ "SAEDocument" SG_ 3221225472 RefrigerantHighPressSwitch "J1939-71";
BA_ "SPN" SG_ 3221225472 RefrigerantHighPressSwitch 605;
BA_ "SigType" SG_ 3221225472 RefrigerantHighPressSwitch 4;
BA_ "SAEDocument" SG_ 3221225472 RefrigerantLowPressSwitch "J1939-71";
BA_ "SPN" SG_ 3221225472 RefrigerantLowPressSwitch 875;
BA_ "SigType" SG_ 3221225472 RefrigerantLowPressSwitch 4;
BA_ "SAEDocument" SG_ 3221225472 A_CHighPressFanSwitch "J1939-71";
BA_ "SPN" SG_ 3221225472 A_CHighPressFanSwitch 985;
BA_ "SigType" SG_ 3221225472 A_CHighPressFanSwitch 4;
BA_ "SAEDocument" SG_ 3221225472 EngIdleShutdownTimerFunction "J1939-71";
BA_ "SPN" SG_ 3221225472 EngIdleShutdownTimerFunction 591;
BA_ "SigType" SG_ 3221225472 EngIdleShutdownTimerFunction 4;
BA_ "SAEDocument" SG_ 3221225472 EngIdleShutdownTimerState "J1939-71";
BA_ "SPN" SG_ 3221225472 EngIdleShutdownTimerState 590;
BA_ "SigType" SG_ 3221225472 EngIdleShutdownTimerState 5;
BA_ "SAEDocument" SG_ 3221225472 EngIdleShutdownTimerOverride "J1939-71";
BA_ "SPN" SG_ 3221225472 EngIdleShutdownTimerOverride 592;
BA_ "SigType" SG_ 3221225472 EngIdleShutdownTimerOverride 5;
BA_ "SAEDocument" SG_ 3221225472 EngIdleShutdownDriverAlertMode "J1939-71";
BA_ "SPN" SG_ 3221225472 EngIdleShutdownDriverAlertMode 594;
BA_ "SigType" SG_ 3221225472 EngIdleShutdownDriverAlertMode 5;
BA_ "SAEDocument" SG_ 3221225472 EngIdleShutdownHasShutdownEng "J1939-71";
BA_ "SPN" SG_ 3221225472 EngIdleShutdownHasShutdownEng 593;
BA_ "SigType" SG_ 3221225472 EngIdleShutdownHasShutdownEng 5;
BA_ "SAEDocument" SG_ 3221225472 VehicleSystem5 "J1939-81";
BA_ "SAEDocument" SG_ 3221225472 VehicleSystem4 "J1939-81";
BA_ "SAEDocument" SG_ 3221225472 VehicleSystem3 "J1939-81";
BA_ "SAEDocument" SG_ 3221225472 VehicleSystem2 "J1939-81";
BA_ "SAEDocument" SG_ 3221225472 VehicleSystem1 "J1939-81";
BA_ "SAEDocument" SG_ 3221225472 ArbitraryAddressCapable "J1939-81";
BA_ "SPN" SG_ 3221225472 ArbitraryAddressCapable 2844;
BA_ "SAEDocument" SG_ 3221225472 IndustryGroup "NMEA2000";
BA_ "SPN" SG_ 3221225472 IndustryGroup 2846;
BA_ "SAEDocument" SG_ 3221225472 VehicleSystemInstance "J1939-81";
BA_ "SPN" SG_ 3221225472 VehicleSystemInstance 2843;
BA_ "SAEDocument" SG_ 3221225472 VehicleSystem "J1939-81";
BA_ "SAEDocument" SG_ 3221225472 ECUInstance "J1939-81";
BA_ "SPN" SG_ 3221225472 ECUInstance 2840;
BA_ "SAEDocument" SG_ 3221225472 FunctionInstance "J1939-81";
BA_ "SPN" SG_ 3221225472 FunctionInstance 2839;
BA_ "SAEDocument" SG_ 3221225472 Function "J1939-81";
BA_ "SPN" SG_ 3221225472 Function 2841;
BA_ "SAEDocument" SG_ 3221225472 ManufacturerCode "NMEA2000";
BA_ "SPN" SG_ 3221225472 ManufacturerCode 2838;
BA_ "SigType" SG_ 3221225472 ManufacturerCode 1;
BA_ "SAEDocument" SG_ 3221225472 IdentityNumber "J1939-81";
BA_ "SPN" SG_ 3221225472 IdentityNumber 2837;
BA_ "SAEDocument" SG_ 3221225472 SrviceDelay_OperationalTimeBased "J1939-71";
BA_ "SPN" SG_ 3221225472 SrviceDelay_OperationalTimeBased 916;
BA_ "SigType" SG_ 3221225472 SrviceDelay_OperationalTimeBased 1;
BA_ "SAEDocument" SG_ 3221225472 ServiceComponentIdentification "J1939-71";
BA_ "SPN" SG_ 3221225472 ServiceComponentIdentification 1584;
BA_ "SigType" SG_ 3221225472 ServiceComponentIdentification 1;
BA_ "SAEDocument" SG_ 3221225472 ServiceDelay_CalendarTimeBased "J1939-71";
BA_ "SPN" SG_ 3221225472 ServiceDelay_CalendarTimeBased 915;
BA_ "SigType" SG_ 3221225472 ServiceDelay_CalendarTimeBased 1;
BA_ "SAEDocument" SG_ 3221225472 ServiceDistance "J1939-71";
BA_ "SPN" SG_ 3221225472 ServiceDistance 914;
BA_ "SigType" SG_ 3221225472 ServiceDistance 1;
BA_ "SAEDocument" SG_ 3221225472 TimeSinceLastService "J1939-71";
BA_ "SPN" SG_ 3221225472 TimeSinceLastService 1350;
BA_ "SigType" SG_ 3221225472 TimeSinceLastService 1;
BA_ "SAEDocument" SG_ 3221225472 MinContinuousRetarderTorque "J1939-71";
BA_ "SPN" SG_ 3221225472 MinContinuousRetarderTorque 1783;
BA_ "SAEDocument" SG_ 3221225472 MaxContinuousRetarderTorque "J1939-71";
BA_ "SPN" SG_ 3221225472 MaxContinuousRetarderTorque 1782;
BA_ "SAEDocument" SG_ 3221225472 MinContinuousRetarderSpeed "J1939-71";
BA_ "SPN" SG_ 3221225472 MinContinuousRetarderSpeed 1781;
BA_ "SAEDocument" SG_ 3221225472 MaxContinuousRetarderSpeed "J1939-71";
BA_ "SPN" SG_ 3221225472 MaxContinuousRetarderSpeed 1780;
BA_ "SAEDocument" SG_ 3221225472 HghLmtThrshldFrMnCntnsTrqFrmRtrd "J1939-71";
BA_ "SPN" SG_ 3221225472 HghLmtThrshldFrMnCntnsTrqFrmRtrd 1779;
BA_ "SAEDocument" SG_ 3221225472 LwLmtThrshldFrMxTrqeFromRetarder "J1939-71";
BA_ "SPN" SG_ 3221225472 LwLmtThrshldFrMxTrqeFromRetarder 1778;
BA_ "SAEDocument" SG_ 3221225472 HghLmtThrshldFrMnCntnsRPMFrmRtrd "J1939-71";
BA_ "SPN" SG_ 3221225472 HghLmtThrshldFrMnCntnsRPMFrmRtrd 1777;
BA_ "SAEDocument" SG_ 3221225472 LwLmtThrshldFrMaxRPMFromRetarder "J1939-71";
BA_ "SPN" SG_ 3221225472 LwLmtThrshldFrMaxRPMFromRetarder 1776;
BA_ "SAEDocument" SG_ 3221225472 DrvlineRetarderOverheatIndicator "J1939-71";
BA_ "SPN" SG_ 3221225472 DrvlineRetarderOverheatIndicator 5346;
BA_ "SigType" SG_ 3221225472 DrvlineRetarderOverheatIndicator 5;
BA_ "SAEDocument" SG_ 3221225472 HydRetarderOilTemp "J1939-71";
BA_ "SPN" SG_ 3221225472 HydRetarderOilTemp 120;
BA_ "SigType" SG_ 3221225472 HydRetarderOilTemp 1;
BA_ "SAEDocument" SG_ 3221225472 HydRetarderPress "J1939-71";
BA_ "SPN" SG_ 3221225472 HydRetarderPress 119;
BA_ "SigType" SG_ 3221225472 HydRetarderPress 1;
BA_ "SAEDocument" SG_ 3221225472 SteerStraightAheadPosReset "J1939-71";
BA_ "SPN" SG_ 3221225472 SteerStraightAheadPosReset 3600;
BA_ "SigType" SG_ 3221225472 SteerStraightAheadPosReset 5;
BA_ "SAEDocument" SG_ 3221225472 EngBuildHoursReset "J1939-71";
BA_ "SPN" SG_ 3221225472 EngBuildHoursReset 1211;
BA_ "SigType" SG_ 3221225472 EngBuildHoursReset 5;
BA_ "SAEDocument" SG_ 3221225472 TripGroup2Proprietary "J1939-71";
BA_ "SPN" SG_ 3221225472 TripGroup2Proprietary 989;
BA_ "SigType" SG_ 3221225472 TripGroup2Proprietary 5;
BA_ "SAEDocument" SG_ 3221225472 TripGroup1 "J1939-71";
BA_ "SPN" SG_ 3221225472 TripGroup1 988;
BA_ "SigType" SG_ 3221225472 TripGroup1 5;
BA_ "SAEDocument" SG_ 3221225472 PercentTorqueAtPeakTorquePoint5 "J1939-71";
BA_ "SPN" SG_ 3221225472 PercentTorqueAtPeakTorquePoint5 555;
BA_ "SigType" SG_ 3221225472 PercentTorqueAtPeakTorquePoint5 1;
BA_ "SAEDocument" SG_ 3221225472 RetarderSpeedAtPeakTorquePoint5 "J1939-71";
BA_ "SPN" SG_ 3221225472 RetarderSpeedAtPeakTorquePoint5 547;
BA_ "SigType" SG_ 3221225472 RetarderSpeedAtPeakTorquePoint5 1;
BA_ "SAEDocument" SG_ 3221225472 PercentTorqueAtPoint4 "J1939-71";
BA_ "SPN" SG_ 3221225472 PercentTorqueAtPoint4 554;
BA_ "SigType" SG_ 3221225472 PercentTorqueAtPoint4 1;
BA_ "SAEDocument" SG_ 3221225472 RetarderSpeedAtPoint4 "J1939-71";
BA_ "SPN" SG_ 3221225472 RetarderSpeedAtPoint4 550;
BA_ "SigType" SG_ 3221225472 RetarderSpeedAtPoint4 1;
BA_ "SAEDocument" SG_ 3221225472 PercentTorqueAtPoint3 "J1939-71";
BA_ "SPN" SG_ 3221225472 PercentTorqueAtPoint3 553;
BA_ "SigType" SG_ 3221225472 PercentTorqueAtPoint3 1;
BA_ "SAEDocument" SG_ 3221225472 RetarderSpeedAtPoint3 "J1939-71";
BA_ "SPN" SG_ 3221225472 RetarderSpeedAtPoint3 549;
BA_ "SigType" SG_ 3221225472 RetarderSpeedAtPoint3 1;
BA_ "SAEDocument" SG_ 3221225472 PercentTorqueAtMaxSpeedPoint2 "J1939-71";
BA_ "SPN" SG_ 3221225472 PercentTorqueAtMaxSpeedPoint2 552;
BA_ "SigType" SG_ 3221225472 PercentTorqueAtMaxSpeedPoint2 1;
BA_ "SAEDocument" SG_ 3221225472 MaxRetarderSpeedPoint2 "J1939-71";
BA_ "SPN" SG_ 3221225472 MaxRetarderSpeedPoint2 548;
BA_ "SigType" SG_ 3221225472 MaxRetarderSpeedPoint2 1;
BA_ "SAEDocument" SG_ 3221225472 PercentTorqueAtIdlePoint1 "J1939-71";
BA_ "SPN" SG_ 3221225472 PercentTorqueAtIdlePoint1 551;
BA_ "SigType" SG_ 3221225472 PercentTorqueAtIdlePoint1 1;
BA_ "SAEDocument" SG_ 3221225472 RetarderSpeedAtIdlePoint1 "J1939-71";
BA_ "SPN" SG_ 3221225472 RetarderSpeedAtIdlePoint1 546;
BA_ "SigType" SG_ 3221225472 RetarderSpeedAtIdlePoint1 1;
BA_ "SAEDocument" SG_ 3221225472 RetarderCtrlMethod "J1939-71";
BA_ "SPN" SG_ 3221225472 RetarderCtrlMethod 557;
BA_ "SigType" SG_ 3221225472 RetarderCtrlMethod 1;
BA_ "SAEDocument" SG_ 3221225472 RetarderLocation "J1939-71";
BA_ "SPN" SG_ 3221225472 RetarderLocation 902;
BA_ "SAEDocument" SG_ 3221225472 RetarderType "J1939-71";
BA_ "SPN" SG_ 3221225472 RetarderType 901;
BA_ "SAEDocument" SG_ 3221225472 EngOperationTimeSinceRebuild "J1939-71";
BA_ "SPN" SG_ 3221225472 EngOperationTimeSinceRebuild 1193;
BA_ "SigType" SG_ 3221225472 EngOperationTimeSinceRebuild 1;
BA_ "SAEDocument" SG_ 3221225472 PowerTakeoffSetSpeed "J1939-71";
BA_ "SPN" SG_ 3221225472 PowerTakeoffSetSpeed 187;
BA_ "SigType" SG_ 3221225472 PowerTakeoffSetSpeed 1;
BA_ "SAEDocument" SG_ 3221225472 PowerTakeoffSpeed "J1939-71";
BA_ "SPN" SG_ 3221225472 PowerTakeoffSpeed 186;
BA_ "SigType" SG_ 3221225472 PowerTakeoffSpeed 1;
BA_ "SAEDocument" SG_ 3221225472 PowerTakeoffOilTemp "J1939-71";
BA_ "SPN" SG_ 3221225472 PowerTakeoffOilTemp 90;
BA_ "SigType" SG_ 3221225472 PowerTakeoffOilTemp 1;
BA_ "SAEDocument" SG_ 3221225472 OprtrEngPTOGvrnrMmrySelectSwitch "J1939-71";
BA_ "SPN" SG_ 3221225472 OprtrEngPTOGvrnrMmrySelectSwitch 2897;
BA_ "SigType" SG_ 3221225472 OprtrEngPTOGvrnrMmrySelectSwitch 4;
BA_ "SAEDocument" SG_ 3221225472 EngRmtPTOGvrnrVrblSpedCtrlSwitch "J1939-71";
BA_ "SPN" SG_ 3221225472 EngRmtPTOGvrnrVrblSpedCtrlSwitch 978;
BA_ "SigType" SG_ 3221225472 EngRmtPTOGvrnrVrblSpedCtrlSwitch 4;
BA_ "SAEDocument" SG_ 3221225472 EngRmtPTOGvrnrPrprgrmmdSpdCtrlSw "J1939-71";
BA_ "SPN" SG_ 3221225472 EngRmtPTOGvrnrPrprgrmmdSpdCtrlSw 979;
BA_ "SigType" SG_ 3221225472 EngRmtPTOGvrnrPrprgrmmdSpdCtrlSw 4;
BA_ "SAEDocument" SG_ 3221225472 EngPTOGvrnrCast_DecelerateSwitch "J1939-71";
BA_ "SPN" SG_ 3221225472 EngPTOGvrnrCast_DecelerateSwitch 983;
BA_ "SigType" SG_ 3221225472 EngPTOGvrnrCast_DecelerateSwitch 4;
BA_ "SAEDocument" SG_ 3221225472 EngPTOGovernorSetSwitch "J1939-71";
BA_ "SPN" SG_ 3221225472 EngPTOGovernorSetSwitch 984;
BA_ "SigType" SG_ 3221225472 EngPTOGovernorSetSwitch 4;
BA_ "SAEDocument" SG_ 3221225472 EngPTOGovernorResumeSwitch "J1939-71";
BA_ "SPN" SG_ 3221225472 EngPTOGovernorResumeSwitch 982;
BA_ "SigType" SG_ 3221225472 EngPTOGovernorResumeSwitch 4;
BA_ "SAEDocument" SG_ 3221225472 EngPTOGovernorEnableSwitch "J1939-71";
BA_ "SPN" SG_ 3221225472 EngPTOGovernorEnableSwitch 980;
BA_ "SigType" SG_ 3221225472 EngPTOGovernorEnableSwitch 4;
BA_ "SAEDocument" SG_ 3221225472 EngPTOGovernorAccelerateSwitch "J1939-71";
BA_ "SPN" SG_ 3221225472 EngPTOGovernorAccelerateSwitch 981;
BA_ "SigType" SG_ 3221225472 EngPTOGovernorAccelerateSwitch 4;
BA_ "SAEDocument" SG_ 3221225472 RmtPTOGvrnrPrprgrmmdSpdCtrlSwtch "J1939-71";
BA_ "SPN" SG_ 3221225472 RmtPTOGvrnrPrprgrmmdSpdCtrlSwtch 3447;
BA_ "SigType" SG_ 3221225472 RmtPTOGvrnrPrprgrmmdSpdCtrlSwtch 4;
BA_ "SAEDocument" SG_ 3221225472 AuxInputIgnoreSwitch "J1939-71";
BA_ "SPN" SG_ 3221225472 AuxInputIgnoreSwitch 3448;
BA_ "SigType" SG_ 3221225472 AuxInputIgnoreSwitch 4;
BA_ "SAEDocument" SG_ 3221225472 EngAltDroopAuxInputSelect "J1939-71";
BA_ "SPN" SG_ 3221225472 EngAltDroopAuxInputSelect 2885;
BA_ "SAEDocument" SG_ 3221225472 EngAltDroopRemoteAccelSelect "J1939-71";
BA_ "SPN" SG_ 3221225472 EngAltDroopRemoteAccelSelect 2886;
BA_ "SAEDocument" SG_ 3221225472 EngAltDroopAccel2Select "J1939-71";
BA_ "SPN" SG_ 3221225472 EngAltDroopAccel2Select 2879;
BA_ "SAEDocument" SG_ 3221225472 EngAltDroopAccel1Select "J1939-71";
BA_ "SPN" SG_ 3221225472 EngAltDroopAccel1Select 2881;
BA_ "SAEDocument" SG_ 3221225472 EngAltRatingSelect "J1939-71";
BA_ "SPN" SG_ 3221225472 EngAltRatingSelect 2882;
BA_ "SigType" SG_ 3221225472 EngAltRatingSelect 1;
BA_ "SAEDocument" SG_ 3221225472 EngAltLowIdleSwitch "J1939-71";
BA_ "SPN" SG_ 3221225472 EngAltLowIdleSwitch 2883;
BA_ "SigType" SG_ 3221225472 EngAltLowIdleSwitch 4;
BA_ "SAEDocument" SG_ 3221225472 EngSynchronizationSwitch "J1939-71";
BA_ "SPN" SG_ 3221225472 EngSynchronizationSwitch 1377;
BA_ "SigType" SG_ 3221225472 EngSynchronizationSwitch 4;
BA_ "SAEDocument" SG_ 3221225472 EngAuxGovernorSwitch "J1939-71";
BA_ "SPN" SG_ 3221225472 EngAuxGovernorSwitch 2884;
BA_ "SigType" SG_ 3221225472 EngAuxGovernorSwitch 4;
BA_ "SAEDocument" SG_ 3221225472 EngAltDroopAuxInputSelectState "J1939-71";
BA_ "SPN" SG_ 3221225472 EngAltDroopAuxInputSelectState 2895;
BA_ "SAEDocument" SG_ 3221225472 EngAltDropRemoteAccelSelectState "J1939-71";
BA_ "SPN" SG_ 3221225472 EngAltDropRemoteAccelSelectState 2894;
BA_ "SAEDocument" SG_ 3221225472 EngAltDroopAccel2SelectState "J1939-71";
BA_ "SPN" SG_ 3221225472 EngAltDroopAccel2SelectState 2893;
BA_ "SAEDocument" SG_ 3221225472 EngAltDroopAccel1SelectState "J1939-71";
BA_ "SPN" SG_ 3221225472 EngAltDroopAccel1SelectState 2889;
BA_ "SAEDocument" SG_ 3221225472 EngAltRatingSelectState "J1939-71";
BA_ "SPN" SG_ 3221225472 EngAltRatingSelectState 2888;
BA_ "SAEDocument" SG_ 3221225472 EngAltLowIdleSelectState "J1939-71";
BA_ "SPN" SG_ 3221225472 EngAltLowIdleSelectState 2891;
BA_ "SigType" SG_ 3221225472 EngAltLowIdleSelectState 5;
BA_ "SAEDocument" SG_ 3221225472 EngMultiUnitSyncState "J1939-71";
BA_ "SPN" SG_ 3221225472 EngMultiUnitSyncState 2890;
BA_ "SigType" SG_ 3221225472 EngMultiUnitSyncState 5;
BA_ "SAEDocument" SG_ 3221225472 EngAuxGovernorState "J1939-71";
BA_ "SPN" SG_ 3221225472 EngAuxGovernorState 2896;
BA_ "SigType" SG_ 3221225472 EngAuxGovernorState 5;
BA_ "SAEDocument" SG_ 3221225472 AppliedVehicleSpeedLimit "J1939-71";
BA_ "SPN" SG_ 3221225472 AppliedVehicleSpeedLimit 2595;
BA_ "SAEDocument" SG_ 3221225472 MaxVehicleSpeedLimit7 "J1939-71";
BA_ "SPN" SG_ 3221225472 MaxVehicleSpeedLimit7 2594;
BA_ "SAEDocument" SG_ 3221225472 MaxVehicleSpeedLimit6 "J1939-71";
BA_ "SPN" SG_ 3221225472 MaxVehicleSpeedLimit6 2593;
BA_ "SAEDocument" SG_ 3221225472 MaxVehicleSpeedLimit5 "J1939-71";
BA_ "SPN" SG_ 3221225472 MaxVehicleSpeedLimit5 2592;
BA_ "SAEDocument" SG_ 3221225472 MaxVehicleSpeedLimit4 "J1939-71";
BA_ "SPN" SG_ 3221225472 MaxVehicleSpeedLimit4 2591;
BA_ "SAEDocument" SG_ 3221225472 MaxVehicleSpeedLimit3 "J1939-71";
BA_ "SPN" SG_ 3221225472 MaxVehicleSpeedLimit3 2590;
BA_ "SAEDocument" SG_ 3221225472 MaxVehicleSpeedLimit2 "J1939-71";
BA_ "SPN" SG_ 3221225472 MaxVehicleSpeedLimit2 2589;
BA_ "SAEDocument" SG_ 3221225472 MaxVehicleSpeedLimit1 "J1939-71";
BA_ "SPN" SG_ 3221225472 MaxVehicleSpeedLimit1 2588;
BA_ "SAEDocument" SG_ 3221225472 OprtrsBlackOutIntensitySelection "J1939-71";
BA_ "SPN" SG_ 3221225472 OprtrsBlackOutIntensitySelection 1844;
BA_ "SAEDocument" SG_ 3221225472 BlackOutWorkLampSelect "J1939-71";
BA_ "SPN" SG_ 3221225472 BlackOutWorkLampSelect 1842;
BA_ "SigType" SG_ 3221225472 BlackOutWorkLampSelect 5;
BA_ "SAEDocument" SG_ 3221225472 NightVisionIlluminatorSelect "J1939-71";
BA_ "SPN" SG_ 3221225472 NightVisionIlluminatorSelect 1843;
BA_ "SigType" SG_ 3221225472 NightVisionIlluminatorSelect 5;
BA_ "SAEDocument" SG_ 3221225472 BlackOutBrake_StopLampSelect "J1939-71";
BA_ "SPN" SG_ 3221225472 BlackOutBrake_StopLampSelect 1841;
BA_ "SigType" SG_ 3221225472 BlackOutBrake_StopLampSelect 5;
BA_ "SAEDocument" SG_ 3221225472 ConvoyDrivingLampSelect "J1939-71";
BA_ "SPN" SG_ 3221225472 ConvoyDrivingLampSelect 1837;
BA_ "SigType" SG_ 3221225472 ConvoyDrivingLampSelect 5;
BA_ "SAEDocument" SG_ 3221225472 ConvoyLampSelect "J1939-71";
BA_ "SPN" SG_ 3221225472 ConvoyLampSelect 1838;
BA_ "SigType" SG_ 3221225472 ConvoyLampSelect 5;
BA_ "SAEDocument" SG_ 3221225472 FrontBlackOutMarkerLampSelect "J1939-71";
BA_ "SPN" SG_ 3221225472 FrontBlackOutMarkerLampSelect 1839;
BA_ "SigType" SG_ 3221225472 FrontBlackOutMarkerLampSelect 5;
BA_ "SAEDocument" SG_ 3221225472 RearBlackOutMarkerSelect "J1939-71";
BA_ "SPN" SG_ 3221225472 RearBlackOutMarkerSelect 1840;
BA_ "SigType" SG_ 3221225472 RearBlackOutMarkerSelect 5;
BA_ "SAEDocument" SG_ 3221225472 SlowVesselModeStatus "J1939-71";
BA_ "SPN" SG_ 3221225472 SlowVesselModeStatus 2617;
BA_ "SigType" SG_ 3221225472 SlowVesselModeStatus 5;
BA_ "SAEDocument" SG_ 3221225472 TrollingModeStatus "J1939-71";
BA_ "SPN" SG_ 3221225472 TrollingModeStatus 2616;
BA_ "SigType" SG_ 3221225472 TrollingModeStatus 5;
BA_ "SAEDocument" SG_ 3221225472 EngThrttlSynchrnzationModeStatus "J1939-71";
BA_ "SPN" SG_ 3221225472 EngThrttlSynchrnzationModeStatus 2615;
BA_ "SAEDocument" SG_ 3221225472 EngMainBearing11Temp "J1939-71";
BA_ "SPN" SG_ 3221225472 EngMainBearing11Temp 1167;
BA_ "SigType" SG_ 3221225472 EngMainBearing11Temp 1;
BA_ "SAEDocument" SG_ 3221225472 EngMainBearing10Temp "J1939-71";
BA_ "SPN" SG_ 3221225472 EngMainBearing10Temp 1166;
BA_ "SigType" SG_ 3221225472 EngMainBearing10Temp 1;
BA_ "SAEDocument" SG_ 3221225472 EngMainBearing9Temp "J1939-71";
BA_ "SPN" SG_ 3221225472 EngMainBearing9Temp 1165;
BA_ "SigType" SG_ 3221225472 EngMainBearing9Temp 1;
BA_ "SAEDocument" SG_ 3221225472 EngMainBearing8Temp "J1939-71";
BA_ "SPN" SG_ 3221225472 EngMainBearing8Temp 1164;
BA_ "SigType" SG_ 3221225472 EngMainBearing8Temp 1;
BA_ "SAEDocument" SG_ 3221225472 EngMainBearing7Temp "J1939-71";
BA_ "SPN" SG_ 3221225472 EngMainBearing7Temp 1163;
BA_ "SigType" SG_ 3221225472 EngMainBearing7Temp 1;
BA_ "SAEDocument" SG_ 3221225472 EngMainBearing6Temp "J1939-71";
BA_ "SPN" SG_ 3221225472 EngMainBearing6Temp 1162;
BA_ "SigType" SG_ 3221225472 EngMainBearing6Temp 1;
BA_ "SAEDocument" SG_ 3221225472 EngMainBearing5Temp "J1939-71";
BA_ "SPN" SG_ 3221225472 EngMainBearing5Temp 1161;
BA_ "SigType" SG_ 3221225472 EngMainBearing5Temp 1;
BA_ "SAEDocument" SG_ 3221225472 EngMainBearing4Temp "J1939-71";
BA_ "SPN" SG_ 3221225472 EngMainBearing4Temp 1160;
BA_ "SigType" SG_ 3221225472 EngMainBearing4Temp 1;
BA_ "SAEDocument" SG_ 3221225472 EngMainBearing3Temp "J1939-71";
BA_ "SPN" SG_ 3221225472 EngMainBearing3Temp 1159;
BA_ "SigType" SG_ 3221225472 EngMainBearing3Temp 1;
BA_ "SAEDocument" SG_ 3221225472 EngMainBearing2Temp "J1939-71";
BA_ "SPN" SG_ 3221225472 EngMainBearing2Temp 1158;
BA_ "SigType" SG_ 3221225472 EngMainBearing2Temp 1;
BA_ "SAEDocument" SG_ 3221225472 EngMainBearing1Temp "J1939-71";
BA_ "SPN" SG_ 3221225472 EngMainBearing1Temp 1157;
BA_ "SigType" SG_ 3221225472 EngMainBearing1Temp 1;
BA_ "SAEDocument" SG_ 3221225472 DisplayDeadbands "J1939-71";
BA_ "SPN" SG_ 3221225472 DisplayDeadbands 2577;
BA_ "SAEDocument" SG_ 3221225472 LEDPatternCtrl "J1939-71";
BA_ "SPN" SG_ 3221225472 LEDPatternCtrl 2578;
BA_ "SAEDocument" SG_ 3221225472 LEDDisplayDeadbandCtrl "J1939-71";
BA_ "SPN" SG_ 3221225472 LEDDisplayDeadbandCtrl 1806;
BA_ "SAEDocument" SG_ 3221225472 LEDDisplayModeCtrl "J1939-71";
BA_ "SPN" SG_ 3221225472 LEDDisplayModeCtrl 1805;
BA_ "SAEDocument" SG_ 3221225472 LEDDisplayData1 "J1939-71";
BA_ "SPN" SG_ 3221225472 LEDDisplayData1 1573;
BA_ "SAEDocument" SG_ 3221225472 LaserStrikeDataLatency "J1939-71";
BA_ "SPN" SG_ 3221225472 LaserStrikeDataLatency 2793;
BA_ "SigType" SG_ 3221225472 LaserStrikeDataLatency 1;
BA_ "SAEDocument" SG_ 3221225472 LaserReceiverType "J1939-71";
BA_ "SPN" SG_ 3221225472 LaserReceiverType 2576;
BA_ "SAEDocument" SG_ 3221225472 LaserStrikeVerticalDeviation "J1939-71";
BA_ "SPN" SG_ 3221225472 LaserStrikeVerticalDeviation 1574;
BA_ "SigType" SG_ 3221225472 LaserStrikeVerticalDeviation 1;
BA_ "SAEDocument" SG_ 3221225472 AbsLaserStrikePos "J1939-71";
BA_ "SPN" SG_ 3221225472 AbsLaserStrikePos 2794;
BA_ "SigType" SG_ 3221225472 AbsLaserStrikePos 1;
BA_ "SAEDocument" SG_ 3221225472 LaserTracerInformation "J1939-71";
BA_ "SPN" SG_ 3221225472 LaserTracerInformation 1583;
BA_ "SAEDocument" SG_ 3221225472 LEDDisplayData2 "J1939-71";
BA_ "SPN" SG_ 3221225472 LEDDisplayData2 1582;
BA_ "SAEDocument" SG_ 3221225472 LaserTracerHorizontalDeviation "J1939-71";
BA_ "SPN" SG_ 3221225472 LaserTracerHorizontalDeviation 1581;
BA_ "SigType" SG_ 3221225472 LaserTracerHorizontalDeviation 1;
BA_ "SAEDocument" SG_ 3221225472 LaserTracerVerticalDistance "J1939-71";
BA_ "SPN" SG_ 3221225472 LaserTracerVerticalDistance 1580;
BA_ "SigType" SG_ 3221225472 LaserTracerVerticalDistance 1;
BA_ "SAEDocument" SG_ 3221225472 LaserTracerTargetDeviation "J1939-71";
BA_ "SPN" SG_ 3221225472 LaserTracerTargetDeviation 1579;
BA_ "SigType" SG_ 3221225472 LaserTracerTargetDeviation 1;
BA_ "SAEDocument" SG_ 3221225472 BldeHeightSetPointHighResolution "J1939-71";
BA_ "SPN" SG_ 3221225472 BldeHeightSetPointHighResolution 1759;
BA_ "SigType" SG_ 3221225472 BldeHeightSetPointHighResolution 1;
BA_ "SAEDocument" SG_ 3221225472 ModifyLevelingSystemSetPoint "J1939-71";
BA_ "SPN" SG_ 3221225472 ModifyLevelingSystemSetPoint 1575;
BA_ "SigType" SG_ 3221225472 ModifyLevelingSystemSetPoint 1;
BA_ "SAEDocument" SG_ 3221225472 StElvtnSensor2ReferenceElevation "J1939-71";
BA_ "SPN" SG_ 3221225472 StElvtnSensor2ReferenceElevation 5406;
BA_ "SigType" SG_ 3221225472 StElvtnSensor2ReferenceElevation 5;
BA_ "SAEDocument" SG_ 3221225472 StElvtnSensor1ReferenceElevation "J1939-71";
BA_ "SPN" SG_ 3221225472 StElvtnSensor1ReferenceElevation 5405;
BA_ "SigType" SG_ 3221225472 StElvtnSensor1ReferenceElevation 5;
BA_ "SAEDocument" SG_ 3221225472 SdshftDsrdBldeOffsetOperatorCtrl "J1939-71";
BA_ "SPN" SG_ 3221225472 SdshftDsrdBldeOffsetOperatorCtrl 3339;
BA_ "SAEDocument" SG_ 3221225472 SdshiftBladeCtrlModeOperatorCtrl "J1939-71";
BA_ "SPN" SG_ 3221225472 SdshiftBladeCtrlModeOperatorCtrl 3338;
BA_ "SAEDocument" SG_ 3221225472 RghtDsredBladeOffsetOperatorCtrl "J1939-71";
BA_ "SPN" SG_ 3221225472 RghtDsredBladeOffsetOperatorCtrl 3337;
BA_ "SAEDocument" SG_ 3221225472 LftDsiredBladeOffsetOperatorCtrl "J1939-71";
BA_ "SPN" SG_ 3221225472 LftDsiredBladeOffsetOperatorCtrl 3336;
BA_ "SAEDocument" SG_ 3221225472 RightBladeCtrlModeOperatorCtrl "J1939-71";
BA_ "SPN" SG_ 3221225472 RightBladeCtrlModeOperatorCtrl 3335;
BA_ "SAEDocument" SG_ 3221225472 LeftBladeCtrlModeOperatorCtrl "J1939-71";
BA_ "SPN" SG_ 3221225472 LeftBladeCtrlModeOperatorCtrl 3334;
BA_ "SAEDocument" SG_ 3221225472 BladeAutoModeCmd "J1939-71";
BA_ "SPN" SG_ 3221225472 BladeAutoModeCmd 3158;
BA_ "SAEDocument" SG_ 3221225472 DesiredGradeOffsetSwitch "J1939-71";
BA_ "SPN" SG_ 3221225472 DesiredGradeOffsetSwitch 3157;
BA_ "SAEDocument" SG_ 3221225472 BladeCtrlModeSwitch "J1939-71";
BA_ "SPN" SG_ 3221225472 BladeCtrlModeSwitch 3156;
BA_ "SAEDocument" SG_ 3221225472 MastPos "J1939-71";
BA_ "SPN" SG_ 3221225472 MastPos 1576;
BA_ "SigType" SG_ 3221225472 MastPos 1;
BA_ "SAEDocument" SG_ 3221225472 FlexibleFuelPercentage "J1939-71";
BA_ "SPN" SG_ 3221225472 FlexibleFuelPercentage 5458;
BA_ "SAEDocument" SG_ 3221225472 EngAverageFuelEconomy "J1939-71";
BA_ "SPN" SG_ 3221225472 EngAverageFuelEconomy 185;
BA_ "SigType" SG_ 3221225472 EngAverageFuelEconomy 1;
BA_ "SAEDocument" SG_ 3221225472 EngInstantaneousFuelEconomy "J1939-71";
BA_ "SPN" SG_ 3221225472 EngInstantaneousFuelEconomy 184;
BA_ "SigType" SG_ 3221225472 EngInstantaneousFuelEconomy 1;
BA_ "SAEDocument" SG_ 3221225472 EngFuelRate "J1939-71";
BA_ "SPN" SG_ 3221225472 EngFuelRate 183;
BA_ "SigType" SG_ 3221225472 EngFuelRate 1;
BA_ "SAEDocument" SG_ 3221225472 EngThrottleValve2Pos "J1939-71";
BA_ "SPN" SG_ 3221225472 EngThrottleValve2Pos 3673;
BA_ "SigType" SG_ 3221225472 EngThrottleValve2Pos 1;
BA_ "SAEDocument" SG_ 3221225472 EngThrottleValve1Pos "J1939-71";
BA_ "SPN" SG_ 3221225472 EngThrottleValve1Pos 51;
BA_ "SigType" SG_ 3221225472 EngThrottleValve1Pos 1;
BA_ "SAEDocument" SG_ 3221225472 EngTotalFuelUsed "J1939-71";
BA_ "SPN" SG_ 3221225472 EngTotalFuelUsed 250;
BA_ "SigType" SG_ 3221225472 EngTotalFuelUsed 1;
BA_ "SAEDocument" SG_ 3221225472 EngTripFuel "J1939-71";
BA_ "SPN" SG_ 3221225472 EngTripFuel 182;
BA_ "SigType" SG_ 3221225472 EngTripFuel 1;
BA_ "SAEDocument" SG_ 3221225472 FrontWheelDriveActuatorStatus "J1939-71";
BA_ "SPN" SG_ 3221225472 FrontWheelDriveActuatorStatus 2612;
BA_ "SigType" SG_ 3221225472 FrontWheelDriveActuatorStatus 4;
BA_ "SAEDocument" SG_ 3221225472 FMSstandardSWversionSupported "J1939-71";
BA_ "SPN" SG_ 3221225472 FMSstandardSWversionSupported 2806;
BA_ "SigType" SG_ 3221225472 FMSstandardSWversionSupported 1;
BA_ "SAEDocument" SG_ 3221225472 FMSstandardRequestsSupported "J1939-71";
BA_ "SPN" SG_ 3221225472 FMSstandardRequestsSupported 2805;
BA_ "SigType" SG_ 3221225472 FMSstandardRequestsSupported 5;
BA_ "SAEDocument" SG_ 3221225472 FMSstandardDiagnosticsSupported "J1939-71";
BA_ "SPN" SG_ 3221225472 FMSstandardDiagnosticsSupported 2804;
BA_ "SigType" SG_ 3221225472 FMSstandardDiagnosticsSupported 5;
BA_ "SAEDocument" SG_ 3221225472 LnDpartureIndicationEnableStatus "J1939-71";
BA_ "SPN" SG_ 3221225472 LnDpartureIndicationEnableStatus 1702;
BA_ "SigType" SG_ 3221225472 LnDpartureIndicationEnableStatus 5;
BA_ "SAEDocument" SG_ 3221225472 LaneTrackingStatusLeftSide "J1939-71";
BA_ "SPN" SG_ 3221225472 LaneTrackingStatusLeftSide 1710;
BA_ "SigType" SG_ 3221225472 LaneTrackingStatusLeftSide 5;
BA_ "SAEDocument" SG_ 3221225472 LaneTrackingStatusRightSide "J1939-71";
BA_ "SPN" SG_ 3221225472 LaneTrackingStatusRightSide 1711;
BA_ "SigType" SG_ 3221225472 LaneTrackingStatusRightSide 5;
BA_ "SAEDocument" SG_ 3221225472 EngFuelLeakage2 "J1939-71";
BA_ "SPN" SG_ 3221225472 EngFuelLeakage2 1240;
BA_ "SigType" SG_ 3221225472 EngFuelLeakage2 5;
BA_ "SAEDocument" SG_ 3221225472 EngFuelLeakage1 "J1939-71";
BA_ "SPN" SG_ 3221225472 EngFuelLeakage1 1239;
BA_ "SigType" SG_ 3221225472 EngFuelLeakage1 5;
BA_ "SAEDocument" SG_ 3221225472 FanDriveBypassCmdStatus "J1939-71";
BA_ "SPN" SG_ 3221225472 FanDriveBypassCmdStatus 4212;
BA_ "SAEDocument" SG_ 3221225472 HydFanMotorPress "J1939-71";
BA_ "SPN" SG_ 3221225472 HydFanMotorPress 4211;
BA_ "SigType" SG_ 3221225472 HydFanMotorPress 1;
BA_ "SAEDocument" SG_ 3221225472 FanSpeed "J1939-71";
BA_ "SPN" SG_ 3221225472 FanSpeed 1639;
BA_ "SigType" SG_ 3221225472 FanSpeed 1;
BA_ "SAEDocument" SG_ 3221225472 FanDriveState "J1939-71";
BA_ "SPN" SG_ 3221225472 FanDriveState 977;
BA_ "SAEDocument" SG_ 3221225472 EstPercentFanSpeed "J1939-71";
BA_ "SPN" SG_ 3221225472 EstPercentFanSpeed 975;
BA_ "SAEDocument" SG_ 3221225472 EngTorqueLimit6AxleInput "J1939-71";
BA_ "SPN" SG_ 3221225472 EngTorqueLimit6AxleInput 1263;
BA_ "SigType" SG_ 3221225472 EngTorqueLimit6AxleInput 1;
BA_ "SAEDocument" SG_ 3221225472 EngTorqueLimit5Switch "J1939-71";
BA_ "SPN" SG_ 3221225472 EngTorqueLimit5Switch 1262;
BA_ "SigType" SG_ 3221225472 EngTorqueLimit5Switch 1;
BA_ "SAEDocument" SG_ 3221225472 EngTorqueLimit4Trans "J1939-71";
BA_ "SPN" SG_ 3221225472 EngTorqueLimit4Trans 1261;
BA_ "SigType" SG_ 3221225472 EngTorqueLimit4Trans 1;
BA_ "SAEDocument" SG_ 3221225472 EngTorqueLimit3Trans "J1939-71";
BA_ "SPN" SG_ 3221225472 EngTorqueLimit3Trans 1260;
BA_ "SigType" SG_ 3221225472 EngTorqueLimit3Trans 1;
BA_ "SAEDocument" SG_ 3221225472 TransGearRatio3 "J1939-71";
BA_ "SPN" SG_ 3221225472 TransGearRatio3 1259;
BA_ "SigType" SG_ 3221225472 TransGearRatio3 1;
BA_ "SAEDocument" SG_ 3221225472 EngTorqueLimit2Trans "J1939-71";
BA_ "SPN" SG_ 3221225472 EngTorqueLimit2Trans 1258;
BA_ "SigType" SG_ 3221225472 EngTorqueLimit2Trans 1;
BA_ "SAEDocument" SG_ 3221225472 TransGearRatio2 "J1939-71";
BA_ "SPN" SG_ 3221225472 TransGearRatio2 1257;
BA_ "SigType" SG_ 3221225472 TransGearRatio2 1;
BA_ "SAEDocument" SG_ 3221225472 EngTorqueLimit1Trans "J1939-71";
BA_ "SPN" SG_ 3221225472 EngTorqueLimit1Trans 1256;
BA_ "SigType" SG_ 3221225472 EngTorqueLimit1Trans 1;
BA_ "SAEDocument" SG_ 3221225472 TransGearRatio1 "J1939-71";
BA_ "SPN" SG_ 3221225472 TransGearRatio1 1255;
BA_ "SigType" SG_ 3221225472 TransGearRatio1 1;
BA_ "SAEDocument" SG_ 3221225472 EngTorqueLimitFeature "J1939-71";
BA_ "SPN" SG_ 3221225472 EngTorqueLimitFeature 1632;
BA_ "SAEDocument" SG_ 3221225472 TorqueLimitingFeatureStatus "J1939-71";
BA_ "SPN" SG_ 3221225472 TorqueLimitingFeatureStatus 1254;
BA_ "SigType" SG_ 3221225472 TorqueLimitingFeatureStatus 5;
BA_ "SAEDocument" SG_ 3221225472 CalibRecordDurationTime "J1939-71";
BA_ "SPN" SG_ 3221225472 CalibRecordDurationTime 1253;
BA_ "SigType" SG_ 3221225472 CalibRecordDurationTime 1;
BA_ "SAEDocument" SG_ 3221225472 CalibRecordStartYear "J1939-71";
BA_ "SPN" SG_ 3221225472 CalibRecordStartYear 1252;
BA_ "SigType" SG_ 3221225472 CalibRecordStartYear 1;
BA_ "SAEDocument" SG_ 3221225472 CalibRecordStartDay "J1939-71";
BA_ "SPN" SG_ 3221225472 CalibRecordStartDay 1251;
BA_ "SigType" SG_ 3221225472 CalibRecordStartDay 1;
BA_ "SAEDocument" SG_ 3221225472 CalibRecordStartMonth "J1939-71";
BA_ "SPN" SG_ 3221225472 CalibRecordStartMonth 1250;
BA_ "SigType" SG_ 3221225472 CalibRecordStartMonth 1;
BA_ "SAEDocument" SG_ 3221225472 EngPeakTorque2 "J1939-71";
BA_ "SPN" SG_ 3221225472 EngPeakTorque2 1249;
BA_ "SigType" SG_ 3221225472 EngPeakTorque2 1;
BA_ "SAEDocument" SG_ 3221225472 EngPeakTorque1 "J1939-71";
BA_ "SPN" SG_ 3221225472 EngPeakTorque1 1248;
BA_ "SigType" SG_ 3221225472 EngPeakTorque1 1;
BA_ "SAEDocument" SG_ 3221225472 EngPower "J1939-71";
BA_ "SPN" SG_ 3221225472 EngPower 1247;
BA_ "SigType" SG_ 3221225472 EngPower 1;
BA_ "SAEDocument" SG_ 3221225472 NumberOfEngTorqueHistoryRecords "J1939-71";
BA_ "SPN" SG_ 3221225472 NumberOfEngTorqueHistoryRecords 1246;
BA_ "SigType" SG_ 3221225472 NumberOfEngTorqueHistoryRecords 1;
BA_ "SAEDocument" SG_ 3221225472 TransClutch_ConverterInputSpeed "J1939-71";
BA_ "SPN" SG_ 3221225472 TransClutch_ConverterInputSpeed 5052;
BA_ "SigType" SG_ 3221225472 TransClutch_ConverterInputSpeed 1;
BA_ "SAEDocument" SG_ 3221225472 TransTorqueConverterRatio "J1939-71";
BA_ "SPN" SG_ 3221225472 TransTorqueConverterRatio 3030;
BA_ "SigType" SG_ 3221225472 TransTorqueConverterRatio 1;
BA_ "SAEDocument" SG_ 3221225472 TrnsRverseGearShiftInhibitStatus "J1939-71";
BA_ "SPN" SG_ 3221225472 TrnsRverseGearShiftInhibitStatus 4261;
BA_ "SigType" SG_ 3221225472 TrnsRverseGearShiftInhibitStatus 4;
BA_ "SAEDocument" SG_ 3221225472 TrnsCrrentRangeDisplayBlankState "J1939-71";
BA_ "SPN" SG_ 3221225472 TrnsCrrentRangeDisplayBlankState 4176;
BA_ "SigType" SG_ 3221225472 TrnsCrrentRangeDisplayBlankState 5;
BA_ "SAEDocument" SG_ 3221225472 TransWarningIndicator "J1939-71";
BA_ "SPN" SG_ 3221225472 TransWarningIndicator 5344;
BA_ "SigType" SG_ 3221225472 TransWarningIndicator 5;
BA_ "SAEDocument" SG_ 3221225472 TransMode8Indicator "J1939-71";
BA_ "SPN" SG_ 3221225472 TransMode8Indicator 4253;
BA_ "SigType" SG_ 3221225472 TransMode8Indicator 5;
BA_ "SAEDocument" SG_ 3221225472 TransMode7Indicator "J1939-71";
BA_ "SPN" SG_ 3221225472 TransMode7Indicator 4252;
BA_ "SigType" SG_ 3221225472 TransMode7Indicator 5;
BA_ "SAEDocument" SG_ 3221225472 TransMode6Indicator "J1939-71";
BA_ "SPN" SG_ 3221225472 TransMode6Indicator 4251;
BA_ "SigType" SG_ 3221225472 TransMode6Indicator 5;
BA_ "SAEDocument" SG_ 3221225472 TransMode5Indicator "J1939-71";
BA_ "SPN" SG_ 3221225472 TransMode5Indicator 4250;
BA_ "SigType" SG_ 3221225472 TransMode5Indicator 5;
BA_ "SAEDocument" SG_ 3221225472 TransRequestedGearFeedback "J1939-71";
BA_ "SPN" SG_ 3221225472 TransRequestedGearFeedback 3289;
BA_ "SAEDocument" SG_ 3221225472 TransMode1Indicator "J1939-71";
BA_ "SPN" SG_ 3221225472 TransMode1Indicator 2536;
BA_ "SigType" SG_ 3221225472 TransMode1Indicator 5;
BA_ "SAEDocument" SG_ 3221225472 TransMode2Indicator "J1939-71";
BA_ "SPN" SG_ 3221225472 TransMode2Indicator 2537;
BA_ "SigType" SG_ 3221225472 TransMode2Indicator 5;
BA_ "SAEDocument" SG_ 3221225472 TransMode3Indicator "J1939-71";
BA_ "SPN" SG_ 3221225472 TransMode3Indicator 2538;
BA_ "SigType" SG_ 3221225472 TransMode3Indicator 5;
BA_ "SAEDocument" SG_ 3221225472 TransMode4Indicator "J1939-71";
BA_ "SPN" SG_ 3221225472 TransMode4Indicator 2539;
BA_ "SigType" SG_ 3221225472 TransMode4Indicator 5;
BA_ "SAEDocument" SG_ 3221225472 TransShiftInhibitIndicator "J1939-71";
BA_ "SPN" SG_ 3221225472 TransShiftInhibitIndicator 1851;
BA_ "SigType" SG_ 3221225472 TransShiftInhibitIndicator 5;
BA_ "SAEDocument" SG_ 3221225472 TransEngCrankEnable "J1939-71";
BA_ "SPN" SG_ 3221225472 TransEngCrankEnable 2900;
BA_ "SigType" SG_ 3221225472 TransEngCrankEnable 5;
BA_ "SAEDocument" SG_ 3221225472 ActiveShiftConsoleIndicator "J1939-71";
BA_ "SPN" SG_ 3221225472 ActiveShiftConsoleIndicator 2945;
BA_ "SigType" SG_ 3221225472 ActiveShiftConsoleIndicator 5;
BA_ "SAEDocument" SG_ 3221225472 TransReadyForBrakeRelease "J1939-71";
BA_ "SPN" SG_ 3221225472 TransReadyForBrakeRelease 3086;
BA_ "SigType" SG_ 3221225472 TransReadyForBrakeRelease 5;
BA_ "SAEDocument" SG_ 3221225472 TrnsRqstedRangeDisplayFlashState "J1939-71";
BA_ "SPN" SG_ 3221225472 TrnsRqstedRangeDisplayFlashState 1849;
BA_ "SigType" SG_ 3221225472 TrnsRqstedRangeDisplayFlashState 5;
BA_ "SAEDocument" SG_ 3221225472 TrnsRqstedRangeDisplayBlankState "J1939-71";
BA_ "SPN" SG_ 3221225472 TrnsRqstedRangeDisplayBlankState 1850;
BA_ "SigType" SG_ 3221225472 TrnsRqstedRangeDisplayBlankState 5;
BA_ "SAEDocument" SG_ 3221225472 TransServiceIndicator "J1939-71";
BA_ "SPN" SG_ 3221225472 TransServiceIndicator 4178;
BA_ "SigType" SG_ 3221225472 TransServiceIndicator 5;
BA_ "SAEDocument" SG_ 3221225472 ClutchLifeRemaining "J1939-71";
BA_ "SPN" SG_ 3221225472 ClutchLifeRemaining 2983;
BA_ "SigType" SG_ 3221225472 ClutchLifeRemaining 1;
BA_ "SAEDocument" SG_ 3221225472 LowestPossibleGear "J1939-71";
BA_ "SPN" SG_ 3221225472 LowestPossibleGear 1114;
BA_ "SAEDocument" SG_ 3221225472 HighestPossibleGear "J1939-71";
BA_ "SPN" SG_ 3221225472 HighestPossibleGear 1115;
BA_ "SAEDocument" SG_ 3221225472 RecommendedGear "J1939-71";
BA_ "SPN" SG_ 3221225472 RecommendedGear 1113;
BA_ "SAEDocument" SG_ 3221225472 TransForwardDirectionSwitch "J1939-71";
BA_ "SPN" SG_ 3221225472 TransForwardDirectionSwitch 903;
BA_ "SigType" SG_ 3221225472 TransForwardDirectionSwitch 5;
BA_ "SAEDocument" SG_ 3221225472 TransNeutralSwitch "J1939-71";
BA_ "SPN" SG_ 3221225472 TransNeutralSwitch 604;
BA_ "SigType" SG_ 3221225472 TransNeutralSwitch 5;
BA_ "SAEDocument" SG_ 3221225472 TransReverseDirectionSwitch "J1939-71";
BA_ "SPN" SG_ 3221225472 TransReverseDirectionSwitch 767;
BA_ "SigType" SG_ 3221225472 TransReverseDirectionSwitch 5;
BA_ "SAEDocument" SG_ 3221225472 TransLowRangeSenseSwitch "J1939-71";
BA_ "SPN" SG_ 3221225472 TransLowRangeSenseSwitch 779;
BA_ "SigType" SG_ 3221225472 TransLowRangeSenseSwitch 5;
BA_ "SAEDocument" SG_ 3221225472 TransHighRangeSenseSwitch "J1939-71";
BA_ "SPN" SG_ 3221225472 TransHighRangeSenseSwitch 778;
BA_ "SigType" SG_ 3221225472 TransHighRangeSenseSwitch 5;
BA_ "SAEDocument" SG_ 3221225472 TransSynchronizerBrakeValue "J1939-71";
BA_ "SPN" SG_ 3221225472 TransSynchronizerBrakeValue 54;
BA_ "SigType" SG_ 3221225472 TransSynchronizerBrakeValue 1;
BA_ "SAEDocument" SG_ 3221225472 TransSynchronizerClutchValue "J1939-71";
BA_ "SPN" SG_ 3221225472 TransSynchronizerClutchValue 53;
BA_ "SigType" SG_ 3221225472 TransSynchronizerClutchValue 1;
BA_ "SAEDocument" SG_ 3221225472 TransInertiaBrakeActuator "J1939-71";
BA_ "SPN" SG_ 3221225472 TransInertiaBrakeActuator 787;
BA_ "SigType" SG_ 3221225472 TransInertiaBrakeActuator 5;
BA_ "SAEDocument" SG_ 3221225472 TransDefuelActuator "J1939-71";
BA_ "SPN" SG_ 3221225472 TransDefuelActuator 786;
BA_ "SigType" SG_ 3221225472 TransDefuelActuator 5;
BA_ "SAEDocument" SG_ 3221225472 TransLockupClutchActuator "J1939-71";
BA_ "SPN" SG_ 3221225472 TransLockupClutchActuator 740;
BA_ "SigType" SG_ 3221225472 TransLockupClutchActuator 5;
BA_ "SAEDocument" SG_ 3221225472 TransClutchActuator "J1939-71";
BA_ "SPN" SG_ 3221225472 TransClutchActuator 788;
BA_ "SigType" SG_ 3221225472 TransClutchActuator 5;
BA_ "SAEDocument" SG_ 3221225472 TransSplitterIndirectActuator "J1939-71";
BA_ "SPN" SG_ 3221225472 TransSplitterIndirectActuator 771;
BA_ "SigType" SG_ 3221225472 TransSplitterIndirectActuator 5;
BA_ "SAEDocument" SG_ 3221225472 TransSplitterDirectActuator "J1939-71";
BA_ "SPN" SG_ 3221225472 TransSplitterDirectActuator 770;
BA_ "SigType" SG_ 3221225472 TransSplitterDirectActuator 5;
VAL_ 3221225472 CTIWheelEndElectricalFault_12 3 "NotSupported" 2 "Error" 1 "NotDefined" 0 "Ok" ;
VAL_ 3221225472 CTIWheelEndElectricalFault_11 3 "NotSupported" 2 "Error" 1 "NotDefined" 0 "Ok" ;
VAL_ 3221225472 CTIWheelEndElectricalFault_10 3 "NotSupported" 2 "Error" 1 "NotDefined" 0 "Ok" ;
VAL_ 3221225472 CTIWheelEndElectricalFault_01 3 "NotSupported" 2 "Error" 1 "NotDefined" 0 "Ok" ;
VAL_ 3221225472 CTITireStatus_33 3 "NotSupported" 2 "Error" 1 "TireLeakDetected" 0 "Ok" ;
VAL_ 3221225472 CTITireStatus_32 3 "NotSupported" 2 "Error" 1 "TireLeakDetected" 0 "Ok" ;
VAL_ 3221225472 CTITireStatus_31 3 "NotSupported" 2 "Error" 1 "TireLeakDetected" 0 "Ok" ;
VAL_ 3221225472 CTITireStatus_30 3 "NotSupported" 2 "Error" 1 "TireLeakDetected" 0 "Ok" ;
VAL_ 3221225472 CTITireStatus_23 3 "NotSupported" 2 "Error" 1 "TireLeakDetected" 0 "Ok" ;
VAL_ 3221225472 CTITireStatus_22 3 "NotSupported" 2 "Error" 1 "TireLeakDetected" 0 "Ok" ;
VAL_ 3221225472 CTITireStatus_21 3 "NotSupported" 2 "Error" 1 "TireLeakDetected" 0 "Ok" ;
VAL_ 3221225472 CTITireStatus_20 3 "NotSupported" 2 "Error" 1 "TireLeakDetected" 0 "Ok" ;
VAL_ 3221225472 CTITireStatus_13 3 "NotSupported" 2 "Error" 1 "TireLeakDetected" 0 "Ok" ;
VAL_ 3221225472 CTITireStatus_12 3 "NotSupported" 2 "Error" 1 "TireLeakDetected" 0 "Ok" ;
VAL_ 3221225472 CTITireStatus_11 3 "NotSupported" 2 "Error" 1 "TireLeakDetected" 0 "Ok" ;
VAL_ 3221225472 CTITireStatus_10 3 "NotSupported" 2 "Error" 1 "TireLeakDetected" 0 "Ok" ;
VAL_ 3221225472 CTITireStatus_01 3 "NotSupported" 2 "Error" 1 "TireLeakDetected" 0 "Ok" ;
VAL_ 3221225472 TirePressThresholdDetection_33 7 "NotAvailable" 6 "ErrorIndicator" 5 "NotDefined" 4 "ExtrmUndrPrssTrPrssrIsAtALvlWhr" 3 "UndrPrssTrPrssrIsLwrThnThPrssrD" 2 "NWrnngPrssTrPrssrIsWthnThThrshl" 1 "OvrPrssTrPrssrIsHghrThnThPrssrD" 0 "ExtrmOvrPrssTrPrssrIsAtALvlWhrT" ;
VAL_ 3221225472 TirePressThresholdDetection_32 7 "NotAvailable" 6 "ErrorIndicator" 5 "NotDefined" 4 "ExtrmUndrPrssTrPrssrIsAtALvlWhr" 3 "UndrPrssTrPrssrIsLwrThnThPrssrD" 2 "NWrnngPrssTrPrssrIsWthnThThrshl" 1 "OvrPrssTrPrssrIsHghrThnThPrssrD" 0 "ExtrmOvrPrssTrPrssrIsAtALvlWhrT" ;
VAL_ 3221225472 TirePressThresholdDetection_31 7 "NotAvailable" 6 "ErrorIndicator" 5 "NotDefined" 4 "ExtrmUndrPrssTrPrssrIsAtALvlWhr" 3 "UndrPrssTrPrssrIsLwrThnThPrssrD" 2 "NWrnngPrssTrPrssrIsWthnThThrshl" 1 "OvrPrssTrPrssrIsHghrThnThPrssrD" 0 "ExtrmOvrPrssTrPrssrIsAtALvlWhrT" ;
VAL_ 3221225472 TirePressThresholdDetection_30 7 "NotAvailable" 6 "ErrorIndicator" 5 "NotDefined" 4 "ExtrmUndrPrssTrPrssrIsAtALvlWhr" 3 "UndrPrssTrPrssrIsLwrThnThPrssrD" 2 "NWrnngPrssTrPrssrIsWthnThThrshl" 1 "OvrPrssTrPrssrIsHghrThnThPrssrD" 0 "ExtrmOvrPrssTrPrssrIsAtALvlWhrT" ;
VAL_ 3221225472 TirePressThresholdDetection_23 7 "NotAvailable" 6 "ErrorIndicator" 5 "NotDefined" 4 "ExtrmUndrPrssTrPrssrIsAtALvlWhr" 3 "UndrPrssTrPrssrIsLwrThnThPrssrD" 2 "NWrnngPrssTrPrssrIsWthnThThrshl" 1 "OvrPrssTrPrssrIsHghrThnThPrssrD" 0 "ExtrmOvrPrssTrPrssrIsAtALvlWhrT" ;
VAL_ 3221225472 TirePressThresholdDetection_22 7 "NotAvailable" 6 "ErrorIndicator" 5 "NotDefined" 4 "ExtrmUndrPrssTrPrssrIsAtALvlWhr" 3 "UndrPrssTrPrssrIsLwrThnThPrssrD" 2 "NWrnngPrssTrPrssrIsWthnThThrshl" 1 "OvrPrssTrPrssrIsHghrThnThPrssrD" 0 "ExtrmOvrPrssTrPrssrIsAtALvlWhrT" ;
VAL_ 3221225472 TirePressThresholdDetection_21 7 "NotAvailable" 6 "ErrorIndicator" 5 "NotDefined" 4 "ExtrmUndrPrssTrPrssrIsAtALvlWhr" 3 "UndrPrssTrPrssrIsLwrThnThPrssrD" 2 "NWrnngPrssTrPrssrIsWthnThThrshl" 1 "OvrPrssTrPrssrIsHghrThnThPrssrD" 0 "ExtrmOvrPrssTrPrssrIsAtALvlWhrT" ;
VAL_ 3221225472 TirePressThresholdDetection_20 7 "NotAvailable" 6 "ErrorIndicator" 5 "NotDefined" 4 "ExtrmUndrPrssTrPrssrIsAtALvlWhr" 3 "UndrPrssTrPrssrIsLwrThnThPrssrD" 2 "NWrnngPrssTrPrssrIsWthnThThrshl" 1 "OvrPrssTrPrssrIsHghrThnThPrssrD" 0 "ExtrmOvrPrssTrPrssrIsAtALvlWhrT" ;
VAL_ 3221225472 TirePressThresholdDetection_00 7 "NotAvailable" 6 "ErrorIndicator" 5 "NotDefined" 4 "ExtrmUndrPrssTrPrssrIsAtALvlWhr" 3 "UndrPrssTrPrssrIsLwrThnThPrssrD" 2 "NWrnngPrssTrPrssrIsWthnThThrshl" 1 "OvrPrssTrPrssrIsHghrThnThPrssrD" 0 "ExtrmOvrPrssTrPrssrIsAtALvlWhrT" ;
VAL_ 3221225472 CTIWheelSensorStatus_00 3 "NotSupported" 2 "NotDefined" 1 "On" 0 "Off_IsolatedFromCTIPressCtrl" ;
VAL_ 3221225472 CTIWheelEndElectricalFault_00 3 "NotSupported" 2 "Error" 1 "NotDefined" 0 "Ok" ;
VAL_ 3221225472 CTITireStatus_00 3 "NotSupported" 2 "Error" 1 "TireLeakDetected" 0 "Ok" ;
VAL_ 3221225472 EngTrbWstgateActuator1TempStatus 7 "Not available" 6 "Error" 5 "Not Defined" 4 "Low Most severe" 3 "Low Least severe" 2 "In Range" 1 "High Least severe" 0 "High Most severe" ;
VAL_ 3221225472 TransMode8 3 "Take no action" 2 "Reserved" 1 "Enable" 0 "Disable" ;
VAL_ 3221225472 TransMode7 3 "Take no action" 2 "Reserved" 1 "Enable" 0 "Disable" ;
VAL_ 3221225472 TransMode6 3 "Take no action" 2 "Reserved" 1 "Enable" 0 "Disable" ;
VAL_ 3221225472 TransMode5 3 "Take no action" 2 "Reserved" 1 "Enable" 0 "Disable" ;
VAL_ 3221225472 TrnsShftSlectorDisplayModeSwitch 3 "Not available" 2 "Error" 1 "On" 0 "Off" ;
VAL_ 3221225472 TransRequestedLaunchGear 15 "Not Available" 14 "Error" 13 "Reserved" 12 "Launch the vehicle in Reverse 4" 11 "Launch the vehicle in Reverse 3" 10 "Launch the vehicle in Reverse 2" 9 "Launch the vehicle in Reverse 1" 8 "Launch the vehicle in 8th gear" 7 "Launch the vehicle in 7th gear" 6 "Launch the vehicle in 6th gear" 5 "Launch the vehicle in 5th gear" 4 "Launch the vehicle in 4th gear" 3 "Launch the vehicle in 3rd gear" 2 "Launch the vehicle in 2nd gear" 1 "Launch the vehicle in 1st gear" 0 "No specific launch gear requested use default launch gear" ;
VAL_ 3221225472 TransMode4 3 "Take no action" 2 "Reserved" 1 "Enable" 0 "Disable" ;
VAL_ 3221225472 TransMode3 3 "Take no action" 2 "Reserved" 1 "Enable" 0 "Disable" ;
VAL_ 3221225472 TransMode2 3 "Take no action" 2 "Reserved" 1 "Enable" 0 "Disable" ;
VAL_ 3221225472 TransMode1 3 "Take no action" 2 "Reserved" 1 "Enable" 0 "Disable" ;
VAL_ 3221225472 DisengageDiffLockRqCentralRear 3 "Take no action" 2 "Reserved" 1 "Disengage differential lock" 0 "Engage differential lock" ;
VAL_ 3221225472 DisengageDiffLockRqCentralFront 3 "Take no action" 2 "Reserved" 1 "Disengage differential lock" 0 "Engage differential lock" ;
VAL_ 3221225472 DisengageDiffLockRqCentral 3 "Take no action" 2 "Reserved" 1 "Disengage differential lock" 0 "Engage differential lock" ;
VAL_ 3221225472 DisengageDiffLockRqRearAxle2 3 "Take no action" 2 "Reserved" 1 "Disengage differential lock" 0 "Engage differential lock" ;
VAL_ 3221225472 DisengageDiffLockRqRearAxle1 3 "Take no action" 2 "Reserved" 1 "Disengage differential lock" 0 "Engage differential lock" ;
VAL_ 3221225472 DisengageDiffLockRqFrontAxle2 3 "Take no action" 2 "Reserved" 1 "Disengage differential lock" 0 "Engage differential lock" ;
VAL_ 3221225472 DisengageDiffLockRqFrontAxle1 3 "Take no action" 2 "Reserved" 1 "Disengage differential lock" 0 "Engage differential lock" ;
VAL_ 3221225472 TransReverseGearShiftInhibitRq 3 "Take no action" 2 "Reserved" 1 "Inhibit shifts into Reverse gear and shift transmission to Neutral if already in Reverse or attempting to shift to" 0 "Allow shifts into Reverse gear" ;
VAL_ 3221225472 DisengageDrivelineRq 2 "Reserved" 3 "Take no action" 1 "Disengage driveline" 0 "Allow driveline engagement" ;
VAL_ 3221225472 TrnsTrqeConverterLockupDisableRq 3 "Take no action" 2 "Reserved" 1 "Disable torque converter lockup" 0 "Allow torque converter lockup" ;
VAL_ 3221225472 TransGearShiftInhibitRq 2 "Reserved" 3 "Take no action leave function as is" 1 "Gear shifts are inhibited enable function" 0 "Gear shifts are allowed disable function" ;
VAL_ 3221225472 EngTurboOilLevelSwitch 3 "Not available" 2 "Error" 1 "Oil present at turbocharger" 0 "No oil present at turbocharger" ;
VAL_ 3221225472 PTOShutdownHasShutdownEng 3 "Not available" 2 "Error" 1 "Yes" 0 "No" ;
VAL_ 3221225472 EngAirShutoffStatus 3 "Not Available" 2 "Error" 1 "Air flow restricted" 0 "Air flow allowed to engine" ;
VAL_ 3221225472 EngOverspeedTest 3 "Not Available" 2 "Reserved" 1 "Engine Overspeed Test Active" 0 "Engine Overspeed Test Not Active" ;
VAL_ 3221225472 EngAirShutoffCmdStatus 0 "Air Shutoff Disabled not attempting to shutoff engine air supply" 3 "Not Available" 2 "Reserved" 1 "Air Shutoff Enabled attempting to shutoff engine air supply" ;
VAL_ 3221225472 EngAlarmOutputCmdStatus 3 "Not Available" 2 "Reserved" 1 "Engine Alarm Output Command Active" 0 "Engine Alarm Output Command Not Active" ;
VAL_ 3221225472 EngAlarmAcknowledge 3 "Not Available" 2 "Error" 1 "Engine Alarm Acknowledge Active" 0 "Engine Alarm Acknowledge Not Active" ;
VAL_ 3221225472 EngProtectionSystemConfig 3 "Not available" 2 "Error" 1 "Enabled in calibration" 0 "Disabled in calibration" ;
VAL_ 3221225472 EngProtectionSystemTimerState 3 "Not available" 2 "Error" 1 "Active" 0 "Inactive" ;
VAL_ 3221225472 EngProtectionSystemTimerOverride 3 "Not available" 2 "Error" 1 "Active" 0 "Inactive" ;
VAL_ 3221225472 EngPrtctnSystmApprachingShutdown 3 "Not available" 2 "Error" 1 "Approaching" 0 "Not approaching" ;
VAL_ 3221225472 EngPrtectionSystemHasShutdownEng 3 "Not available" 2 "Error" 1 "Yes" 0 "No" ;
VAL_ 3221225472 EngWaitToStartLamp 3 "Not available" 2 "Error" 1 "On" 0 "Off" ;
VAL_ 3221225472 RefrigerantHighPressSwitch 3 "Not available" 2 "Error" 1 "Pressure too high compressor clutch may be disengaged" 0 "Pressure normal" ;
VAL_ 3221225472 RefrigerantLowPressSwitch 3 "Not available" 2 "Error" 1 "Pressure too low compressor clutch may be disengaged" 0 "Pressure normal" ;
VAL_ 3221225472 A_CHighPressFanSwitch 3 "Not available" 2 "Error" 1 "Pressure high fan may be engaged" 0 "Pressure normal" ;
VAL_ 3221225472 EngIdleShutdownTimerFunction 3 "Not available" 2 "Error" 1 "Enabled in calibration" 0 "Disabled in calibration" ;
VAL_ 3221225472 EngIdleShutdownTimerState 3 "Not available" 2 "Error" 1 "Active" 0 "Inactive" ;
VAL_ 3221225472 EngIdleShutdownTimerOverride 3 "Not available" 2 "Error" 1 "Active" 0 "Inactive" ;
VAL_ 3221225472 EngIdleShutdownDriverAlertMode 3 "Not available" 2 "Error" 1 "Active" 0 "Inactive" ;
VAL_ 3221225472 EngIdleShutdownHasShutdownEng 3 "Not available" 2 "Error" 1 "Yes" 0 "No" ;
VAL_ 3221225472 VehicleSystem5 127 "Not Available" 0 "Ind. Process Control Stationary" ;
VAL_ 3221225472 VehicleSystem4 100 "Deck/Cargo/Fishing equip. sys" 90 "Environmental (HVAC) Systems" 80 "Instrumentation/General Systems" 70 "Communications Systems" 60 "Navigation Systems" 50 "Propulsion Systems" 40 "Steering Systems" 30 "Power Mgmt and lighting systems" 25 "Gateway" 20 "Safety Systems" 10 "System Tools" 127 "Not Available" 0 "Non-specific System" ;
VAL_ 3221225472 VehicleSystem3 8 "Grader" 7 "Four Wheel Drive Loader" 6 "Forklift" 5 "Excavator" 4 "Crawler" 3 "Backhoe" 2 "Articulated Dump Truck" 1 "Skid Steer Loader" 127 "Not Available" 0 "Non-specific System" ;
VAL_ 3221225472 VehicleSystem2 16 "Skidder" 15 "Earth Work" 14 "Special Crops" 13 "Powered Auxiliary Device" 12 "Farm Yard Operations" 11 "Transport/Trailer" 10 "Irrigation" 9 "Forage" 8 "Root Harvesters" 7 "Harvesters" 6 "Sprayers" 5 "Fertilizers" 4 "Planters/Seeders" 3 "Secondary Tillage" 2 "Tillage" 1 "Tractor" 127 "Not Available" 0 "Non-specific System" ;
VAL_ 3221225472 VehicleSystem1 2 "Trailer" 1 "Tractor" 127 "Not Available" 0 "Non-specific System" ;
VAL_ 3221225472 IndustryGroup 6 "Reserved for SAE" 7 "Reserved for SAE" 5 "IndustrialProcessCtrlStationary" 4 "Marine" 3 "Construction" 2 "Agricultural and Forestry" 1 "On-Highway" 0 "Global" ;
VAL_ 3221225472 VehicleSystem 0 "Non-specific System" 127 "Not Available" ;
VAL_ 3221225472 Function 127 "Reserved" 126 "Reserved" 125 "Reserved" 124 "Reserved" 123 "Reserved" 122 "Reserved" 121 "Reserved" 120 "Reserved" 119 "Reserved" 118 "Reserved" 117 "Reserved" 116 "Reserved" 115 "Reserved" 114 "Reserved" 113 "Reserved" 112 "Reserved" 111 "Reserved" 110 "Reserved" 109 "Reserved" 108 "Reserved" 107 "Reserved" 106 "Reserved" 105 "Reserved" 104 "Reserved" 103 "Reserved" 102 "Reserved" 101 "Reserved" 42 "Water Pump Control" 41 "Lighting - Operator Controls" 40 "Seat Control" 39 "Ignition Control Module" 38 "Tire Pressure Control" 37 "Cab Controller" 36 "Pneumatic - System Controller" 35 "Suspension - System Controller" 34 "Hydraulic Pump Controller" 33 "System Monitor" 32 "Headway Controller" 31 "Propulsion Battery Charger" 30 "Management Computer" 29 "Virtual Terminal (in cab)" 28 "Off Vehicle Gateway" 27 "Power TakeOff (Secondary or Front)" 26 "Body Controller" 25 "Network Interconnect ECU" 24 "Vehicle Security" 23 "Vehicle Navigation" 22 "Aerodynamic Control" 21 "Cab Climate Control" 20 "Trip Recorder" 19 "Instrument Cluster" 18 "Suspension - Drive Axle" 17 "Suspension - Steer Axle" 16 "Steering Controller" 15 "Fuel System" 14 "Cruise Control" 13 "Retarder - Driveline" 12 "Retarder - Engine" 11 "Brakes - Drive Axle" 10 "Brakes - Steer Axle" 9 "Brakes - System Controller" 8 "Axle - Drive" 7 "Axle - Steering" 6 "Power TakeOff - (Main or Rear)" 5 "Shift Control/Console" 4 "Battery Pack Monitor" 3 "Transmission" 2 "Electric Propulsion Control" 1 "Auxiliary Power Unit (APU)" 0 "Engine" 100 "Reserved" 99 "Reserved" 98 "Reserved" 97 "Reserved" 96 "Reserved" 95 "Reserved" 94 "Reserved" 93 "Reserved" 92 "Reserved" 91 "Reserved" 90 "Reserved" 89 "Reserved" 88 "Reserved" 87 "Reserved" 86 "Reserved" 85 "Reserved" 84 "Reserved" 83 "Reserved" 82 "Reserved" 81 "Reserved" 80 "Reserved" 79 "Reserved" 78 "Reserved" 77 "Reserved" 76 "Reserved" 75 "Supplemental Fan" 74 "Lubrication System" 73 "Rollover Detection Control" 72 "Coolant Valve Controller" 71 "Transfer Case Control" 70 "Auxiliary Regeneration Device" 69 "Engine Emission Aftertreatement System" 68 "Aftertreatment system gas measurement" 67 "Electrical System Controller" 66 "I/O Controller" 65 "Gas Flow Measurement" 64 "Endurance Braking" 63 "Engine Valve Controller" 62 "On-Board Diagnostic Unit" 61 "File Server/Printer" 60 "Cab Display" 59 "Starter" 58 "Fan Drive Control" 57 "Steering Column Unit" 56 "Communications Unit, Radio" 55 "Communications Unit, Satellite" 54 "Communications Unit, Cellular" 53 "Alternator/Charging System" 52 "Chassis Controller" 51 "Forward-Looking Collision Warning System" 50 "Auxiliary Heater" 49 "Clutch/Converter Control" 48 "Ramp Control" 47 "Information System Controller" 46 "Oil Sensor Unit" 45 "Vehicle Dynamic Stability Control" 44 "Exhaust Emission Control" 43 "Transmission Display" ;
VAL_ 3221225472 ManufacturerCode 381 "B&G" 374 "Northern Lights" 373 "Electronic Design" 371 "Delphi" 370 "Heinzmann GmbH & Co. KG" 369 "Power Torque Engineering Ltd" 368 "HANSENHOF_electronic" 367 "Fliegl Agrartechnik" 366 "Viewnyx Corp." 365 "Digi-Star, LLC" 364 "OEM Controls Inc." 363 "BEI Duncan" 362 "Alois Poettinger Maschinenfabrik GmbH" 361 "InMach" 360 "HJS Fahrzeugtechnik GmbH & Co KG" 359 "Ludwig Bergmann GmbH" 358 "Victron Energy BV" 357 "Hardi International A/S" 356 "Fischer Panda Generators, Inc" 355 "Mastervolt International B.V." 354 "Junkkari OY" 353 "Hegemon Electronics, Inc." 352 "SAME DEUTZ-FAHR" 351 "Thrane & Thrane" 350 "Noris Marine Systems GmbH & Co KG" 349 "Suonentiet" 348 "Amazonen Werke H. Dreyer" 347 "Honeywell" 346 "Control Solutions" 345 "Korean Maritime University" 344 "Parvus Corporation" 343 "Baumer Group" 342 "THOMAS MAGNETE GmbH" 341 "Boning GmbH & Co" 340 "Continental AG" 339 "Competence Center ISOBUS e.V." 338 "GRAF-SYTECO" 337 "Carraro S.p.A." 336 "APE s.r.o." 335 "Evo Electric Ltd" 334 "Takata-Petri AG" 333 "Hadley Products Corporation" 332 "HWH Corporation" 331 "Horton, Inc." 330 "Kidde Aerospace and Defense" 329 "Deif A/S" 328 "Qwerty Electronik AB" 252 "Sensor-Technik Wiedemann GmbH" 251 "German Agricultural Society" 250 "Kuhn Group" 249 "Schaltbau GmbH" 233 "Yacht Monitoring Solutions Inc." 232 "TSD Integrated Controls" 1863 "Thomas G. Faria Co." 1862 "Sanshin" 1861 "Vector CANtech" 1860 "MMP" 1859 "Kvasar AB" 1858 "Litton" 1857 "Simrad" 1856 "Trimble" 1855 "Furuno USA" 1854 "Northstar Technologies" 1853 "Japan Radio Co." 1852 "Navionics" 1851 "Raymarine" 1850 "Teleflex" 222 "Generac Power Systems, Inc." 221 "SiE" 220 "Beede Electrical Instrument Company, Inc." 219 "Cat OEM Solutions" 218 "Gits Manufacturing Company" 217 "RM Michaelides Software & Elektronik GmbH" 216 "Paneltronics Inc." 215 "Aetna Engineering/Fireboy-Xintex" 214 "MC elettronica Srl" 213 "CNH Belgium N.V." 212 "Sure Power Industries, Inc." 211 "DNA Group" 210 "Iteris, Inc." 209 "Bell Equip. Co. SA (PTY) LTD" 208 "Drew Technologies, Inc." 207 "Otto Engineering" 206 "port GmbH" 205 "SmarTire Systems Inc" 204 "The Morey Corporation" 203 "MILtronik GmbH" 202 "Curtis Instruments, Inc." 201 "Disenos y Tecnologia S.A." 200 "MGM Brakes" 199 "Actia Corp." 198 "Mystic Valley Communications" 197 "Mechron Power Systems" 196 "LEMKEN GmbH & Co. KG" 195 "General Engine Products" 194 "TriMark Corporation" 193 "Nobletec" 192 "Floscan" 191 "XATA Corporation" 190 "Hella KGaA Hueck & Co." 189 "QUALCOMM" 188 "EMP Corp." 187 "Air-Weigh" 186 "Altronic, Inc." 185 "Beede Electrical Instrument Company" 184 "EIA Electronics" 183 "KDS Controls, Inc." 182 "Vehicle Systems Engineering B.V." 181 "Coretronics, Inc." 180 "Smart Power Systems" 179 "TeeJet Technologies Denmark" 178 "Siemens VDO Automotive AG" 177 "Diagnostic System Associates" 176 "Moritz Aerospace" 175 "Veris Technologies, Inc." 174 "AB Volvo Penta" 173 "Ryeso, Inc." 172 "Yanmar Marine USA" 171 "Wachendorff Elektronik GmbH & Co. KG" 170 "Computronics Corporation Ltd." 169 "Marlin Technologies Inc." 168 "Xantrex" 167 "JLG Industries Inc." 166 "Phoenix International" 165 "CPAC Systems AB" 164 "DaimlerChrysler Off-Highway" 163 "BRP Inc." 162 "Axiomatic Technologies" 161 "Offshore Systems (UK) Limited" 160 "Nido" 159 "NTech Industries Inc." 158 "Firestone Industrial Products Company" 157 "ISSPRO Inc." 156 "ITT Industries - Cannon" 155 "Vetronix Corporation" 154 "Westerbeke Corporation" 153 "Woodward, Industrial Controls Division" 152 "elobau GmbH & Co. KG" 151 "Raven Industries Inc. - Flow Controls Division" 150 "Fleetguard" 149 "Holset" 148 "Blue Water Data, Inc." 147 "Nautibus Electronic GmbH" 146 "Maxima Technologies" 145 "MurCal Controls" 144 "Mercury Marine" 143 "W. Gmeiner GmbH & Co." 142 "TRW Automotive (Commercial Steering Systems)" 141 "Thales Navigation Ltd." 140 "Lowrance Electronics, Inc." 139 "Caterpillar Trimble Control Technologies (CTCT), LLC" 138 "Georg Fritzmeier GmbH & Co. KG" 137 "Maretron" 136 "Komatsu Ltd." 135 "Airmar Technology Corporation" 134 "Iris Technology Ltd." 133 "Bucher Schoerling GmbH" 132 "Mulag-Fahrzeugwerk" 131 "ITT Industries" 130 "Nido - Universal Machines B.V." 129 "OMNEX Control Systems, Inc." 128 "Gerhard Duecker GmbH & Co. KG" 127 "Holland USA" 126 "Driver Tech" 125 "Nevada Automotive Test Center" 124 "Hydac Electronic" 123 "Basler Electric" 122 "FG Wilson (Engineering) Limited" 121 "HED (Hydro Electronic Devices, Inc.)" 120 "RDS Technology Ltd." 119 "IntegriNautics" 118 "Intron GmbH" 117 "HUSCO International" 116 "BEELINE Technologies" 115 "NACCO Materials Handling Group, Inc." 114 "EControls, Inc." 113 "Stress-Tek, Inc." 112 "MECALAC" 111 "Maschinenfabrik Bernhard Krone GmbH" 110 "EPIQ Sensor-Nite" 109 "TeeJet Technologies Denmark" 108 "WTK-Elecktronik GmbH" 107 "Grimme Landmaschinen GmbH & Co. KG" 106 "BAE Systems Controls, Inc." 105 "Kiepe Elektrik GmbH & Co. KG" 104 "Claas Selbstfahrende Erntemaschinen GmbH" 103 "Agrocom GmbH & Co. Agrarsystem KG" 102 "AGCO GmbH & Co." 101 "Sensoria" 100 "VDO Technik AG" 99 "International Transmissions Ltd (ITL)" 98 "Mueller-Elektronik GmbH & Co." 97 "Ag Leader Technology, Inc." 96 "Mech@tronic IT GmbH" 95 "Pacific Insight Electronics Corp." 94 "CNH Global N.V." 93 "Perkins Engines Company Ltd." 92 "Ag-Chem Equipment Co., Inc." 91 "BSG Bodensee Steuergeraete GmbH" 90 "Knorr-Bremse SfN GmbH" 89 "Kverneland Group, Electronics Division" 88 "Satloc Precision GPS" 87 "J.C. Bamford Excavators Ltd (JCB)" 86 "C.E. Niehoff & Company" 85 "Kohler Co." 84 "New Holland UK Limited" 83 "Eaton VORAD Technologies" 82 "Bobcat/Ingersoll-Rand" 81 "Fire Research Corp" 80 "Twin Disc, Inc." 79 "Daimler Benz AG - Engine Division (PBM)" 78 "Frank W. Murphy Manufacturing, Inc." 77 "Deere Power Systems Group" 76 "unused" 75 "Deere & Co. Agricultural Division" 74 "Eaton Axle-Brake Division" 73 "LeTourneau, Inc." 72 "Sisu Corporation" 71 "Vansco Electronics Ltd." 70 "Flex-Coil Limited" 69 "Trimble Navigation" 68 "Scania" 67 "Funk Manufacturing Company" 66 "John Deere Construction Equipment Division" 65 "MAN Nutzfahrzeuge AG" 64 "unused" 63 "ZF Industries Inc." 62 "Wabco" 61 "Volvo Truck Corp." 60 "Volvo Trucks North America Inc." 59 "VES Inc." 58 "SPX Corporation, OTC Division" 57 "Sauer-Danfoss Co." 56 "SAIC" 55 "Ryder System Inc." 54 "Meritor Wabco" 53 "Continental Automotive Systems US, Inc." 52 "Meritor Automotive, Inc." 51 "Robert Bosch GmbH" 50 "Robert Bosch Corp" 49 "RE America Inc." 48 "Pollak Alphabet" 47 "Phillips Semiconductor" 46 "Parasoft Computing Solutions" 45 "PACCAR" 44 "Nippondenso Co. Ltd." 43 "International Truck and Engine Corp. Vehicle Electronics" 42 "International Truck and Engine Corp. Engine Electronics" 41 "Motorola Inc." 40 "Motorola AIEG Inc." 39 "Microfirm Inc." 38 "Micro Processor Systems Inc." 37 "Mack Trucks Inc." 36 "Lucas Ltd." 35 "Kenworth Truck Co." 34 "Kelsey Hayes Co." 33 "John Deere" 32 "Jacobs Vehicle Systems" 31 "J Pollak Corp." 30 "Isuzu Motors Ltd." 29 "Hino Motors Ltd." 28 "Grote Ind. Inc." 27 "GMC" 26 "General Motors Corp., Service Technology Group" 25 "Daimler Trucks North America LLC" 24 "Ford Motor Co., Vehicle Controls" 23 "Ford Motor Co., Heavy Truck" 22 "Ford Motor Co., Electronic Concepts $ Systems" 21 "Echilin Inc., Midland Brake Inc." 20 "Eaton Ltd" 19 "Eaton Corp. Trucking Info Services" 18 "Eaton Corp, Transmission Division" 17 "Eaton Corp. Res & Dev" 16 "Eaton Corp." 15 "Dickey-John Corp." 14 "Detroit Diesel Corporation" 13 "Delco Electronics" 12 "Deere & Company, Precision Farming" 11 "Dearborn Group Inc." 10 "Cummins Engine Co." 9 "Chrysler Corp." 8 "Caterpillar Inc." 7 "Case Corp." 6 "Berifors Electronics AB" 5 "AMP Inc." 4 "Ametek-Dixson" 3 "Ametek, US Gauge Division" 2 "Allison Transmission, GMC" 1 "Allied Signal Inc." 0 "Reserved" 231 "Topcon Positioning Systems, Inc." 230 "Saucon Technologies" 229 "Garmin International Inc." 228 "ZF Marine Electronics" 227 "Lykketronic A/S" 226 "Monaco Coach Corporation" 225 "SKF" 224 "EMMI Network, S.L." 223 "Vaueo Retarder Co., Ltd." 263 "IMMI" 262 "HydraForce, Inc" 261 "Red Dot Corporation" 260 "Reichhardt GmbH" 259 "Jetter AG" 258 "ARAG" 257 "Honda Motor Co., Ltd" 256 "Tyco Electronics AMP" 255 "MEAS France" 254 "GE Sensing" 253 "Mobile Control Systems" 298 "Holley Performance" 297 "Zonar Systems Inc" 296 "micro dynamics GmbH" 295 "BEP Marine" 294 "Grayhill Inc." 293 "Spyder Controls Corp." 292 "IKUSI - Angel Iglesias S.A." 291 "Groeneveld Transport Efficiency BV" 290 "Kuebler GmbH" 289 "Watlow" 288 "Mitsubishi FUSO Truck & Bus Corp." 287 "NTech Industries, Inc" 286 "Coelmo srl" 285 "Sea Recovery Corp" 284 "Mobile Tech Chile" 283 "CWF Hamilton & Co Ltd" 282 "Medallion Instrumentation Systems" 281 "Precision Governors LLC" 311 "Patrick Power Products" 310 "TECNORD srl" 309 "Krauss-Maffei Wegmann GmbH & Co. KG" 308 "Cyntrx" 307 "MAS Technologies" 306 "Sleipner Motor AB" 305 "NovAtel Inc" 304 "EmpirBus AB" 303 "CTS Corporation" 302 "Nissin Kogyo Co., LTD" 301 "Parker Hannifin (UK) Ltd FDE group" 300 "Systron Donner Automotive" 299 "Rauch Landmaschinen GmbH" 280 "Leica Geosystems Pty Ltd" 279 "Geometris LP" 278 "Takata Electronics" 277 "LHP Telematics" 276 "Aqua-Hot Heating Systems" 275 "Navico Egersund AS" 274 "LTW Technology Co., LTD" 273 "Active Research Limited" 272 "Gross Mechanical Laboratories, Inc" 327 "Sonceboz SA" 326 "Akron Brass Company" 325 "ASM Automation Sensorik Messtechnik GmbH" 324 "Snap-on Diagnostics" 323 "Mobileye Vision Technologies Ltd." 322 "MICHENKA s.r.o." 321 "Ultra Electronics, Electrics" 320 "Miedema Landbouwwerktuigenfabriek B.V." 319 "Cadec Global" 318 "SAT Plan" 317 "Navtronics Bvba" 316 "ITT Flow Control" 315 "Icom Incorporated" 314 "CSM GmbH" 313 "Ilmor Engineering, Inc" 312 "Lectronix, Inc." 271 "Cole Hersee" 270 "Tennant" 269 "Saft America Inc.,  Space & Defense Division" 268 "Accurate Technologies" 267 "Red Lion Controls, Inc" 266 "International Thermal Research Ltd" 265 "MTS Sensor Technologie GmbH" 264 "Autolync" 248 "Cooper Standard Automotive Active Systems Group" 247 "ePULSE" 246 "Class 1, Inc" 245 "Capstan Ag Systems, Inc." 244 "Techno-Matic" 243 "eRide, Inc." 242 "Kokusandenki Co. Ltd" 241 "Schneider Automation SAS " 240 "Vanair Mfg" 239 "May & Scofield Ltd" 238 "ZF Friedrichshafen AG" 237 "Agtron Enterprises Inc" 236 "Norac Systems International Inc" 235 "SailorMade Marine Telemetry - Tetra Technology Ltd." 234 "Mondial electronic GmbH" ;
VAL_ 3221225472 DrvlineRetarderOverheatIndicator 3 "Not available" 2 "Driveline Retarder Overheat Indicator is flashing" 1 "Driveline Retarder Overheat Indicator is on continuously" 0 "Driveline Retarder Overheat Indicator is off" ;
VAL_ 3221225472 SteerStraightAheadPosReset 3 "Not applicable" 2 "Reserved take no action" 1 "Reset" 0 "Take no action  Do not Reset" ;
VAL_ 3221225472 EngBuildHoursReset 2 "Reserved" 3 "Take no action" 1 "Reset" 0 "Do not reset" ;
VAL_ 3221225472 TripGroup2Proprietary 2 "Reserved" 3 "Not applicable" 1 "Reset" 0 "Take no action" ;
VAL_ 3221225472 TripGroup1 2 "Reserved" 3 "Not applicable" 1 "Reset" 0 "Take no action" ;
VAL_ 3221225472 RetarderLocation 15 "Not available" 14 "Other" 5 "Trailer Vehicle speed" 4 "Secondary Driveline Output Shaft rpm" 3 "Secondary Transmission Output Output Shaft rpm" 2 "Primary Transmission Input Engine rpm" 1 "Primary Engine Exhaust Brake Exhaust pressure" 0 "Primary Engine Compression Release Brake Engine rpm" ;
VAL_ 3221225472 RetarderType 15 "Not available" 14 "Other" 4 "Exhaust" 3 "Compression Release Engine retarder" 2 "Cooled Friction" 1 "Hydraulic" 0 "Electric/Magnetic" ;
VAL_ 3221225472 OprtrEngPTOGvrnrMmrySelectSwitch 3 "not available" 2 "error" 1 "PTO set speed memory 2 selected" 0 "PTO set speed memory 1 selected" ;
VAL_ 3221225472 EngRmtPTOGvrnrVrblSpedCtrlSwitch 3 "Not available" 2 "Error" 1 "On" 0 "Off" ;
VAL_ 3221225472 EngRmtPTOGvrnrPrprgrmmdSpdCtrlSw 3 "Not available" 2 "Error" 1 "On" 0 "Off" ;
VAL_ 3221225472 EngPTOGvrnrCast_DecelerateSwitch 3 "Not available" 2 "Error" 1 "On" 0 "Off" ;
VAL_ 3221225472 EngPTOGovernorSetSwitch 3 "Not available" 2 "Error" 1 "On" 0 "Off" ;
VAL_ 3221225472 EngPTOGovernorResumeSwitch 3 "Not available" 2 "Error" 1 "On" 0 "Off" ;
VAL_ 3221225472 EngPTOGovernorEnableSwitch 3 "Not available" 2 "Error" 1 "On" 0 "Off" ;
VAL_ 3221225472 EngPTOGovernorAccelerateSwitch 3 "Not available" 2 "Error" 1 "On" 0 "Off" ;
VAL_ 3221225472 RmtPTOGvrnrPrprgrmmdSpdCtrlSwtch 3 "Not Available" 2 "Error" 1 "On" 0 "Off" ;
VAL_ 3221225472 AuxInputIgnoreSwitch 3 "Not Available" 2 "Error" 1 "On" 0 "Off" ;
VAL_ 3221225472 EngAltDroopAuxInputSelect 15 "Not available" 14 "Error condition" 1 "thru 1101  One of Alternate Droop Setting 1 through 13 in sequential order is selected" 0 "Normal Droop Setting is selected" ;
VAL_ 3221225472 EngAltDroopRemoteAccelSelect 15 "Not available" 14 "Error condition" 1 "thru 1101  One of Alternate Droop Setting 1 through 13 in sequential order is selected" 0 "Normal Droop Setting is selected" ;
VAL_ 3221225472 EngAltDroopAccel2Select 15 "Not available" 14 "Error condition" 1 "thru 1101  One of Alternate Droop Setting 1 through 13 in sequential order is selected" 0 "Normal Droop Setting is selected" ;
VAL_ 3221225472 EngAltDroopAccel1Select 15 "Not available" 14 "Error condition" 1 "thru 1101  One of Alternate Droop Setting 1 through 13 in sequential order is selected" 0 "Normal Droop Setting is selected" ;
VAL_ 3221225472 EngAltLowIdleSwitch 3 "Not available or Unused" 2 "Error" 1 "Alternate low idle point is selected" 0 "Default low idle point is selected" ;
VAL_ 3221225472 EngSynchronizationSwitch 3 "Not available or Unused" 2 "Error" 1 "Functionality is enabled on" 0 "Functionality is disabled off" ;
VAL_ 3221225472 EngAuxGovernorSwitch 2 "Error condition" 1 "Auxiliary Governor is enabled" 0 "Auxiliary Governor is disabled" 3 "Not available" ;
VAL_ 3221225472 EngAltDroopAuxInputSelectState 15 "Not available" 14 "SAE reserved" 1 "thru 1101  Control state is One of Alternate Droop Setting 1 through 13 in sequential order" 0 "Control state is Normal Droop Setting" ;
VAL_ 3221225472 EngAltDropRemoteAccelSelectState 15 "Not available" 14 "SAE reserved" 1 "thru 1101  Control state is One of Alternate Droop Setting 1 through 13 in sequential order" 0 "Control state is Normal Droop Setting" ;
VAL_ 3221225472 EngAltDroopAccel2SelectState 15 "Not available" 14 "SAE reserved" 1 "thru 1101  Controls state is One of Alternate Droop Setting 1 through 13 in sequential order" 0 "Controls state is Normal Droop Setting" ;
VAL_ 3221225472 EngAltDroopAccel1SelectState 15 "Not available" 14 "SAE reserved" 1 "thru 1101  Control state is one of Alternate Droop Setting 1 through 13 in sequential order" 0 "Control state is Normal Droop Setting" ;
VAL_ 3221225472 EngAltRatingSelectState 1 "Control state is Alternate Power Fueling 1" 0 "Control state is Maximum Power Fueling" ;
VAL_ 3221225472 EngAltLowIdleSelectState 3 "not available" 2 "SAE reserved" 1 "Alternate idle state" 0 "Normal idle state" ;
VAL_ 3221225472 EngMultiUnitSyncState 3 "Not available" 2 "SAE reserved" 1 "Control State is Functionality enabled on" 0 "Control State is Functionality disabled off" ;
VAL_ 3221225472 EngAuxGovernorState 3 "Not available" 2 "SAE reserved" 1 "Control State is Auxiliary Governor enabled" 0 "Control State is Auxiliary Governor disabled" ;
VAL_ 3221225472 BlackOutWorkLampSelect 3 "Not Supported" 2 "Reserved" 1 "On" 0 "Off" ;
VAL_ 3221225472 NightVisionIlluminatorSelect 3 "Not Supported" 2 "Reserved" 1 "On" 0 "Off" ;
VAL_ 3221225472 BlackOutBrake_StopLampSelect 3 "Not Supported" 2 "Reserved" 1 "On" 0 "Off" ;
VAL_ 3221225472 ConvoyDrivingLampSelect 3 "Not Supported" 2 "Reserved" 1 "On" 0 "Off" ;
VAL_ 3221225472 ConvoyLampSelect 3 "Not Supported" 2 "Reserved" 1 "On" 0 "Off" ;
VAL_ 3221225472 FrontBlackOutMarkerLampSelect 3 "Not Supported" 2 "Reserved" 1 "On" 0 "Off" ;
VAL_ 3221225472 RearBlackOutMarkerSelect 3 "Not Supported" 2 "Reserved" 1 "On" 0 "Off" ;
VAL_ 3221225472 SlowVesselModeStatus 3 "Take no action" 2 "Reserved" 1 "Slow vessel mode is ACTIVE" 0 "Slow vessel mode is OFF" ;
VAL_ 3221225472 TrollingModeStatus 3 "Take no action" 2 "Reserved" 1 "Trolling mode is ACTIVE" 0 "Trolling mode is OFF" ;
VAL_ 3221225472 EngThrttlSynchrnzationModeStatus 15 "Take no action" 4 "Synchronized Master" 3 "Synchronized Starboard" 2 "Synchronized Port" 1 "Synchronized Center" 0 "Not Synchronized" ;
VAL_ 3221225472 DisplayDeadbands 15 "Not Available" 3 "1110 Reserved" 2 "Wide  / 24mm" 1 "Standard  / 12mm" 0 "Narrow  / 45mm" ;
VAL_ 3221225472 LEDPatternCtrl 15 "Not Available" 3 "1110 Reserved" 2 "7 Channel" 1 "Offset" 0 "5 Channel" ;
VAL_ 3221225472 LEDDisplayDeadbandCtrl 15 "Not Available or Not applicable" 5 "1110 Reserved" 4 "/ 1 mm 0003 feet 004 inches" 3 "/ 5 mm 0017 feet 02 inches" 2 "/ 24 mm 0080 feet 096 inches" 1 "/ 12 mm 0040 feet 045 inches" 0 "/ 45 mm 0015 feet 018 inches" ;
VAL_ 3221225472 LEDDisplayModeCtrl 15 "Not Available or Not Applicable" 3 "1110 Reserved" 2 "Center OnGrade Display Mode 2  7 CHANNEL" 1 "Offset OnGrade Display Mode" 0 "Center OnGrade Display Mode 1  5 CHANNEL" ;
VAL_ 3221225472 LEDDisplayData1 254 "Error" 159 "No data ie no laser strikes" 149 "High Coarse" 148 "High Medium/Coarse" 147 "High Medium" 146 "High Medium/Fine" 145 "High Fine" 144 "On Grade" 132 "Low Fine" 131 "Low Medium/Fine" 130 "Low Medium" 129 "Low Medium/Coarse" 128 "Low Coarse" 32 "Low Coarse LED on" 16 "Low Fine LED on" 8 "Ongrade LED on" 4 "High Fine LED on" 2 "High Coarse LED on" ;
VAL_ 3221225472 LaserTracerInformation 32 "Curb 1  yes" 16 "Stringline 1  yes" 8 "Previous pass 1  yes" 4 "Valid target 1  yes" 2 "Laser is ready" 1 "Laser power is on" ;
VAL_ 3221225472 LEDDisplayData2 64 "Right LED on" 32 "Left LED on" 16 "Down LED on" 8 "Up LED on" 4 "Ongrade C LED on" 2 "Ongrade B LED on" 1 "Ongrade A LED on" ;
VAL_ 3221225472 StElvtnSensor2ReferenceElevation 3 "Dont Care / Take No Action" 2 "Reserved" 1 "Set Reference Elevation" 0 "Do not Set Reference Elevation" ;
VAL_ 3221225472 StElvtnSensor1ReferenceElevation 3 "Dont Care / Take No Action" 2 "Reserved" 1 "Set Reference Elevation" 0 "Do not Set Reference Elevation" ;
VAL_ 3221225472 SdshftDsrdBldeOffsetOperatorCtrl 15 "Not Installed" 14 "Error Indicator" 4 "1101 Reserved" 3 "Automatic Operator Control Request" 2 "Manual Operator Control Request" 0 "No Operator Control Request" 1 "Momentary Operator Control Request" ;
VAL_ 3221225472 SdshiftBladeCtrlModeOperatorCtrl 15 "Not installed" 14 "Error Indicator" 2 "Decrement Operator Control Request" 0 "No Operator Control Request" 1 "Increment Operator Control Request" ;
VAL_ 3221225472 RghtDsredBladeOffsetOperatorCtrl 15 "Not installed" 14 "Error Indicator" 3 "1101 Reserved" 2 "Decrement Operator Control Request" 0 "No Operator Control Request" 1 "Increment Operator Control Request" ;
VAL_ 3221225472 LftDsiredBladeOffsetOperatorCtrl 15 "Not installed" 14 "Error Indicator" 3 "1101 Reserved" 2 "Decrement Operator Control Request" 0 "No Operator Control Request" 1 "Increment Operator Control Request" ;
VAL_ 3221225472 RightBladeCtrlModeOperatorCtrl 15 "Not Installed" 14 "Error Indicator" 3 "Automatic Operator Control Request" 2 "Manual Operator Control Request" 0 "No Change" 1 "Momentary Operator Control Request" ;
VAL_ 3221225472 LeftBladeCtrlModeOperatorCtrl 15 "Not Installed" 14 "Error Indicator" 12 "1101 Reserved" 3 "Automatic Operator Control Request" 2 "Manual Operator Control Request" 0 "No Change" 1 "Momentary Operator Control Request" ;
VAL_ 3221225472 BladeAutoModeCmd 4 "Auto Not Allowed  Auto mode is not allowed under any condition" 3 "Service Mode  Auto mode is permitted only for special services such as calibrations" 2 "Suspend Auto  Auto mode is temporarily not allowed and the control issuing this command wants the primary" 1 "Activity Allows Auto  Auto mode permitted only if the primary control system detects operator activity The control" 0 "Auto Allowed  Auto mode permitted as appropriate auto button was pushed or directly returned from Suspend" ;
VAL_ 3221225472 DesiredGradeOffsetSwitch 15 "Not installed" 14 "Error Indicator" 2 "Decrement button pressed" 0 "No button pressed" 1 "Increment button pressed" ;
VAL_ 3221225472 BladeCtrlModeSwitch 15 "Not Installed" 14 "Error Indicator" 3 "Automatic button pressed" 2 "Manual button pressed" 0 "No button pressed" 1 "Mode button pressed" ;
VAL_ 3221225472 FrontWheelDriveActuatorStatus 3 "Not Available" 2 "Error" 1 "Front Wheel Drive Actuator engaged" 0 "Front Wheel Drive Actuator not engaged" ;
VAL_ 3221225472 FMSstandardRequestsSupported 3 "Dont care" 2 "Reserved" 1 "On request mode is supported" 0 "On request mode is not supported" ;
VAL_ 3221225472 FMSstandardDiagnosticsSupported 3 "Dont care" 2 "Reserved" 1 "Diagnostics Is Supported" 0 "Diagnostics Is Not Supported" ;
VAL_ 3221225472 LnDpartureIndicationEnableStatus 3 "Not Used" 2 "Reserved" 1 "Lane Departure Indication enabled" 0 "Lane Departure indication disabled" ;
VAL_ 3221225472 LaneTrackingStatusLeftSide 3 "Dont care/Take no action" 2 "Reserved" 1 "Tracking Left side" 0 "Not Tracking Left side" ;
VAL_ 3221225472 LaneTrackingStatusRightSide 3 "Dont Care/take no action" 2 "Reserved" 1 "Tracking Right side" 0 "Not Tracking Right side" ;
VAL_ 3221225472 EngFuelLeakage2 3 "Not available" 2 "Error" 1 "leakage detected" 0 "no leakage detected" ;
VAL_ 3221225472 EngFuelLeakage1 3 "Not available" 2 "Error" 1 "leakage detected" 0 "no leakage detected" ;
VAL_ 3221225472 FanDriveState 15 "Not available" 14 "Other" 13 "Engine brake" 12 "Timer" 11 "A/C system" 10 "Transmission retarder" 9 "Manual control" 8 "Reverse Operation" 7 "Default Operation" 6 "Excessive hydraulic oil temperature" 5 "Excessive transmission oil temperature" 4 "Excessive engine coolant temperature" 3 "Excessive engine oil temperature" 2 "Excessive engine air temperature" 1 "Engine systemGeneral" 0 "Fan off" ;
VAL_ 3221225472 EngTorqueLimitFeature 7 "Not available" 4 "Current torque rating" 3 "Previous torque rating rating prior to the current rating" 2 "First torque rating" 1 "Highest torque rating" 0 "Reserved" ;
VAL_ 3221225472 TorqueLimitingFeatureStatus 3 "Not available" 2 "Error" 1 "Enabled" 0 "Disabled" ;
VAL_ 3221225472 TrnsRverseGearShiftInhibitStatus 3 "Not Available" 2 "Error" 1 "Reverse gear shifts are currently inhibited" 0 "Reverse gear shifts are currently allowed" ;
VAL_ 3221225472 TransWarningIndicator 3 "Not available" 2 "Transmission Warning Indicator is flashing" 1 "Transmission Warning Indicator is on continuously" 0 "Transmission Warning Indicator is off" ;
VAL_ 3221225472 TransMode8Indicator 3 "Take no action" 2 "Reserved" 1 "Enable" 0 "Disable" ;
VAL_ 3221225472 TransMode7Indicator 3 "Take no action" 2 "Reserved" 1 "Enable" 0 "Disable" ;
VAL_ 3221225472 TransMode6Indicator 3 "Take no action" 2 "Reserved" 1 "Enable" 0 "Disable" ;
VAL_ 3221225472 TransMode5Indicator 3 "Take no action" 2 "Reserved" 1 "Enable" 0 "Disable" ;
VAL_ 3221225472 TransMode1Indicator 3 "Not available" 2 "Error" 1 "Transmission Mode 1 Active" 0 "Transmission Mode 1 not active" ;
VAL_ 3221225472 TransMode2Indicator 3 "Not available" 2 "Error" 1 "Transmission Mode 2 Active" 0 "Transmission Mode 2 not active" ;
VAL_ 3221225472 TransMode3Indicator 3 "Not available" 2 "Error" 1 "Transmission Mode 3 Active" 0 "Transmission Mode 3 not active" ;
VAL_ 3221225472 TransMode4Indicator 3 "Not available" 2 "Error" 1 "Transmission Mode 4 Active" 0 "Transmission Mode 4 not active" ;
VAL_ 3221225472 TransShiftInhibitIndicator 3 "Take no action" 2 "Reserved" 1 "Active shift is inhibited" 0 "Inactive shift is not inhibited" ;
VAL_ 3221225472 TransEngCrankEnable 3 "Not available" 2 "Error" 1 "Cranking enabled engine cranking is allowed by the transmission" 0 "Cranking disabled engine cranking is prohibited by the transmission" ;
VAL_ 3221225472 ActiveShiftConsoleIndicator 3 "Not available" 2 "Reserved" 1 "Secondary shift console is active" 0 "Primary shift console is active" ;
VAL_ 3221225472 TransReadyForBrakeRelease 3 "Not available" 2 "Error" 1 "Transmission Ready for Brake Release" 0 "Transmission Not Ready for Brake Release" ;
VAL_ 3221225472 TrnsRqstedRangeDisplayFlashState 3 "Take no action" 2 "Reserved" 1 "Active Transmission Requested Range display should be flashing" 0 "Inactive Transmission Requested Range display should not be flashing" ;
VAL_ 3221225472 TrnsRqstedRangeDisplayBlankState 3 "Take no action" 2 "Reserved" 1 "Active Transmission Requested Range display should be blanked" 0 "Inactive Transmission Requested Range display should not be blanked" ;
VAL_ 3221225472 TransServiceIndicator 3 "Not available" 2 "Transmission Service Indicator is flashing" 1 "Transmission Service Indicator is on continuously" 0 "Transmission Service Indicator is off" ;
VAL_ 3221225472 TransForwardDirectionSwitch 3 "Not available" 2 "Error" 1 "On" 0 "Off" ;
VAL_ 3221225472 TransNeutralSwitch 3 "Not available" 2 "Error" 1 "On" 0 "Off" ;
VAL_ 3221225472 TransReverseDirectionSwitch 3 "Not available" 2 "Error" 1 "On" 0 "Off" ;
VAL_ 3221225472 TransLowRangeSenseSwitch 3 "Not available" 2 "Error" 1 "On" 0 "Off" ;
VAL_ 3221225472 TransHighRangeSenseSwitch 3 "Not available" 2 "Error" 1 "On" 0 "Off" ;
VAL_ 3221225472 TransInertiaBrakeActuator 3 "Not available" 2 "Error" 1 "On" 0 "Off" ;
VAL_ 3221225472 TransDefuelActuator 3 "Not available" 2 "Error" 1 "On" 0 "Off" ;
VAL_ 3221225472 TransLockupClutchActuator 3 "Not available" 2 "Error" 1 "On" 0 "Off" ;
VAL_ 3221225472 TransClutchActuator 3 "Not available" 2 "Error" 1 "On" 0 "Off" ;
VAL_ 3221225472 TransSplitterIndirectActuator 3 "Not available" 2 "Error" 1 "On" 0 "Off" ;
VAL_ 3221225472 TransSplitterDirectActuator 3 "Not available" 2 "Error" 1 "On" 0 "Off" ;
