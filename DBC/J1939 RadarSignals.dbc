VERSION ""

NS_ :

BS_:

BU_: Turbocharger OnBoardDataLogger OffBoardDiagnosticTool2 OffBoardDiagnosticTool1 FileServer ParkingBrakeController SeatControl2 FanDriveController SteeringColumnUnit CommunicationUnitRadio CommunicationUnitSatellite CommunicationUnitCellular PropulsionBatteryCharger ChassisController2 ChassisController1 EngineValveControl AuxiliaryHeater2 AuxiliaryHeater1 ClutchUnit RampControl InformationSystem1 SuspensionSystemController2 OilSensor VehicleDynamicStability ExhaustEmissionController TransmissionDisplay2 TransmissionDisplay1 ClimateControl2 WaterPumpController RearAxleSteeringController LightingOperatorControl SeatController1 IgnitionController2 IgnitionController1 TirePressureController CabController2 CabController1 PneumaticSystemController SuspensionSystemController1 HydraulicPumpController EnduranceBrakingSystem RetarderExhaustEngine2 OnBoardDiagnosticUnit HeadwayController RetarderExhaustEngine1 CabDisplay1 ManagementComputer VirtualTerminal OffVehicleGateway PowerTakeOffFront HitchControl AuxiliaryValveControl BodyController TractorTrailerBridge1 StarterSystem ElectricalSystem VehicleSecurity VehicleNavigation AerodynamicControl ElectricalChargingSystem ClimateControl1 TripRecorder InstrumentCluster SuspensionDriveAxle2 SuspensionDriveAxle1 SuspensionSteerAxle SteeringController FuelSystem CruiseControl RetarderDriveline RetarderEngine BrakesDriveAxle2 BrakesDriveAxle1 BrakesSystemController BrakesSteerAxle AxleDrive2 AxleDrive1 AxleSteering PowerTakeOff ShiftConsoleSecondary ShiftConsolePrimary Transmission2 Transmission1 Engine2 Engine1

BO_ 3221225472 VECTOR__INDEPENDENT_SIG_MSG: 0 Vector__XXX
 SG_ KneelingRqLeftSide : 0|2@1+ (1,0) [0|3] "" Vector__XXX
 SG_ AutomaticTractionHelp : 0|2@1+ (1,0) [0|3] "" Vector__XXX
 SG_ MemoryLevel : 0|4@1+ (1,0) [0|15] "" Vector__XXX
 SG_ SuspensionCtrlRefusalInformation : 0|4@1+ (1,0) [0|15] "" Vector__XXX
 SG_ SpeedDependantLevelCtrlStatus : 0|2@1+ (1,0) [0|3] "" Vector__XXX
 SG_ AllwLevelCtrlDuringBrakingStatus : 0|2@1+ (1,0) [0|3] "" Vector__XXX
 SG_ SuspensionRemoteCtrl2 : 0|2@1+ (1,0) [0|3] "" Vector__XXX
 SG_ SuspensionRemoteCtrl1 : 0|2@1+ (1,0) [0|3] "" Vector__XXX
 SG_ RearAxleInBumperRange : 0|2@1+ (1,0) [0|3] "" Vector__XXX
 SG_ FrontAxleInBumperRange : 0|2@1+ (1,0) [0|3] "" Vector__XXX
 SG_ DoorRelease : 0|2@1+ (1,0) [0|3] "" Vector__XXX
 SG_ VehicleMotionInhibit : 0|2@1+ (1,0) [0|3] "" Vector__XXX
 SG_ SecurityDevice : 0|2@1+ (1,0) [0|3] "" Vector__XXX
 SG_ LevelCtrlMode : 0|4@1+ (1,0) [0|15] "" Vector__XXX
 SG_ KneelingInformation : 0|4@1+ (1,0) [0|15] "" Vector__XXX
 SG_ LiftingCtrlModeRearAxle : 0|2@1+ (1,0) [0|3] "" Vector__XXX
 SG_ LiftingCtrlModeFrontAxle : 0|2@1+ (1,0) [0|3] "" Vector__XXX
 SG_ LoweringCtrlModeRearAxle : 0|2@1+ (1,0) [0|3] "" Vector__XXX
 SG_ LoweringCtrlModeFrontAxle : 0|2@1+ (1,0) [0|3] "" Vector__XXX
 SG_ AboveNominalLevelRearAxle : 0|2@1+ (1,0) [0|3] "" Vector__XXX
 SG_ AboveNominalLevelFrontAxle : 0|2@1+ (1,0) [0|3] "" Vector__XXX
 SG_ BelowNominalLevelRearAxle : 0|2@1+ (1,0) [0|3] "" Vector__XXX
 SG_ BelowNominalLevelFrontAxle : 0|2@1+ (1,0) [0|3] "" Vector__XXX
 SG_ NominalLevelRearAxle : 0|4@1+ (1,0) [0|15] "" Vector__XXX
 SG_ NominalLevelFrontAxle : 0|4@1+ (1,0) [0|15] "" Vector__XXX
 SG_ Alt4Status : 0|2@1+ (1,0) [0|3] "" Vector__XXX
 SG_ Alt3Status : 0|2@1+ (1,0) [0|3] "" Vector__XXX
 SG_ Alt2Status : 0|2@1+ (1,0) [0|3] "" Vector__XXX
 SG_ Alt1Status : 0|2@1+ (1,0) [0|3] "" Vector__XXX
 SG_ AltSpeed : 0|16@1+ (0.5,0) [0|32127.5] "rpm" Vector__XXX
 SG_ AuxAbsPressReading : 0|16@1+ (0.5,0) [0|32127.5] "kPa" Vector__XXX
 SG_ AuxGagePressReading1 : 0|16@1+ (0.5,0) [0|32127.5] "kPa" Vector__XXX
 SG_ AuxVacuumPressReading : 0|16@1+ (0.5,0) [0|32127.5] "kPa" Vector__XXX
 SG_ SpecificHumidity : 0|16@1+ (0.01,0) [0|642.55] "g/kg" Vector__XXX
 SG_ SolarSensorMax : 0|8@1+ (1,0) [0|100] "mW/cm^2" Vector__XXX
 SG_ SolarIntensityPercent : 0|8@1+ (0.4,0) [0|100] "%" Vector__XXX
 SG_ TestType : 0|8@1+ (1,0) [1|64] "" Vector__XXX
 SG_ FlashRedStopLamp : 0|2@1+ (1,0) [0|3] "" Vector__XXX
 SG_ FlashProtectLamp : 0|2@1+ (1,0) [0|3] "" Vector__XXX
 SG_ FlashMalfuncIndicatorLamp : 0|2@1+ (1,0) [0|3] "" Vector__XXX
 SG_ FlashAmberWarningLamp : 0|2@1+ (1,0) [0|3] "" Vector__XXX
 SG_ MalfunctionIndicatorLampStatus : 0|2@1+ (1,0) [0|3] "" Vector__XXX
 SG_ RedStopLampState : 0|2@1+ (1,0) [0|3] "" Vector__XXX
 SG_ AmberWarningLampStatus : 0|2@1+ (1,0) [0|3] "" Vector__XXX
 SG_ ProtectLampStatus : 0|2@1+ (1,0) [0|3] "" Vector__XXX
 SG_ DTC5 : 0|32@1+ (1,0) [0|4294967295] "" Vector__XXX
 SG_ DTC4 : 0|32@1+ (1,0) [0|4294967295] "" Vector__XXX
 SG_ DTC3 : 0|32@1+ (1,0) [0|4294967295] "" Vector__XXX
 SG_ DTC2 : 0|32@1+ (1,0) [0|4294967295] "" Vector__XXX
 SG_ BoostPressureControlSystemStatus : 0|1@1- (1,0) [0|0] "" Vector__XXX
 SG_ NOxConvertingCatalystAdsorberSta : 0|1@1- (1,0) [0|0] "" Vector__XXX
 SG_ NMHCConvertingCatalystStatus : 0|1@1- (1,0) [0|0] "" Vector__XXX
 SG_ BoostPressureControlSystemSuppor : 0|1@1- (1,0) [0|0] "" Vector__XXX
 SG_ DieselParticulateFilterSupport : 0|1@1- (1,0) [0|0] "" Vector__XXX
 SG_ NOxConvertingCatalystAdsorberSup : 0|1@1- (1,0) [0|0] "" Vector__XXX
 SG_ NMHCConvertingCatalystSupport : 0|1@1- (1,0) [0|0] "" Vector__XXX
 SG_ MisfireMonitoringSupport : 0|1@1+ (1,0) [0|0] "" Vector__XXX
 SG_ OBDCompliance : 0|8@1+ (1,0) [0|240] "" Vector__XXX
 SG_ PreviouslyActiveTroubleCodes : 0|8@1+ (1,0) [0|240] "" Vector__XXX
 SG_ ActiveTroubleCodes : 0|8@1+ (1,0) [0|240] "" Vector__XXX
 SG_ SecondAirSystemMonStatus : 0|1@1+ (1,0) [0|1] "" Vector__XXX
 SG_ EvaporativeSystemMonStatus : 0|1@1+ (1,0) [0|1] "" Vector__XXX
 SG_ ACSystemRefrigerantMonStatus : 0|1@1+ (1,0) [0|1] "" Vector__XXX
 SG_ OxygenSensorHeaterMonStatus : 0|1@1+ (1,0) [0|1] "" Vector__XXX
 SG_ OxygenSensorMonStatus : 0|1@1+ (1,0) [0|1] "" Vector__XXX
 SG_ EGRSystemMonitoringStatus : 0|1@1+ (1,0) [0|1] "" Vector__XXX
 SG_ CatalystMonStatus : 0|1@1+ (1,0) [0|1] "" Vector__XXX
 SG_ ColdStartAidSystemMonStatus : 0|1@1+ (1,0) [0|1] "" Vector__XXX
 SG_ HeatedCatalystMonStatus : 0|1@1+ (1,0) [0|0] "" Vector__XXX
 SG_ CatalystMonSupp : 0|1@1+ (1,0) [0|1] "" Vector__XXX
 SG_ ColdStartAidSystemMonSupp : 0|1@1+ (1,0) [0|1] "" Vector__XXX
 SG_ HeatedCatalystMonSupp : 0|1@1+ (1,0) [0|0] "" Vector__XXX
 SG_ EvaporativeSystemMonSupp : 0|1@1+ (1,0) [0|1] "" Vector__XXX
 SG_ SecondAirSystemMonSupp : 0|1@1+ (1,0) [0|1] "" Vector__XXX
 SG_ ACSystemRefrigerantMonSupp : 0|1@1+ (1,0) [0|1] "" Vector__XXX
 SG_ OxygenSensorMonSupp : 0|1@1+ (1,0) [0|1] "" Vector__XXX
 SG_ OxygenSensorHeaterMonSupp : 0|1@1+ (1,0) [0|1] "" Vector__XXX
 SG_ EGRSystemMonitoringSupp : 0|1@1+ (1,0) [0|1] "" Vector__XXX
 SG_ MisfireMonitoringStatus : 0|1@1+ (1,0) [0|0] "" Vector__XXX
 SG_ ComprehensiveCompMonStatus : 0|1@1+ (1,0) [0|1] "" Vector__XXX
 SG_ FuelSystemMonitoringStatus : 0|1@1+ (1,0) [0|1] "" Vector__XXX
 SG_ ComprehensiveComponentMonSupp : 0|1@1+ (1,0) [0|0] "" Vector__XXX
 SG_ FuelSystemMonitoringSupport : 0|1@1+ (1,0) [0|1] "" Vector__XXX
 SG_ FreezeFrameLength : 0|8@1+ (1,0) [0|255] "Byte" Vector__XXX
 SG_ WheelBasedVehicleSpeed : 0|16@1+ (0.0039062485409696,0) [0|250.996] "km/h" Vector__XXX
 SG_ EngPercentLoadAtCurrentSpeed : 0|8@1+ (1,0) [0|250] "%" Vector__XXX
 SG_ ExpandedFreezeFrameLength : 0|8@1+ (1,0) [0|255] "Byte" Vector__XXX
 SG_ SPNSupported1High : 0|3@1+ (1,0) [0|7] "" Vector__XXX
 SG_ SPNSupportTypeSTR3 : 0|1@1+ (1,0) [0|1] "" Vector__XXX
 SG_ SPNSupportTypeSTR2 : 0|1@1+ (1,0) [0|1] "" Vector__XXX
 SG_ SPNSupportTypeEFF3 : 0|1@1+ (1,0) [0|1] "" Vector__XXX
 SG_ SPNSupportTypeEFF2 : 0|1@1+ (1,0) [0|1] "" Vector__XXX
 SG_ SPNSupportTypeDS3 : 0|1@1+ (1,0) [0|1] "" Vector__XXX
 SG_ SPNSupportTypeDS2 : 0|1@1+ (1,0) [0|1] "" Vector__XXX
 SG_ SPNSupported3High : 0|3@1+ (1,0) [0|7] "" Vector__XXX
 SG_ SPNSupported2High : 0|3@1+ (1,0) [0|7] "" Vector__XXX
 SG_ SPNSupported3 : 0|16@1+ (1,0) [0|65535] "" Vector__XXX
 SG_ SPNSupported2 : 0|16@1+ (1,0) [0|65535] "" Vector__XXX
 SG_ SPNDataLength3 : 0|8@1+ (1,0) [0|240] "" Vector__XXX
 SG_ SPNSupportTypeSTR1 : 0|1@1+ (1,0) [0|1] "" Vector__XXX
 SG_ SPNSupportTypeDS1 : 0|1@1+ (1,0) [0|1] "" Vector__XXX
 SG_ SPNSupportTypeEFF1 : 0|1@1+ (1,0) [0|1] "" Vector__XXX
 SG_ SPNDataLength2 : 0|8@1+ (1,0) [0|240] "" Vector__XXX
 SG_ SPNDataLength1 : 0|8@1+ (1,0) [0|240] "" Vector__XXX
 SG_ SPNSupported1 : 0|16@1+ (1,0) [0|65535] "" Vector__XXX
 SG_ FlashRedStopLamp : 0|2@1+ (1,0) [0|3] "" Vector__XXX
 SG_ FlashProtectLamp : 0|2@1+ (1,0) [0|3] "" Vector__XXX
 SG_ FlashMalfuncIndicatorLamp : 0|2@1+ (1,0) [0|3] "" Vector__XXX
 SG_ FlashAmberWarningLamp : 0|2@1+ (1,0) [0|3] "" Vector__XXX
 SG_ MalfunctionIndicatorLampStatus : 0|2@1+ (1,0) [0|3] "" Vector__XXX
 SG_ RedStopLampState : 0|2@1+ (1,0) [0|3] "" Vector__XXX
 SG_ AmberWarningLampStatus : 0|2@1+ (1,0) [0|3] "" Vector__XXX
 SG_ ProtectLampStatus : 0|2@1+ (1,0) [0|3] "" Vector__XXX
 SG_ DTC5 : 0|32@1+ (1,0) [0|4294967295] "" Vector__XXX
 SG_ DTC4 : 0|32@1+ (1,0) [0|4294967295] "" Vector__XXX
 SG_ DTC3 : 0|32@1+ (1,0) [0|4294967295] "" Vector__XXX
 SG_ DTC2 : 0|32@1+ (1,0) [0|4294967295] "" Vector__XXX
 SG_ IndividualDTCClearControlByte : 0|8@1+ (1,0) [0|255] "" Vector__XXX
 SG_ CtrlByteIndicIndividualDTCClear : 0|8@1+ (1,0) [0|255] "" Vector__XXX
 SG_ TimeSinceDTCsCleared : 0|16@1+ (1,0) [0|64255] "mins" Vector__XXX
 SG_ MinutesRunByEngineMILActivated : 0|16@1+ (1,0) [0|64255] "mins" Vector__XXX
 SG_ DistanceSinceDTCsCleared : 0|16@1+ (1,0) [0|64255] "km" Vector__XXX
 SG_ DistanceWhileMILisActivated : 0|16@1+ (1,0) [0|64255] "km" Vector__XXX
 SG_ ApplSysMonitorDenominator : 0|16@1+ (1,0) [0|65535] "" Vector__XXX
 SG_ ApplSysMonitorNumerator : 0|16@1+ (1,0) [0|65535] "" Vector__XXX
 SG_ SPNofApplSysMonitor : 0|24@1+ (1,0) [0|524287] "" Vector__XXX
 SG_ OBDMonitoringCondEncountered : 0|16@1+ (1,0) [0|65535] "" Vector__XXX
 SG_ IgnitionCycleCounter : 0|16@1+ (1,0) [0|65535] "" Vector__XXX
 SG_ MalfunctionIndicatorLampStatus : 0|2@1+ (1,0) [0|3] "" Vector__XXX
 SG_ RedStopLampState : 0|2@1+ (1,0) [0|3] "" Vector__XXX
 SG_ AmberWarningLampStatus : 0|2@1+ (1,0) [0|3] "" Vector__XXX
 SG_ ProtectLampStatus : 0|2@1+ (1,0) [0|3] "" Vector__XXX
 SG_ FlashRedStopLamp : 0|2@1+ (1,0) [0|3] "" Vector__XXX
 SG_ FlashProtectLamp : 0|2@1+ (1,0) [0|3] "" Vector__XXX
 SG_ FlashMalfuncIndicatorLamp : 0|2@1+ (1,0) [0|3] "" Vector__XXX
 SG_ FlashAmberWarningLamp : 0|2@1+ (1,0) [0|3] "" Vector__XXX
 SG_ DTC5 : 0|32@1+ (1,0) [0|4294967295] "" Vector__XXX
 SG_ DTC4 : 0|32@1+ (1,0) [0|4294967295] "" Vector__XXX
 SG_ DTC3 : 0|32@1+ (1,0) [0|4294967295] "" Vector__XXX
 SG_ DTC2 : 0|32@1+ (1,0) [0|4294967295] "" Vector__XXX
 SG_ CalibrationID4 : 0|32@1+ (1,0) [0|4294967295] "" Vector__XXX
 SG_ CalibrationID3 : 0|32@1+ (1,0) [0|4294967295] "" Vector__XXX
 SG_ CalibrationID2 : 0|32@1+ (1,0) [0|4294967295] "" Vector__XXX
 SG_ CalibrationID1 : 0|32@1+ (1,0) [0|4294967295] "" Vector__XXX
 SG_ CalibrationVerificationNumber : 0|32@1+ (1,0) [0|4294967295] "" Vector__XXX
 SG_ BootLoadData7 : 0|8@1- (1,0) [0|0] "" Vector__XXX
 SG_ BootLoadData6 : 0|8@1- (1,0) [0|0] "" Vector__XXX
 SG_ BootLoadData5 : 0|8@1- (1,0) [0|0] "" Vector__XXX
 SG_ BootLoadData4 : 0|8@1- (1,0) [0|0] "" Vector__XXX
 SG_ BootLoadData3 : 0|8@1- (1,0) [0|0] "" Vector__XXX
 SG_ BootLoadData2 : 0|8@1- (1,0) [0|0] "" Vector__XXX
 SG_ BootLoadData1 : 0|8@1- (1,0) [0|0] "" Vector__XXX
 SG_ BootLoadData : 0|8@1- (1,0) [0|0] "" Vector__XXX
 SG_ RawBinaryData6 : 0|8@1- (1,0) [0|0] "" Vector__XXX
 SG_ RawBinaryData5 : 0|8@1- (1,0) [0|0] "" Vector__XXX
 SG_ RawBinaryData4 : 0|8@1- (1,0) [0|0] "" Vector__XXX
 SG_ RawBinaryData3 : 0|8@1- (1,0) [0|0] "" Vector__XXX
 SG_ RawBinaryData2 : 0|8@1- (1,0) [0|0] "" Vector__XXX
 SG_ RawBinaryData1 : 0|8@1- (1,0) [0|0] "" Vector__XXX
 SG_ RawBinaryData : 0|8@1- (1,0) [0|0] "" Vector__XXX
 SG_ NumberOfOccurance : 0|8@1+ (1,0) [0|0] "" Vector__XXX
 SG_ NumberAllowed : 0|8@1+ (1,0) [0|2047] "" Vector__XXX
 SG_ Seed : 0|16@1+ (1,0) [0|65535] "" Vector__XXX
 SG_ EDCP_Extension : 0|8@1+ (1,0) [0|255] "" Vector__XXX
 SG_ ErrorIndicator : 0|24@1+ (1,0) [0|16777215] "" Vector__XXX
 SG_ Status : 0|3@1+ (1,0) [0|7] "" Vector__XXX
 SG_ NumberAllowedHigh : 0|3@1+ (1,0) [0|7] "" Vector__XXX
 SG_ KeyOrUserLevel : 0|16@1+ (1,0) [0|65535] "" Vector__XXX
 SG_ PointerExtension : 0|8@1+ (1,0) [0|255] "" Vector__XXX
 SG_ Pointer : 0|24@1+ (1,0) [0|16777215] "" Vector__XXX
 SG_ Command : 0|3@1+ (1,0) [0|7] "" Vector__XXX
 SG_ PointerType : 0|1@1+ (1,0) [0|1] "" Vector__XXX
 SG_ NumberRequested : 0|8@1+ (1,0) [0|2047] "" Vector__XXX
 SG_ NumberRequestedHigh : 0|3@1+ (1,0) [0|7] "" Vector__XXX
 SG_ HoldSignal : 0|4@1+ (1,0) [0|15] "" Vector__XXX
 SG_ J1939Network3 : 0|2@1+ (1,0) [0|3] "" Vector__XXX
 SG_ J1939Network2 : 0|2@1+ (1,0) [0|3] "" Vector__XXX
 SG_ ISO9141 : 0|2@1+ (1,0) [0|3] "" Vector__XXX
 SG_ SAE_J1850 : 0|2@1+ (1,0) [0|3] "" Vector__XXX
 SG_ ManufacturerSpecificPort : 0|2@1+ (1,0) [0|3] "" Vector__XXX
 SG_ CurrentDataLink : 0|2@1+ (1,0) [0|3] "" Vector__XXX
 SG_ SAE_J1587 : 0|2@1+ (1,0) [0|3] "" Vector__XXX
 SG_ SAE_J1922 : 0|2@1+ (1,0) [0|3] "" Vector__XXX
 SG_ J1939Network1 : 0|2@1+ (1,0) [0|3] "" Vector__XXX
 SG_ SuspendSignal : 0|4@1+ (1,0) [0|15] "" Vector__XXX
 SG_ SuspendDuration : 0|16@1+ (1,0) [0|64255] "sec" Vector__XXX
 SG_ FlashRedStopLamp : 0|2@1+ (1,0) [0|3] "" Vector__XXX
 SG_ FlashProtectLamp : 0|2@1+ (1,0) [0|3] "" Vector__XXX
 SG_ MalfunctionIndicatorLampStatus : 0|2@1+ (1,0) [0|3] "" Vector__XXX
 SG_ RedStopLampState : 0|2@1+ (1,0) [0|3] "" Vector__XXX
 SG_ AmberWarningLampStatus : 0|2@1+ (1,0) [0|3] "" Vector__XXX
 SG_ ProtectLampStatus : 0|2@1+ (1,0) [0|3] "" Vector__XXX
 SG_ FlashMalfuncIndicatorLamp : 0|2@1+ (1,0) [0|3] "" Vector__XXX
 SG_ FlashAmberWarningLamp : 0|2@1+ (1,0) [0|3] "" Vector__XXX
 SG_ DTC5 : 0|32@1+ (1,0) [0|4294967295] "" Vector__XXX
 SG_ DTC4 : 0|32@1+ (1,0) [0|4294967295] "" Vector__XXX
 SG_ DTC3 : 0|32@1+ (1,0) [0|4294967295] "" Vector__XXX
 SG_ DTC2 : 0|32@1+ (1,0) [0|4294967295] "" Vector__XXX
 SG_ TestIdentifierSupported : 0|64@1+ (1,0) [1|1.844674407371E+019] "" Vector__XXX
 SG_ FlashRedStopLamp : 0|2@1+ (1,0) [0|3] "" Vector__XXX
 SG_ FlashProtectLamp : 0|2@1+ (1,0) [0|3] "" Vector__XXX
 SG_ FlashMalfuncIndicatorLamp : 0|2@1+ (1,0) [0|3] "" Vector__XXX
 SG_ FlashAmberWarningLamp : 0|2@1+ (1,0) [0|3] "" Vector__XXX
 SG_ MalfunctionIndicatorLampStatus : 0|2@1+ (1,0) [0|3] "" Vector__XXX
 SG_ AmberWarningLampStatus : 0|2@1+ (1,0) [0|3] "" Vector__XXX
 SG_ RedStopLampState : 0|2@1+ (1,0) [0|3] "" Vector__XXX
 SG_ ProtectLampStatus : 0|2@1+ (1,0) [0|3] "" Vector__XXX
 SG_ DTC5 : 0|32@1+ (1,0) [0|4294967295] "" Vector__XXX
 SG_ DTC4 : 0|32@1+ (1,0) [0|4294967295] "" Vector__XXX
 SG_ DTC3 : 0|32@1+ (1,0) [0|4294967295] "" Vector__XXX
 SG_ DTC2 : 0|32@1+ (1,0) [0|4294967295] "" Vector__XXX
 SG_ UtlityOverallPowerFactorLagging : 0|2@1+ (1,0) [0|3] "" Vector__XXX
 SG_ UtilityOverallPowerFactor : 0|16@1+ (1,-1) [-1|2.92181] "" Vector__XXX
 SG_ UtilityTotalReactivePower : 0|32@1+ (1,-2000000000) [-2000000000|2211081215] "VAr" Vector__XXX
 SG_ UtilityTotalApparentPower : 0|32@1+ (1,-2000000000) [-2000000000|2211081215] "VA" Vector__XXX
 SG_ UtilityTotalRealPower : 0|32@1+ (1,-2000000000) [-2000000000|2211081215] "W" Vector__XXX
 SG_ UtilityTotalKWHoursImport : 0|32@1+ (1,0) [0|4211081215] "kWh" Vector__XXX
 SG_ UtilityTotalKWHoursExport : 0|32@1+ (1,0) [0|4211081215] "kWh" Vector__XXX
 SG_ UtilityPhaseCPowerFactorLagging : 0|2@1+ (1,0) [0|3] "" Vector__XXX
 SG_ UtilityPhaseCPowerFactor : 0|16@1+ (1,-1) [-1|2.92181] "" Vector__XXX
 SG_ UtilityPhaseCReactivePower : 0|32@1+ (1,-2000000000) [-2000000000|2211081215] "VAr" Vector__XXX
 SG_ UtilityPhaseCApparentPower : 0|32@1+ (1,-2000000000) [-2000000000|2211081215] "VA" Vector__XXX
 SG_ UtilityPhaseCRealPower : 0|32@1+ (1,-2000000000) [-2000000000|2211081215] "W" Vector__XXX
 SG_ UtilityPhaseCACRMSCurrent : 0|16@1+ (1,0) [0|64255] "A" Vector__XXX
 SG_ UtilityPhaseCACFrequency : 0|16@1+ (1,0) [0|501.9921875] "Hz" Vector__XXX
 SG_ UtltyPhsCLneNeutralACRMSVoltage : 0|16@1+ (1,0) [0|64255] "V" Vector__XXX
 SG_ UtltyPhseCALineLineACRMSVoltage : 0|16@1+ (1,0) [0|64255] "V" Vector__XXX
 SG_ UtilityPhaseBPowerFactorLagging : 0|2@1+ (1,0) [0|3] "" Vector__XXX
 SG_ UtilityPhaseBPowerFactor : 0|16@1+ (1,-1) [-1|2.92181] "" Vector__XXX
 SG_ UtilityPhaseBReactivePower : 0|32@1+ (1,-2000000000) [-2000000000|2211081215] "VAr" Vector__XXX
 SG_ UtilityPhaseBApparentPower : 0|32@1+ (1,-2000000000) [-2000000000|2211081215] "VA" Vector__XXX
 SG_ UtilityPhaseBRealPower : 0|32@1+ (1,-2000000000) [-2000000000|2211081215] "W" Vector__XXX
 SG_ UtilityPhaseBACRMSCurrent : 0|16@1+ (1,0) [0|64255] "A" Vector__XXX
 SG_ UtilityPhaseBACFrequency : 0|16@1+ (1,0) [0|501.9921875] "Hz" Vector__XXX
 SG_ UtltyPhsBLneNeutralACRMSVoltage : 0|16@1+ (1,0) [0|64255] "V" Vector__XXX
 SG_ UtltyPhseBCLineLineACRMSVoltage : 0|16@1+ (1,0) [0|64255] "V" Vector__XXX
 SG_ UtilityPhaseAPowerFactorLagging : 0|2@1+ (1,0) [0|3] "" Vector__XXX
 SG_ UtilityPhaseAPowerFactor : 0|16@1+ (1,-1) [-1|2.92181] "" Vector__XXX
 SG_ UtilityPhaseAReactivePower : 0|32@1+ (1,-2000000000) [-2000000000|2211081215] "VAr" Vector__XXX
 SG_ UtilityPhaseAApparentPower : 0|32@1+ (1,-2000000000) [-2000000000|2211081215] "VA" Vector__XXX
 SG_ UtilityPhaseARealPower : 0|32@1+ (1,-2000000000) [-2000000000|2211081215] "W" Vector__XXX
 SG_ UtilityPhaseAACRMSCurrent : 0|16@1+ (1,0) [0|64255] "A" Vector__XXX
 SG_ UtilityPhaseAACFrequency : 0|16@1+ (1,0) [0|501.9921875] "Hz" Vector__XXX
 SG_ UtltyPhsALneNeutralACRMSVoltage : 0|16@1+ (1,0) [0|64255] "V" Vector__XXX
 SG_ UtltyPhseABLineLineACRMSVoltage : 0|16@1+ (1,0) [0|64255] "V" Vector__XXX
 SG_ UtilityAverageACRMSCurrent : 0|16@1+ (1,0) [0|64255] "A" Vector__XXX
 SG_ UtilityAverageACFrequency : 0|16@1+ (1,0) [0|501.9921875] "Hz" Vector__XXX
 SG_ UtltyAvrgLneNeutralACRMSVoltage : 0|16@1+ (1,0) [0|64255] "V" Vector__XXX
 SG_ UtltyAvrageLineLineACRMSVoltage : 0|16@1+ (1,0) [0|64255] "V" Vector__XXX
 SG_ GnrtorOverallPowerFactorLagging : 0|2@1+ (1,0) [0|3] "" Vector__XXX
 SG_ GeneratorOverallPowerFactor : 0|16@1+ (1,-1) [-1|2.92181] "" Vector__XXX
 SG_ GeneratorTotalReactivePower : 0|32@1+ (1,-2000000000) [-2000000000|2211081215] "VAr" Vector__XXX
 SG_ GeneratorTotalApparentPower : 0|32@1+ (1,-2000000000) [-2000000000|2211081215] "VA" Vector__XXX
 SG_ GeneratorTotalRealPower : 0|32@1+ (1,-2000000000) [-2000000000|2211081215] "W" Vector__XXX
 SG_ GeneratorTotalKWHoursImport : 0|32@1+ (1,0) [0|4211081215] "kWh" Vector__XXX
 SG_ GeneratorTotalKWHoursExport : 0|32@1+ (1,0) [0|4211081215] "kWh" Vector__XXX
 SG_ GnratorPhaseCPowerFactorLagging : 0|2@1+ (1,0) [0|3] "" Vector__XXX
 SG_ GeneratorPhaseCPowerFactor : 0|16@1+ (1,-1) [-1|2.92181] "" Vector__XXX
 SG_ GeneratorPhaseCReactivePower : 0|32@1+ (1,-2000000000) [-2000000000|2211081215] "VAr" Vector__XXX
 SG_ GeneratorPhaseCApparentPower : 0|32@1+ (1,-2000000000) [-2000000000|2211081215] "VA" Vector__XXX
 SG_ GeneratorPhaseCRealPower : 0|32@1+ (1,-2000000000) [-2000000000|2211081215] "W" Vector__XXX
 SG_ GeneratorPhaseCACRMSCurrent : 0|16@1+ (1,0) [0|64255] "A" Vector__XXX
 SG_ GeneratorPhaseCACFrequency : 0|16@1+ (1,0) [0|501.9921875] "Hz" Vector__XXX
 SG_ GnrtrPhsCLneNeutralACRMSVoltage : 0|16@1+ (1,0) [0|64255] "V" Vector__XXX
 SG_ GnrtrPhseCALineLineACRMSVoltage : 0|16@1+ (1,0) [0|64255] "V" Vector__XXX
 SG_ GnratorPhaseBPowerFactorLagging : 0|2@1+ (1,0) [0|3] "" Vector__XXX
 SG_ GeneratorPhaseBPowerFactor : 0|16@1+ (1,-1) [-1|2.92181] "" Vector__XXX
 SG_ GeneratorPhaseBReactivePower : 0|32@1+ (1,-2000000000) [-2000000000|2211081215] "VAr" Vector__XXX
 SG_ GeneratorPhaseBApparentPower : 0|32@1+ (1,-2000000000) [-2000000000|2211081215] "VA" Vector__XXX
 SG_ GeneratorPhaseBRealPower : 0|32@1+ (1,-2000000000) [-2000000000|2211081215] "W" Vector__XXX
 SG_ GeneratorPhaseBACRMSCurrent : 0|16@1+ (1,0) [0|64255] "A" Vector__XXX
 SG_ GeneratorPhaseBACFrequency : 0|16@1+ (1,0) [0|501.9921875] "Hz" Vector__XXX
 SG_ GnrtrPhsBLneNeutralACRMSVoltage : 0|16@1+ (1,0) [0|64255] "V" Vector__XXX
 SG_ GnrtrPhseBCLineLineACRMSVoltage : 0|16@1+ (1,0) [0|64255] "V" Vector__XXX
 SG_ GnratorPhaseAPowerFactorLagging : 0|2@1+ (1,0) [0|3] "" Vector__XXX
 SG_ GeneratorPhaseAPowerFactor : 0|16@1+ (1,-1) [-1|2.92181] "" Vector__XXX
 SG_ GeneratorPhaseAReactivePower : 0|32@1+ (1,-2000000000) [-2000000000|2211081215] "VAr" Vector__XXX
 SG_ GeneratorPhaseAApparentPower : 0|32@1+ (1,-2000000000) [-2000000000|2211081215] "VA" Vector__XXX
 SG_ GeneratorPhaseARealPower : 0|32@1+ (1,-2000000000) [-2000000000|2211081215] "W" Vector__XXX
 SG_ GeneratorPhaseAACRMSCurrent : 0|16@1+ (1,0) [0|64255] "A" Vector__XXX
 SG_ GeneratorPhaseAACFrequency : 0|16@1+ (1,0) [0|501.9921875] "Hz" Vector__XXX
 SG_ GnrtrPhsALneNeutralACRMSVoltage : 0|16@1+ (1,0) [0|64255] "V" Vector__XXX
 SG_ GnrtrPhseABLineLineACRMSVoltage : 0|16@1+ (1,0) [0|64255] "V" Vector__XXX
 SG_ GeneratorAverageACRMSCurrent : 0|16@1+ (1,0) [0|64255] "A" Vector__XXX
 SG_ GeneratorAverageACFrequency : 0|16@1+ (1,0) [0|501.9921875] "Hz" Vector__XXX
 SG_ GnrtrAvrgLneNeutralACRMSVoltage : 0|16@1+ (1,0) [0|64255] "V" Vector__XXX
 SG_ GnrtrAvrageLineLineACRMSVoltage : 0|16@1+ (1,0) [0|64255] "V" Vector__XXX
 SG_ Bus1_UtilityACPhaseDifference : 0|16@1+ (1,-200) [-200|301.99] "deg" Vector__XXX
 SG_ Bus1_UtilityInSync : 0|2@1+ (1,0) [0|3] "" Vector__XXX
 SG_ Bus1_UtilityVoltageMatch : 0|2@1+ (1,0) [0|3] "" Vector__XXX
 SG_ Bus1_UtilityFrequencyMatch : 0|2@1+ (1,0) [0|3] "" Vector__XXX
 SG_ Bus1_UtilityPhaseMatch : 0|2@1+ (1,0) [0|3] "" Vector__XXX
 SG_ Bus1_UtilityDeadBus : 0|2@1+ (1,0) [0|3] "" Vector__XXX
 SG_ Bus1PhaseCACFrequency : 0|16@1+ (1,0) [0|501.9921875] "Hz" Vector__XXX
 SG_ Bs1PhseCLineNeutralACRMSVoltage : 0|16@1+ (1,0) [0|64255] "V" Vector__XXX
 SG_ Bus1PhaseCALineLineACRMSVoltage : 0|16@1+ (1,0) [0|64255] "V" Vector__XXX
 SG_ Bus1PhaseBACFrequency : 0|16@1+ (1,0) [0|501.9921875] "Hz" Vector__XXX
 SG_ Bs1PhseBLineNeutralACRMSVoltage : 0|16@1+ (1,0) [0|64255] "V" Vector__XXX
 SG_ Bus1PhaseBCLineLineACRMSVoltage : 0|16@1+ (1,0) [0|64255] "V" Vector__XXX
 SG_ Bus1PhaseAACFrequency : 0|16@1+ (1,0) [0|501.9921875] "Hz" Vector__XXX
 SG_ Bs1PhseALineNeutralACRMSVoltage : 0|16@1+ (1,0) [0|64255] "V" Vector__XXX
 SG_ Bus1PhaseABLineLineACRMSVoltage : 0|16@1+ (1,0) [0|64255] "V" Vector__XXX
 SG_ Bus1_GeneratorACPhaseDifference : 0|16@1+ (1,-200) [-200|301.99] "deg" Vector__XXX
 SG_ Bus1_GeneratorInSync : 0|2@1+ (1,0) [0|3] "" Vector__XXX
 SG_ Bus1_GeneratorVoltageMatch : 0|2@1+ (1,0) [0|3] "" Vector__XXX
 SG_ Bus1_GeneratorFrequencyMatch : 0|2@1+ (1,0) [0|3] "" Vector__XXX
 SG_ Bus1_GeneratorPhaseMatch : 0|2@1+ (1,0) [0|3] "" Vector__XXX
 SG_ Bus1_GeneratorDeadBus : 0|2@1+ (1,0) [0|3] "" Vector__XXX
 SG_ Bus1AverageACFrequency : 0|16@1+ (1,0) [0|501.9921875] "Hz" Vector__XXX
 SG_ Bs1AvrgeLineNeutralACRMSVoltage : 0|16@1+ (1,0) [0|64255] "V" Vector__XXX
 SG_ Bus1AverageLineLineACRMSVoltage : 0|16@1+ (1,0) [0|64255] "V" Vector__XXX
 SG_ NumberOfMembers : 0|8@1+ (1,0) [0|0] "" Vector__XXX
 SG_ AddressAssignment : 0|8@1+ (1,0) [0|255] "" Vector__XXX
 SG_ ShrtNameOfActualReportingDevice : 0|32@1+ (1,0) [0|0] "(2^32 - 1)" Vector__XXX
 SG_ LengthOfDataForTheReportedPGN : 0|8@1+ (1,0) [0|255] "" Vector__XXX
 SG_ PGNofRequstedInformation : 0|24@1+ (1,0) [0|16777215] "" Vector__XXX
 SG_ SequenceNumber : 0|8@1+ (1,0) [0|255] "" Vector__XXX
 SG_ TotalNumberOfPacketsEoMA : 0|8@1+ (1,0) [0|255] "" Vector__XXX
 SG_ TotalMessageSizeEoMA : 0|16@1+ (1,0) [0|64255] "counts" Vector__XXX
 SG_ TotalMessageSizeBAM : 0|16@1+ (1,0) [0|64255] "counts" Vector__XXX
 SG_ TotalNumberOfPacketsBAM : 0|8@1+ (1,0) [0|255] "" Vector__XXX
 SG_ ConnectionAbortReason : 0|8@1+ (1,0) [0|255] "" Vector__XXX
 SG_ NextPacketNumberToBeSent : 0|8@1+ (1,0) [0|255] "" Vector__XXX
 SG_ NumberOfPacketsThatCanBeSent : 0|8@1+ (1,0) [0|255] "" Vector__XXX
 SG_ PGNumber : 0|24@1+ (1,0) [0|16777200] "" Vector__XXX
 SG_ MaximumNumberOfPackets : 0|8@1+ (1,0) [0|255] "" Vector__XXX
 SG_ TotalNumberOfPackets : 0|8@1+ (1,0) [0|255] "" Vector__XXX
 SG_ TotalMessageSize : 0|16@1+ (1,0) [0|64255] "counts" Vector__XXX
 SG_ UseTransferMode : 0|2@1+ (1,0) [0|3] "" Vector__XXX
 SG_ ParameterGroupNumber : 0|24@1+ (1,0) [0|16777215] "" Vector__XXX
 SG_ ParameterGroupNumber : 0|24@1+ (1,0) [0|16777215] "" Vector__XXX
 SG_ AxleGroupWeight : 0|16@1+ (2,0) [0|128510] "kg" Vector__XXX
 SG_ AxleGroupLocation : 0|4@1+ (1,0) [0|15] "" Vector__XXX
 SG_ AxleGroupLocation : 0|4@1+ (1,0) [0|15] "" Vector__XXX
 SG_ AxleGroupFullWeightCalib : 0|16@1+ (2,0) [0|128510] "kg" Vector__XXX
 SG_ AxleGroupEmptyWeightCalib : 0|16@1+ (2,0) [0|128510] "kg" Vector__XXX
 SG_ DsrdAftrclrClntThermostatOpening : 0|8@1+ (1,0) [0|100] "%" Vector__XXX
 SG_ DsrdAftercoolerCoolantIntakeTemp : 0|8@1+ (1,-40) [-40|210] "deg C" Vector__XXX
 SG_ AftercoolerCoolantThermostatMode : 0|2@1+ (1,0) [0|3] "" Vector__XXX
 SG_ AddtnlTrlrAxlGrupWeightAvailable : 0|2@1+ (1,0) [0|3] "" Vector__XXX
 SG_ TrailerHAxleGroupWeightAvailable : 0|2@1+ (1,0) [0|3] "" Vector__XXX
 SG_ TrailerGAxleGroupWeightAvailable : 0|2@1+ (1,0) [0|3] "" Vector__XXX
 SG_ TrailerFAxleGroupWeightAvailable : 0|2@1+ (1,0) [0|3] "" Vector__XXX
 SG_ TrailerEAxleGroupWeightAvailable : 0|2@1+ (1,0) [0|3] "" Vector__XXX
 SG_ TrailerDAxleGroupWeightAvailable : 0|2@1+ (1,0) [0|3] "" Vector__XXX
 SG_ TrailerCAxleGroupWeightAvailable : 0|2@1+ (1,0) [0|3] "" Vector__XXX
 SG_ TrailerBAxleGroupWeightAvailable : 0|2@1+ (1,0) [0|3] "" Vector__XXX
 SG_ TrailerAAxleGroupWeightAvailable : 0|2@1+ (1,0) [0|3] "" Vector__XXX
 SG_ AddtnlTrctrAxlGrpWeightAvailable : 0|2@1+ (1,0) [0|3] "" Vector__XXX
 SG_ TagAxleGroupWeightAvailable : 0|2@1+ (1,0) [0|3] "" Vector__XXX
 SG_ DriveAxleGroupWeightAvailable : 0|2@1+ (1,0) [0|3] "" Vector__XXX
 SG_ LiftAxleGroupWeightAvailable : 0|2@1+ (1,0) [0|3] "" Vector__XXX
 SG_ SteerAxleGroupWeightAvailable : 0|2@1+ (1,0) [0|3] "" Vector__XXX
 SG_ FlashRedStopLamp : 0|2@1+ (1,0) [0|3] "" Vector__XXX
 SG_ FlashProtectLamp : 0|2@1+ (1,0) [0|3] "" Vector__XXX
 SG_ FlashMalfuncIndicatorLamp : 0|2@1+ (1,0) [0|3] "" Vector__XXX
 SG_ FlashAmberWarningLamp : 0|2@1+ (1,0) [0|3] "" Vector__XXX
 SG_ MalfunctionIndicatorLampStatus : 0|2@1+ (1,0) [0|3] "" Vector__XXX
 SG_ AmberWarningLampStatus : 0|2@1+ (1,0) [0|3] "" Vector__XXX
 SG_ RedStopLampState : 0|2@1+ (1,0) [0|3] "" Vector__XXX
 SG_ ProtectLampStatus : 0|2@1+ (1,0) [0|3] "" Vector__XXX
 SG_ DTC5 : 0|32@1+ (1,0) [0|4294967295] "" Vector__XXX
 SG_ DTC4 : 0|32@1+ (1,0) [0|4294967295] "" Vector__XXX
 SG_ DTC3 : 0|32@1+ (1,0) [0|4294967295] "" Vector__XXX
 SG_ DTC2 : 0|32@1+ (1,0) [0|4294967295] "" Vector__XXX
 SG_ FlashRedStopLamp : 0|2@1+ (1,0) [0|3] "" Vector__XXX
 SG_ FlashProtectLamp : 0|2@1+ (1,0) [0|3] "" Vector__XXX
 SG_ FlashMalfuncIndicatorLamp : 0|2@1+ (1,0) [0|3] "" Vector__XXX
 SG_ FlashAmberWarningLamp : 0|2@1+ (1,0) [0|3] "" Vector__XXX
 SG_ MalfunctionIndicatorLampStatus : 0|2@1+ (1,0) [0|3] "" Vector__XXX
 SG_ AmberWarningLampStatus : 0|2@1+ (1,0) [0|3] "" Vector__XXX
 SG_ RedStopLampState : 0|2@1+ (1,0) [0|3] "" Vector__XXX
 SG_ ProtectLampStatus : 0|2@1+ (1,0) [0|3] "" Vector__XXX
 SG_ DTC5 : 0|32@1+ (1,0) [0|4294967295] "" Vector__XXX
 SG_ DTC4 : 0|32@1+ (1,0) [0|4294967295] "" Vector__XXX
 SG_ DTC3 : 0|32@1+ (1,0) [0|4294967295] "" Vector__XXX
 SG_ DTC2 : 0|32@1+ (1,0) [0|4294967295] "" Vector__XXX
 SG_ FlashRedStopLamp : 0|2@1+ (1,0) [0|3] "" Vector__XXX
 SG_ FlashProtectLamp : 0|2@1+ (1,0) [0|3] "" Vector__XXX
 SG_ FlashMalfuncIndicatorLamp : 0|2@1+ (1,0) [0|3] "" Vector__XXX
 SG_ FlashAmberWarningLamp : 0|2@1+ (1,0) [0|3] "" Vector__XXX
 SG_ MalfunctionIndicatorLampStatus : 0|2@1+ (1,0) [0|3] "" Vector__XXX
 SG_ AmberWarningLampStatus : 0|2@1+ (1,0) [0|3] "" Vector__XXX
 SG_ RedStopLampState : 0|2@1+ (1,0) [0|3] "" Vector__XXX
 SG_ ProtectLampStatus : 0|2@1+ (1,0) [0|3] "" Vector__XXX
 SG_ DTC5 : 0|32@1+ (1,0) [0|4294967295] "" Vector__XXX
 SG_ DTC4 : 0|32@1+ (1,0) [0|4294967295] "" Vector__XXX
 SG_ DTC3 : 0|32@1+ (1,0) [0|4294967295] "" Vector__XXX
 SG_ DTC2 : 0|32@1+ (1,0) [0|4294967295] "" Vector__XXX
 SG_ FlashRedStopLamp : 0|2@1+ (1,0) [0|3] "" Vector__XXX
 SG_ FlashProtectLamp : 0|2@1+ (1,0) [0|3] "" Vector__XXX
 SG_ FlashMalfuncIndicatorLamp : 0|2@1+ (1,0) [0|3] "" Vector__XXX
 SG_ FlashAmberWarningLamp : 0|2@1+ (1,0) [0|3] "" Vector__XXX
 SG_ MalfunctionIndicatorLampStatus : 0|2@1+ (1,0) [0|3] "" Vector__XXX
 SG_ AmberWarningLampStatus : 0|2@1+ (1,0) [0|3] "" Vector__XXX
 SG_ RedStopLampState : 0|2@1+ (1,0) [0|3] "" Vector__XXX
 SG_ ProtectLampStatus : 0|2@1+ (1,0) [0|3] "" Vector__XXX
 SG_ DTC5 : 0|32@1+ (1,0) [0|4294967295] "" Vector__XXX
 SG_ DTC4 : 0|32@1+ (1,0) [0|4294967295] "" Vector__XXX
 SG_ DTC3 : 0|32@1+ (1,0) [0|4294967295] "" Vector__XXX
 SG_ DTC2 : 0|32@1+ (1,0) [0|4294967295] "" Vector__XXX
 SG_ FlashRedStopLamp : 0|2@1+ (1,0) [0|3] "" Vector__XXX
 SG_ FlashProtectLamp : 0|2@1+ (1,0) [0|3] "" Vector__XXX
 SG_ FlashMalfuncIndicatorLamp : 0|2@1+ (1,0) [0|3] "" Vector__XXX
 SG_ FlashAmberWarningLamp : 0|2@1+ (1,0) [0|3] "" Vector__XXX
 SG_ MalfunctionIndicatorLampStatus : 0|2@1+ (1,0) [0|3] "" Vector__XXX
 SG_ AmberWarningLampStatus : 0|2@1+ (1,0) [0|3] "" Vector__XXX
 SG_ RedStopLampState : 0|2@1+ (1,0) [0|3] "" Vector__XXX
 SG_ ProtectLampStatus : 0|2@1+ (1,0) [0|3] "" Vector__XXX
 SG_ DTC5 : 0|32@1+ (1,0) [0|4294967295] "" Vector__XXX
 SG_ DTC4 : 0|32@1+ (1,0) [0|4294967295] "" Vector__XXX
 SG_ DTC3 : 0|32@1+ (1,0) [0|4294967295] "" Vector__XXX
 SG_ DTC2 : 0|32@1+ (1,0) [0|4294967295] "" Vector__XXX
 SG_ FlashRedStopLamp : 0|2@1+ (1,0) [0|3] "" Vector__XXX
 SG_ FlashProtectLamp : 0|2@1+ (1,0) [0|3] "" Vector__XXX
 SG_ FlashMalfuncIndicatorLamp : 0|2@1+ (1,0) [0|3] "" Vector__XXX
 SG_ FlashAmberWarningLamp : 0|2@1+ (1,0) [0|3] "" Vector__XXX
 SG_ MalfunctionIndicatorLampStatus : 0|2@1+ (1,0) [0|3] "" Vector__XXX
 SG_ AmberWarningLampStatus : 0|2@1+ (1,0) [0|3] "" Vector__XXX
 SG_ RedStopLampState : 0|2@1+ (1,0) [0|3] "" Vector__XXX
 SG_ ProtectLampStatus : 0|2@1+ (1,0) [0|3] "" Vector__XXX
 SG_ DTC5 : 0|32@1+ (1,0) [0|4294967295] "" Vector__XXX
 SG_ DTC4 : 0|32@1+ (1,0) [0|4294967295] "" Vector__XXX
 SG_ DTC3 : 0|32@1+ (1,0) [0|4294967295] "" Vector__XXX
 SG_ DTC2 : 0|32@1+ (1,0) [0|4294967295] "" Vector__XXX
 SG_ FlashRedStopLamp : 0|2@1+ (1,0) [0|3] "" Vector__XXX
 SG_ FlashProtectLamp : 0|2@1+ (1,0) [0|3] "" Vector__XXX
 SG_ FlashMalfuncIndicatorLamp : 0|2@1+ (1,0) [0|3] "" Vector__XXX
 SG_ FlashAmberWarningLamp : 0|2@1+ (1,0) [0|3] "" Vector__XXX
 SG_ MalfunctionIndicatorLampStatus : 0|2@1+ (1,0) [0|3] "" Vector__XXX
 SG_ AmberWarningLampStatus : 0|2@1+ (1,0) [0|3] "" Vector__XXX
 SG_ RedStopLampState : 0|2@1+ (1,0) [0|3] "" Vector__XXX
 SG_ ProtectLampStatus : 0|2@1+ (1,0) [0|3] "" Vector__XXX
 SG_ DTC5 : 0|32@1+ (1,0) [0|4294967295] "" Vector__XXX
 SG_ DTC4 : 0|32@1+ (1,0) [0|4294967295] "" Vector__XXX
 SG_ DTC3 : 0|32@1+ (1,0) [0|4294967295] "" Vector__XXX
 SG_ DTC2 : 0|32@1+ (1,0) [0|4294967295] "" Vector__XXX
 SG_ FlashRedStopLamp : 0|2@1+ (1,0) [0|3] "" Vector__XXX
 SG_ FlashProtectLamp : 0|2@1+ (1,0) [0|3] "" Vector__XXX
 SG_ FlashMalfuncIndicatorLamp : 0|2@1+ (1,0) [0|3] "" Vector__XXX
 SG_ FlashAmberWarningLamp : 0|2@1+ (1,0) [0|3] "" Vector__XXX
 SG_ MalfunctionIndicatorLampStatus : 0|2@1+ (1,0) [0|3] "" Vector__XXX
 SG_ AmberWarningLampStatus : 0|2@1+ (1,0) [0|3] "" Vector__XXX
 SG_ RedStopLampState : 0|2@1+ (1,0) [0|3] "" Vector__XXX
 SG_ ProtectLampStatus : 0|2@1+ (1,0) [0|3] "" Vector__XXX
 SG_ DTC5 : 0|32@1+ (1,0) [0|4294967295] "" Vector__XXX
 SG_ DTC4 : 0|32@1+ (1,0) [0|4294967295] "" Vector__XXX
 SG_ DTC3 : 0|32@1+ (1,0) [0|4294967295] "" Vector__XXX
 SG_ DTC2 : 0|32@1+ (1,0) [0|4294967295] "" Vector__XXX
 SG_ FlashRedStopLamp : 0|2@1+ (1,0) [0|3] "" Vector__XXX
 SG_ FlashProtectLamp : 0|2@1+ (1,0) [0|3] "" Vector__XXX
 SG_ FlashMalfuncIndicatorLamp : 0|2@1+ (1,0) [0|3] "" Vector__XXX
 SG_ FlashAmberWarningLamp : 0|2@1+ (1,0) [0|3] "" Vector__XXX
 SG_ MalfunctionIndicatorLampStatus : 0|2@1+ (1,0) [0|3] "" Vector__XXX
 SG_ AmberWarningLampStatus : 0|2@1+ (1,0) [0|3] "" Vector__XXX
 SG_ RedStopLampState : 0|2@1+ (1,0) [0|3] "" Vector__XXX
 SG_ ProtectLampStatus : 0|2@1+ (1,0) [0|3] "" Vector__XXX
 SG_ DTC5 : 0|32@1+ (1,0) [0|4294967295] "" Vector__XXX
 SG_ DTC4 : 0|32@1+ (1,0) [0|4294967295] "" Vector__XXX
 SG_ DTC3 : 0|32@1+ (1,0) [0|4294967295] "" Vector__XXX
 SG_ DTC2 : 0|32@1+ (1,0) [0|4294967295] "" Vector__XXX
 SG_ FlashRedStopLamp : 0|2@1+ (1,0) [0|3] "" Vector__XXX
 SG_ FlashProtectLamp : 0|2@1+ (1,0) [0|3] "" Vector__XXX
 SG_ FlashMalfuncIndicatorLamp : 0|2@1+ (1,0) [0|3] "" Vector__XXX
 SG_ FlashAmberWarningLamp : 0|2@1+ (1,0) [0|3] "" Vector__XXX
 SG_ MalfunctionIndicatorLampStatus : 0|2@1+ (1,0) [0|3] "" Vector__XXX
 SG_ AmberWarningLampStatus : 0|2@1+ (1,0) [0|3] "" Vector__XXX
 SG_ RedStopLampState : 0|2@1+ (1,0) [0|3] "" Vector__XXX
 SG_ ProtectLampStatus : 0|2@1+ (1,0) [0|3] "" Vector__XXX
 SG_ DTC5 : 0|32@1+ (1,0) [0|4294967295] "" Vector__XXX
 SG_ DTC4 : 0|32@1+ (1,0) [0|4294967295] "" Vector__XXX
 SG_ DTC3 : 0|32@1+ (1,0) [0|4294967295] "" Vector__XXX
 SG_ DTC2 : 0|32@1+ (1,0) [0|4294967295] "" Vector__XXX
 SG_ FlashRedStopLamp : 0|2@1+ (1,0) [0|3] "" Vector__XXX
 SG_ FlashProtectLamp : 0|2@1+ (1,0) [0|3] "" Vector__XXX
 SG_ FlashMalfuncIndicatorLamp : 0|2@1+ (1,0) [0|3] "" Vector__XXX
 SG_ FlashAmberWarningLamp : 0|2@1+ (1,0) [0|3] "" Vector__XXX
 SG_ MalfunctionIndicatorLampStatus : 0|2@1+ (1,0) [0|3] "" Vector__XXX
 SG_ AmberWarningLampStatus : 0|2@1+ (1,0) [0|3] "" Vector__XXX
 SG_ RedStopLampState : 0|2@1+ (1,0) [0|3] "" Vector__XXX
 SG_ ProtectLampStatus : 0|2@1+ (1,0) [0|3] "" Vector__XXX
 SG_ DTC5 : 0|32@1+ (1,0) [0|4294967295] "" Vector__XXX
 SG_ DTC4 : 0|32@1+ (1,0) [0|4294967295] "" Vector__XXX
 SG_ DTC3 : 0|32@1+ (1,0) [0|4294967295] "" Vector__XXX
 SG_ DTC2 : 0|32@1+ (1,0) [0|4294967295] "" Vector__XXX
 SG_ FlashRedStopLamp : 0|2@1+ (1,0) [0|3] "" Vector__XXX
 SG_ FlashProtectLamp : 0|2@1+ (1,0) [0|3] "" Vector__XXX
 SG_ FlashMalfuncIndicatorLamp : 0|2@1+ (1,0) [0|3] "" Vector__XXX
 SG_ FlashAmberWarningLamp : 0|2@1+ (1,0) [0|3] "" Vector__XXX
 SG_ MalfunctionIndicatorLampStatus : 0|2@1+ (1,0) [0|3] "" Vector__XXX
 SG_ AmberWarningLampStatus : 0|2@1+ (1,0) [0|3] "" Vector__XXX
 SG_ RedStopLampState : 0|2@1+ (1,0) [0|3] "" Vector__XXX
 SG_ ProtectLampStatus : 0|2@1+ (1,0) [0|3] "" Vector__XXX
 SG_ DTC5 : 0|32@1+ (1,0) [0|4294967295] "" Vector__XXX
 SG_ DTC4 : 0|32@1+ (1,0) [0|4294967295] "" Vector__XXX
 SG_ DTC3 : 0|32@1+ (1,0) [0|4294967295] "" Vector__XXX
 SG_ DTC2 : 0|32@1+ (1,0) [0|4294967295] "" Vector__XXX
 SG_ FlashRedStopLamp : 0|2@1+ (1,0) [0|3] "" Vector__XXX
 SG_ FlashProtectLamp : 0|2@1+ (1,0) [0|3] "" Vector__XXX
 SG_ FlashMalfuncIndicatorLamp : 0|2@1+ (1,0) [0|3] "" Vector__XXX
 SG_ FlashAmberWarningLamp : 0|2@1+ (1,0) [0|3] "" Vector__XXX
 SG_ MalfunctionIndicatorLampStatus : 0|2@1+ (1,0) [0|3] "" Vector__XXX
 SG_ AmberWarningLampStatus : 0|2@1+ (1,0) [0|3] "" Vector__XXX
 SG_ RedStopLampState : 0|2@1+ (1,0) [0|3] "" Vector__XXX
 SG_ ProtectLampStatus : 0|2@1+ (1,0) [0|3] "" Vector__XXX
 SG_ DTC5 : 0|32@1+ (1,0) [0|4294967295] "" Vector__XXX
 SG_ DTC4 : 0|32@1+ (1,0) [0|4294967295] "" Vector__XXX
 SG_ DTC3 : 0|32@1+ (1,0) [0|4294967295] "" Vector__XXX
 SG_ DTC2 : 0|32@1+ (1,0) [0|4294967295] "" Vector__XXX
 SG_ ZeroNetVehicleWeightChange : 0|2@1+ (1,0) [0|3] "" Vector__XXX
 SG_ EngExhaustGasTempAverageBank2 : 0|16@1+ (1,-273) [-273|1734.96875] "deg C" Vector__XXX
 SG_ EngExhaustGasTempAverageBank1 : 0|16@1+ (1,-273) [-273|1734.96875] "deg C" Vector__XXX
 SG_ EngExhaustGasTempAverage : 0|16@1+ (1,-273) [-273|1734.96875] "deg C" Vector__XXX
 SG_ PermanentDTCs : 0|8@1+ (1,0) [0|255] "" Vector__XXX
 SG_ PreviouslyMILOnDTCs : 0|8@1+ (1,0) [0|255] "" Vector__XXX
 SG_ MILOnDTCs : 0|8@1+ (1,0) [0|255] "" Vector__XXX
 SG_ AllPendingDTCs : 0|8@1+ (1,0) [0|255] "" Vector__XXX
 SG_ PendingDTCs : 0|8@1+ (1,0) [0|255] "" Vector__XXX
 SG_ FlashRedStopLamp : 0|2@1+ (1,0) [0|3] "" Vector__XXX
 SG_ FlashProtectLamp : 0|2@1+ (1,0) [0|3] "" Vector__XXX
 SG_ FlashMalfuncIndicatorLamp : 0|2@1+ (1,0) [0|3] "" Vector__XXX
 SG_ FlashAmberWarningLamp : 0|2@1+ (1,0) [0|3] "" Vector__XXX
 SG_ MalfunctionIndicatorLampStatus : 0|2@1+ (1,0) [0|3] "" Vector__XXX
 SG_ AmberWarningLampStatus : 0|2@1+ (1,0) [0|3] "" Vector__XXX
 SG_ RedStopLampState : 0|2@1+ (1,0) [0|3] "" Vector__XXX
 SG_ ProtectLampStatus : 0|2@1+ (1,0) [0|3] "" Vector__XXX
 SG_ DTC5 : 0|32@1+ (1,0) [0|4294967295] "" Vector__XXX
 SG_ DTC4 : 0|32@1+ (1,0) [0|4294967295] "" Vector__XXX
 SG_ DTC3 : 0|32@1+ (1,0) [0|4294967295] "" Vector__XXX
 SG_ DTC2 : 0|32@1+ (1,0) [0|4294967295] "" Vector__XXX
 SG_ FlashRedStopLamp : 0|2@1+ (1,0) [0|3] "" Vector__XXX
 SG_ FlashProtectLamp : 0|2@1+ (1,0) [0|3] "" Vector__XXX
 SG_ FlashMalfuncIndicatorLamp : 0|2@1+ (1,0) [0|3] "" Vector__XXX
 SG_ FlashAmberWarningLamp : 0|2@1+ (1,0) [0|3] "" Vector__XXX
 SG_ MalfunctionIndicatorLampStatus : 0|2@1+ (1,0) [0|3] "" Vector__XXX
 SG_ AmberWarningLampStatus : 0|2@1+ (1,0) [0|3] "" Vector__XXX
 SG_ RedStopLampState : 0|2@1+ (1,0) [0|3] "" Vector__XXX
 SG_ ProtectLampStatus : 0|2@1+ (1,0) [0|3] "" Vector__XXX
 SG_ DTC5 : 0|32@1+ (1,0) [0|4294967295] "" Vector__XXX
 SG_ DTC4 : 0|32@1+ (1,0) [0|4294967295] "" Vector__XXX
 SG_ DTC3 : 0|32@1+ (1,0) [0|4294967295] "" Vector__XXX
 SG_ DTC2 : 0|32@1+ (1,0) [0|4294967295] "" Vector__XXX
 SG_ AETCSpeedValue : 0|16@1+ (0.125,0) [0|8031.875] "rpm" Vector__XXX
 SG_ AETCTorqueValue : 0|16@1+ (1,0) [0|64255] "Nm" Vector__XXX
 SG_ NumberOfAETCDataPoints : 0|4@1+ (1,0) [0|15] "" Vector__XXX
 SG_ AETCDataCollectionStandard : 0|4@1+ (1,0) [0|15] "" Vector__XXX
 SG_ RightHeadlampLightDistribution : 0|4@1+ (1,0) [0|15] "" Vector__XXX
 SG_ LeftHeadlampLightDistribution : 0|4@1+ (1,0) [0|15] "" Vector__XXX
 SG_ RightHeadlampDynamicBendingLight : 0|3@1+ (1,0) [0|7] "" Vector__XXX
 SG_ LeftHeadlampDynamicBendingLight : 0|3@1+ (1,0) [0|7] "" Vector__XXX
 SG_ AuxI_OChannel2 : 0|16@1+ (1,0) [0|64255] "counts" Vector__XXX
 SG_ AuxI_OChannel1 : 0|16@1+ (1,0) [0|64255] "counts" Vector__XXX
 SG_ AuxI_O13 : 0|2@1+ (1,0) [0|3] "" Vector__XXX
 SG_ AuxI_O14 : 0|2@1+ (1,0) [0|3] "" Vector__XXX
 SG_ AuxI_O15 : 0|2@1+ (1,0) [0|3] "" Vector__XXX
 SG_ AuxI_O16 : 0|2@1+ (1,0) [0|3] "" Vector__XXX
 SG_ AuxI_O09 : 0|2@1+ (1,0) [0|3] "" Vector__XXX
 SG_ AuxI_O10 : 0|2@1+ (1,0) [0|3] "" Vector__XXX
 SG_ AuxI_O11 : 0|2@1+ (1,0) [0|3] "" Vector__XXX
 SG_ AuxI_O12 : 0|2@1+ (1,0) [0|3] "" Vector__XXX
 SG_ AuxI_O05 : 0|2@1+ (1,0) [0|3] "" Vector__XXX
 SG_ AuxI_O06 : 0|2@1+ (1,0) [0|3] "" Vector__XXX
 SG_ AuxI_O07 : 0|2@1+ (1,0) [0|3] "" Vector__XXX
 SG_ AuxI_O08 : 0|2@1+ (1,0) [0|3] "" Vector__XXX
 SG_ AuxI_O01 : 0|2@1+ (1,0) [0|3] "" Vector__XXX
 SG_ AuxI_O02 : 0|2@1+ (1,0) [0|3] "" Vector__XXX
 SG_ AuxI_O03 : 0|2@1+ (1,0) [0|3] "" Vector__XXX
 SG_ AuxI_O04 : 0|2@1+ (1,0) [0|3] "" Vector__XXX
 SG_ AuxI_O45 : 0|2@1+ (1,0) [0|3] "" Vector__XXX
 SG_ AuxI_O46 : 0|2@1+ (1,0) [0|3] "" Vector__XXX
 SG_ AuxI_O47 : 0|2@1+ (1,0) [0|3] "" Vector__XXX
 SG_ AuxI_O48 : 0|2@1+ (1,0) [0|3] "" Vector__XXX
 SG_ AuxI_O41 : 0|2@1+ (1,0) [0|3] "" Vector__XXX
 SG_ AuxI_O42 : 0|2@1+ (1,0) [0|3] "" Vector__XXX
 SG_ AuxI_O43 : 0|2@1+ (1,0) [0|3] "" Vector__XXX
 SG_ AuxI_O44 : 0|2@1+ (1,0) [0|3] "" Vector__XXX
 SG_ AuxI_O37 : 0|2@1+ (1,0) [0|3] "" Vector__XXX
 SG_ AuxI_O38 : 0|2@1+ (1,0) [0|3] "" Vector__XXX
 SG_ AuxI_O39 : 0|2@1+ (1,0) [0|3] "" Vector__XXX
 SG_ AuxI_O40 : 0|2@1+ (1,0) [0|3] "" Vector__XXX
 SG_ AuxI_O33 : 0|2@1+ (1,0) [0|3] "" Vector__XXX
 SG_ AuxI_O34 : 0|2@1+ (1,0) [0|3] "" Vector__XXX
 SG_ AuxI_O35 : 0|2@1+ (1,0) [0|3] "" Vector__XXX
 SG_ AuxI_O36 : 0|2@1+ (1,0) [0|3] "" Vector__XXX
 SG_ AuxI_O29 : 0|2@1+ (1,0) [0|3] "" Vector__XXX
 SG_ AuxI_O30 : 0|2@1+ (1,0) [0|3] "" Vector__XXX
 SG_ AuxI_O31 : 0|2@1+ (1,0) [0|3] "" Vector__XXX
 SG_ AuxI_O32 : 0|2@1+ (1,0) [0|3] "" Vector__XXX
 SG_ AuxI_O25 : 0|2@1+ (1,0) [0|3] "" Vector__XXX
 SG_ AuxI_O26 : 0|2@1+ (1,0) [0|3] "" Vector__XXX
 SG_ AuxI_O27 : 0|2@1+ (1,0) [0|3] "" Vector__XXX
 SG_ AuxI_O28 : 0|2@1+ (1,0) [0|3] "" Vector__XXX
 SG_ AuxI_O21 : 0|2@1+ (1,0) [0|3] "" Vector__XXX
 SG_ AuxI_O22 : 0|2@1+ (1,0) [0|3] "" Vector__XXX
 SG_ AuxI_O23 : 0|2@1+ (1,0) [0|3] "" Vector__XXX
 SG_ AuxI_O24 : 0|2@1+ (1,0) [0|3] "" Vector__XXX
 SG_ AuxI_O17 : 0|2@1+ (1,0) [0|3] "" Vector__XXX
 SG_ AuxI_O18 : 0|2@1+ (1,0) [0|3] "" Vector__XXX
 SG_ AuxI_O19 : 0|2@1+ (1,0) [0|3] "" Vector__XXX
 SG_ AuxI_O20 : 0|2@1+ (1,0) [0|3] "" Vector__XXX
 SG_ AuxI_O77 : 0|2@1+ (1,0) [0|3] "" Vector__XXX
 SG_ AuxI_O78 : 0|2@1+ (1,0) [0|3] "" Vector__XXX
 SG_ AuxI_O79 : 0|2@1+ (1,0) [0|3] "" Vector__XXX
 SG_ AuxI_O80 : 0|2@1+ (1,0) [0|3] "" Vector__XXX
 SG_ AuxI_O73 : 0|2@1+ (1,0) [0|3] "" Vector__XXX
 SG_ AuxI_O74 : 0|2@1+ (1,0) [0|3] "" Vector__XXX
 SG_ AuxI_O75 : 0|2@1+ (1,0) [0|3] "" Vector__XXX
 SG_ AuxI_O76 : 0|2@1+ (1,0) [0|3] "" Vector__XXX
 SG_ AuxI_O69 : 0|2@1+ (1,0) [0|3] "" Vector__XXX
 SG_ AuxI_O70 : 0|2@1+ (1,0) [0|3] "" Vector__XXX
 SG_ AuxI_O71 : 0|2@1+ (1,0) [0|3] "" Vector__XXX
 SG_ AuxI_O72 : 0|2@1+ (1,0) [0|3] "" Vector__XXX
 SG_ AuxI_O65 : 0|2@1+ (1,0) [0|3] "" Vector__XXX
 SG_ AuxI_O66 : 0|2@1+ (1,0) [0|3] "" Vector__XXX
 SG_ AuxI_O67 : 0|2@1+ (1,0) [0|3] "" Vector__XXX
 SG_ AuxI_O68 : 0|2@1+ (1,0) [0|3] "" Vector__XXX
 SG_ AuxI_O61 : 0|2@1+ (1,0) [0|3] "" Vector__XXX
 SG_ ParameterGroupNumber : 0|24@1+ (1,0) [0|16777215] "" Vector__XXX
 SG_ EngPercentLoadAtCurrentSpeed : 0|8@1+ (1,0) [0|250] "%" Vector__XXX
 SG_ WheelBasedVehicleSpeed : 0|16@1+ (0.0039062485409696,0) [0|250.996] "km/h" Vector__XXX

CM_ SG_ 3221225472 KneelingRqLeftSide "Command signal to activate the kneeling functionality on the left side of the vehicle";
CM_ SG_ 3221225472 AutomaticTractionHelp "This signal enables the traction help (load transfer) in case of an active ASR function";
CM_ SG_ 3221225472 MemoryLevel "Signal which indicates that the air suspension control has memory levels selected or stored.";
CM_ SG_ 3221225472 SuspensionCtrlRefusalInformation "Signal which indicates that the air suspension control cannot perform a request due to the operating conditions. It also";
CM_ SG_ 3221225472 SpeedDependantLevelCtrlStatus "This parameter indicates if the function Speed Dependant Level Control is active. The function is activated by SPN 5295.";
CM_ SG_ 3221225472 AllwLevelCtrlDuringBrakingStatus "This parameter indicates if the function Allow Level Control During Braking is active. Functions is activated by SPN 5293.";
CM_ SG_ 3221225472 SuspensionRemoteCtrl2 "Signal which indicates that the suspension system is controlled by remote control #2. Remote control is an external unit to";
CM_ SG_ 3221225472 SuspensionRemoteCtrl1 "Signal which indicates that the suspension system is controlled by remote control #1. Remote control is an external unit to";
CM_ SG_ 3221225472 RearAxleInBumperRange "Signal which indicates that the vehicle height at the rear axle (SPNs 1723 and 1724) is within the bumper range.";
CM_ SG_ 3221225472 FrontAxleInBumperRange "Signal which indicates that the vehicle height at the front axle (SPNs 1721 and 1722) is within the bumper range.";
CM_ SG_ 3221225472 DoorRelease "Signal which indicates that the doors may be opened. [Please note: doors instead of door!]";
CM_ SG_ 3221225472 VehicleMotionInhibit "Signal which indicates whether vehicle motion is inhibited.";
CM_ SG_ 3221225472 SecurityDevice "The signal which indicates the status of the security device. An example of a security device is a curbstone feeler";
CM_ SG_ 3221225472 LevelCtrlMode "Signal which indicates the actual control mode of the air suspension system";
CM_ SG_ 3221225472 KneelingInformation "Signal which indicates the actual level change in case of kneeling function";
CM_ SG_ 3221225472 LiftingCtrlModeRearAxle "Signal which indicates the actual lifting level change at the rear axle";
CM_ SG_ 3221225472 LiftingCtrlModeFrontAxle "Signal which indicates the actual lifting level change at the front axle";
CM_ SG_ 3221225472 LoweringCtrlModeRearAxle "Signal which indicates the actual lowering level change at the rear axle";
CM_ SG_ 3221225472 LoweringCtrlModeFrontAxle "Signal which indicates the actual lowering level change at the front axle";
CM_ SG_ 3221225472 AboveNominalLevelRearAxle "Signal which indicates whether the actual height of the rear axle is above the nominal (desired) level of the rear axle. For";
CM_ SG_ 3221225472 AboveNominalLevelFrontAxle "Signal which indicates whether the actual height of the front axle is above the nominal (desired) level of the front axle. For";
CM_ SG_ 3221225472 BelowNominalLevelRearAxle "Signal which indicates whether the actual height of the rear axle is below the nominal (desired) level for the rear axle. For";
CM_ SG_ 3221225472 BelowNominalLevelFrontAxle "Signal which indicates whether the actual height of the front axle is below the nominal (desired) level for the front axle. For";
CM_ SG_ 3221225472 NominalLevelRearAxle "Signal which indicates the nominal (desired) height of the rear axle to be controlled by the suspension system.";
CM_ SG_ 3221225472 NominalLevelFrontAxle "Signal which indicates the nominal (desired) height of the front axle to be controlled by the suspension system.";
CM_ SG_ 3221225472 Alt4Status "Alternator 4 operating status.";
CM_ SG_ 3221225472 Alt3Status "Alternator 3 operating status.";
CM_ SG_ 3221225472 Alt2Status "Alternator 2 operating status.";
CM_ SG_ 3221225472 Alt1Status "Alternator 1 operating status.";
CM_ SG_ 3221225472 AltSpeed "Actual rotation speed of the alternator.";
CM_ SG_ 3221225472 AuxAbsPressReading "Identifies the current absolute pressure (relative to 0 pressure) that is configured uniquely per application. Not to be used";
CM_ SG_ 3221225472 AuxGagePressReading1 "Identifies the current gage pressure (relative to atmosphere) that is configured uniquely per application. Not to be used in";
CM_ SG_ 3221225472 AuxVacuumPressReading "Identifies the current vacuum pressure (relative to atmosphere) that is configured uniquely per application. Not to be used";
CM_ SG_ 3221225472 SpecificHumidity "Specific humidity of the ambient intake air.";
CM_ SG_ 3221225472 SolarSensorMax "This is the maximum value which can be reported by the sensor for the solar intensity. (This is a configuration parameter)";
CM_ SG_ 3221225472 SolarIntensityPercent "This is the solar radiation (power density) falling on the vehicle in percent of the maximum sensor value (SPN 2611).";
CM_ SG_ 3221225472 TestType "Identifies the non-continously monitored component identifier that was tested.";
CM_ SG_ 3221225472 FlashRedStopLamp "This parameter provides the capability to flash the RSL (SPN 3039).This parameter provides the capability to flash the RSL (SPN 3039).This parameter provides the capability to flash the RSL (SPN 3039).This parameter provides the capability to flash the RSL (SPN 3039).This parameter provides the capability to flash the RSL (SPN 3039).This parameter provides the capability to flash the RSL (SPN 3039).This parameter provides the capability to flash the RSL (SPN 3039).This parameter provides the capability to flash the RSL (SPN 3039).This parameter provides the capability to flash the RSL (SPN 3039).This parameter provides the capability to flash the RSL (SPN 3039).This parameter provides the capability to flash the RSL (SPN 3039).This parameter provides the capability to flash the RSL (SPN 3039).This parameter provides the capability to flash the RSL (SPN 3039).This parameter provides the capability to flash the RSL (SPN 3039).This parameter provides the capability to flash the RSL (SPN 3039).This parameter pro";
CM_ SG_ 3221225472 FlashProtectLamp "This parameter provides the capability to flash the engine protect lamp (SPN 3041).This parameter provides the capability to flash the engine protect lamp (SPN 3041).This parameter provides the capability to flash the engine protect lamp (SPN 3041).This parameter provides the capability to flash the engine protect lamp (SPN 3041).This parameter provides the capability to flash the engine protect lamp (SPN 3041).This parameter provides the capability to flash the engine protect lamp (SPN 3041).This parameter provides the capability to flash the engine protect lamp (SPN 3041).This parameter provides the capability to flash the engine protect lamp (SPN 3041).This parameter provides the capability to flash the engine protect lamp (SPN 3041).This parameter provides the capability to flash the engine protect lamp (SPN 3041).This parameter provides the capability to flash the engine protect lamp (SPN 3041).This parameter provides the capability to flash the engine protect lamp (SPN 3041).This parameter provides the";
CM_ SG_ 3221225472 FlashMalfuncIndicatorLamp "This parameter provides the capability to flash the MIL (SPN 3038).This parameter provides the capability to flash the MIL (SPN 3038).This parameter provides the capability to flash the MIL (SPN 3038).This parameter provides the capability to flash the MIL (SPN 3038).This parameter provides the capability to flash the MIL (SPN 3038).This parameter provides the capability to flash the MIL (SPN 3038).This parameter provides the capability to flash the MIL (SPN 3038).This parameter provides the capability to flash the MIL (SPN 3038).This parameter provides the capability to flash the MIL (SPN 3038).This parameter provides the capability to flash the MIL (SPN 3038).This parameter provides the capability to flash the MIL (SPN 3038).This parameter provides the capability to flash the MIL (SPN 3038).This parameter provides the capability to flash the MIL (SPN 3038).This parameter provides the capability to flash the MIL (SPN 3038).This parameter provides the capability to flash the MIL (SPN 3038).This parameter pro";
CM_ SG_ 3221225472 FlashAmberWarningLamp "This parameter provides the capability to flash the AWL (SPN 3040). This parameter provides the capability to flash the AWL (SPN 3040). This parameter provides the capability to flash the AWL (SPN 3040). This parameter provides the capability to flash the AWL (SPN 3040). This parameter provides the capability to flash the AWL (SPN 3040). This parameter provides the capability to flash the AWL (SPN 3040). This parameter provides the capability to flash the AWL (SPN 3040). This parameter provides the capability to flash the AWL (SPN 3040). This parameter provides the capability to flash the AWL (SPN 3040). This parameter provides the capability to flash the AWL (SPN 3040). This parameter provides the capability to flash the AWL (SPN 3040). This parameter provides the capability to flash the AWL (SPN 3040). This parameter provides the capability to flash the AWL (SPN 3040). This parameter provides the capability to flash the AWL (SPN 3040). This parameter provides the capability to flash the AWL (SPN 3040). Thi";
CM_ SG_ 3221225472 MalfunctionIndicatorLampStatus "A lamp used to relay only emissions-related trouble code information.A lamp used to relay only emissions-related trouble code information.A lamp used to relay only emissions-related trouble code information.A lamp used to relay only emissions-related trouble code information.A lamp used to relay only emissions-related trouble code information.A lamp used to relay only emissions-related trouble code information.A lamp used to relay only emissions-related trouble code information.A lamp used to relay only emissions-related trouble code information.A lamp used to relay only emissions-related trouble code information.A lamp used to relay only emissions-related trouble code information.A lamp used to relay only emissions-related trouble code information.A lamp used to relay only emissions-related trouble code information.A lamp used to relay only emissions-related trouble code information.A lamp used to relay only emissions-related trouble code information.A lamp used to relay only emissions-related trouble code ";
CM_ SG_ 3221225472 RedStopLampState "This lamp is uesed to relay trouble code information that is of a severe enought condition that it warrants stopping the vehicle.This lamp is uesed to relay trouble code information that is of a severe enought condition that it warrants stopping the vehicle.This lamp is uesed to relay trouble code information that is of a severe enought condition that it warrants stopping the vehicle.This lamp is uesed to relay trouble code information that is of a severe enought condition that it warrants stopping the vehicle.This lamp is uesed to relay trouble code information that is of a severe enought condition that it warrants stopping the vehicle.This lamp is uesed to relay trouble code information that is of a severe enought condition that it warrants stopping the vehicle.This lamp is uesed to relay trouble code information that is of a severe enought condition that it warrants stopping the vehicle.This lamp is uesed to relay trouble code information that is of a severe enought condition that it warrants stopping the";
CM_ SG_ 3221225472 AmberWarningLampStatus "This lamp is used to relay trouble code information that is reporting a problem with the vehicle system but the vehicle need
not be immediately stopped.This lamp is used to relay trouble code information that is reporting a problem with the vehicle system but the vehicle need
not be immediately stopped.This lamp is used to relay trouble code information that is reporting a problem with the vehicle system but the vehicle need
not be immediately stopped.This lamp is used to relay trouble code information that is reporting a problem with the vehicle system but the vehicle need
not be immediately stopped.This lamp is used to relay trouble code information that is reporting a problem with the vehicle system but the vehicle need
not be immediately stopped.This lamp is used to relay trouble code information that is reporting a problem with the vehicle system but the vehicle need
not be immediately stopped.This lamp is used to relay trouble code information that is reporting a problem with the vehicle system b";
CM_ SG_ 3221225472 ProtectLampStatus "This lamp is used to relay trouble code informatio that is reporting a problem with a vehicle system that is most
probably not electronic subsystem related.This lamp is used to relay trouble code informatio that is reporting a problem with a vehicle system that is most
probably not electronic subsystem related.This lamp is used to relay trouble code informatio that is reporting a problem with a vehicle system that is most
probably not electronic subsystem related.This lamp is used to relay trouble code informatio that is reporting a problem with a vehicle system that is most
probably not electronic subsystem related.This lamp is used to relay trouble code informatio that is reporting a problem with a vehicle system that is most
probably not electronic subsystem related.This lamp is used to relay trouble code informatio that is reporting a problem with a vehicle system that is most
probably not electronic subsystem related.This lamp is used to relay trouble code informatio that is reporting a problem wi";
CM_ SG_ 3221225472 DTC5 "Diagnostic Trouble CodeDiagnostic Trouble CodeDiagnostic Trouble CodeDiagnostic Trouble CodeDiagnostic Trouble CodeDiagnostic Trouble CodeDiagnostic Trouble CodeDiagnostic Trouble CodeDiagnostic Trouble CodeDiagnostic Trouble CodeDiagnostic Trouble CodeDiagnostic Trouble CodeDiagnostic Trouble CodeDiagnostic Trouble CodeDiagnostic Trouble CodeDiagnostic Trouble CodeDiagnostic Trouble CodeDiagnostic Trouble CodeDiagnostic Trouble CodeDiagnostic Trouble Code";
CM_ SG_ 3221225472 DTC4 "Diagnostic Trouble CodeDiagnostic Trouble CodeDiagnostic Trouble CodeDiagnostic Trouble CodeDiagnostic Trouble CodeDiagnostic Trouble CodeDiagnostic Trouble CodeDiagnostic Trouble CodeDiagnostic Trouble CodeDiagnostic Trouble CodeDiagnostic Trouble CodeDiagnostic Trouble CodeDiagnostic Trouble CodeDiagnostic Trouble CodeDiagnostic Trouble CodeDiagnostic Trouble CodeDiagnostic Trouble CodeDiagnostic Trouble CodeDiagnostic Trouble CodeDiagnostic Trouble Code";
CM_ SG_ 3221225472 DTC3 "Diagnostic Trouble CodeDiagnostic Trouble CodeDiagnostic Trouble CodeDiagnostic Trouble CodeDiagnostic Trouble CodeDiagnostic Trouble CodeDiagnostic Trouble CodeDiagnostic Trouble CodeDiagnostic Trouble CodeDiagnostic Trouble CodeDiagnostic Trouble CodeDiagnostic Trouble CodeDiagnostic Trouble CodeDiagnostic Trouble CodeDiagnostic Trouble CodeDiagnostic Trouble CodeDiagnostic Trouble CodeDiagnostic Trouble CodeDiagnostic Trouble CodeDiagnostic Trouble Code";
CM_ SG_ 3221225472 DTC2 "Diagnostic Trouble CodeDiagnostic Trouble CodeDiagnostic Trouble CodeDiagnostic Trouble CodeDiagnostic Trouble CodeDiagnostic Trouble CodeDiagnostic Trouble CodeDiagnostic Trouble CodeDiagnostic Trouble CodeDiagnostic Trouble CodeDiagnostic Trouble CodeDiagnostic Trouble CodeDiagnostic Trouble CodeDiagnostic Trouble CodeDiagnostic Trouble CodeDiagnostic Trouble CodeDiagnostic Trouble CodeDiagnostic Trouble CodeDiagnostic Trouble CodeDiagnostic Trouble Code";
CM_ SG_ 3221225472 OBDCompliance "Identifies the OBD compliance capabilityof the responding controller.";
CM_ SG_ 3221225472 PreviouslyActiveTroubleCodes "Identifies the number of previously active trouble codes that are present in a specific controller.";
CM_ SG_ 3221225472 ActiveTroubleCodes "Identifies the number of active trouble codes that are present in a specific controller.";
CM_ SG_ 3221225472 FreezeFrameLength "The freeze frame length shall be equal to the number of bytes in the required parameters plus the number of bytes in the
manufacturer specific parameters.";
CM_ SG_ 3221225472 WheelBasedVehicleSpeed "Speed of the vehicle as calculated from wheel or tailshaft speed.Speed of the vehicle as calculated from wheel or tailshaft speed.";
CM_ SG_ 3221225472 EngPercentLoadAtCurrentSpeed "The ratio of actual engine percent torque (indicated) to maximum indicated torque available at the current engine speed,The ratio of actual engine percent torque (indicated) to maximum indicated torque available at the current engine speed,";
CM_ SG_ 3221225472 ExpandedFreezeFrameLength "The freeze frame length shall be equal to the number of bytes in the required parameters plus the number of bytes in the
manufacturer specific parameters.";
CM_ SG_ 3221225472 SPNSupported1High "This parameter defines the SPN(s) that is/are supported for the freeze frame and/or data stream information.";
CM_ SG_ 3221225472 SPNSupportTypeSTR3 "This parameter defines whether the applicable parameter (that is the SPN) is supported in the freeze frame, the data stream or both the freeze frame and data stream.";
CM_ SG_ 3221225472 SPNSupportTypeSTR2 "This parameter defines whether the applicable parameter (that is the SPN) is supported in the freeze frame, the data stream or both the freeze frame and data stream.";
CM_ SG_ 3221225472 SPNSupportTypeEFF3 "This parameter defines whether the applicable parameter (that is the SPN) is supported in the freeze frame, the data stream or both the freeze frame and data stream.";
CM_ SG_ 3221225472 SPNSupportTypeEFF2 "This parameter defines whether the applicable parameter (that is the SPN) is supported in the freeze frame, the data stream or both the freeze frame and data stream.";
CM_ SG_ 3221225472 SPNSupportTypeDS3 "This parameter defines whether the applicable parameter (that is the SPN) is supported in the freeze frame, the data stream or both the freeze frame and data stream.";
CM_ SG_ 3221225472 SPNSupportTypeDS2 "This parameter defines whether the applicable parameter (that is the SPN) is supported in the freeze frame, the data stream or both the freeze frame and data stream.";
CM_ SG_ 3221225472 SPNSupported3High "This parameter defines the SPN(s) that is/are supported for the freeze frame and/or data stream information.";
CM_ SG_ 3221225472 SPNSupported2High "This parameter defines the SPN(s) that is/are supported for the freeze frame and/or data stream information.";
CM_ SG_ 3221225472 SPNSupported3 "This parameter defines the SPN(s) that is/are supported for the freeze frame and/or data stream information.";
CM_ SG_ 3221225472 SPNSupported2 "This parameter defines the SPN(s) that is/are supported for the freeze frame and/or data stream information.";
CM_ SG_ 3221225472 SPNDataLength3 "The number of data bytes associated with the SPN in the Freeze Frame.";
CM_ SG_ 3221225472 SPNSupportTypeSTR1 "This parameter defines whether the applicable parameter (that is the SPN) is supported in the freeze frame, the data stream or both the freeze frame and data stream.";
CM_ SG_ 3221225472 SPNSupportTypeDS1 "This parameter defines whether the applicable parameter (that is the SPN) is supported in the freeze frame, the data stream or both the freeze frame and data stream.";
CM_ SG_ 3221225472 SPNSupportTypeEFF1 "This parameter defines whether the applicable parameter (that is the SPN) is supported in the freeze frame, the data stream or both the freeze frame and data stream.";
CM_ SG_ 3221225472 SPNDataLength2 "The number of data bytes associated with the SPN in the Freeze Frame.";
CM_ SG_ 3221225472 SPNDataLength1 "The number of data bytes associated with the SPN in the Freeze Frame.";
CM_ SG_ 3221225472 SPNSupported1 "This parameter defines the SPN(s) that is/are supported for the freeze frame and/or data stream information.";
CM_ SG_ 3221225472 TimeSinceDTCsCleared "Time accumulated since DTCs were cleared (via an external test equipment or possibly, a battery disconnect) (SPN=?).";
CM_ SG_ 3221225472 MinutesRunByEngineMILActivated "Accumulated count (in minutes) while the MIL is activated (on) (SPN=?).";
CM_ SG_ 3221225472 DistanceSinceDTCsCleared "Distance accumulated since DTCs were cleared (SPN=?).";
CM_ SG_ 3221225472 DistanceWhileMILisActivated "The kilometers accumulated while the MIL is activated (SPN 3060).";
CM_ SG_ 3221225472 ApplSysMonitorDenominator "The number of times a vehicle has been operated that constitutes a driving cycle where this Applicable System Monitor could be operated per regulatory requirements (SPN 3068).";
CM_ SG_ 3221225472 ApplSysMonitorNumerator "The number of times a vehicle has been operated such that all conditions necessary for the Applicable System Monitor to detect a malfunction have been encountered (SPN 3067).";
CM_ SG_ 3221225472 SPNofApplSysMonitor "Contain the SPN of the system monitor for which Monitor ratio is being reported (SPN 3066).";
CM_ SG_ 3221225472 OBDMonitoringCondEncountered "Displays the number of times that the vehicle has been operated in the specified OBD monitoring conditions (SPN 3049).";
CM_ SG_ 3221225472 IgnitionCycleCounter "A single counter that defines the number of ignition cycles (SPN 3048).";
CM_ SG_ 3221225472 NumberOfOccurance "Number of occurance of raw binary data";
CM_ SG_ 3221225472 ErrorIndicator "Error Indicator/EDC Parameter";
CM_ SG_ 3221225472 KeyOrUserLevel "Key/User Level";
CM_ SG_ 3221225472 NumberRequested "Length/Number Requested";
CM_ SG_ 3221225472 NumberRequestedHigh "Length/Number Requested";
CM_ SG_ 3221225472 HoldSignal "Indicator to all nodes that the communication ports that have been acted upon by the 'Stop start broadcast'
PGN are remaining in the modified state.";
CM_ SG_ 3221225472 J1939Network3 "Identifies the action to be performed on the SAE J1939 Network #3.";
CM_ SG_ 3221225472 J1939Network2 "Identifies the action to be performed on the SAE J1939 Network #2.";
CM_ SG_ 3221225472 ISO9141 "Identifies the action to be performed on the ISO9141 communications port.";
CM_ SG_ 3221225472 SAE_J1850 "Identifies the action to be performed on the SAE J1850 communications port.";
CM_ SG_ 3221225472 ManufacturerSpecificPort "Identifies the action to be performed on 'Other, manufacturer specific port' communications port.";
CM_ SG_ 3221225472 CurrentDataLink "Identifies the action to be performed on the communications port that this parameter was received.";
CM_ SG_ 3221225472 SAE_J1587 "Identifies the action to be performed on the SAE J1587 communications port.";
CM_ SG_ 3221225472 SAE_J1922 "Identifies the action to be performed on the SAE J1922 communications port.";
CM_ SG_ 3221225472 J1939Network1 "Identifies the action to be performed on the SAE J1939 Network #1, Primary vehicle communications port.";
CM_ SG_ 3221225472 TestIdentifierSupported "Indicates the test identifiers that the controller supports.";
CM_ SG_ 3221225472 UtlityOverallPowerFactorLagging "Lead/lag status for utility incomer average power factor.";
CM_ SG_ 3221225472 UtilityOverallPowerFactor "The average power factor of the utility incomer.";
CM_ SG_ 3221225472 UtilityTotalReactivePower "The total reactive power delivered by the utility incomer";
CM_ SG_ 3221225472 UtilityTotalApparentPower "The total apparent power delivered by the utility incomer.";
CM_ SG_ 3221225472 UtilityTotalRealPower "Total real power delivered by the utility incomer.";
CM_ SG_ 3221225472 UtilityTotalKWHoursImport "The total kilowatt-hours that have been imported by the utility incomer.";
CM_ SG_ 3221225472 UtilityTotalKWHoursExport "The total kilowatt-hours that have been exported by the utility incomer.";
CM_ SG_ 3221225472 UtilityPhaseCPowerFactorLagging "Lead/lag status for utility incomer phase C power factor.";
CM_ SG_ 3221225472 UtilityPhaseCPowerFactor "The power factor of phases C of the utility incomer.";
CM_ SG_ 3221225472 UtilityPhaseCReactivePower "The reactive power delivered by phase C of the utility incomer";
CM_ SG_ 3221225472 UtilityPhaseCApparentPower "The apparent power delivered by phase C of the utility incomer.";
CM_ SG_ 3221225472 UtilityPhaseCRealPower "The real power delivered by phase C of the utility incomer.";
CM_ SG_ 3221225472 UtilityPhaseCACRMSCurrent "RMS current measured at the utility incomer phase C.";
CM_ SG_ 3221225472 UtilityPhaseCACFrequency "AC frequency measured at the utility incomer phase C.";
CM_ SG_ 3221225472 UtltyPhsCLneNeutralACRMSVoltage "Line to Neutral RMS voltage measured at the utility incomer phase C.";
CM_ SG_ 3221225472 UtltyPhseCALineLineACRMSVoltage "Line to Line RMS voltage measured at the utility incomer phase CA.";
CM_ SG_ 3221225472 UtilityPhaseBPowerFactorLagging "Lead/lag status for utility incomer phase B power factor.";
CM_ SG_ 3221225472 UtilityPhaseBPowerFactor "The power factor of phases B of the utility incomer.";
CM_ SG_ 3221225472 UtilityPhaseBReactivePower "The reactive power delivered by phase B of the utility incomer";
CM_ SG_ 3221225472 UtilityPhaseBApparentPower "The apparent power delivered by phase B of the utility incomer.";
CM_ SG_ 3221225472 UtilityPhaseBRealPower "The real power delivered by phase B of the utility incomer.";
CM_ SG_ 3221225472 UtilityPhaseBACRMSCurrent "RMS current measured at the utility incomer phase B.";
CM_ SG_ 3221225472 UtilityPhaseBACFrequency "AC frequency measured at the utility incomer phase B.";
CM_ SG_ 3221225472 UtltyPhsBLneNeutralACRMSVoltage "Line to Neutral RMS voltage measured at the utility incomer phase B.";
CM_ SG_ 3221225472 UtltyPhseBCLineLineACRMSVoltage "Line to Line RMS voltage measured at the utility incomer phase BC.";
CM_ SG_ 3221225472 UtilityPhaseAPowerFactorLagging "Lead/lag status for utility incomer phase A power factor.";
CM_ SG_ 3221225472 UtilityPhaseAPowerFactor "The power factor of phase A of the utility incomer.";
CM_ SG_ 3221225472 UtilityPhaseAReactivePower "The reactive power delivered by phase A of the utility incomer";
CM_ SG_ 3221225472 UtilityPhaseAApparentPower "The apparent power delivered by phase A of the utility incomer.";
CM_ SG_ 3221225472 UtilityPhaseARealPower "The real power delivered by phase A of the utility incomer.";
CM_ SG_ 3221225472 UtilityPhaseAACRMSCurrent "RMS current measured at the utility incomer phase A.";
CM_ SG_ 3221225472 UtilityPhaseAACFrequency "AC frequency measured at the utility incomer phase A.";
CM_ SG_ 3221225472 UtltyPhsALneNeutralACRMSVoltage "Line to Neutral RMS voltage measured at the utility incomer phase A.";
CM_ SG_ 3221225472 UtltyPhseABLineLineACRMSVoltage "Line to Line RMS voltage measured at the utility incomer phase AB.";
CM_ SG_ 3221225472 UtilityAverageACRMSCurrent "Average RMS current measured at the utility incomer.";
CM_ SG_ 3221225472 UtilityAverageACFrequency "Average AC frequency measured at the utility incomer.";
CM_ SG_ 3221225472 UtltyAvrgLneNeutralACRMSVoltage "The average Line to Neutral AC RMS voltage measured at the utility incomer .";
CM_ SG_ 3221225472 UtltyAvrageLineLineACRMSVoltage "Average Line to Line RMS voltage measured at the utility incomer .";
CM_ SG_ 3221225472 GnrtorOverallPowerFactorLagging "Lead/lag status for generator average power factor.";
CM_ SG_ 3221225472 GeneratorOverallPowerFactor "The average power factor of the generator.";
CM_ SG_ 3221225472 GeneratorTotalReactivePower "The total reactive power delivered by the generator";
CM_ SG_ 3221225472 GeneratorTotalApparentPower "The total apparent power delivered by the generator.";
CM_ SG_ 3221225472 GeneratorTotalRealPower "Total real power delivered by the generator.";
CM_ SG_ 3221225472 GeneratorTotalKWHoursImport "The total kilowatt-hours that have been imported by the generator.";
CM_ SG_ 3221225472 GeneratorTotalKWHoursExport "The total kilowatt-hours that have been exported by the generator.";
CM_ SG_ 3221225472 GnratorPhaseCPowerFactorLagging "Lead/lag status for generator phase C power factor.";
CM_ SG_ 3221225472 GeneratorPhaseCPowerFactor "The power factor of phases C of the generator.";
CM_ SG_ 3221225472 GeneratorPhaseCReactivePower "The reactive power delivered by phase C of the generator";
CM_ SG_ 3221225472 GeneratorPhaseCApparentPower "The apparent power delivered by phase C of the generator.";
CM_ SG_ 3221225472 GeneratorPhaseCRealPower "The real power delivered by phase C of the generator.";
CM_ SG_ 3221225472 GeneratorPhaseCACRMSCurrent "RMS current measured at the generator phase C output.";
CM_ SG_ 3221225472 GeneratorPhaseCACFrequency "AC frequency measured at the generator phase C output.";
CM_ SG_ 3221225472 GnrtrPhsCLneNeutralACRMSVoltage "Line to Neutral RMS voltage measured at the generator phase C output.";
CM_ SG_ 3221225472 GnrtrPhseCALineLineACRMSVoltage "Line to Line RMS voltage measured at the generator phase CA output.";
CM_ SG_ 3221225472 GnratorPhaseBPowerFactorLagging "Lead/lag status for generator phase B power factor.";
CM_ SG_ 3221225472 GeneratorPhaseBPowerFactor "The power factor of phases B of the generator.";
CM_ SG_ 3221225472 GeneratorPhaseBReactivePower "The reactive power delivered by phase B of the generator";
CM_ SG_ 3221225472 GeneratorPhaseBApparentPower "The apparent power delivered by phase B of the generator.";
CM_ SG_ 3221225472 GeneratorPhaseBRealPower "The real power delivered by phase B of the generator.";
CM_ SG_ 3221225472 GeneratorPhaseBACRMSCurrent "RMS current measured at the generator phase B output.";
CM_ SG_ 3221225472 GeneratorPhaseBACFrequency "AC frequency measured at the generator phase B output.";
CM_ SG_ 3221225472 GnrtrPhsBLneNeutralACRMSVoltage "Line to Neutral RMS voltage measured at the generator phase B output.";
CM_ SG_ 3221225472 GnrtrPhseBCLineLineACRMSVoltage "Line to Line RMS voltage measured at the generator phase BC output.";
CM_ SG_ 3221225472 GnratorPhaseAPowerFactorLagging "Lead/lag status for generator phase A power factor.";
CM_ SG_ 3221225472 GeneratorPhaseAPowerFactor "The power factor of phase A of the generator.";
CM_ SG_ 3221225472 GeneratorPhaseAReactivePower "The reactive power delivered by phase A of the generator";
CM_ SG_ 3221225472 GeneratorPhaseAApparentPower "The apparent power delivered by phase A of the generator.";
CM_ SG_ 3221225472 GeneratorPhaseARealPower "The real power delivered by phase A of the generator.";
CM_ SG_ 3221225472 GeneratorPhaseAACRMSCurrent "RMS current measured at the generator phase A output.";
CM_ SG_ 3221225472 GeneratorPhaseAACFrequency "AC frequency measured at the generator phase A output.";
CM_ SG_ 3221225472 GnrtrPhsALneNeutralACRMSVoltage "Line to Neutral RMS voltage measured at the generator phase A output.";
CM_ SG_ 3221225472 GnrtrPhseABLineLineACRMSVoltage "Line to Line RMS voltage measured at the generator phase AB output.";
CM_ SG_ 3221225472 GeneratorAverageACRMSCurrent "Average RMS current measured at the generator output.";
CM_ SG_ 3221225472 GeneratorAverageACFrequency "Average AC frequency measured at the generator output.";
CM_ SG_ 3221225472 GnrtrAvrgLneNeutralACRMSVoltage "The average Line to Neutral AC RMS voltage measured at the Generator output.";
CM_ SG_ 3221225472 GnrtrAvrageLineLineACRMSVoltage "Average Line to Line RMS voltage measured at the generator output.";
CM_ SG_ 3221225472 Bus1_UtilityACPhaseDifference "The phase difference between the Bus #1 voltage and Utility voltage.";
CM_ SG_ 3221225472 Bus1_UtilityInSync "Indicator of whether Bus #1 and Utility are properly synchronized for paralleling. This indicator will be based on parameters such as Voltage Match, Frequency Match, and Phase Match.";
CM_ SG_ 3221225472 Bus1_UtilityVoltageMatch "Indicator of whether voltage difference between Bus #1 and Utility is adequate for paralleling. This indicator will be based on the measured AC voltages qualified using parameters such as Voltage Tolerance.";
CM_ SG_ 3221225472 Bus1_UtilityFrequencyMatch "Indicator of whether frequency difference between Bus #1 and Utility is adequate for paralleling. This indicator will be based on the measured AC frequencies qualified using parameters such as Frequency Tolerance, Phase Tolerance, and Dwell Time.";
CM_ SG_ 3221225472 Bus1_UtilityPhaseMatch "Indicator of whether phase difference between Bus #1 and Utility is adequate for paralleling. This indicator will be based on the measured AC phase difference qualified using parameters such as Phase Tolerance and Dwell Time.";
CM_ SG_ 3221225472 Bus1_UtilityDeadBus "Indicator of whether Bus #1 is considered dead for closing to the utility. This indicator will be based on parameters such as Bus #1 Voltage and dead bus threshold values.";
CM_ SG_ 3221225472 Bus1PhaseCACFrequency "AC frequency measured at bus #1 phase C.";
CM_ SG_ 3221225472 Bs1PhseCLineNeutralACRMSVoltage "Line to Neutral RMS voltage measured at bus #1 phase C.";
CM_ SG_ 3221225472 Bus1PhaseCALineLineACRMSVoltage "Line to Line RMS voltage measured at bus #1 phase CA.";
CM_ SG_ 3221225472 Bus1PhaseBACFrequency "AC frequency measured at bus #1 phase B.";
CM_ SG_ 3221225472 Bs1PhseBLineNeutralACRMSVoltage "Line to Neutral RMS voltage measured at bus #1 phase B.";
CM_ SG_ 3221225472 Bus1PhaseBCLineLineACRMSVoltage "Line to Line RMS voltage measured at bus #1 phase BC.";
CM_ SG_ 3221225472 Bus1PhaseAACFrequency "AC frequency measured at bus #1 phase A.";
CM_ SG_ 3221225472 Bs1PhseALineNeutralACRMSVoltage "Line to Neutral RMS voltage measured at bus #1 phase A.";
CM_ SG_ 3221225472 Bus1PhaseABLineLineACRMSVoltage "Line to Line RMS voltage measured at bus #1 phase AB.";
CM_ SG_ 3221225472 Bus1_GeneratorACPhaseDifference "The phase difference between the Bus #1 voltage and Generator voltage.";
CM_ SG_ 3221225472 Bus1_GeneratorInSync "Indicator of whether Bus #1 and Generator are properly synchronized for paralleling. This indicator will be based on parameters such as Voltage Match, Frequency Match, and Phase Match.";
CM_ SG_ 3221225472 Bus1_GeneratorVoltageMatch "Indicator of whether voltage difference between Bus #1 and Generator is adequate for paralleling. This indicator will be based on the measured AC voltages qualified using parameters such as Voltage Tolerance.";
CM_ SG_ 3221225472 Bus1_GeneratorFrequencyMatch "Indicator of whether frequency difference between Bus #1 and Generator is adequate for paralleling. This indicator will be based on the measured AC frequencies qualified using parameters such as Frequency Tolerance, Phase Tolerance, and Dwell Time.";
CM_ SG_ 3221225472 Bus1_GeneratorPhaseMatch "Indicator of whether phase difference between Bus #1 and Generator is adequate for paralleling. This indicator will be based on the measured AC phase difference qualified using parameters such as Phase Tolerance and Dwell Time.";
CM_ SG_ 3221225472 Bus1_GeneratorDeadBus "Indicator of whether Bus #1 is considered dead for closing to the generator. This indicator will be based on parameters such as Bus #1 Voltage and dead bus threshold values.";
CM_ SG_ 3221225472 Bus1AverageACFrequency "Average AC frequency measured at bus #1.";
CM_ SG_ 3221225472 Bs1AvrgeLineNeutralACRMSVoltage "The average Line to Neutral AC RMS voltage measured at bus #1 .";
CM_ SG_ 3221225472 Bus1AverageLineLineACRMSVoltage "Average Line to Line RMS voltage measured at bus #1 .";
CM_ SG_ 3221225472 AddressAssignment "The source address that is to be assigned to the CA that has the NAME corresponding to the one conveyed in the first eight bytes of this Commanded Address message.";
CM_ SG_ 3221225472 ShrtNameOfActualReportingDevice "Short name of reporting device of the requested PGN via the Transfer PGN.";
CM_ SG_ 3221225472 LengthOfDataForTheReportedPGN "Length of data reported with the associated PGN via the Transfer PGN.";
CM_ SG_ 3221225472 PGNofRequstedInformation "PGN associated with this transfer message";
CM_ SG_ 3221225472 TotalNumberOfPacketsEoMA "Total number of packets for BAM message.Total number of packets received for RTS/CTS message.Total number of packets for RTS/CTS message.";
CM_ SG_ 3221225472 TotalMessageSizeEoMA "Total message size (in bytes) for BAM message.Total message size (in bytes) for RTS/CTS message.Total message size (in bytes) for RTS/CTS message.";
CM_ SG_ 3221225472 TotalMessageSizeBAM "Total message size (in bytes) for BAM message.Total message size (in bytes) for RTS/CTS message.Total message size (in bytes) for RTS/CTS message.";
CM_ SG_ 3221225472 TotalNumberOfPacketsBAM "Total number of packets for BAM message.Total number of packets received for RTS/CTS message.Total number of packets for RTS/CTS message.";
CM_ SG_ 3221225472 ConnectionAbortReason "Reason for connection abort message.";
CM_ SG_ 3221225472 NextPacketNumberToBeSent "Next Packet Number to be sent (TP.CM_CTS)";
CM_ SG_ 3221225472 NumberOfPacketsThatCanBeSent "Number of Packets that can be sent (TP.CM_CTS)";
CM_ SG_ 3221225472 MaximumNumberOfPackets "Maximum number of packets for RTS/CTS message.";
CM_ SG_ 3221225472 TotalNumberOfPackets "Total number of packets for BAM message.Total number of packets received for RTS/CTS message.Total number of packets for RTS/CTS message.";
CM_ SG_ 3221225472 TotalMessageSize "Total message size (in bytes) for BAM message.Total message size (in bytes) for RTS/CTS message.Total message size (in bytes) for RTS/CTS message.";
CM_ SG_ 3221225472 UseTransferMode "Requester is to respond via the Transfer PGN";
CM_ SG_ 3221225472 ParameterGroupNumber "PGN which is requested by Request2 messagePGN which is requested by Request2 messagePGN which is requested by Request2 message";
CM_ SG_ 3221225472 AxleGroupWeight "Total mass imposed on the road surface by all the tires in the axle group";
CM_ SG_ 3221225472 AxleGroupLocation "Specific axle group used in conjunction with and when communicating the axle group weight, listed from the front of theSpecific axle group used in conjunction with and when communicating the axle group calibration, listed from the front of";
CM_ SG_ 3221225472 AxleGroupFullWeightCalib "The full weight calibration measurement of an axle group";
CM_ SG_ 3221225472 AxleGroupEmptyWeightCalib "The empty weight calibration measurement of an axle group";
CM_ SG_ 3221225472 DsrdAftrclrClntThermostatOpening "Used to transmit the desired position of the low temperature aftercooler temperature control valve. 0% represents the";
CM_ SG_ 3221225472 DsrdAftercoolerCoolantIntakeTemp "Indicates the desired temperature of the fluid in the low temperature aftercooler circuit to an electronic thermostat. If the";
CM_ SG_ 3221225472 AftercoolerCoolantThermostatMode "Specifies if the aftercooler coolant thermostat valve will operate in temperature control mode or position control mode.";
CM_ SG_ 3221225472 AddtnlTrlrAxlGrupWeightAvailable "Indicates the availability of the additional trailer axle group for purposes of weight measurement";
CM_ SG_ 3221225472 TrailerHAxleGroupWeightAvailable "Indicates the availability of the trailer H axle group for purposes of weight measurement";
CM_ SG_ 3221225472 TrailerGAxleGroupWeightAvailable "Indicates the availability of the trailer G axle group for purposes of weight measurement";
CM_ SG_ 3221225472 TrailerFAxleGroupWeightAvailable "Indicates the availability of the trailer F axle group for purposes of weight measurement";
CM_ SG_ 3221225472 TrailerEAxleGroupWeightAvailable "Indicates the availability of the trailer E axle group for purposes of weight measurement";
CM_ SG_ 3221225472 TrailerDAxleGroupWeightAvailable "Indicates the availability of the trailer D axle group for purposes of weight measurement";
CM_ SG_ 3221225472 TrailerCAxleGroupWeightAvailable "Indicates the availability of the trailer C axle group for purposes of weight measurement";
CM_ SG_ 3221225472 TrailerBAxleGroupWeightAvailable "Indicates the availability of the trailer B axle group for purposes of weight measurement";
CM_ SG_ 3221225472 TrailerAAxleGroupWeightAvailable "Indicates the availability of the trailer A axle group for purposes of weight measurement";
CM_ SG_ 3221225472 AddtnlTrctrAxlGrpWeightAvailable "Indicates the availability of the additional tractor axle group for purposes of weight measurement";
CM_ SG_ 3221225472 TagAxleGroupWeightAvailable "Indicates the availability of the tag axle group for purposes of weight measurement";
CM_ SG_ 3221225472 DriveAxleGroupWeightAvailable "Indicates the availability of the drive axle group for purposes of weight measurement";
CM_ SG_ 3221225472 LiftAxleGroupWeightAvailable "Indicates the availability of the lift axle group for purposes of weight measurement";
CM_ SG_ 3221225472 SteerAxleGroupWeightAvailable "Indicates the availability of the steer axle group for purposes of weight measurement";
CM_ SG_ 3221225472 ZeroNetVehicleWeightChange "Zero Net Vehicle Weight Change command. A controller receiving this command will record the current Gross";
CM_ SG_ 3221225472 EngExhaustGasTempAverageBank2 "The calculated average temperature based upon all of the Bank 2 (right bank) engine exhaust port temperatures. This is";
CM_ SG_ 3221225472 EngExhaustGasTempAverageBank1 "The calculated average temperature based upon all of the Bank 1 (left bank) engine exhaust port temperatures. This is";
CM_ SG_ 3221225472 EngExhaustGasTempAverage "The calculated average temperature based upon all of the engine exhaust port temperatures. This is the average";
CM_ SG_ 3221225472 PermanentDTCs "Identifies the current number of permanent DTCs";
CM_ SG_ 3221225472 PreviouslyMILOnDTCs "Identifies the current number of previously MIL-On DTCs";
CM_ SG_ 3221225472 MILOnDTCs "Identifies the current number of MIL-On DTCs";
CM_ SG_ 3221225472 AllPendingDTCs "Identifies the current total number of pending DTCs, including emission related";
CM_ SG_ 3221225472 PendingDTCs "Identifies the current number of emission related pending DTCs";
CM_ SG_ 3221225472 AETCSpeedValue "Engine speed value of the data points in PGN 64912 – Advertised Engine Torque Curve (AETC).";
CM_ SG_ 3221225472 AETCTorqueValue "Engine torque value of the data points in PGN 64912 – Advertised Engine Torque Curve (AETC).";
CM_ SG_ 3221225472 NumberOfAETCDataPoints "Indicates the number of speed / torque data points contained in the Advertised Engine Torque Curve broadcast (AETC).";
CM_ SG_ 3221225472 AETCDataCollectionStandard "Indicates the standardized method by which torque data was obtained for the Advertised Engine Torque Curve (AETC).";
CM_ SG_ 3221225472 RightHeadlampLightDistribution "This parameter indicates what kind of light distribution is set by the AFS system for the right headlamp.";
CM_ SG_ 3221225472 LeftHeadlampLightDistribution "This parameter indicates what kind of light distribution is set by the AFS system for the left headlamp.";
CM_ SG_ 3221225472 RightHeadlampDynamicBendingLight "This parameter indicates whether the dynamic bending light of the left headlamp is working properly.";
CM_ SG_ 3221225472 LeftHeadlampDynamicBendingLight "This parameter indicates whether the dynamic bending light of the left headlamp is working properly.";
CM_ SG_ 3221225472 AuxI_OChannel2 "Auxiliary channel of data (16 bit) read by the ECU. This data is in A/D counts and is manufacturer specific. It may be";
CM_ SG_ 3221225472 AuxI_OChannel1 "Auxiliary channel of data (16 bit) read by the ECU. This data is in A/D counts and is manufacturer specific. It may be";
CM_ SG_ 3221225472 AuxI_O13 "Identifies the current status of auxiliary input/output functions that are configured uniquely per application.";
CM_ SG_ 3221225472 AuxI_O14 "Identifies the current status of auxiliary input/output functions that are configured uniquely per application.";
CM_ SG_ 3221225472 AuxI_O15 "Identifies the current status of auxiliary input/output functions that are configured uniquely per application.";
CM_ SG_ 3221225472 AuxI_O16 "Identifies the current status of auxiliary input/output functions that are configured uniquely per application.";
CM_ SG_ 3221225472 AuxI_O09 "Identifies the current status of auxiliary input/output functions that are configured uniquely per application.";
CM_ SG_ 3221225472 AuxI_O10 "Identifies the current status of auxiliary input/output functions that are configured uniquely per application.";
CM_ SG_ 3221225472 AuxI_O11 "Identifies the current status of auxiliary input/output functions that are configured uniquely per application.";
CM_ SG_ 3221225472 AuxI_O12 "Identifies the current status of auxiliary input/output functions that are configured uniquely per application.";
CM_ SG_ 3221225472 AuxI_O05 "Identifies the current status of auxiliary input/output functions that are configured uniquely per application.";
CM_ SG_ 3221225472 AuxI_O06 "Identifies the current status of auxiliary input/output functions that are configured uniquely per application.";
CM_ SG_ 3221225472 AuxI_O07 "Identifies the current status of auxiliary input/output functions that are configured uniquely per application.";
CM_ SG_ 3221225472 AuxI_O08 "Identifies the current status of auxiliary input/output functions that are configured uniquely per application.";
CM_ SG_ 3221225472 AuxI_O01 "Identifies the current status of auxiliary input/output functions that are configured uniquely per application.";
CM_ SG_ 3221225472 AuxI_O02 "Identifies the current status of auxiliary input/output functions that are configured uniquely per application.";
CM_ SG_ 3221225472 AuxI_O03 "Identifies the current status of auxiliary input/output functions that are configured uniquely per application.";
CM_ SG_ 3221225472 AuxI_O04 "Identifies the current status of auxiliary input/output functions that are configured uniquely per application.";
CM_ SG_ 3221225472 AuxI_O45 "Identifies the current status of auxiliary input/output functions that are configured uniquely per application.";
CM_ SG_ 3221225472 AuxI_O46 "Identifies the current status of auxiliary input/output functions that are configured uniquely per application.";
CM_ SG_ 3221225472 AuxI_O47 "Identifies the current status of auxiliary input/output functions that are configured uniquely per application.";
CM_ SG_ 3221225472 AuxI_O48 "Identifies the current status of auxiliary input/output functions that are configured uniquely per application.";
CM_ SG_ 3221225472 AuxI_O41 "Identifies the current status of auxiliary input/output functions that are configured uniquely per application.";
CM_ SG_ 3221225472 AuxI_O42 "Identifies the current status of auxiliary input/output functions that are configured uniquely per application.";
CM_ SG_ 3221225472 AuxI_O43 "Identifies the current status of auxiliary input/output functions that are configured uniquely per application.";
CM_ SG_ 3221225472 AuxI_O44 "Identifies the current status of auxiliary input/output functions that are configured uniquely per application.";
CM_ SG_ 3221225472 AuxI_O37 "Identifies the current status of auxiliary input/output functions that are configured uniquely per application.";
CM_ SG_ 3221225472 AuxI_O38 "Identifies the current status of auxiliary input/output functions that are configured uniquely per application.";
CM_ SG_ 3221225472 AuxI_O39 "Identifies the current status of auxiliary input/output functions that are configured uniquely per application.";
CM_ SG_ 3221225472 AuxI_O40 "Identifies the current status of auxiliary input/output functions that are configured uniquely per application.";
CM_ SG_ 3221225472 AuxI_O33 "Identifies the current status of auxiliary input/output functions that are configured uniquely per application.";
CM_ SG_ 3221225472 AuxI_O34 "Identifies the current status of auxiliary input/output functions that are configured uniquely per application.";
CM_ SG_ 3221225472 AuxI_O35 "Identifies the current status of auxiliary input/output functions that are configured uniquely per application.";
CM_ SG_ 3221225472 AuxI_O36 "Identifies the current status of auxiliary input/output functions that are configured uniquely per application.";
CM_ SG_ 3221225472 AuxI_O29 "Identifies the current status of auxiliary input/output functions that are configured uniquely per application.";
CM_ SG_ 3221225472 AuxI_O30 "Identifies the current status of auxiliary input/output functions that are configured uniquely per application.";
CM_ SG_ 3221225472 AuxI_O31 "Identifies the current status of auxiliary input/output functions that are configured uniquely per application.";
CM_ SG_ 3221225472 AuxI_O32 "Identifies the current status of auxiliary input/output functions that are configured uniquely per application.";
CM_ SG_ 3221225472 AuxI_O25 "Identifies the current status of auxiliary input/output functions that are configured uniquely per application.";
CM_ SG_ 3221225472 AuxI_O26 "Identifies the current status of auxiliary input/output functions that are configured uniquely per application.";
CM_ SG_ 3221225472 AuxI_O27 "Identifies the current status of auxiliary input/output functions that are configured uniquely per application.";
CM_ SG_ 3221225472 AuxI_O28 "Identifies the current status of auxiliary input/output functions that are configured uniquely per application.";
CM_ SG_ 3221225472 AuxI_O21 "Identifies the current status of auxiliary input/output functions that are configured uniquely per application.";
CM_ SG_ 3221225472 AuxI_O22 "Identifies the current status of auxiliary input/output functions that are configured uniquely per application.";
CM_ SG_ 3221225472 AuxI_O23 "Identifies the current status of auxiliary input/output functions that are configured uniquely per application.";
CM_ SG_ 3221225472 AuxI_O24 "Identifies the current status of auxiliary input/output functions that are configured uniquely per application.";
CM_ SG_ 3221225472 AuxI_O17 "Identifies the current status of auxiliary input/output functions that are configured uniquely per application.";
CM_ SG_ 3221225472 AuxI_O18 "Identifies the current status of auxiliary input/output functions that are configured uniquely per application.";
CM_ SG_ 3221225472 AuxI_O19 "Identifies the current status of auxiliary input/output functions that are configured uniquely per application.";
CM_ SG_ 3221225472 AuxI_O20 "Identifies the current status of auxiliary input/output functions that are configured uniquely per application.";
CM_ SG_ 3221225472 AuxI_O77 "Identifies the current status of auxiliary input/output functions that are configured uniquely per application.";
CM_ SG_ 3221225472 AuxI_O78 "Identifies the current status of auxiliary input/output functions that are configured uniquely per application.";
CM_ SG_ 3221225472 AuxI_O79 "Identifies the current status of auxiliary input/output functions that are configured uniquely per application.";
CM_ SG_ 3221225472 AuxI_O80 "Identifies the current status of auxiliary input/output functions that are configured uniquely per application.";
CM_ SG_ 3221225472 AuxI_O73 "Identifies the current status of auxiliary input/output functions that are configured uniquely per application.";
CM_ SG_ 3221225472 AuxI_O74 "Identifies the current status of auxiliary input/output functions that are configured uniquely per application.";
CM_ SG_ 3221225472 AuxI_O75 "Identifies the current status of auxiliary input/output functions that are configured uniquely per application.";
CM_ SG_ 3221225472 AuxI_O76 "Identifies the current status of auxiliary input/output functions that are configured uniquely per application.";
CM_ SG_ 3221225472 AuxI_O69 "Identifies the current status of auxiliary input/output functions that are configured uniquely per application.";
CM_ SG_ 3221225472 AuxI_O70 "Identifies the current status of auxiliary input/output functions that are configured uniquely per application.";
CM_ SG_ 3221225472 AuxI_O71 "Identifies the current status of auxiliary input/output functions that are configured uniquely per application.";
CM_ SG_ 3221225472 AuxI_O72 "Identifies the current status of auxiliary input/output functions that are configured uniquely per application.";
CM_ SG_ 3221225472 AuxI_O65 "Identifies the current status of auxiliary input/output functions that are configured uniquely per application.";
CM_ SG_ 3221225472 AuxI_O66 "Identifies the current status of auxiliary input/output functions that are configured uniquely per application.";
CM_ SG_ 3221225472 AuxI_O67 "Identifies the current status of auxiliary input/output functions that are configured uniquely per application.";
CM_ SG_ 3221225472 AuxI_O68 "Identifies the current status of auxiliary input/output functions that are configured uniquely per application.";
CM_ SG_ 3221225472 AuxI_O61 "Identifies the current status of auxiliary input/output functions that are configured uniquely per application.";
BA_DEF_ SG_  "SigType" ENUM  "Default","Range","RangeSigned","ASCII","Discrete","Control","ReferencePGN","DTC","StringDelimiter","StringLength","StringLengthControl";
BA_DEF_ SG_  "GenSigStartValue" INT 0 10000;
BA_DEF_ SG_  "GenSigSendType" ENUM  "Cyclic","OnWrite","reserved","OnChange","reserved","reserved","reserved","NoSigSendType";
BA_DEF_ SG_  "GenSigILSupport" ENUM  "Yes","No";
BA_DEF_ SG_  "GenSigEVName" STRING ;
BA_DEF_ SG_  "SPN" INT 0 524287;
BA_DEF_ SG_  "SAEDocument" STRING ;
BA_DEF_ BO_  "GenMsgILSupport" ENUM  "Yes","No";
BA_DEF_ BO_  "GenMsgRequestable" INT 0 1;
BA_DEF_ BO_  "GenMsgSendType" ENUM  "cyclic","reserved","cyclicIfActive","reserved","reserved","reserved","reserved","reserved","noMsgSendType";
BA_DEF_ BO_  "VFrameFormat" ENUM  "StandardCAN","ExtendedCAN","reserved","J1939PG";
BA_DEF_ BO_  "SingleFrame" INT 0 1;
BA_DEF_ BO_  "GenMsgCycleTime" INT 0 3600000;
BA_DEF_ BO_  "SAE_Document" STRING ;
BA_DEF_ SG_  "SystemSignalLongSymbol" STRING ;
BA_DEF_DEF_  "SigType" "Default";
BA_DEF_DEF_  "GenSigStartValue" 0;
BA_DEF_DEF_  "GenSigSendType" "NoSigSendType";
BA_DEF_DEF_  "GenSigILSupport" "Yes";
BA_DEF_DEF_  "GenSigEVName" "Env@Nodename_@Signame";
BA_DEF_DEF_  "SPN" 0;
BA_DEF_DEF_  "SAEDocument" "";
BA_DEF_DEF_  "GenMsgILSupport" "Yes";
BA_DEF_DEF_  "GenMsgRequestable" 1;
BA_DEF_DEF_  "GenMsgSendType" "noMsgSendType";
BA_DEF_DEF_  "VFrameFormat" "J1939PG";
BA_DEF_DEF_  "SingleFrame" 1;
BA_DEF_DEF_  "GenMsgCycleTime" 0;
BA_DEF_DEF_  "SAE_Document" "";
BA_DEF_DEF_  "SystemSignalLongSymbol" "";
BA_ "SAEDocument" SG_ 3221225472 KneelingRqLeftSide "J1939-71";
BA_ "SPN" SG_ 3221225472 KneelingRqLeftSide 1749;
BA_ "SigType" SG_ 3221225472 KneelingRqLeftSide 5;
BA_ "SAEDocument" SG_ 3221225472 AutomaticTractionHelp "J1939-71";
BA_ "SPN" SG_ 3221225472 AutomaticTractionHelp 2984;
BA_ "SigType" SG_ 3221225472 AutomaticTractionHelp 5;
BA_ "SAEDocument" SG_ 3221225472 MemoryLevel "J1939-71";
BA_ "SPN" SG_ 3221225472 MemoryLevel 5432;
BA_ "SAEDocument" SG_ 3221225472 SuspensionCtrlRefusalInformation "J1939-71";
BA_ "SPN" SG_ 3221225472 SuspensionCtrlRefusalInformation 1827;
BA_ "SAEDocument" SG_ 3221225472 SpeedDependantLevelCtrlStatus "J1939-71";
BA_ "SPN" SG_ 3221225472 SpeedDependantLevelCtrlStatus 5296;
BA_ "SigType" SG_ 3221225472 SpeedDependantLevelCtrlStatus 5;
BA_ "SAEDocument" SG_ 3221225472 AllwLevelCtrlDuringBrakingStatus "J1939-71";
BA_ "SPN" SG_ 3221225472 AllwLevelCtrlDuringBrakingStatus 5294;
BA_ "SigType" SG_ 3221225472 AllwLevelCtrlDuringBrakingStatus 5;
BA_ "SAEDocument" SG_ 3221225472 SuspensionRemoteCtrl2 "J1939-71";
BA_ "SPN" SG_ 3221225472 SuspensionRemoteCtrl2 1825;
BA_ "SigType" SG_ 3221225472 SuspensionRemoteCtrl2 4;
BA_ "SAEDocument" SG_ 3221225472 SuspensionRemoteCtrl1 "J1939-71";
BA_ "SPN" SG_ 3221225472 SuspensionRemoteCtrl1 1826;
BA_ "SigType" SG_ 3221225472 SuspensionRemoteCtrl1 4;
BA_ "SAEDocument" SG_ 3221225472 RearAxleInBumperRange "J1939-71";
BA_ "SPN" SG_ 3221225472 RearAxleInBumperRange 1823;
BA_ "SigType" SG_ 3221225472 RearAxleInBumperRange 4;
BA_ "SAEDocument" SG_ 3221225472 FrontAxleInBumperRange "J1939-71";
BA_ "SPN" SG_ 3221225472 FrontAxleInBumperRange 1824;
BA_ "SigType" SG_ 3221225472 FrontAxleInBumperRange 4;
BA_ "SAEDocument" SG_ 3221225472 DoorRelease "J1939-71";
BA_ "SPN" SG_ 3221225472 DoorRelease 1744;
BA_ "SigType" SG_ 3221225472 DoorRelease 5;
BA_ "SAEDocument" SG_ 3221225472 VehicleMotionInhibit "J1939-71";
BA_ "SPN" SG_ 3221225472 VehicleMotionInhibit 1745;
BA_ "SigType" SG_ 3221225472 VehicleMotionInhibit 5;
BA_ "SAEDocument" SG_ 3221225472 SecurityDevice "J1939-71";
BA_ "SPN" SG_ 3221225472 SecurityDevice 1746;
BA_ "SigType" SG_ 3221225472 SecurityDevice 5;
BA_ "SAEDocument" SG_ 3221225472 LevelCtrlMode "J1939-71";
BA_ "SPN" SG_ 3221225472 LevelCtrlMode 1741;
BA_ "SAEDocument" SG_ 3221225472 KneelingInformation "J1939-71";
BA_ "SPN" SG_ 3221225472 KneelingInformation 1742;
BA_ "SAEDocument" SG_ 3221225472 LiftingCtrlModeRearAxle "J1939-71";
BA_ "SPN" SG_ 3221225472 LiftingCtrlModeRearAxle 1756;
BA_ "SigType" SG_ 3221225472 LiftingCtrlModeRearAxle 5;
BA_ "SAEDocument" SG_ 3221225472 LiftingCtrlModeFrontAxle "J1939-71";
BA_ "SPN" SG_ 3221225472 LiftingCtrlModeFrontAxle 1739;
BA_ "SigType" SG_ 3221225472 LiftingCtrlModeFrontAxle 5;
BA_ "SAEDocument" SG_ 3221225472 LoweringCtrlModeRearAxle "J1939-71";
BA_ "SPN" SG_ 3221225472 LoweringCtrlModeRearAxle 1755;
BA_ "SigType" SG_ 3221225472 LoweringCtrlModeRearAxle 5;
BA_ "SAEDocument" SG_ 3221225472 LoweringCtrlModeFrontAxle "J1939-71";
BA_ "SPN" SG_ 3221225472 LoweringCtrlModeFrontAxle 1740;
BA_ "SigType" SG_ 3221225472 LoweringCtrlModeFrontAxle 5;
BA_ "SAEDocument" SG_ 3221225472 AboveNominalLevelRearAxle "J1939-71";
BA_ "SPN" SG_ 3221225472 AboveNominalLevelRearAxle 1736;
BA_ "SigType" SG_ 3221225472 AboveNominalLevelRearAxle 4;
BA_ "SAEDocument" SG_ 3221225472 AboveNominalLevelFrontAxle "J1939-71";
BA_ "SPN" SG_ 3221225472 AboveNominalLevelFrontAxle 1737;
BA_ "SigType" SG_ 3221225472 AboveNominalLevelFrontAxle 4;
BA_ "SAEDocument" SG_ 3221225472 BelowNominalLevelRearAxle "J1939-71";
BA_ "SPN" SG_ 3221225472 BelowNominalLevelRearAxle 1754;
BA_ "SigType" SG_ 3221225472 BelowNominalLevelRearAxle 5;
BA_ "SAEDocument" SG_ 3221225472 BelowNominalLevelFrontAxle "J1939-71";
BA_ "SPN" SG_ 3221225472 BelowNominalLevelFrontAxle 1738;
BA_ "SigType" SG_ 3221225472 BelowNominalLevelFrontAxle 4;
BA_ "SAEDocument" SG_ 3221225472 NominalLevelRearAxle "J1939-71";
BA_ "SPN" SG_ 3221225472 NominalLevelRearAxle 1733;
BA_ "SAEDocument" SG_ 3221225472 NominalLevelFrontAxle "J1939-71";
BA_ "SPN" SG_ 3221225472 NominalLevelFrontAxle 1734;
BA_ "SAEDocument" SG_ 3221225472 Alt4Status "J1939-71";
BA_ "SPN" SG_ 3221225472 Alt4Status 3356;
BA_ "SigType" SG_ 3221225472 Alt4Status 4;
BA_ "SAEDocument" SG_ 3221225472 Alt3Status "J1939-71";
BA_ "SPN" SG_ 3221225472 Alt3Status 3355;
BA_ "SigType" SG_ 3221225472 Alt3Status 4;
BA_ "SAEDocument" SG_ 3221225472 Alt2Status "J1939-71";
BA_ "SPN" SG_ 3221225472 Alt2Status 3354;
BA_ "SigType" SG_ 3221225472 Alt2Status 4;
BA_ "SAEDocument" SG_ 3221225472 Alt1Status "J1939-71";
BA_ "SPN" SG_ 3221225472 Alt1Status 3353;
BA_ "SigType" SG_ 3221225472 Alt1Status 4;
BA_ "SAEDocument" SG_ 3221225472 AltSpeed "J1939-71";
BA_ "SPN" SG_ 3221225472 AltSpeed 589;
BA_ "SigType" SG_ 3221225472 AltSpeed 1;
BA_ "SAEDocument" SG_ 3221225472 AuxAbsPressReading "J1939-71";
BA_ "SPN" SG_ 3221225472 AuxAbsPressReading 138;
BA_ "SigType" SG_ 3221225472 AuxAbsPressReading 1;
BA_ "SAEDocument" SG_ 3221225472 AuxGagePressReading1 "J1939-71";
BA_ "SPN" SG_ 3221225472 AuxGagePressReading1 137;
BA_ "SigType" SG_ 3221225472 AuxGagePressReading1 1;
BA_ "SAEDocument" SG_ 3221225472 AuxVacuumPressReading "J1939-71";
BA_ "SPN" SG_ 3221225472 AuxVacuumPressReading 136;
BA_ "SigType" SG_ 3221225472 AuxVacuumPressReading 1;
BA_ "SAEDocument" SG_ 3221225472 SpecificHumidity "J1939-71";
BA_ "SPN" SG_ 3221225472 SpecificHumidity 4490;
BA_ "SigType" SG_ 3221225472 SpecificHumidity 1;
BA_ "SAEDocument" SG_ 3221225472 SolarSensorMax "J1939-71";
BA_ "SPN" SG_ 3221225472 SolarSensorMax 2611;
BA_ "SAEDocument" SG_ 3221225472 SolarIntensityPercent "J1939-71";
BA_ "SPN" SG_ 3221225472 SolarIntensityPercent 2610;
BA_ "SigType" SG_ 3221225472 SolarIntensityPercent 1;
BA_ "SAEDocument" SG_ 3221225472 TestType "J1939-73";
BA_ "SPN" SG_ 3221225472 TestType 1225;
BA_ "GenSigStartValue" SG_ 3221225472 TestType 1;
BA_ "SigType" SG_ 3221225472 TestType 1;
BA_ "SAEDocument" SG_ 3221225472 FlashRedStopLamp "J1939-73";
BA_ "SPN" SG_ 3221225472 FlashRedStopLamp 3039;
BA_ "SigType" SG_ 3221225472 FlashRedStopLamp 4;
BA_ "SAEDocument" SG_ 3221225472 FlashProtectLamp "J1939-73";
BA_ "SPN" SG_ 3221225472 FlashProtectLamp 3041;
BA_ "SigType" SG_ 3221225472 FlashProtectLamp 4;
BA_ "SAEDocument" SG_ 3221225472 FlashMalfuncIndicatorLamp "J1939-73";
BA_ "SPN" SG_ 3221225472 FlashMalfuncIndicatorLamp 3038;
BA_ "SigType" SG_ 3221225472 FlashMalfuncIndicatorLamp 4;
BA_ "SAEDocument" SG_ 3221225472 FlashAmberWarningLamp "J1939-73";
BA_ "SPN" SG_ 3221225472 FlashAmberWarningLamp 3040;
BA_ "SigType" SG_ 3221225472 FlashAmberWarningLamp 4;
BA_ "SAEDocument" SG_ 3221225472 MalfunctionIndicatorLampStatus "J1939-73";
BA_ "SPN" SG_ 3221225472 MalfunctionIndicatorLampStatus 1213;
BA_ "SigType" SG_ 3221225472 MalfunctionIndicatorLampStatus 4;
BA_ "SAEDocument" SG_ 3221225472 RedStopLampState "J1939-73";
BA_ "SPN" SG_ 3221225472 RedStopLampState 623;
BA_ "SigType" SG_ 3221225472 RedStopLampState 4;
BA_ "SAEDocument" SG_ 3221225472 AmberWarningLampStatus "J1939-73";
BA_ "SPN" SG_ 3221225472 AmberWarningLampStatus 624;
BA_ "SigType" SG_ 3221225472 AmberWarningLampStatus 4;
BA_ "SAEDocument" SG_ 3221225472 ProtectLampStatus "J1939-73";
BA_ "SPN" SG_ 3221225472 ProtectLampStatus 987;
BA_ "SigType" SG_ 3221225472 ProtectLampStatus 4;
BA_ "SAEDocument" SG_ 3221225472 DTC5 "J1939-73";
BA_ "SigType" SG_ 3221225472 DTC5 7;
BA_ "SAEDocument" SG_ 3221225472 DTC4 "J1939-73";
BA_ "SigType" SG_ 3221225472 DTC4 7;
BA_ "SAEDocument" SG_ 3221225472 DTC3 "J1939-73";
BA_ "SigType" SG_ 3221225472 DTC3 7;
BA_ "SAEDocument" SG_ 3221225472 DTC2 "J1939-73";
BA_ "SigType" SG_ 3221225472 DTC2 7;
BA_ "SystemSignalLongSymbol" SG_ 3221225472 NOxConvertingCatalystAdsorberSta "NOxConvertingCatalystAdsorberStatus";
BA_ "SystemSignalLongSymbol" SG_ 3221225472 BoostPressureControlSystemSuppor "BoostPressureControlSystemSupport";
BA_ "SystemSignalLongSymbol" SG_ 3221225472 NOxConvertingCatalystAdsorberSup "NOxConvertingCatalystAdsorberSupport";
BA_ "SAEDocument" SG_ 3221225472 MisfireMonitoringSupport "J1939-73";
BA_ "SAEDocument" SG_ 3221225472 OBDCompliance "J1939-73";
BA_ "SPN" SG_ 3221225472 OBDCompliance 1220;
BA_ "SigType" SG_ 3221225472 OBDCompliance 1;
BA_ "SAEDocument" SG_ 3221225472 PreviouslyActiveTroubleCodes "J1939-73";
BA_ "SPN" SG_ 3221225472 PreviouslyActiveTroubleCodes 1219;
BA_ "SigType" SG_ 3221225472 PreviouslyActiveTroubleCodes 1;
BA_ "SAEDocument" SG_ 3221225472 ActiveTroubleCodes "J1939-73";
BA_ "SPN" SG_ 3221225472 ActiveTroubleCodes 1218;
BA_ "SigType" SG_ 3221225472 ActiveTroubleCodes 1;
BA_ "SAEDocument" SG_ 3221225472 SecondAirSystemMonStatus "J1939-73";
BA_ "SAEDocument" SG_ 3221225472 EvaporativeSystemMonStatus "J1939-73";
BA_ "SAEDocument" SG_ 3221225472 ACSystemRefrigerantMonStatus "J1939-73";
BA_ "SAEDocument" SG_ 3221225472 OxygenSensorHeaterMonStatus "J1939-73";
BA_ "SAEDocument" SG_ 3221225472 OxygenSensorMonStatus "J1939-73";
BA_ "SAEDocument" SG_ 3221225472 EGRSystemMonitoringStatus "J1939-73";
BA_ "SAEDocument" SG_ 3221225472 CatalystMonStatus "J1939-73";
BA_ "SAEDocument" SG_ 3221225472 ColdStartAidSystemMonStatus "J1939-73";
BA_ "SAEDocument" SG_ 3221225472 HeatedCatalystMonStatus "J1939-73";
BA_ "SAEDocument" SG_ 3221225472 CatalystMonSupp "J1939-73";
BA_ "SAEDocument" SG_ 3221225472 ColdStartAidSystemMonSupp "J1939-73";
BA_ "SAEDocument" SG_ 3221225472 HeatedCatalystMonSupp "J1939-73";
BA_ "SAEDocument" SG_ 3221225472 EvaporativeSystemMonSupp "J1939-73";
BA_ "SAEDocument" SG_ 3221225472 SecondAirSystemMonSupp "J1939-73";
BA_ "SAEDocument" SG_ 3221225472 ACSystemRefrigerantMonSupp "J1939-73";
BA_ "SAEDocument" SG_ 3221225472 OxygenSensorMonSupp "J1939-73";
BA_ "SAEDocument" SG_ 3221225472 OxygenSensorHeaterMonSupp "J1939-73";
BA_ "SAEDocument" SG_ 3221225472 EGRSystemMonitoringSupp "J1939-73";
BA_ "SAEDocument" SG_ 3221225472 MisfireMonitoringStatus "J1939-73";
BA_ "SAEDocument" SG_ 3221225472 ComprehensiveCompMonStatus "J1939-73";
BA_ "SAEDocument" SG_ 3221225472 FuelSystemMonitoringStatus "J1939-73";
BA_ "SAEDocument" SG_ 3221225472 ComprehensiveComponentMonSupp "J1939-73";
BA_ "SAEDocument" SG_ 3221225472 FuelSystemMonitoringSupport "J1939-73";
BA_ "SAEDocument" SG_ 3221225472 FreezeFrameLength "J1939-73";
BA_ "SPN" SG_ 3221225472 FreezeFrameLength 1217;
BA_ "SAEDocument" SG_ 3221225472 WheelBasedVehicleSpeed "J1939-71";
BA_ "SPN" SG_ 3221225472 WheelBasedVehicleSpeed 84;
BA_ "SigType" SG_ 3221225472 WheelBasedVehicleSpeed 1;
BA_ "SAEDocument" SG_ 3221225472 EngPercentLoadAtCurrentSpeed "J1939-71";
BA_ "SPN" SG_ 3221225472 EngPercentLoadAtCurrentSpeed 92;
BA_ "SAEDocument" SG_ 3221225472 ExpandedFreezeFrameLength "J1939-73";
BA_ "SPN" SG_ 3221225472 ExpandedFreezeFrameLength 3149;
BA_ "SAEDocument" SG_ 3221225472 SPNSupported1High "J1939-73";
BA_ "SAEDocument" SG_ 3221225472 SPNSupportTypeSTR3 "J1939-73";
BA_ "SAEDocument" SG_ 3221225472 SPNSupportTypeSTR2 "J1939-73";
BA_ "SAEDocument" SG_ 3221225472 SPNSupportTypeEFF3 "J1939-73";
BA_ "SAEDocument" SG_ 3221225472 SPNSupportTypeEFF2 "J1939-73";
BA_ "SAEDocument" SG_ 3221225472 SPNSupportTypeDS3 "J1939-73";
BA_ "SAEDocument" SG_ 3221225472 SPNSupportTypeDS2 "J1939-73";
BA_ "SAEDocument" SG_ 3221225472 SPNSupported3High "J1939-73";
BA_ "SAEDocument" SG_ 3221225472 SPNSupported2High "J1939-73";
BA_ "SAEDocument" SG_ 3221225472 SPNSupported3 "J1939-73";
BA_ "SAEDocument" SG_ 3221225472 SPNSupported2 "J1939-73";
BA_ "SAEDocument" SG_ 3221225472 SPNDataLength3 "J1939-73";
BA_ "SAEDocument" SG_ 3221225472 SPNSupportTypeSTR1 "J1939-73";
BA_ "SAEDocument" SG_ 3221225472 SPNSupportTypeDS1 "J1939-73";
BA_ "SAEDocument" SG_ 3221225472 SPNSupportTypeEFF1 "J1939-73";
BA_ "SAEDocument" SG_ 3221225472 SPNDataLength2 "J1939-73";
BA_ "SAEDocument" SG_ 3221225472 SPNDataLength1 "J1939-73";
BA_ "SPN" SG_ 3221225472 SPNDataLength1 4103;
BA_ "SAEDocument" SG_ 3221225472 SPNSupported1 "J1939-73";
BA_ "SPN" SG_ 3221225472 SPNSupported1 3297;
BA_ "SAEDocument" SG_ 3221225472 IndividualDTCClearControlByte "J1939-73";
BA_ "SPN" SG_ 3221225472 IndividualDTCClearControlByte 3034;
BA_ "SAEDocument" SG_ 3221225472 CtrlByteIndicIndividualDTCClear "J1939-73";
BA_ "SPN" SG_ 3221225472 CtrlByteIndicIndividualDTCClear 3035;
BA_ "SAEDocument" SG_ 3221225472 TimeSinceDTCsCleared "J1939-73";
BA_ "SPN" SG_ 3221225472 TimeSinceDTCsCleared 3296;
BA_ "SigType" SG_ 3221225472 TimeSinceDTCsCleared 1;
BA_ "SAEDocument" SG_ 3221225472 MinutesRunByEngineMILActivated "J1939-73";
BA_ "SPN" SG_ 3221225472 MinutesRunByEngineMILActivated 3295;
BA_ "SigType" SG_ 3221225472 MinutesRunByEngineMILActivated 1;
BA_ "SAEDocument" SG_ 3221225472 DistanceSinceDTCsCleared "J1939-73";
BA_ "SPN" SG_ 3221225472 DistanceSinceDTCsCleared 3294;
BA_ "SigType" SG_ 3221225472 DistanceSinceDTCsCleared 1;
BA_ "SAEDocument" SG_ 3221225472 DistanceWhileMILisActivated "J1939-73";
BA_ "SPN" SG_ 3221225472 DistanceWhileMILisActivated 3069;
BA_ "SigType" SG_ 3221225472 DistanceWhileMILisActivated 1;
BA_ "SAEDocument" SG_ 3221225472 ApplSysMonitorDenominator "J1939-73";
BA_ "SPN" SG_ 3221225472 ApplSysMonitorDenominator 3068;
BA_ "SigType" SG_ 3221225472 ApplSysMonitorDenominator 1;
BA_ "SAEDocument" SG_ 3221225472 ApplSysMonitorNumerator "J1939-73";
BA_ "SPN" SG_ 3221225472 ApplSysMonitorNumerator 3067;
BA_ "SigType" SG_ 3221225472 ApplSysMonitorNumerator 1;
BA_ "SAEDocument" SG_ 3221225472 SPNofApplSysMonitor "J1939-73";
BA_ "SPN" SG_ 3221225472 SPNofApplSysMonitor 3066;
BA_ "SigType" SG_ 3221225472 SPNofApplSysMonitor 1;
BA_ "SAEDocument" SG_ 3221225472 OBDMonitoringCondEncountered "J1939-73";
BA_ "SPN" SG_ 3221225472 OBDMonitoringCondEncountered 3049;
BA_ "SigType" SG_ 3221225472 OBDMonitoringCondEncountered 1;
BA_ "SAEDocument" SG_ 3221225472 IgnitionCycleCounter "J1939-73";
BA_ "SPN" SG_ 3221225472 IgnitionCycleCounter 3048;
BA_ "SigType" SG_ 3221225472 IgnitionCycleCounter 1;
BA_ "SAEDocument" SG_ 3221225472 CalibrationID4 "J1939-73";
BA_ "SAEDocument" SG_ 3221225472 CalibrationID3 "J1939-73";
BA_ "SAEDocument" SG_ 3221225472 CalibrationID2 "J1939-73";
BA_ "SAEDocument" SG_ 3221225472 CalibrationID1 "J1939-73";
BA_ "SPN" SG_ 3221225472 CalibrationID1 1635;
BA_ "SAEDocument" SG_ 3221225472 CalibrationVerificationNumber "J1939-73";
BA_ "SPN" SG_ 3221225472 CalibrationVerificationNumber 1634;
BA_ "SigType" SG_ 3221225472 CalibrationVerificationNumber 1;
BA_ "SAEDocument" SG_ 3221225472 BootLoadData7 "J1939-73";
BA_ "SAEDocument" SG_ 3221225472 BootLoadData6 "J1939-73";
BA_ "SAEDocument" SG_ 3221225472 BootLoadData5 "J1939-73";
BA_ "SAEDocument" SG_ 3221225472 BootLoadData4 "J1939-73";
BA_ "SAEDocument" SG_ 3221225472 BootLoadData3 "J1939-73";
BA_ "SAEDocument" SG_ 3221225472 BootLoadData2 "J1939-73";
BA_ "SAEDocument" SG_ 3221225472 BootLoadData1 "J1939-73";
BA_ "SAEDocument" SG_ 3221225472 BootLoadData "J1939-73";
BA_ "SAEDocument" SG_ 3221225472 RawBinaryData6 "J1939-73";
BA_ "SAEDocument" SG_ 3221225472 RawBinaryData5 "J1939-73";
BA_ "SAEDocument" SG_ 3221225472 RawBinaryData4 "J1939-73";
BA_ "SAEDocument" SG_ 3221225472 RawBinaryData3 "J1939-73";
BA_ "SAEDocument" SG_ 3221225472 RawBinaryData2 "J1939-73";
BA_ "SAEDocument" SG_ 3221225472 RawBinaryData1 "J1939-73";
BA_ "SAEDocument" SG_ 3221225472 RawBinaryData "J1939-73";
BA_ "SAEDocument" SG_ 3221225472 NumberOfOccurance "J1939-73";
BA_ "SAEDocument" SG_ 3221225472 NumberAllowed "J1939-73";
BA_ "SAEDocument" SG_ 3221225472 Seed "J1939-73";
BA_ "SAEDocument" SG_ 3221225472 EDCP_Extension "J1939-73";
BA_ "SAEDocument" SG_ 3221225472 ErrorIndicator "J1939-73";
BA_ "SAEDocument" SG_ 3221225472 Status "J1939-73";
BA_ "SAEDocument" SG_ 3221225472 NumberAllowedHigh "J1939-73";
BA_ "SAEDocument" SG_ 3221225472 KeyOrUserLevel "J1939-73";
BA_ "SPN" SG_ 3221225472 KeyOrUserLevel 1645;
BA_ "SAEDocument" SG_ 3221225472 PointerExtension "J1939-73";
BA_ "SPN" SG_ 3221225472 PointerExtension 1643;
BA_ "SAEDocument" SG_ 3221225472 Pointer "J1939-73";
BA_ "SPN" SG_ 3221225472 Pointer 1644;
BA_ "SAEDocument" SG_ 3221225472 Command "J1939-73";
BA_ "SPN" SG_ 3221225472 Command 1642;
BA_ "SAEDocument" SG_ 3221225472 PointerType "J1939-73";
BA_ "SPN" SG_ 3221225472 PointerType 1641;
BA_ "SAEDocument" SG_ 3221225472 NumberRequested "J1939-73";
BA_ "SPN" SG_ 3221225472 NumberRequested 1640;
BA_ "SAEDocument" SG_ 3221225472 NumberRequestedHigh "J1939-73";
BA_ "SAEDocument" SG_ 3221225472 HoldSignal "J1939-73";
BA_ "SPN" SG_ 3221225472 HoldSignal 1236;
BA_ "SAEDocument" SG_ 3221225472 J1939Network3 "J1939-73";
BA_ "SPN" SG_ 3221225472 J1939Network3 1235;
BA_ "SigType" SG_ 3221225472 J1939Network3 4;
BA_ "SAEDocument" SG_ 3221225472 J1939Network2 "J1939-73";
BA_ "SPN" SG_ 3221225472 J1939Network2 1231;
BA_ "SigType" SG_ 3221225472 J1939Network2 4;
BA_ "SAEDocument" SG_ 3221225472 ISO9141 "J1939-73";
BA_ "SPN" SG_ 3221225472 ISO9141 1232;
BA_ "SigType" SG_ 3221225472 ISO9141 4;
BA_ "SAEDocument" SG_ 3221225472 SAE_J1850 "J1939-73";
BA_ "SPN" SG_ 3221225472 SAE_J1850 1233;
BA_ "SigType" SG_ 3221225472 SAE_J1850 4;
BA_ "SAEDocument" SG_ 3221225472 ManufacturerSpecificPort "J1939-73";
BA_ "SPN" SG_ 3221225472 ManufacturerSpecificPort 1234;
BA_ "SigType" SG_ 3221225472 ManufacturerSpecificPort 4;
BA_ "SAEDocument" SG_ 3221225472 CurrentDataLink "J1939-73";
BA_ "SPN" SG_ 3221225472 CurrentDataLink 1230;
BA_ "SigType" SG_ 3221225472 CurrentDataLink 4;
BA_ "SAEDocument" SG_ 3221225472 SAE_J1587 "J1939-73";
BA_ "SPN" SG_ 3221225472 SAE_J1587 608;
BA_ "SigType" SG_ 3221225472 SAE_J1587 4;
BA_ "SAEDocument" SG_ 3221225472 SAE_J1922 "J1939-73";
BA_ "SPN" SG_ 3221225472 SAE_J1922 622;
BA_ "SigType" SG_ 3221225472 SAE_J1922 4;
BA_ "SAEDocument" SG_ 3221225472 J1939Network1 "J1939-73";
BA_ "SPN" SG_ 3221225472 J1939Network1 639;
BA_ "SigType" SG_ 3221225472 J1939Network1 4;
BA_ "SAEDocument" SG_ 3221225472 SuspendSignal "J1939-73";
BA_ "SPN" SG_ 3221225472 SuspendSignal 2618;
BA_ "SAEDocument" SG_ 3221225472 SuspendDuration "J1939-73";
BA_ "SPN" SG_ 3221225472 SuspendDuration 2619;
BA_ "SAEDocument" SG_ 3221225472 TestIdentifierSupported "J1939-73";
BA_ "SPN" SG_ 3221225472 TestIdentifierSupported 1229;
BA_ "GenSigStartValue" SG_ 3221225472 TestIdentifierSupported 1;
BA_ "SigType" SG_ 3221225472 TestIdentifierSupported 1;
BA_ "SAEDocument" SG_ 3221225472 UtlityOverallPowerFactorLagging "J1939-75";
BA_ "SPN" SG_ 3221225472 UtlityOverallPowerFactorLagging 2522;
BA_ "SigType" SG_ 3221225472 UtlityOverallPowerFactorLagging 4;
BA_ "SAEDocument" SG_ 3221225472 UtilityOverallPowerFactor "J1939-75";
BA_ "SPN" SG_ 3221225472 UtilityOverallPowerFactor 2498;
BA_ "SigType" SG_ 3221225472 UtilityOverallPowerFactor 1;
BA_ "SAEDocument" SG_ 3221225472 UtilityTotalReactivePower "J1939-75";
BA_ "SPN" SG_ 3221225472 UtilityTotalReactivePower 2490;
BA_ "SigType" SG_ 3221225472 UtilityTotalReactivePower 1;
BA_ "SAEDocument" SG_ 3221225472 UtilityTotalApparentPower "J1939-75";
BA_ "SPN" SG_ 3221225472 UtilityTotalApparentPower 2494;
BA_ "SigType" SG_ 3221225472 UtilityTotalApparentPower 1;
BA_ "SAEDocument" SG_ 3221225472 UtilityTotalRealPower "J1939-75";
BA_ "SPN" SG_ 3221225472 UtilityTotalRealPower 2486;
BA_ "SigType" SG_ 3221225472 UtilityTotalRealPower 1;
BA_ "SAEDocument" SG_ 3221225472 UtilityTotalKWHoursImport "J1939-75";
BA_ "SPN" SG_ 3221225472 UtilityTotalKWHoursImport 2503;
BA_ "SigType" SG_ 3221225472 UtilityTotalKWHoursImport 4;
BA_ "SAEDocument" SG_ 3221225472 UtilityTotalKWHoursExport "J1939-75";
BA_ "SPN" SG_ 3221225472 UtilityTotalKWHoursExport 2502;
BA_ "SigType" SG_ 3221225472 UtilityTotalKWHoursExport 4;
BA_ "SAEDocument" SG_ 3221225472 UtilityPhaseCPowerFactorLagging "J1939-75";
BA_ "SPN" SG_ 3221225472 UtilityPhaseCPowerFactorLagging 2525;
BA_ "SigType" SG_ 3221225472 UtilityPhaseCPowerFactorLagging 4;
BA_ "SAEDocument" SG_ 3221225472 UtilityPhaseCPowerFactor "J1939-75";
BA_ "SPN" SG_ 3221225472 UtilityPhaseCPowerFactor 2501;
BA_ "SigType" SG_ 3221225472 UtilityPhaseCPowerFactor 1;
BA_ "SAEDocument" SG_ 3221225472 UtilityPhaseCReactivePower "J1939-75";
BA_ "SPN" SG_ 3221225472 UtilityPhaseCReactivePower 2493;
BA_ "SigType" SG_ 3221225472 UtilityPhaseCReactivePower 1;
BA_ "SAEDocument" SG_ 3221225472 UtilityPhaseCApparentPower "J1939-75";
BA_ "SPN" SG_ 3221225472 UtilityPhaseCApparentPower 2497;
BA_ "SigType" SG_ 3221225472 UtilityPhaseCApparentPower 1;
BA_ "SAEDocument" SG_ 3221225472 UtilityPhaseCRealPower "J1939-75";
BA_ "SPN" SG_ 3221225472 UtilityPhaseCRealPower 2489;
BA_ "SigType" SG_ 3221225472 UtilityPhaseCRealPower 1;
BA_ "SAEDocument" SG_ 3221225472 UtilityPhaseCACRMSCurrent "J1939-75";
BA_ "SPN" SG_ 3221225472 UtilityPhaseCACRMSCurrent 2485;
BA_ "SigType" SG_ 3221225472 UtilityPhaseCACRMSCurrent 1;
BA_ "SAEDocument" SG_ 3221225472 UtilityPhaseCACFrequency "J1939-75";
BA_ "SPN" SG_ 3221225472 UtilityPhaseCACFrequency 2473;
BA_ "SigType" SG_ 3221225472 UtilityPhaseCACFrequency 1;
BA_ "SAEDocument" SG_ 3221225472 UtltyPhsCLneNeutralACRMSVoltage "J1939-75";
BA_ "SPN" SG_ 3221225472 UtltyPhsCLneNeutralACRMSVoltage 2481;
BA_ "SigType" SG_ 3221225472 UtltyPhsCLneNeutralACRMSVoltage 1;
BA_ "SAEDocument" SG_ 3221225472 UtltyPhseCALineLineACRMSVoltage "J1939-75";
BA_ "SPN" SG_ 3221225472 UtltyPhseCALineLineACRMSVoltage 2477;
BA_ "SigType" SG_ 3221225472 UtltyPhseCALineLineACRMSVoltage 1;
BA_ "SAEDocument" SG_ 3221225472 UtilityPhaseBPowerFactorLagging "J1939-75";
BA_ "SPN" SG_ 3221225472 UtilityPhaseBPowerFactorLagging 2524;
BA_ "SigType" SG_ 3221225472 UtilityPhaseBPowerFactorLagging 4;
BA_ "SAEDocument" SG_ 3221225472 UtilityPhaseBPowerFactor "J1939-75";
BA_ "SPN" SG_ 3221225472 UtilityPhaseBPowerFactor 2500;
BA_ "SigType" SG_ 3221225472 UtilityPhaseBPowerFactor 1;
BA_ "SAEDocument" SG_ 3221225472 UtilityPhaseBReactivePower "J1939-75";
BA_ "SPN" SG_ 3221225472 UtilityPhaseBReactivePower 2492;
BA_ "SigType" SG_ 3221225472 UtilityPhaseBReactivePower 1;
BA_ "SAEDocument" SG_ 3221225472 UtilityPhaseBApparentPower "J1939-75";
BA_ "SPN" SG_ 3221225472 UtilityPhaseBApparentPower 2496;
BA_ "SigType" SG_ 3221225472 UtilityPhaseBApparentPower 1;
BA_ "SAEDocument" SG_ 3221225472 UtilityPhaseBRealPower "J1939-75";
BA_ "SPN" SG_ 3221225472 UtilityPhaseBRealPower 2488;
BA_ "SigType" SG_ 3221225472 UtilityPhaseBRealPower 1;
BA_ "SAEDocument" SG_ 3221225472 UtilityPhaseBACRMSCurrent "J1939-75";
BA_ "SPN" SG_ 3221225472 UtilityPhaseBACRMSCurrent 2484;
BA_ "SigType" SG_ 3221225472 UtilityPhaseBACRMSCurrent 1;
BA_ "SAEDocument" SG_ 3221225472 UtilityPhaseBACFrequency "J1939-75";
BA_ "SPN" SG_ 3221225472 UtilityPhaseBACFrequency 2472;
BA_ "SigType" SG_ 3221225472 UtilityPhaseBACFrequency 1;
BA_ "SAEDocument" SG_ 3221225472 UtltyPhsBLneNeutralACRMSVoltage "J1939-75";
BA_ "SPN" SG_ 3221225472 UtltyPhsBLneNeutralACRMSVoltage 2480;
BA_ "SigType" SG_ 3221225472 UtltyPhsBLneNeutralACRMSVoltage 1;
BA_ "SAEDocument" SG_ 3221225472 UtltyPhseBCLineLineACRMSVoltage "J1939-75";
BA_ "SPN" SG_ 3221225472 UtltyPhseBCLineLineACRMSVoltage 2476;
BA_ "SigType" SG_ 3221225472 UtltyPhseBCLineLineACRMSVoltage 1;
BA_ "SAEDocument" SG_ 3221225472 UtilityPhaseAPowerFactorLagging "J1939-75";
BA_ "SPN" SG_ 3221225472 UtilityPhaseAPowerFactorLagging 2523;
BA_ "SigType" SG_ 3221225472 UtilityPhaseAPowerFactorLagging 4;
BA_ "SAEDocument" SG_ 3221225472 UtilityPhaseAPowerFactor "J1939-75";
BA_ "SPN" SG_ 3221225472 UtilityPhaseAPowerFactor 2499;
BA_ "SigType" SG_ 3221225472 UtilityPhaseAPowerFactor 1;
BA_ "SAEDocument" SG_ 3221225472 UtilityPhaseAReactivePower "J1939-75";
BA_ "SPN" SG_ 3221225472 UtilityPhaseAReactivePower 2491;
BA_ "SigType" SG_ 3221225472 UtilityPhaseAReactivePower 1;
BA_ "SAEDocument" SG_ 3221225472 UtilityPhaseAApparentPower "J1939-75";
BA_ "SPN" SG_ 3221225472 UtilityPhaseAApparentPower 2495;
BA_ "SigType" SG_ 3221225472 UtilityPhaseAApparentPower 1;
BA_ "SAEDocument" SG_ 3221225472 UtilityPhaseARealPower "J1939-75";
BA_ "SPN" SG_ 3221225472 UtilityPhaseARealPower 2487;
BA_ "SigType" SG_ 3221225472 UtilityPhaseARealPower 1;
BA_ "SAEDocument" SG_ 3221225472 UtilityPhaseAACRMSCurrent "J1939-75";
BA_ "SPN" SG_ 3221225472 UtilityPhaseAACRMSCurrent 2483;
BA_ "SigType" SG_ 3221225472 UtilityPhaseAACRMSCurrent 1;
BA_ "SAEDocument" SG_ 3221225472 UtilityPhaseAACFrequency "J1939-75";
BA_ "SPN" SG_ 3221225472 UtilityPhaseAACFrequency 2471;
BA_ "SigType" SG_ 3221225472 UtilityPhaseAACFrequency 1;
BA_ "SAEDocument" SG_ 3221225472 UtltyPhsALneNeutralACRMSVoltage "J1939-75";
BA_ "SPN" SG_ 3221225472 UtltyPhsALneNeutralACRMSVoltage 2479;
BA_ "SigType" SG_ 3221225472 UtltyPhsALneNeutralACRMSVoltage 1;
BA_ "SAEDocument" SG_ 3221225472 UtltyPhseABLineLineACRMSVoltage "J1939-75";
BA_ "SPN" SG_ 3221225472 UtltyPhseABLineLineACRMSVoltage 2475;
BA_ "SigType" SG_ 3221225472 UtltyPhseABLineLineACRMSVoltage 1;
BA_ "SAEDocument" SG_ 3221225472 UtilityAverageACRMSCurrent "J1939-75";
BA_ "SPN" SG_ 3221225472 UtilityAverageACRMSCurrent 2482;
BA_ "SigType" SG_ 3221225472 UtilityAverageACRMSCurrent 1;
BA_ "SAEDocument" SG_ 3221225472 UtilityAverageACFrequency "J1939-75";
BA_ "SPN" SG_ 3221225472 UtilityAverageACFrequency 2470;
BA_ "SigType" SG_ 3221225472 UtilityAverageACFrequency 1;
BA_ "SAEDocument" SG_ 3221225472 UtltyAvrgLneNeutralACRMSVoltage "J1939-75";
BA_ "SPN" SG_ 3221225472 UtltyAvrgLneNeutralACRMSVoltage 2478;
BA_ "SigType" SG_ 3221225472 UtltyAvrgLneNeutralACRMSVoltage 1;
BA_ "SAEDocument" SG_ 3221225472 UtltyAvrageLineLineACRMSVoltage "J1939-75";
BA_ "SPN" SG_ 3221225472 UtltyAvrageLineLineACRMSVoltage 2474;
BA_ "SigType" SG_ 3221225472 UtltyAvrageLineLineACRMSVoltage 1;
BA_ "SAEDocument" SG_ 3221225472 GnrtorOverallPowerFactorLagging "J1939-75";
BA_ "SPN" SG_ 3221225472 GnrtorOverallPowerFactorLagging 2518;
BA_ "SigType" SG_ 3221225472 GnrtorOverallPowerFactorLagging 4;
BA_ "SAEDocument" SG_ 3221225472 GeneratorOverallPowerFactor "J1939-75";
BA_ "SPN" SG_ 3221225472 GeneratorOverallPowerFactor 2464;
BA_ "SigType" SG_ 3221225472 GeneratorOverallPowerFactor 1;
BA_ "SAEDocument" SG_ 3221225472 GeneratorTotalReactivePower "J1939-75";
BA_ "SPN" SG_ 3221225472 GeneratorTotalReactivePower 2456;
BA_ "SigType" SG_ 3221225472 GeneratorTotalReactivePower 1;
BA_ "SAEDocument" SG_ 3221225472 GeneratorTotalApparentPower "J1939-75";
BA_ "SPN" SG_ 3221225472 GeneratorTotalApparentPower 2460;
BA_ "SigType" SG_ 3221225472 GeneratorTotalApparentPower 1;
BA_ "SAEDocument" SG_ 3221225472 GeneratorTotalRealPower "J1939-75";
BA_ "SPN" SG_ 3221225472 GeneratorTotalRealPower 2452;
BA_ "SigType" SG_ 3221225472 GeneratorTotalRealPower 1;
BA_ "SAEDocument" SG_ 3221225472 GeneratorTotalKWHoursImport "J1939-75";
BA_ "SPN" SG_ 3221225472 GeneratorTotalKWHoursImport 2469;
BA_ "SigType" SG_ 3221225472 GeneratorTotalKWHoursImport 4;
BA_ "SAEDocument" SG_ 3221225472 GeneratorTotalKWHoursExport "J1939-75";
BA_ "SPN" SG_ 3221225472 GeneratorTotalKWHoursExport 2468;
BA_ "SigType" SG_ 3221225472 GeneratorTotalKWHoursExport 4;
BA_ "SAEDocument" SG_ 3221225472 GnratorPhaseCPowerFactorLagging "J1939-75";
BA_ "SPN" SG_ 3221225472 GnratorPhaseCPowerFactorLagging 2521;
BA_ "SigType" SG_ 3221225472 GnratorPhaseCPowerFactorLagging 4;
BA_ "SAEDocument" SG_ 3221225472 GeneratorPhaseCPowerFactor "J1939-75";
BA_ "SPN" SG_ 3221225472 GeneratorPhaseCPowerFactor 2467;
BA_ "SigType" SG_ 3221225472 GeneratorPhaseCPowerFactor 1;
BA_ "SAEDocument" SG_ 3221225472 GeneratorPhaseCReactivePower "J1939-75";
BA_ "SPN" SG_ 3221225472 GeneratorPhaseCReactivePower 2459;
BA_ "SigType" SG_ 3221225472 GeneratorPhaseCReactivePower 1;
BA_ "SAEDocument" SG_ 3221225472 GeneratorPhaseCApparentPower "J1939-75";
BA_ "SPN" SG_ 3221225472 GeneratorPhaseCApparentPower 2463;
BA_ "SigType" SG_ 3221225472 GeneratorPhaseCApparentPower 1;
BA_ "SAEDocument" SG_ 3221225472 GeneratorPhaseCRealPower "J1939-75";
BA_ "SPN" SG_ 3221225472 GeneratorPhaseCRealPower 2455;
BA_ "SigType" SG_ 3221225472 GeneratorPhaseCRealPower 1;
BA_ "SAEDocument" SG_ 3221225472 GeneratorPhaseCACRMSCurrent "J1939-75";
BA_ "SPN" SG_ 3221225472 GeneratorPhaseCACRMSCurrent 2451;
BA_ "SigType" SG_ 3221225472 GeneratorPhaseCACRMSCurrent 1;
BA_ "SAEDocument" SG_ 3221225472 GeneratorPhaseCACFrequency "J1939-75";
BA_ "SPN" SG_ 3221225472 GeneratorPhaseCACFrequency 2439;
BA_ "SigType" SG_ 3221225472 GeneratorPhaseCACFrequency 1;
BA_ "SAEDocument" SG_ 3221225472 GnrtrPhsCLneNeutralACRMSVoltage "J1939-75";
BA_ "SPN" SG_ 3221225472 GnrtrPhsCLneNeutralACRMSVoltage 2447;
BA_ "SigType" SG_ 3221225472 GnrtrPhsCLneNeutralACRMSVoltage 1;
BA_ "SAEDocument" SG_ 3221225472 GnrtrPhseCALineLineACRMSVoltage "J1939-75";
BA_ "SPN" SG_ 3221225472 GnrtrPhseCALineLineACRMSVoltage 2443;
BA_ "SigType" SG_ 3221225472 GnrtrPhseCALineLineACRMSVoltage 1;
BA_ "SAEDocument" SG_ 3221225472 GnratorPhaseBPowerFactorLagging "J1939-75";
BA_ "SPN" SG_ 3221225472 GnratorPhaseBPowerFactorLagging 2520;
BA_ "SigType" SG_ 3221225472 GnratorPhaseBPowerFactorLagging 4;
BA_ "SAEDocument" SG_ 3221225472 GeneratorPhaseBPowerFactor "J1939-75";
BA_ "SPN" SG_ 3221225472 GeneratorPhaseBPowerFactor 2466;
BA_ "SigType" SG_ 3221225472 GeneratorPhaseBPowerFactor 1;
BA_ "SAEDocument" SG_ 3221225472 GeneratorPhaseBReactivePower "J1939-75";
BA_ "SPN" SG_ 3221225472 GeneratorPhaseBReactivePower 2458;
BA_ "SigType" SG_ 3221225472 GeneratorPhaseBReactivePower 1;
BA_ "SAEDocument" SG_ 3221225472 GeneratorPhaseBApparentPower "J1939-75";
BA_ "SPN" SG_ 3221225472 GeneratorPhaseBApparentPower 2462;
BA_ "SigType" SG_ 3221225472 GeneratorPhaseBApparentPower 1;
BA_ "SAEDocument" SG_ 3221225472 GeneratorPhaseBRealPower "J1939-75";
BA_ "SPN" SG_ 3221225472 GeneratorPhaseBRealPower 2454;
BA_ "SigType" SG_ 3221225472 GeneratorPhaseBRealPower 1;
BA_ "SAEDocument" SG_ 3221225472 GeneratorPhaseBACRMSCurrent "J1939-75";
BA_ "SPN" SG_ 3221225472 GeneratorPhaseBACRMSCurrent 2450;
BA_ "SigType" SG_ 3221225472 GeneratorPhaseBACRMSCurrent 1;
BA_ "SAEDocument" SG_ 3221225472 GeneratorPhaseBACFrequency "J1939-75";
BA_ "SPN" SG_ 3221225472 GeneratorPhaseBACFrequency 2438;
BA_ "SigType" SG_ 3221225472 GeneratorPhaseBACFrequency 1;
BA_ "SAEDocument" SG_ 3221225472 GnrtrPhsBLneNeutralACRMSVoltage "J1939-75";
BA_ "SPN" SG_ 3221225472 GnrtrPhsBLneNeutralACRMSVoltage 2446;
BA_ "SigType" SG_ 3221225472 GnrtrPhsBLneNeutralACRMSVoltage 1;
BA_ "SAEDocument" SG_ 3221225472 GnrtrPhseBCLineLineACRMSVoltage "J1939-75";
BA_ "SPN" SG_ 3221225472 GnrtrPhseBCLineLineACRMSVoltage 2442;
BA_ "SigType" SG_ 3221225472 GnrtrPhseBCLineLineACRMSVoltage 1;
BA_ "SAEDocument" SG_ 3221225472 GnratorPhaseAPowerFactorLagging "J1939-75";
BA_ "SPN" SG_ 3221225472 GnratorPhaseAPowerFactorLagging 2519;
BA_ "SigType" SG_ 3221225472 GnratorPhaseAPowerFactorLagging 4;
BA_ "SAEDocument" SG_ 3221225472 GeneratorPhaseAPowerFactor "J1939-75";
BA_ "SPN" SG_ 3221225472 GeneratorPhaseAPowerFactor 2465;
BA_ "SigType" SG_ 3221225472 GeneratorPhaseAPowerFactor 1;
BA_ "SAEDocument" SG_ 3221225472 GeneratorPhaseAReactivePower "J1939-75";
BA_ "SPN" SG_ 3221225472 GeneratorPhaseAReactivePower 2457;
BA_ "SigType" SG_ 3221225472 GeneratorPhaseAReactivePower 1;
BA_ "SAEDocument" SG_ 3221225472 GeneratorPhaseAApparentPower "J1939-75";
BA_ "SPN" SG_ 3221225472 GeneratorPhaseAApparentPower 2461;
BA_ "SigType" SG_ 3221225472 GeneratorPhaseAApparentPower 1;
BA_ "SAEDocument" SG_ 3221225472 GeneratorPhaseARealPower "J1939-75";
BA_ "SPN" SG_ 3221225472 GeneratorPhaseARealPower 2453;
BA_ "SigType" SG_ 3221225472 GeneratorPhaseARealPower 1;
BA_ "SAEDocument" SG_ 3221225472 GeneratorPhaseAACRMSCurrent "J1939-75";
BA_ "SPN" SG_ 3221225472 GeneratorPhaseAACRMSCurrent 2449;
BA_ "SigType" SG_ 3221225472 GeneratorPhaseAACRMSCurrent 1;
BA_ "SAEDocument" SG_ 3221225472 GeneratorPhaseAACFrequency "J1939-75";
BA_ "SPN" SG_ 3221225472 GeneratorPhaseAACFrequency 2437;
BA_ "SigType" SG_ 3221225472 GeneratorPhaseAACFrequency 1;
BA_ "SAEDocument" SG_ 3221225472 GnrtrPhsALneNeutralACRMSVoltage "J1939-75";
BA_ "SPN" SG_ 3221225472 GnrtrPhsALneNeutralACRMSVoltage 2445;
BA_ "SigType" SG_ 3221225472 GnrtrPhsALneNeutralACRMSVoltage 1;
BA_ "SAEDocument" SG_ 3221225472 GnrtrPhseABLineLineACRMSVoltage "J1939-75";
BA_ "SPN" SG_ 3221225472 GnrtrPhseABLineLineACRMSVoltage 2441;
BA_ "SigType" SG_ 3221225472 GnrtrPhseABLineLineACRMSVoltage 1;
BA_ "SAEDocument" SG_ 3221225472 GeneratorAverageACRMSCurrent "J1939-75";
BA_ "SPN" SG_ 3221225472 GeneratorAverageACRMSCurrent 2448;
BA_ "SigType" SG_ 3221225472 GeneratorAverageACRMSCurrent 1;
BA_ "SAEDocument" SG_ 3221225472 GeneratorAverageACFrequency "J1939-75";
BA_ "SPN" SG_ 3221225472 GeneratorAverageACFrequency 2436;
BA_ "SigType" SG_ 3221225472 GeneratorAverageACFrequency 1;
BA_ "SAEDocument" SG_ 3221225472 GnrtrAvrgLneNeutralACRMSVoltage "J1939-75";
BA_ "SPN" SG_ 3221225472 GnrtrAvrgLneNeutralACRMSVoltage 2444;
BA_ "SigType" SG_ 3221225472 GnrtrAvrgLneNeutralACRMSVoltage 1;
BA_ "SAEDocument" SG_ 3221225472 GnrtrAvrageLineLineACRMSVoltage "J1939-75";
BA_ "SPN" SG_ 3221225472 GnrtrAvrageLineLineACRMSVoltage 2440;
BA_ "SigType" SG_ 3221225472 GnrtrAvrageLineLineACRMSVoltage 1;
BA_ "SAEDocument" SG_ 3221225472 Bus1_UtilityACPhaseDifference "J1939-75";
BA_ "SPN" SG_ 3221225472 Bus1_UtilityACPhaseDifference 2517;
BA_ "SigType" SG_ 3221225472 Bus1_UtilityACPhaseDifference 1;
BA_ "SAEDocument" SG_ 3221225472 Bus1_UtilityInSync "J1939-75";
BA_ "SPN" SG_ 3221225472 Bus1_UtilityInSync 2534;
BA_ "SigType" SG_ 3221225472 Bus1_UtilityInSync 4;
BA_ "SAEDocument" SG_ 3221225472 Bus1_UtilityVoltageMatch "J1939-75";
BA_ "SPN" SG_ 3221225472 Bus1_UtilityVoltageMatch 2532;
BA_ "SigType" SG_ 3221225472 Bus1_UtilityVoltageMatch 4;
BA_ "SAEDocument" SG_ 3221225472 Bus1_UtilityFrequencyMatch "J1939-75";
BA_ "SPN" SG_ 3221225472 Bus1_UtilityFrequencyMatch 2533;
BA_ "SigType" SG_ 3221225472 Bus1_UtilityFrequencyMatch 4;
BA_ "SAEDocument" SG_ 3221225472 Bus1_UtilityPhaseMatch "J1939-75";
BA_ "SPN" SG_ 3221225472 Bus1_UtilityPhaseMatch 2531;
BA_ "SigType" SG_ 3221225472 Bus1_UtilityPhaseMatch 4;
BA_ "SAEDocument" SG_ 3221225472 Bus1_UtilityDeadBus "J1939-75";
BA_ "SPN" SG_ 3221225472 Bus1_UtilityDeadBus 2535;
BA_ "SigType" SG_ 3221225472 Bus1_UtilityDeadBus 4;
BA_ "SAEDocument" SG_ 3221225472 Bus1PhaseCACFrequency "J1939-75";
BA_ "SPN" SG_ 3221225472 Bus1PhaseCACFrequency 2507;
BA_ "SigType" SG_ 3221225472 Bus1PhaseCACFrequency 1;
BA_ "SAEDocument" SG_ 3221225472 Bs1PhseCLineNeutralACRMSVoltage "J1939-75";
BA_ "SPN" SG_ 3221225472 Bs1PhseCLineNeutralACRMSVoltage 2515;
BA_ "SigType" SG_ 3221225472 Bs1PhseCLineNeutralACRMSVoltage 1;
BA_ "SAEDocument" SG_ 3221225472 Bus1PhaseCALineLineACRMSVoltage "J1939-75";
BA_ "SPN" SG_ 3221225472 Bus1PhaseCALineLineACRMSVoltage 2511;
BA_ "SigType" SG_ 3221225472 Bus1PhaseCALineLineACRMSVoltage 1;
BA_ "SAEDocument" SG_ 3221225472 Bus1PhaseBACFrequency "J1939-75";
BA_ "SPN" SG_ 3221225472 Bus1PhaseBACFrequency 2506;
BA_ "SigType" SG_ 3221225472 Bus1PhaseBACFrequency 1;
BA_ "SAEDocument" SG_ 3221225472 Bs1PhseBLineNeutralACRMSVoltage "J1939-75";
BA_ "SPN" SG_ 3221225472 Bs1PhseBLineNeutralACRMSVoltage 2514;
BA_ "SigType" SG_ 3221225472 Bs1PhseBLineNeutralACRMSVoltage 1;
BA_ "SAEDocument" SG_ 3221225472 Bus1PhaseBCLineLineACRMSVoltage "J1939-75";
BA_ "SPN" SG_ 3221225472 Bus1PhaseBCLineLineACRMSVoltage 2510;
BA_ "SigType" SG_ 3221225472 Bus1PhaseBCLineLineACRMSVoltage 1;
BA_ "SAEDocument" SG_ 3221225472 Bus1PhaseAACFrequency "J1939-75";
BA_ "SPN" SG_ 3221225472 Bus1PhaseAACFrequency 2505;
BA_ "SigType" SG_ 3221225472 Bus1PhaseAACFrequency 1;
BA_ "SAEDocument" SG_ 3221225472 Bs1PhseALineNeutralACRMSVoltage "J1939-75";
BA_ "SPN" SG_ 3221225472 Bs1PhseALineNeutralACRMSVoltage 2513;
BA_ "SigType" SG_ 3221225472 Bs1PhseALineNeutralACRMSVoltage 1;
BA_ "SAEDocument" SG_ 3221225472 Bus1PhaseABLineLineACRMSVoltage "J1939-75";
BA_ "SPN" SG_ 3221225472 Bus1PhaseABLineLineACRMSVoltage 2509;
BA_ "SigType" SG_ 3221225472 Bus1PhaseABLineLineACRMSVoltage 1;
BA_ "SAEDocument" SG_ 3221225472 Bus1_GeneratorACPhaseDifference "J1939-75";
BA_ "SPN" SG_ 3221225472 Bus1_GeneratorACPhaseDifference 2516;
BA_ "SigType" SG_ 3221225472 Bus1_GeneratorACPhaseDifference 1;
BA_ "SAEDocument" SG_ 3221225472 Bus1_GeneratorInSync "J1939-75";
BA_ "SPN" SG_ 3221225472 Bus1_GeneratorInSync 2529;
BA_ "SigType" SG_ 3221225472 Bus1_GeneratorInSync 4;
BA_ "SAEDocument" SG_ 3221225472 Bus1_GeneratorVoltageMatch "J1939-75";
BA_ "SPN" SG_ 3221225472 Bus1_GeneratorVoltageMatch 2527;
BA_ "SigType" SG_ 3221225472 Bus1_GeneratorVoltageMatch 4;
BA_ "SAEDocument" SG_ 3221225472 Bus1_GeneratorFrequencyMatch "J1939-75";
BA_ "SPN" SG_ 3221225472 Bus1_GeneratorFrequencyMatch 2528;
BA_ "SigType" SG_ 3221225472 Bus1_GeneratorFrequencyMatch 4;
BA_ "SAEDocument" SG_ 3221225472 Bus1_GeneratorPhaseMatch "J1939-75";
BA_ "SPN" SG_ 3221225472 Bus1_GeneratorPhaseMatch 2526;
BA_ "SigType" SG_ 3221225472 Bus1_GeneratorPhaseMatch 4;
BA_ "SAEDocument" SG_ 3221225472 Bus1_GeneratorDeadBus "J1939-75";
BA_ "SPN" SG_ 3221225472 Bus1_GeneratorDeadBus 2530;
BA_ "SigType" SG_ 3221225472 Bus1_GeneratorDeadBus 4;
BA_ "SAEDocument" SG_ 3221225472 Bus1AverageACFrequency "J1939-75";
BA_ "SPN" SG_ 3221225472 Bus1AverageACFrequency 2504;
BA_ "SigType" SG_ 3221225472 Bus1AverageACFrequency 1;
BA_ "SAEDocument" SG_ 3221225472 Bs1AvrgeLineNeutralACRMSVoltage "J1939-75";
BA_ "SPN" SG_ 3221225472 Bs1AvrgeLineNeutralACRMSVoltage 2512;
BA_ "SigType" SG_ 3221225472 Bs1AvrgeLineNeutralACRMSVoltage 1;
BA_ "SAEDocument" SG_ 3221225472 Bus1AverageLineLineACRMSVoltage "J1939-75";
BA_ "SPN" SG_ 3221225472 Bus1AverageLineLineACRMSVoltage 2508;
BA_ "SigType" SG_ 3221225472 Bus1AverageLineLineACRMSVoltage 1;
BA_ "SigType" SG_ 3221225472 NumberOfMembers 3;
BA_ "SAEDocument" SG_ 3221225472 AddressAssignment "J1939-81";
BA_ "SPN" SG_ 3221225472 AddressAssignment 2847;
BA_ "SigType" SG_ 3221225472 AddressAssignment 1;
BA_ "SAEDocument" SG_ 3221225472 ShrtNameOfActualReportingDevice "J1939-21";
BA_ "SPN" SG_ 3221225472 ShrtNameOfActualReportingDevice 2554;
BA_ "SigType" SG_ 3221225472 ShrtNameOfActualReportingDevice 4;
BA_ "SAEDocument" SG_ 3221225472 LengthOfDataForTheReportedPGN "J1939-21";
BA_ "SPN" SG_ 3221225472 LengthOfDataForTheReportedPGN 2553;
BA_ "SigType" SG_ 3221225472 LengthOfDataForTheReportedPGN 1;
BA_ "SAEDocument" SG_ 3221225472 PGNofRequstedInformation "J1939-21";
BA_ "SPN" SG_ 3221225472 PGNofRequstedInformation 2552;
BA_ "SigType" SG_ 3221225472 PGNofRequstedInformation 6;
BA_ "SAEDocument" SG_ 3221225472 SequenceNumber "J1939-21";
BA_ "SPN" SG_ 3221225472 SequenceNumber 2572;
BA_ "SAEDocument" SG_ 3221225472 TotalNumberOfPacketsEoMA "J1939-21";
BA_ "SAEDocument" SG_ 3221225472 TotalMessageSizeEoMA "J1939-21";
BA_ "SAEDocument" SG_ 3221225472 TotalMessageSizeBAM "J1939-21";
BA_ "SAEDocument" SG_ 3221225472 TotalNumberOfPacketsBAM "J1939-21";
BA_ "SAEDocument" SG_ 3221225472 ConnectionAbortReason "J1939-21";
BA_ "SPN" SG_ 3221225472 ConnectionAbortReason 2570;
BA_ "SAEDocument" SG_ 3221225472 NextPacketNumberToBeSent "J1939-21";
BA_ "SPN" SG_ 3221225472 NextPacketNumberToBeSent 2562;
BA_ "SAEDocument" SG_ 3221225472 NumberOfPacketsThatCanBeSent "J1939-21";
BA_ "SPN" SG_ 3221225472 NumberOfPacketsThatCanBeSent 2561;
BA_ "SAEDocument" SG_ 3221225472 PGNumber "J1939-21";
BA_ "SPN" SG_ 3221225472 PGNumber 2560;
BA_ "SigType" SG_ 3221225472 PGNumber 6;
BA_ "SAEDocument" SG_ 3221225472 MaximumNumberOfPackets "J1939-21";
BA_ "SPN" SG_ 3221225472 MaximumNumberOfPackets 2559;
BA_ "SAEDocument" SG_ 3221225472 TotalNumberOfPackets "J1939-21";
BA_ "SPN" SG_ 3221225472 TotalNumberOfPackets 2558;
BA_ "SAEDocument" SG_ 3221225472 TotalMessageSize "J1939-21";
BA_ "SPN" SG_ 3221225472 TotalMessageSize 2557;
BA_ "SAEDocument" SG_ 3221225472 UseTransferMode "J1939-21";
BA_ "SPN" SG_ 3221225472 UseTransferMode 2575;
BA_ "SigType" SG_ 3221225472 UseTransferMode 4;
BA_ "SAEDocument" SG_ 3221225472 ParameterGroupNumber "J1939-21";
BA_ "SPN" SG_ 3221225472 ParameterGroupNumber 2574;
BA_ "SigType" SG_ 3221225472 ParameterGroupNumber 6;
BA_ "SAEDocument" SG_ 3221225472 AxleGroupWeight "J1939-71";
BA_ "SPN" SG_ 3221225472 AxleGroupWeight 409;
BA_ "SigType" SG_ 3221225472 AxleGroupWeight 1;
BA_ "SAEDocument" SG_ 3221225472 AxleGroupLocation "J1939-71";
BA_ "SPN" SG_ 3221225472 AxleGroupLocation 4074;
BA_ "SAEDocument" SG_ 3221225472 AxleGroupFullWeightCalib "J1939-71";
BA_ "SPN" SG_ 3221225472 AxleGroupFullWeightCalib 407;
BA_ "SigType" SG_ 3221225472 AxleGroupFullWeightCalib 1;
BA_ "SAEDocument" SG_ 3221225472 AxleGroupEmptyWeightCalib "J1939-71";
BA_ "SPN" SG_ 3221225472 AxleGroupEmptyWeightCalib 408;
BA_ "SigType" SG_ 3221225472 AxleGroupEmptyWeightCalib 1;
BA_ "SAEDocument" SG_ 3221225472 DsrdAftrclrClntThermostatOpening "J1939-71";
BA_ "SPN" SG_ 3221225472 DsrdAftrclrClntThermostatOpening 4200;
BA_ "SAEDocument" SG_ 3221225472 DsrdAftercoolerCoolantIntakeTemp "J1939-71";
BA_ "SPN" SG_ 3221225472 DsrdAftercoolerCoolantIntakeTemp 4199;
BA_ "SAEDocument" SG_ 3221225472 AftercoolerCoolantThermostatMode "J1939-71";
BA_ "SPN" SG_ 3221225472 AftercoolerCoolantThermostatMode 4198;
BA_ "SigType" SG_ 3221225472 AftercoolerCoolantThermostatMode 5;
BA_ "SAEDocument" SG_ 3221225472 AddtnlTrlrAxlGrupWeightAvailable "J1939-71";
BA_ "SPN" SG_ 3221225472 AddtnlTrlrAxlGrupWeightAvailable 4072;
BA_ "SigType" SG_ 3221225472 AddtnlTrlrAxlGrupWeightAvailable 5;
BA_ "SAEDocument" SG_ 3221225472 TrailerHAxleGroupWeightAvailable "J1939-71";
BA_ "SPN" SG_ 3221225472 TrailerHAxleGroupWeightAvailable 4071;
BA_ "SigType" SG_ 3221225472 TrailerHAxleGroupWeightAvailable 5;
BA_ "SAEDocument" SG_ 3221225472 TrailerGAxleGroupWeightAvailable "J1939-71";
BA_ "SPN" SG_ 3221225472 TrailerGAxleGroupWeightAvailable 4070;
BA_ "SigType" SG_ 3221225472 TrailerGAxleGroupWeightAvailable 5;
BA_ "SAEDocument" SG_ 3221225472 TrailerFAxleGroupWeightAvailable "J1939-71";
BA_ "SPN" SG_ 3221225472 TrailerFAxleGroupWeightAvailable 4069;
BA_ "SigType" SG_ 3221225472 TrailerFAxleGroupWeightAvailable 5;
BA_ "SAEDocument" SG_ 3221225472 TrailerEAxleGroupWeightAvailable "J1939-71";
BA_ "SPN" SG_ 3221225472 TrailerEAxleGroupWeightAvailable 4068;
BA_ "SigType" SG_ 3221225472 TrailerEAxleGroupWeightAvailable 5;
BA_ "SAEDocument" SG_ 3221225472 TrailerDAxleGroupWeightAvailable "J1939-71";
BA_ "SPN" SG_ 3221225472 TrailerDAxleGroupWeightAvailable 4067;
BA_ "SigType" SG_ 3221225472 TrailerDAxleGroupWeightAvailable 5;
BA_ "SAEDocument" SG_ 3221225472 TrailerCAxleGroupWeightAvailable "J1939-71";
BA_ "SPN" SG_ 3221225472 TrailerCAxleGroupWeightAvailable 4066;
BA_ "SigType" SG_ 3221225472 TrailerCAxleGroupWeightAvailable 5;
BA_ "SAEDocument" SG_ 3221225472 TrailerBAxleGroupWeightAvailable "J1939-71";
BA_ "SPN" SG_ 3221225472 TrailerBAxleGroupWeightAvailable 4065;
BA_ "SigType" SG_ 3221225472 TrailerBAxleGroupWeightAvailable 5;
BA_ "SAEDocument" SG_ 3221225472 TrailerAAxleGroupWeightAvailable "J1939-71";
BA_ "SPN" SG_ 3221225472 TrailerAAxleGroupWeightAvailable 4064;
BA_ "SigType" SG_ 3221225472 TrailerAAxleGroupWeightAvailable 5;
BA_ "SAEDocument" SG_ 3221225472 AddtnlTrctrAxlGrpWeightAvailable "J1939-71";
BA_ "SPN" SG_ 3221225472 AddtnlTrctrAxlGrpWeightAvailable 4063;
BA_ "SigType" SG_ 3221225472 AddtnlTrctrAxlGrpWeightAvailable 5;
BA_ "SAEDocument" SG_ 3221225472 TagAxleGroupWeightAvailable "J1939-71";
BA_ "SPN" SG_ 3221225472 TagAxleGroupWeightAvailable 4062;
BA_ "SigType" SG_ 3221225472 TagAxleGroupWeightAvailable 5;
BA_ "SAEDocument" SG_ 3221225472 DriveAxleGroupWeightAvailable "J1939-71";
BA_ "SPN" SG_ 3221225472 DriveAxleGroupWeightAvailable 4061;
BA_ "SigType" SG_ 3221225472 DriveAxleGroupWeightAvailable 5;
BA_ "SAEDocument" SG_ 3221225472 LiftAxleGroupWeightAvailable "J1939-71";
BA_ "SPN" SG_ 3221225472 LiftAxleGroupWeightAvailable 4060;
BA_ "SigType" SG_ 3221225472 LiftAxleGroupWeightAvailable 5;
BA_ "SAEDocument" SG_ 3221225472 SteerAxleGroupWeightAvailable "J1939-71";
BA_ "SPN" SG_ 3221225472 SteerAxleGroupWeightAvailable 4059;
BA_ "SigType" SG_ 3221225472 SteerAxleGroupWeightAvailable 5;
BA_ "SAEDocument" SG_ 3221225472 ZeroNetVehicleWeightChange "J1939-71";
BA_ "SPN" SG_ 3221225472 ZeroNetVehicleWeightChange 4075;
BA_ "SigType" SG_ 3221225472 ZeroNetVehicleWeightChange 5;
BA_ "SAEDocument" SG_ 3221225472 EngExhaustGasTempAverageBank2 "J1939-71";
BA_ "SPN" SG_ 3221225472 EngExhaustGasTempAverageBank2 4152;
BA_ "SAEDocument" SG_ 3221225472 EngExhaustGasTempAverageBank1 "J1939-71";
BA_ "SPN" SG_ 3221225472 EngExhaustGasTempAverageBank1 4153;
BA_ "SAEDocument" SG_ 3221225472 EngExhaustGasTempAverage "J1939-71";
BA_ "SPN" SG_ 3221225472 EngExhaustGasTempAverage 4151;
BA_ "SAEDocument" SG_ 3221225472 PermanentDTCs "J1939-73";
BA_ "SPN" SG_ 3221225472 PermanentDTCs 4108;
BA_ "SigType" SG_ 3221225472 PermanentDTCs 1;
BA_ "SAEDocument" SG_ 3221225472 PreviouslyMILOnDTCs "J1939-73";
BA_ "SPN" SG_ 3221225472 PreviouslyMILOnDTCs 4107;
BA_ "SigType" SG_ 3221225472 PreviouslyMILOnDTCs 1;
BA_ "SAEDocument" SG_ 3221225472 MILOnDTCs "J1939-73";
BA_ "SPN" SG_ 3221225472 MILOnDTCs 4106;
BA_ "SigType" SG_ 3221225472 MILOnDTCs 1;
BA_ "SAEDocument" SG_ 3221225472 AllPendingDTCs "J1939-73";
BA_ "SPN" SG_ 3221225472 AllPendingDTCs 4105;
BA_ "SigType" SG_ 3221225472 AllPendingDTCs 1;
BA_ "SAEDocument" SG_ 3221225472 PendingDTCs "J1939-73";
BA_ "SPN" SG_ 3221225472 PendingDTCs 4104;
BA_ "SigType" SG_ 3221225472 PendingDTCs 1;
BA_ "SAEDocument" SG_ 3221225472 AETCSpeedValue "J1939-71";
BA_ "SPN" SG_ 3221225472 AETCSpeedValue 3560;
BA_ "SigType" SG_ 3221225472 AETCSpeedValue 1;
BA_ "SAEDocument" SG_ 3221225472 AETCTorqueValue "J1939-71";
BA_ "SPN" SG_ 3221225472 AETCTorqueValue 3561;
BA_ "SigType" SG_ 3221225472 AETCTorqueValue 1;
BA_ "SAEDocument" SG_ 3221225472 NumberOfAETCDataPoints "J1939-71";
BA_ "SPN" SG_ 3221225472 NumberOfAETCDataPoints 3559;
BA_ "SAEDocument" SG_ 3221225472 AETCDataCollectionStandard "J1939-71";
BA_ "SPN" SG_ 3221225472 AETCDataCollectionStandard 3558;
BA_ "SAEDocument" SG_ 3221225472 RightHeadlampLightDistribution "J1939-71";
BA_ "SPN" SG_ 3221225472 RightHeadlampLightDistribution 3694;
BA_ "SAEDocument" SG_ 3221225472 LeftHeadlampLightDistribution "J1939-71";
BA_ "SPN" SG_ 3221225472 LeftHeadlampLightDistribution 3693;
BA_ "SAEDocument" SG_ 3221225472 RightHeadlampDynamicBendingLight "J1939-71";
BA_ "SPN" SG_ 3221225472 RightHeadlampDynamicBendingLight 3692;
BA_ "SAEDocument" SG_ 3221225472 LeftHeadlampDynamicBendingLight "J1939-71";
BA_ "SPN" SG_ 3221225472 LeftHeadlampDynamicBendingLight 3691;
BA_ "SAEDocument" SG_ 3221225472 AuxI_OChannel2 "J1939-71";
BA_ "SPN" SG_ 3221225472 AuxI_OChannel2 1084;
BA_ "SigType" SG_ 3221225472 AuxI_OChannel2 1;
BA_ "SAEDocument" SG_ 3221225472 AuxI_OChannel1 "J1939-71";
BA_ "SPN" SG_ 3221225472 AuxI_OChannel1 1083;
BA_ "SigType" SG_ 3221225472 AuxI_OChannel1 1;
BA_ "SAEDocument" SG_ 3221225472 AuxI_O13 "J1939-71";
BA_ "SPN" SG_ 3221225472 AuxI_O13 713;
BA_ "SAEDocument" SG_ 3221225472 AuxI_O14 "J1939-71";
BA_ "SPN" SG_ 3221225472 AuxI_O14 714;
BA_ "SAEDocument" SG_ 3221225472 AuxI_O15 "J1939-71";
BA_ "SPN" SG_ 3221225472 AuxI_O15 715;
BA_ "SAEDocument" SG_ 3221225472 AuxI_O16 "J1939-71";
BA_ "SPN" SG_ 3221225472 AuxI_O16 716;
BA_ "SAEDocument" SG_ 3221225472 AuxI_O09 "J1939-71";
BA_ "SPN" SG_ 3221225472 AuxI_O09 709;
BA_ "SAEDocument" SG_ 3221225472 AuxI_O10 "J1939-71";
BA_ "SPN" SG_ 3221225472 AuxI_O10 710;
BA_ "SAEDocument" SG_ 3221225472 AuxI_O11 "J1939-71";
BA_ "SPN" SG_ 3221225472 AuxI_O11 711;
BA_ "SAEDocument" SG_ 3221225472 AuxI_O12 "J1939-71";
BA_ "SPN" SG_ 3221225472 AuxI_O12 712;
BA_ "SAEDocument" SG_ 3221225472 AuxI_O05 "J1939-71";
BA_ "SPN" SG_ 3221225472 AuxI_O05 705;
BA_ "SAEDocument" SG_ 3221225472 AuxI_O06 "J1939-71";
BA_ "SPN" SG_ 3221225472 AuxI_O06 706;
BA_ "SAEDocument" SG_ 3221225472 AuxI_O07 "J1939-71";
BA_ "SPN" SG_ 3221225472 AuxI_O07 707;
BA_ "SAEDocument" SG_ 3221225472 AuxI_O08 "J1939-71";
BA_ "SPN" SG_ 3221225472 AuxI_O08 708;
BA_ "SAEDocument" SG_ 3221225472 AuxI_O01 "J1939-71";
BA_ "SPN" SG_ 3221225472 AuxI_O01 701;
BA_ "SAEDocument" SG_ 3221225472 AuxI_O02 "J1939-71";
BA_ "SPN" SG_ 3221225472 AuxI_O02 702;
BA_ "SAEDocument" SG_ 3221225472 AuxI_O03 "J1939-71";
BA_ "SPN" SG_ 3221225472 AuxI_O03 703;
BA_ "SAEDocument" SG_ 3221225472 AuxI_O04 "J1939-71";
BA_ "SPN" SG_ 3221225472 AuxI_O04 704;
BA_ "SAEDocument" SG_ 3221225472 AuxI_O45 "J1939-71";
BA_ "SPN" SG_ 3221225472 AuxI_O45 3868;
BA_ "SAEDocument" SG_ 3221225472 AuxI_O46 "J1939-71";
BA_ "SPN" SG_ 3221225472 AuxI_O46 3869;
BA_ "SAEDocument" SG_ 3221225472 AuxI_O47 "J1939-71";
BA_ "SPN" SG_ 3221225472 AuxI_O47 3870;
BA_ "SAEDocument" SG_ 3221225472 AuxI_O48 "J1939-71";
BA_ "SPN" SG_ 3221225472 AuxI_O48 3871;
BA_ "SAEDocument" SG_ 3221225472 AuxI_O41 "J1939-71";
BA_ "SPN" SG_ 3221225472 AuxI_O41 3864;
BA_ "SAEDocument" SG_ 3221225472 AuxI_O42 "J1939-71";
BA_ "SPN" SG_ 3221225472 AuxI_O42 3865;
BA_ "SAEDocument" SG_ 3221225472 AuxI_O43 "J1939-71";
BA_ "SPN" SG_ 3221225472 AuxI_O43 3866;
BA_ "SAEDocument" SG_ 3221225472 AuxI_O44 "J1939-71";
BA_ "SPN" SG_ 3221225472 AuxI_O44 3867;
BA_ "SAEDocument" SG_ 3221225472 AuxI_O37 "J1939-71";
BA_ "SPN" SG_ 3221225472 AuxI_O37 3860;
BA_ "SAEDocument" SG_ 3221225472 AuxI_O38 "J1939-71";
BA_ "SPN" SG_ 3221225472 AuxI_O38 3861;
BA_ "SAEDocument" SG_ 3221225472 AuxI_O39 "J1939-71";
BA_ "SPN" SG_ 3221225472 AuxI_O39 3862;
BA_ "SAEDocument" SG_ 3221225472 AuxI_O40 "J1939-71";
BA_ "SPN" SG_ 3221225472 AuxI_O40 3863;
BA_ "SAEDocument" SG_ 3221225472 AuxI_O33 "J1939-71";
BA_ "SPN" SG_ 3221225472 AuxI_O33 3856;
BA_ "SAEDocument" SG_ 3221225472 AuxI_O34 "J1939-71";
BA_ "SPN" SG_ 3221225472 AuxI_O34 3857;
BA_ "SAEDocument" SG_ 3221225472 AuxI_O35 "J1939-71";
BA_ "SPN" SG_ 3221225472 AuxI_O35 3858;
BA_ "SAEDocument" SG_ 3221225472 AuxI_O36 "J1939-71";
BA_ "SPN" SG_ 3221225472 AuxI_O36 3859;
BA_ "SAEDocument" SG_ 3221225472 AuxI_O29 "J1939-71";
BA_ "SPN" SG_ 3221225472 AuxI_O29 3852;
BA_ "SAEDocument" SG_ 3221225472 AuxI_O30 "J1939-71";
BA_ "SPN" SG_ 3221225472 AuxI_O30 3853;
BA_ "SAEDocument" SG_ 3221225472 AuxI_O31 "J1939-71";
BA_ "SPN" SG_ 3221225472 AuxI_O31 3854;
BA_ "SAEDocument" SG_ 3221225472 AuxI_O32 "J1939-71";
BA_ "SPN" SG_ 3221225472 AuxI_O32 3855;
BA_ "SAEDocument" SG_ 3221225472 AuxI_O25 "J1939-71";
BA_ "SPN" SG_ 3221225472 AuxI_O25 3848;
BA_ "SAEDocument" SG_ 3221225472 AuxI_O26 "J1939-71";
BA_ "SPN" SG_ 3221225472 AuxI_O26 3849;
BA_ "SAEDocument" SG_ 3221225472 AuxI_O27 "J1939-71";
BA_ "SPN" SG_ 3221225472 AuxI_O27 3850;
BA_ "SAEDocument" SG_ 3221225472 AuxI_O28 "J1939-71";
BA_ "SPN" SG_ 3221225472 AuxI_O28 3851;
BA_ "SAEDocument" SG_ 3221225472 AuxI_O21 "J1939-71";
BA_ "SPN" SG_ 3221225472 AuxI_O21 3844;
BA_ "SAEDocument" SG_ 3221225472 AuxI_O22 "J1939-71";
BA_ "SPN" SG_ 3221225472 AuxI_O22 3845;
BA_ "SAEDocument" SG_ 3221225472 AuxI_O23 "J1939-71";
BA_ "SPN" SG_ 3221225472 AuxI_O23 3846;
BA_ "SAEDocument" SG_ 3221225472 AuxI_O24 "J1939-71";
BA_ "SPN" SG_ 3221225472 AuxI_O24 3847;
BA_ "SAEDocument" SG_ 3221225472 AuxI_O17 "J1939-71";
BA_ "SPN" SG_ 3221225472 AuxI_O17 3840;
BA_ "SAEDocument" SG_ 3221225472 AuxI_O18 "J1939-71";
BA_ "SPN" SG_ 3221225472 AuxI_O18 3841;
BA_ "SAEDocument" SG_ 3221225472 AuxI_O19 "J1939-71";
BA_ "SPN" SG_ 3221225472 AuxI_O19 3842;
BA_ "SAEDocument" SG_ 3221225472 AuxI_O20 "J1939-71";
BA_ "SPN" SG_ 3221225472 AuxI_O20 3843;
BA_ "SAEDocument" SG_ 3221225472 AuxI_O77 "J1939-71";
BA_ "SPN" SG_ 3221225472 AuxI_O77 3900;
BA_ "SAEDocument" SG_ 3221225472 AuxI_O78 "J1939-71";
BA_ "SPN" SG_ 3221225472 AuxI_O78 3901;
BA_ "SAEDocument" SG_ 3221225472 AuxI_O79 "J1939-71";
BA_ "SPN" SG_ 3221225472 AuxI_O79 3902;
BA_ "SAEDocument" SG_ 3221225472 AuxI_O80 "J1939-71";
BA_ "SPN" SG_ 3221225472 AuxI_O80 3903;
BA_ "SAEDocument" SG_ 3221225472 AuxI_O73 "J1939-71";
BA_ "SPN" SG_ 3221225472 AuxI_O73 3896;
BA_ "SAEDocument" SG_ 3221225472 AuxI_O74 "J1939-71";
BA_ "SPN" SG_ 3221225472 AuxI_O74 3897;
BA_ "SAEDocument" SG_ 3221225472 AuxI_O75 "J1939-71";
BA_ "SPN" SG_ 3221225472 AuxI_O75 3898;
BA_ "SAEDocument" SG_ 3221225472 AuxI_O76 "J1939-71";
BA_ "SPN" SG_ 3221225472 AuxI_O76 3899;
BA_ "SAEDocument" SG_ 3221225472 AuxI_O69 "J1939-71";
BA_ "SPN" SG_ 3221225472 AuxI_O69 3892;
BA_ "SAEDocument" SG_ 3221225472 AuxI_O70 "J1939-71";
BA_ "SPN" SG_ 3221225472 AuxI_O70 3893;
BA_ "SAEDocument" SG_ 3221225472 AuxI_O71 "J1939-71";
BA_ "SPN" SG_ 3221225472 AuxI_O71 3894;
BA_ "SAEDocument" SG_ 3221225472 AuxI_O72 "J1939-71";
BA_ "SPN" SG_ 3221225472 AuxI_O72 3895;
BA_ "SAEDocument" SG_ 3221225472 AuxI_O65 "J1939-71";
BA_ "SPN" SG_ 3221225472 AuxI_O65 3888;
BA_ "SAEDocument" SG_ 3221225472 AuxI_O66 "J1939-71";
BA_ "SPN" SG_ 3221225472 AuxI_O66 3889;
BA_ "SAEDocument" SG_ 3221225472 AuxI_O67 "J1939-71";
BA_ "SPN" SG_ 3221225472 AuxI_O67 3890;
BA_ "SAEDocument" SG_ 3221225472 AuxI_O68 "J1939-71";
BA_ "SPN" SG_ 3221225472 AuxI_O68 3891;
BA_ "SAEDocument" SG_ 3221225472 AuxI_O61 "J1939-71";
BA_ "SPN" SG_ 3221225472 AuxI_O61 3884;
VAL_ 3221225472 KneelingRqLeftSide 3 "Dont care/take no action" 2 "Reserved" 1 "Kneeling request" 0 "No kneeling request" ;
VAL_ 3221225472 AutomaticTractionHelp 3 "Dont care" 2 "Reserved" 1 "Enable automatic traction help" 0 "Disable automatic traction help" ;
VAL_ 3221225472 SuspensionCtrlRefusalInformation 15 "Not available" 14 "Error" 8 "1101 Not defined" 7 "Requested level not available" 6 "General reject Ie no specified reason applies" 5 "Below speed limit" 4 "Above speed limit" 3 "Bogie differential not locked" 2 "Would exceed axle load limit tag axle" 1 "Axle load limit reached load transfer" 0 "Actual request not refused" ;
VAL_ 3221225472 SpeedDependantLevelCtrlStatus 3 "Dont care/take no action" 2 "Reserved" 1 "Active" 0 "Inactive" ;
VAL_ 3221225472 AllwLevelCtrlDuringBrakingStatus 3 "Dont care/take no action" 2 "Reserved" 1 "Activate" 0 "Deactivate" ;
VAL_ 3221225472 SuspensionRemoteCtrl2 3 "Not available" 2 "Error" 1 "Active" 0 "Not active" ;
VAL_ 3221225472 SuspensionRemoteCtrl1 3 "Not available" 2 "Error" 1 "Active" 0 "Not active" ;
VAL_ 3221225472 RearAxleInBumperRange 3 "Not available" 2 "Error" 1 "Actual level within bumper range" 0 "Actual level out of bumper range" ;
VAL_ 3221225472 FrontAxleInBumperRange 3 "Not available" 2 "Error" 1 "Actual level within bumper range" 0 "Actual level out of bumper range" ;
VAL_ 3221225472 DoorRelease 3 "Not available" 2 "Error" 1 "Doors may be opened" 0 "Doors may not be opened" ;
VAL_ 3221225472 VehicleMotionInhibit 3 "Not available" 2 "Error" 1 "Vehicle motion is inhibited" 0 "Vehicle may be moved" ;
VAL_ 3221225472 SecurityDevice 3 "Not available" 2 "Error" 1 "Active" 0 "Not active" ;
VAL_ 3221225472 LevelCtrlMode 10 "Automatic air suspension control prohibited" 15 "Not available" 14 "Error" 9 "Air suspension control prohibited  ie hold current pressures in all suspension devices" 8 "Exhausting bellow function ie the bellows are exhausted totally" 7 "Traction help  load reduce ie the driven axle load is reduced to normal load condition" 6 "Optimum traction 2 ie the pressure at the driven axle is controlled at a fixed value 2" 5 "Optimum traction 1 ie the pressure at the driven axle is controlled at a fixed value 1" 4 "Pressure ratio 2 ie the ratio between the pressures at the driven axle and at the third axle is controlled so that" 3 "Pressure ratio 1 ie the ratio between the pressures at the driven axle and at the third axle is controlled so that" 2 "Load fixing ie the driven axlen is loaded to a value defined by the driver" 1 "Traction help load transfer ie the driven axle is loaded to a maximum value given by legislation or design" 0 "Normal operation ie the system performs a pure control of the vehicle height" ;
VAL_ 3221225472 KneelingInformation 15 "Not available" 14 "Error" 4 "Kneeling abortedie in case of manual actuation the request was dropped before the kneeling level was reached" 3 "Lifting activeie the vehicle is lifted due to a recover request" 2 "Kneeling level reachedie the vehicle is at the fixed kneeling level" 0 "Not activeie the kneeling function is not active" ;
VAL_ 3221225472 LiftingCtrlModeRearAxle 3 "Not available" 2 "Error" 1 "Lifting active" 0 "Lifting not active" ;
VAL_ 3221225472 LiftingCtrlModeFrontAxle 3 "Not available" 2 "Error" 1 "Lifting active" 0 "Lifting not active" ;
VAL_ 3221225472 LoweringCtrlModeRearAxle 3 "Not available" 2 "Error" 1 "Lowering active" 0 "Lowering not active" ;
VAL_ 3221225472 LoweringCtrlModeFrontAxle 3 "Not available" 2 "Error" 1 "Lowering active" 0 "Lowering not active" ;
VAL_ 3221225472 AboveNominalLevelRearAxle 3 "Not available" 2 "Error" 1 "Above" 0 "Not above" ;
VAL_ 3221225472 AboveNominalLevelFrontAxle 3 "Not available" 2 "Error" 1 "Above" 0 "Not above" ;
VAL_ 3221225472 BelowNominalLevelRearAxle 3 "Not available" 2 "Error" 1 "Below" 0 "Not below" ;
VAL_ 3221225472 BelowNominalLevelFrontAxle 3 "Not available" 2 "Error" 1 "Below" 0 "Not below" ;
VAL_ 3221225472 NominalLevelRearAxle 9 "Raising" 10 "Lowering" 15 "Not available" 14 "Error" 8 "Not defined" 7 "Lower Levelie the lowest level to be controlled" 6 "Upper Levelie the highest level to be controlled" 5 "Customer Levelie a level to be defined by customer via parameter setting" 4 "Preset Levelie a level to be defined externally via CAN" 3 "Normal Level 3ie a level permitted for driving for example to lift the vehicle in case of offroad" 2 "Normal Level 2ie a level permitted for driving for example to lower the vehicle in case of high speed" 1 "Normal Level 1ie the level prescribed for normal driving given by design" 0 "Level not specifiedie the nominal level is none of the specified levels no error condition" ;
VAL_ 3221225472 NominalLevelFrontAxle 9 "Raising" 10 "Lowering" 15 "Not available" 14 "Error" 8 "Not defined" 7 "Lower Levelie the lowest level to be controlled" 6 "Upper Levelie the highest level to be controlled" 5 "Customer Levelie a level to be defined by customer via parameter setting" 4 "Preset Levelie a level to be defined externally via CAN" 3 "Normal Level 3ie a level permitted for driving for example to lift the vehicle in case of offroad" 2 "Normal Level 2ie a level permitted for driving for example to lower the vehicle in case of high speed" 1 "Normal Level 1ie the level prescribed for normal driving given by design" 0 "Level not specifiedie the nominal level is none of the specified levels no error condition" ;
VAL_ 3221225472 Alt4Status 3 "not available" 2 "error" 1 "Alternator 4 charging" 0 "Alternator 4 not charging" ;
VAL_ 3221225472 Alt3Status 3 "not available" 2 "error" 1 "Alternator 3 charging" 0 "Alternator 3 not charging" ;
VAL_ 3221225472 Alt2Status 3 "not available" 2 "error" 1 "Alternator 2 charging" 0 "Alternator 2 not charging" ;
VAL_ 3221225472 Alt1Status 3 "not available" 2 "error" 1 "Alternator 1 charging" 0 "Alternator 1 not charging" ;
VAL_ 3221225472 FlashRedStopLamp 3 "Unavailable / Do Not Flash" 2 "Reserved" 1 "Fast Flash" 0 "Slow Flash" ;
VAL_ 3221225472 FlashProtectLamp 3 "Unavailable / Do Not Flash" 2 "Reserved" 1 "Fast Flash" 0 "Slow Flash" ;
VAL_ 3221225472 FlashMalfuncIndicatorLamp 3 "Unavailable / Do Not Flash" 2 "Reserved" 1 "Fast Flash" 0 "Slow Flash" ;
VAL_ 3221225472 FlashAmberWarningLamp 3 "Unavailable / Do Not Flash" 2 "Reserved" 1 "Fast Flash" 0 "Slow Flash" ;
VAL_ 3221225472 MalfunctionIndicatorLampStatus 3 "Not available" 2 "Reserved" 1 "Lamp on" 0 "Lamp off" ;
VAL_ 3221225472 RedStopLampState 3 "Not available" 2 "Reserved" 1 "Lamp on" 0 "Lamp off" ;
VAL_ 3221225472 AmberWarningLampStatus 3 "Not available" 2 "Reserved" 1 "Lamp on" 0 "Lamp off" ;
VAL_ 3221225472 ProtectLampStatus 3 "Not available" 2 "Reserved" 1 "Lamp on" 0 "Lamp off" ;
VAL_ 3221225472 MisfireMonitoringSupport 3 "Not available" 2 "Reserved" 1 "test supported" 0 "test not supported" ;
VAL_ 3221225472 OBDCompliance 10 "JOBD" 11 "JOBD and OBD II" 12 "JOBD and EOBD" 13 "JOBD, EOBD and OBD II" 14 "Heavy Duty Vehicles (EURO IV) B1" 15 "Heavy Duty Vehicles (EURO V) B2" 16 "Heavy Duty Vehicles (EURO EEC) C" 17 "EMD" 18 "EMD+" 19 "HD OBD P" 20 "HD OBD" 21 "WWH OBD" 22 "OBD II (California, ARB 07/08)" 23 "HD EOBD" 25 "OBD-M (SI-SD/I)" 6 "EOBD" 7 "EOBD and OBD II" 8 "EOBD and OBD" 9 "EOBD, OBD and OBD II" 5 "Not intended to meet OBD II req." 4 "OBD I" 3 "OBD and OBD II" 2 "OBD (Federal, EPA)" 1 "OBD II (California, ARB)" 0 "Reserver for assignment by SAE" ;
VAL_ 3221225472 SecondAirSystemMonStatus 1 "TestNotComplete" 0 "TestComplete" ;
VAL_ 3221225472 EvaporativeSystemMonStatus 1 "TestNotComplete" 0 "TestComplete" ;
VAL_ 3221225472 ACSystemRefrigerantMonStatus 1 "TestNotComplete" 0 "TestComplete" ;
VAL_ 3221225472 OxygenSensorHeaterMonStatus 1 "TestNotComplete" 0 "TestComplete" ;
VAL_ 3221225472 OxygenSensorMonStatus 1 "test not complete" 0 "test complete" ;
VAL_ 3221225472 EGRSystemMonitoringStatus 1 "TestNotComplete" 0 "TestComplete" ;
VAL_ 3221225472 CatalystMonStatus 0 "TestComplete" 1 "TestNotComplete" ;
VAL_ 3221225472 ColdStartAidSystemMonStatus 1 "TestNotComplete" 0 "TestComplete" ;
VAL_ 3221225472 HeatedCatalystMonStatus 1 "TestNotComplete" 0 "TestComplete" ;
VAL_ 3221225472 CatalystMonSupp 1 "TestSupported" 0 "TestNotSupported" ;
VAL_ 3221225472 ColdStartAidSystemMonSupp 1 "TestSupported" 0 "TestNotSupported" ;
VAL_ 3221225472 HeatedCatalystMonSupp 1 "TestSupported" 0 "TestNotSupported" ;
VAL_ 3221225472 EvaporativeSystemMonSupp 1 "TestSupported" 0 "TestNotSupported" ;
VAL_ 3221225472 SecondAirSystemMonSupp 1 "TestSupported" 0 "TestNotSupported" ;
VAL_ 3221225472 ACSystemRefrigerantMonSupp 1 "TestSupported" 0 "TestNotSupported" ;
VAL_ 3221225472 OxygenSensorMonSupp 1 "TestSupported" 0 "TestNotSupported" ;
VAL_ 3221225472 OxygenSensorHeaterMonSupp 1 "TestSupported" 0 "TestNotSupported" ;
VAL_ 3221225472 EGRSystemMonitoringSupp 1 "TestSupported" 0 "TestNotSupported" ;
VAL_ 3221225472 MisfireMonitoringStatus 1 "test not complete" 0 "test complete" ;
VAL_ 3221225472 ComprehensiveCompMonStatus 1 "test not complete" 0 "test complete" ;
VAL_ 3221225472 FuelSystemMonitoringStatus 1 "test not complete" 0 "test complete" ;
VAL_ 3221225472 ComprehensiveComponentMonSupp 3 "Not available" 2 "Reserved" 1 "test supported" 0 "test not supported" ;
VAL_ 3221225472 FuelSystemMonitoringSupport 1 "test supported" 0 "test not supported" ;
VAL_ 3221225472 SPNSupportTypeSTR3 1 "SupportedInScaledTestResults" 0 "NotSupportedInScaledTestResults" ;
VAL_ 3221225472 SPNSupportTypeSTR2 1 "SupportedInScaledTestResults" 0 "NotSupportedInScaledTestResults" ;
VAL_ 3221225472 SPNSupportTypeEFF3 1 "SupportedInExFreezeFrame" 0 "NotSupportedInExFreezeFrame" ;
VAL_ 3221225472 SPNSupportTypeEFF2 1 "SupportedInExFreezeFrame" 0 "NotSupportedInExFreezeFrame" ;
VAL_ 3221225472 SPNSupportTypeDS3 1 "SupportedInDataStream" 0 "NotSupportedInDataStream" ;
VAL_ 3221225472 SPNSupportTypeDS2 1 "SupportedInDataStream" 0 "NotSupportedInDataStream" ;
VAL_ 3221225472 SPNSupportTypeSTR1 1 "SupportedInScaledTestResults" 0 "NotSupportedInScaledTestResults" ;
VAL_ 3221225472 SPNSupportTypeDS1 1 "SupportedInDataStream" 0 "NotSupportedInDataStream" ;
VAL_ 3221225472 SPNSupportTypeEFF1 1 "SupportedInExFreezeFrame" 0 "NotSupportedInExFreezeFrame" ;
VAL_ 3221225472 Seed 255 "NoFurtherKeyRequiredOfTool" 1 "UseLongSeedOrKeyFromDataSecMsg" 0 "SeedCompleted_BeginSendingKey" ;
VAL_ 3221225472 EDCP_Extension 9 "DataInErrIndAndDataInSeedIsTime" 6 "DataInErrorIndicator" 3 "ConcatenateDataAsLowerEDCParam" 2 "ConcatenateDataAsHigherEDCParam" 0 "Completed" 255 "NoErrIndicator/EDCParamAvailable" ;
VAL_ 3221225472 ErrorIndicator 16777215 "NoErrorIndicatorAvailable" 65540 "TransprtNotComplWithinTimeAllowd" 65539 "TransportNotInitWithinTimeAllowd" 65538 "NoResponseInTheTimeAllowed" 65537 "ModuleExceedingNumberOfRetries" 65536 "AbortFromExtToNormalSoftwareProc" 4103 "VehicleNotInParkOrNotStationary" 4102 "EngineRunning" 4101 "NotInEngineeringOrDevelopmentMode" 4100 "NotInDiagnosticMode" 4099 "InvalidKey" 4098 "InvalidUserLevel" 4097 "InvalidPassword" 4096 "SecurityErrorGeneral" 266 "NameDoesNotConformToExpectdValue" 265 "DataDoesNotConformToValueRanges" 264 "AddrForBootLoadExeInvalidBoundary" 263 "AddrForBootLoadExeOutsideExeMem" 262 "OpReqExeTransfAndEraseOfProgMem" 261 "OpRequiresPriorEraseOfProgramMem" 260 "OpRequiresPriorEraseOfDataMem" 259 "ReqMemoryExceededAvailableMemory" 258 "LengthNotValidForMemStructAndOp" 257 "AddressNotOnValidBoundary" 256 "AddressingOrDataGeneralError" 36 "InternalFailurePreventingReq" 35 "PROMDidNotVerifyOnWrite" 34 "FLASHDidNotVerifyOnWrite" 33 "RAMDidNotVerifyOnWrite" 32 "EDCParaNotCorrectForDataStream" 31 "ProcessUnspecReqFromThisAddress" 23 "ProcessingEDCPGenerationReq" 22 "ProcessingBootLoadReq" 19 "ProcessingStatusReq" 18 "ProcessingWriteReq" 17 "ProcessingReadReq" 16 "ProcessingEraseReq" 2 "ProcessingForSomeoneElse" 1 "ErrorNotIdentified" 0 "NoError" ;
VAL_ 3221225472 Status 7 "Reserved" 6 "Reserved" 5 "OperationFailed" 4 "OperationCompleted" 3 "Reserved" 2 "Reserved" 1 "Busy" 0 "Proceed" ;
VAL_ 3221225472 KeyOrUserLevel 65535 "NoKeyAvailable" 0 "UseLongSeedOrKey" ;
VAL_ 3221225472 PointerExtension 0 "SPN_SPACE" ;
VAL_ 3221225472 Command 7 "EDCP_Generation" 6 "BootLoad" 5 "OperationFailed" 4 "OperationCompleted" 3 "StatusRequest" 2 "Write" 1 "Read" 0 "Erase" ;
VAL_ 3221225472 PointerType 1 "DirectedSpatialAddressing" 0 "DirectMemoryAddressing" ;
VAL_ 3221225472 HoldSignal 15 "Not available" 1 "Devices whose broadcast state ha" 0 "All devices" ;
VAL_ 3221225472 J1939Network3 3 "Don't care" 2 "Reserved" 1 "Start broadcast" 0 "Stop broadcast" ;
VAL_ 3221225472 J1939Network2 3 "Don't care" 2 "Reserved" 1 "Start broadcast" 0 "Stop broadcast" ;
VAL_ 3221225472 ISO9141 3 "Don't care" 2 "Reserved" 1 "Start broadcast" 0 "Stop broadcast" ;
VAL_ 3221225472 SAE_J1850 3 "Don't care" 2 "Reserved" 1 "Start broadcast" 0 "Stop broadcast" ;
VAL_ 3221225472 ManufacturerSpecificPort 3 "Don't care" 2 "Reserved" 1 "Start broadcast" 0 "Stop broadcast" ;
VAL_ 3221225472 CurrentDataLink 3 "Don't care" 2 "Reserved" 1 "Start broadcast" 0 "Stop broadcast" ;
VAL_ 3221225472 SAE_J1587 3 "Don't care" 2 "Reserved" 1 "Start broadcast" 0 "Stop broadcast" ;
VAL_ 3221225472 SAE_J1922 3 "Don't care" 2 "Reserved" 1 "Start broadcast" 0 "Stop broadcast" ;
VAL_ 3221225472 J1939Network1 3 "Don't care" 2 "Reserved" 1 "Start broadcast" 0 "Stop broadcast" ;
VAL_ 3221225472 SuspendSignal 15 "NotAvailable" 14 "ResumingNormalBroadcastPattern" 3 "TemporarySuspensionOfSomeMessages" 2 "TemporarySuspensionOfAllBroadcasts" 1 "IndefiniteSuspensionOfSomeMessages" 0 "IndefiniteSuspensionOfAllBroadcasts" ;
VAL_ 3221225472 GnrtorOverallPowerFactorLagging 3 "NotAvailable_NotInstalled" 2 "Error" 1 "Lagging" 0 "Leading" ;
VAL_ 3221225472 GnratorPhaseCPowerFactorLagging 3 "NotAvailable_NotInstalled" 2 "Error" 1 "Lagging" 0 "Leading" ;
VAL_ 3221225472 GnratorPhaseBPowerFactorLagging 3 "NotAvailable_NotInstalled" 2 "Error" 1 "Lagging" 0 "Leading" ;
VAL_ 3221225472 GnratorPhaseAPowerFactorLagging 3 "NotAvailable_NotInstalled" 2 "Error" 1 "Lagging" 0 "Leading" ;
VAL_ 3221225472 Bus1_UtilityInSync 3 "NotAvailable" 2 "Error" 1 "Sycnchronized" 0 "NotSynchronized" ;
VAL_ 3221225472 Bus1_UtilityVoltageMatch 3 "NotAvailable" 2 "Error" 1 "VoltagesMatch" 0 "VolatagesDoNotMatch" ;
VAL_ 3221225472 Bus1_UtilityFrequencyMatch 3 "NotAvailable" 2 "Error" 1 "FrequenciesMatch" 0 "FrequenciesDoNotMatch" ;
VAL_ 3221225472 Bus1_UtilityPhaseMatch 3 "NotAvailable" 2 "Error" 1 "PhasesMatch" 0 "PhasesDoNotMatch" ;
VAL_ 3221225472 Bus1_UtilityDeadBus 3 "NotAvailable" 2 "Error" 1 "BusIsDead" 0 "BusIsNotDead" ;
VAL_ 3221225472 Bus1_GeneratorInSync 3 "NotAvailable" 2 "Error" 1 "Sycnchronized" 0 "NotSynchronized" ;
VAL_ 3221225472 Bus1_GeneratorVoltageMatch 3 "NotAvailable" 2 "Error" 1 "VoltagesMatch" 0 "VolatagesDoNotMatch" ;
VAL_ 3221225472 Bus1_GeneratorFrequencyMatch 3 "NotAvailable" 2 "Error" 1 "FrequenciesMatch" 0 "FrequenciesDoNotMatch" ;
VAL_ 3221225472 Bus1_GeneratorPhaseMatch 3 "NotAvailable" 2 "Error" 1 "PhasesMatch" 0 "PhasesDoNotMatch" ;
VAL_ 3221225472 Bus1_GeneratorDeadBus 3 "NotAvailable" 2 "Error" 1 "BusIsDead" 0 "BusIsNotDead" ;
VAL_ 3221225472 PGNumber 255 "NotAvailable" ;
VAL_ 3221225472 UseTransferMode 3 "NA" 2 "Undefined" 1 "Yes" 0 "No" ;
VAL_ 3221225472 AxleGroupLocation 3 "Trailer F axle group" 2 "Trailer E axle group" ;
VAL_ 3221225472 AftercoolerCoolantThermostatMode 3 "dont care/reserved" 2 "reserved" 1 "position control mode used for service only" 0 "temperature control mode" ;
VAL_ 3221225472 AddtnlTrlrAxlGrupWeightAvailable 3 "Not available / not applicable" 2 "Reserved" 1 "Additional trailer axle group present" 0 "Additional trailer axle group not present" ;
VAL_ 3221225472 TrailerHAxleGroupWeightAvailable 3 "Not available / not applicable" 2 "Reserved" 1 "Trailer H axle group present" 0 "Trailer H axle group not present" ;
VAL_ 3221225472 TrailerGAxleGroupWeightAvailable 3 "Not available / not applicable" 2 "Reserved" 1 "Trailer G axle group present" 0 "Trailer G axle group not present" ;
VAL_ 3221225472 TrailerFAxleGroupWeightAvailable 3 "Not available / not applicable" 2 "Reserved" 1 "Trailer F axle group present" 0 "Trailer F axle group not present" ;
VAL_ 3221225472 TrailerEAxleGroupWeightAvailable 3 "Not available / not applicable" 2 "Reserved" 1 "Trailer E axle group present" 0 "Trailer E axle group not present" ;
VAL_ 3221225472 TrailerDAxleGroupWeightAvailable 3 "Not available / not applicable" 2 "Reserved" 1 "Trailer D axle group present" 0 "Trailer D axle group not present" ;
VAL_ 3221225472 TrailerCAxleGroupWeightAvailable 3 "Not available / not applicable" 2 "Reserved" 1 "Trailer C axle group present" 0 "Trailer C axle group not present" ;
VAL_ 3221225472 TrailerBAxleGroupWeightAvailable 3 "Not available / not applicable" 2 "Reserved" 1 "Trailer B axle group present" 0 "Trailer B axle group not present" ;
VAL_ 3221225472 TrailerAAxleGroupWeightAvailable 3 "Not available / not applicable" 2 "Reserved" 1 "Trailer A axle group present" 0 "Trailer A axle group not present" ;
VAL_ 3221225472 AddtnlTrctrAxlGrpWeightAvailable 3 "Not available / not applicable" 2 "Reserved" 1 "Additional tractor axle group present" 0 "Additional tractor axle group not present" ;
VAL_ 3221225472 TagAxleGroupWeightAvailable 3 "Not available / not applicable" 2 "Reserved" 1 "Tag axle group present" 0 "Tag axle group not present" ;
VAL_ 3221225472 DriveAxleGroupWeightAvailable 3 "Not available / not applicable" 2 "Reserved" 1 "Drive axle group present" 0 "Drive axle group not present" ;
VAL_ 3221225472 LiftAxleGroupWeightAvailable 3 "Not available / not applicable" 2 "Reserved" 1 "Lift axle group present" 0 "Lift axle group not present" ;
VAL_ 3221225472 SteerAxleGroupWeightAvailable 3 "Not available / not applicable" 2 "Reserved" 1 "Steer axle group present" 0 "Steer axle group not present" ;
VAL_ 3221225472 ZeroNetVehicleWeightChange 3 "Not available / Not applicable" 2 "Reserved" 1 "Zero Net Vehicle Weight Change" 0 "No change to Net Vehicle Weight Change" ;
VAL_ 3221225472 AETCDataCollectionStandard 15 "Not Available" 0 "SAE J1995" ;
VAL_ 3221225472 RightHeadlampLightDistribution 15 "Not available" 8 "1110 Reserved" 7 "Different light distributions not available No AFS distributions available Head lamp has only one distribution" 6 "Light distribution failure  Module is damaged current position may affect oncoming traffic" 5 "Light distribution fail safe position  Module is damaged current light distribution does not affect oncoming traffic" 4 "Light distribution adverse weather  The adverse weather light improves the viewing situation for the driver on wet" 3 "Light distribution high beam  The high beam distribution of the module generates an illumination level that an" 2 "Light distribution motorway  The task of motorway light is an improved overall viewing distance and an optimum of" 1 "Light distribution country  Country light is mostly similar to the actual SAE low beam pattern Class C" 0 "Light distribution town  The basic light distribution for town light is generated with a symmetrical cutoff line Class" ;
VAL_ 3221225472 LeftHeadlampLightDistribution 15 "Not available" 8 "1110 Reserved" 7 "Different light distributions not available No AFS distributions available Head lamp has only one distribution" 6 "Light distribution failure  Module is damaged current position may affect oncoming traffic" 5 "Light distribution fail safe position  Module is damaged current light distribution does not affect oncoming traffic" 4 "Light distribution adverse weather  The adverse weather light improves the viewing situation for the driver on wet" 3 "Light distribution high beam  The high beam distribution of the module generates an illumination level that an" 2 "Light distribution motorway  The task of motorway light is an improved overall viewing distance and an optimum of" 1 "Light distribution country  Country light is mostly similar to the actual SAE low beam pattern Class C" 0 "Light distribution town  The basic light distribution for town light is generated with a symmetrical cutoff line Class" ;
VAL_ 3221225472 RightHeadlampDynamicBendingLight 7 "Not available" 4 "110 Reserved" 3 "Dynamic bending light failure Bending light does not work current position may affect oncoming traffic" 2 "Dynamic bending light fail safe position Bending light is damaged current position does not affect oncoming traffic" 1 "Dynamic bending light is working properly Normal operation mode Bending light is working properly" 0 "Dynamic bending light deactivated There is no problem but for some reasons eg daylight present the bending" ;
VAL_ 3221225472 LeftHeadlampDynamicBendingLight 7 "Not available" 4 "110 Reserved" 3 "Dynamic bending light failure Bending light does not work current position may affect oncoming traffic" 2 "Dynamic bending light fail safe position Bending light is damaged current position does not affect oncoming traffic" 1 "Dynamic bending light is working properly Normal operation mode Bending light is working properly" 0 "Dynamic bending light deactivated There is no problem but for some reasons eg daylight present the bending" ;
VAL_ 3221225472 AuxI_O13 3 "Not available" 2 "Error" 1 "Auxiliary channel on" 0 "Auxiliary channel off" ;
VAL_ 3221225472 AuxI_O14 3 "Not available" 2 "Error" 1 "Auxiliary channel on" 0 "Auxiliary channel off" ;
VAL_ 3221225472 AuxI_O15 3 "Not available" 2 "Error" 1 "Auxiliary channel on" 0 "Auxiliary channel off" ;
VAL_ 3221225472 AuxI_O16 3 "Not available" 2 "Error" 1 "Auxiliary channel on" 0 "Auxiliary channel off" ;
VAL_ 3221225472 AuxI_O09 3 "Not available" 2 "Error" 1 "Auxiliary channel on" 0 "Auxiliary channel off" ;
VAL_ 3221225472 AuxI_O10 3 "Not available" 2 "Error" 1 "Auxiliary channel on" 0 "Auxiliary channel off" ;
VAL_ 3221225472 AuxI_O11 3 "Not available" 2 "Error" 1 "Auxiliary channel on" 0 "Auxiliary channel off" ;
VAL_ 3221225472 AuxI_O12 3 "Not available" 2 "Error" 1 "Auxiliary channel on" 0 "Auxiliary channel off" ;
VAL_ 3221225472 AuxI_O05 3 "Not available" 2 "Error" 1 "Auxiliary channel on" 0 "Auxiliary channel off" ;
VAL_ 3221225472 AuxI_O06 3 "Not available" 2 "Error" 1 "Auxiliary channel on" 0 "Auxiliary channel off" ;
VAL_ 3221225472 AuxI_O07 3 "Not available" 2 "Error" 1 "Auxiliary channel on" 0 "Auxiliary channel off" ;
VAL_ 3221225472 AuxI_O08 3 "Not available" 2 "Error" 1 "Auxiliary channel on" 0 "Auxiliary channel off" ;
VAL_ 3221225472 AuxI_O01 3 "Not available" 2 "Error" 1 "Auxiliary channel on" 0 "Auxiliary channel off" ;
VAL_ 3221225472 AuxI_O02 3 "Not available" 2 "Error" 1 "Auxiliary channel on" 0 "Auxiliary channel off" ;
VAL_ 3221225472 AuxI_O03 3 "Not available" 2 "Error" 1 "Auxiliary channel on" 0 "Auxiliary channel off" ;
VAL_ 3221225472 AuxI_O04 3 "Not available" 2 "Error" 1 "Auxiliary channel on" 0 "Auxiliary channel off" ;
VAL_ 3221225472 AuxI_O45 3 "Not Available or Take No Action depending on application" 2 "Error Indicator or Not Used  depending on application" 1 "Auxiliary channel on" 0 "Auxiliary channel off" ;
VAL_ 3221225472 AuxI_O46 3 "Not Available or Take No Action depending on application" 2 "Error Indicator or Not Used  depending on application" 1 "Auxiliary channel on" 0 "Auxiliary channel off" ;
VAL_ 3221225472 AuxI_O47 3 "Not Available or Take No Action depending on application" 2 "Error Indicator or Not Used  depending on application" 1 "Auxiliary channel on" 0 "Auxiliary channel off" ;
VAL_ 3221225472 AuxI_O48 3 "Not Available or Take No Action depending on application" 2 "Error Indicator or Not Used  depending on application" 1 "Auxiliary channel on" 0 "Auxiliary channel off" ;
VAL_ 3221225472 AuxI_O41 3 "Not Available or Take No Action depending on application" 2 "Error Indicator or Not Used  depending on application" 1 "Auxiliary channel on" 0 "Auxiliary channel off" ;
VAL_ 3221225472 AuxI_O42 3 "Not Available or Take No Action depending on application" 2 "Error Indicator or Not Used  depending on application" 1 "Auxiliary channel on" 0 "Auxiliary channel off" ;
VAL_ 3221225472 AuxI_O43 3 "Not Available or Take No Action depending on application" 2 "Error Indicator or Not Used  depending on application" 1 "Auxiliary channel on" 0 "Auxiliary channel off" ;
VAL_ 3221225472 AuxI_O44 3 "Not Available or Take No Action depending on application" 2 "Error Indicator or Not Used  depending on application" 1 "Auxiliary channel on" 0 "Auxiliary channel off" ;
VAL_ 3221225472 AuxI_O37 3 "Not Available or Take No Action depending on application" 2 "Error Indicator or Not Used  depending on application" 1 "Auxiliary channel on" 0 "Auxiliary channel off" ;
VAL_ 3221225472 AuxI_O38 3 "Not Available or Take No Action depending on application" 2 "Error Indicator or Not Used  depending on application" 1 "Auxiliary channel on" 0 "Auxiliary channel off" ;
VAL_ 3221225472 AuxI_O39 3 "Not Available or Take No Action depending on application" 2 "Error Indicator or Not Used  depending on application" 1 "Auxiliary channel on" 0 "Auxiliary channel off" ;
VAL_ 3221225472 AuxI_O40 3 "Not Available or Take No Action depending on application" 2 "Error Indicator or Not Used  depending on application" 1 "Auxiliary channel on" 0 "Auxiliary channel off" ;
VAL_ 3221225472 AuxI_O33 3 "Not Available or Take No Action depending on application" 2 "Error Indicator or Not Used  depending on application" 1 "Auxiliary channel on" 0 "Auxiliary channel off" ;
VAL_ 3221225472 AuxI_O34 3 "Not Available or Take No Action depending on application" 2 "Error Indicator or Not Used  depending on application" 1 "Auxiliary channel on" 0 "Auxiliary channel off" ;
VAL_ 3221225472 AuxI_O35 3 "Not Available or Take No Action depending on application" 2 "Error Indicator or Not Used  depending on application" 1 "Auxiliary channel on" 0 "Auxiliary channel off" ;
VAL_ 3221225472 AuxI_O36 3 "Not Available or Take No Action depending on application" 2 "Error Indicator or Not Used  depending on application" 1 "Auxiliary channel on" 0 "Auxiliary channel off" ;
VAL_ 3221225472 AuxI_O29 3 "Not Available or Take No Action depending on application" 2 "Error Indicator or Not Used  depending on application" 1 "Auxiliary channel on" 0 "Auxiliary channel off" ;
VAL_ 3221225472 AuxI_O30 3 "Not Available or Take No Action depending on application" 2 "Error Indicator or Not Used  depending on application" 1 "Auxiliary channel on" 0 "Auxiliary channel off" ;
VAL_ 3221225472 AuxI_O31 3 "Not Available or Take No Action depending on application" 2 "Error Indicator or Not Used  depending on application" 1 "Auxiliary channel on" 0 "Auxiliary channel off" ;
VAL_ 3221225472 AuxI_O32 3 "Not Available or Take No Action depending on application" 2 "Error Indicator or Not Used  depending on application" 1 "Auxiliary channel on" 0 "Auxiliary channel off" ;
VAL_ 3221225472 AuxI_O25 3 "Not Available or Take No Action depending on application" 2 "Error Indicator or Not Used  depending on application" 1 "Auxiliary channel on" 0 "Auxiliary channel off" ;
VAL_ 3221225472 AuxI_O26 3 "Not Available or Take No Action depending on application" 2 "Error Indicator or Not Used  depending on application" 1 "Auxiliary channel on" 0 "Auxiliary channel off" ;
VAL_ 3221225472 AuxI_O27 3 "Not Available or Take No Action depending on application" 2 "Error Indicator or Not Used  depending on application" 1 "Auxiliary channel on" 0 "Auxiliary channel off" ;
VAL_ 3221225472 AuxI_O28 3 "Not Available or Take No Action depending on application" 2 "Error Indicator or Not Used  depending on application" 1 "Auxiliary channel on" 0 "Auxiliary channel off" ;
VAL_ 3221225472 AuxI_O21 3 "Not Available or Take No Action depending on application" 2 "Error Indicator or Not Used  depending on application" 1 "Auxiliary channel on" 0 "Auxiliary channel off" ;
VAL_ 3221225472 AuxI_O22 3 "Not Available or Take No Action depending on application" 2 "Error Indicator or Not Used  depending on application" 1 "Auxiliary channel on" 0 "Auxiliary channel off" ;
VAL_ 3221225472 AuxI_O23 3 "Not Available or Take No Action depending on application" 2 "Error Indicator or Not Used  depending on application" 1 "Auxiliary channel on" 0 "Auxiliary channel off" ;
VAL_ 3221225472 AuxI_O24 3 "Not Available or Take No Action depending on application" 2 "Error Indicator or Not Used  depending on application" 1 "Auxiliary channel on" 0 "Auxiliary channel off" ;
VAL_ 3221225472 AuxI_O17 3 "Not Available or Take No Action depending on application" 2 "Error Indicator or Not Used  depending on application" 1 "Auxiliary channel on" 0 "Auxiliary channel off" ;
VAL_ 3221225472 AuxI_O18 3 "Not Available or Take No Action depending on application" 2 "Error Indicator or Not Used  depending on application" 1 "Auxiliary channel on" 0 "Auxiliary channel off" ;
VAL_ 3221225472 AuxI_O19 3 "Not Available or Take No Action depending on application" 2 "Error Indicator or Not Used  depending on application" 1 "Auxiliary channel on" 0 "Auxiliary channel off" ;
VAL_ 3221225472 AuxI_O20 3 "Not Available or Take No Action depending on application" 2 "Error Indicator or Not Used  depending on application" 1 "Auxiliary channel on" 0 "Auxiliary channel off" ;
VAL_ 3221225472 AuxI_O77 3 "Not Available or Take No Action depending on application" 2 "Error Indicator or Not Used  depending on application" 1 "Auxiliary channel on" 0 "Auxiliary channel off" ;
VAL_ 3221225472 AuxI_O78 3 "Not Available or Take No Action depending on application" 2 "Error Indicator or Not Used  depending on application" 1 "Auxiliary channel on" 0 "Auxiliary channel off" ;
VAL_ 3221225472 AuxI_O79 3 "Not Available or Take No Action depending on application" 2 "Error Indicator or Not Used  depending on application" 1 "Auxiliary channel on" 0 "Auxiliary channel off" ;
VAL_ 3221225472 AuxI_O80 3 "Not Available or Take No Action depending on application" 2 "Error Indicator or Not Used  depending on application" 1 "Auxiliary channel on" 0 "Auxiliary channel off" ;
VAL_ 3221225472 AuxI_O73 3 "Not Available or Take No Action depending on application" 2 "Error Indicator or Not Used  depending on application" 1 "Auxiliary channel on" 0 "Auxiliary channel off" ;
VAL_ 3221225472 AuxI_O74 3 "Not Available or Take No Action depending on application" 2 "Error Indicator or Not Used  depending on application" 1 "Auxiliary channel on" 0 "Auxiliary channel off" ;
VAL_ 3221225472 AuxI_O75 3 "Not Available or Take No Action depending on application" 2 "Error Indicator or Not Used  depending on application" 1 "Auxiliary channel on" 0 "Auxiliary channel off" ;
VAL_ 3221225472 AuxI_O76 3 "Not Available or Take No Action depending on application" 2 "Error Indicator or Not Used  depending on application" 1 "Auxiliary channel on" 0 "Auxiliary channel off" ;
VAL_ 3221225472 AuxI_O69 3 "Not Available or Take No Action depending on application" 2 "Error Indicator or Not Used  depending on application" 1 "Auxiliary channel on" 0 "Auxiliary channel off" ;
VAL_ 3221225472 AuxI_O70 3 "Not Available or Take No Action depending on application" 2 "Error Indicator or Not Used  depending on application" 1 "Auxiliary channel on" 0 "Auxiliary channel off" ;
VAL_ 3221225472 AuxI_O71 3 "Not Available or Take No Action depending on application" 2 "Error Indicator or Not Used  depending on application" 1 "Auxiliary channel on" 0 "Auxiliary channel off" ;
VAL_ 3221225472 AuxI_O72 3 "Not Available or Take No Action depending on application" 2 "Error Indicator or Not Used  depending on application" 1 "Auxiliary channel on" 0 "Auxiliary channel off" ;
VAL_ 3221225472 AuxI_O65 3 "Not Available or Take No Action depending on application" 2 "Error Indicator or Not Used  depending on application" 1 "Auxiliary channel on" 0 "Auxiliary channel off" ;
VAL_ 3221225472 AuxI_O66 3 "Not Available or Take No Action depending on application" 2 "Error Indicator or Not Used  depending on application" 1 "Auxiliary channel on" 0 "Auxiliary channel off" ;
VAL_ 3221225472 AuxI_O67 3 "Not Available or Take No Action depending on application" 2 "Error Indicator or Not Used  depending on application" 1 "Auxiliary channel on" 0 "Auxiliary channel off" ;
VAL_ 3221225472 AuxI_O68 3 "Not Available or Take No Action depending on application" 2 "Error Indicator or Not Used  depending on application" 1 "Auxiliary channel on" 0 "Auxiliary channel off" ;
VAL_ 3221225472 AuxI_O61 3 "Not Available or Take No Action depending on application" 2 "Error Indicator or Not Used  depending on application" 1 "Auxiliary channel on" 0 "Auxiliary channel off" ;
