VERSION ""

NS_ :

BS_:

BU_: Turbocharger OnBoardDataLogger OffBoardDiagnosticTool2 OffBoardDiagnosticTool1 FileServer ParkingBrakeController SeatControl2 FanDriveController SteeringColumnUnit CommunicationUnitRadio CommunicationUnitSatellite CommunicationUnitCellular PropulsionBatteryCharger ChassisController2 ChassisController1 EngineValveControl AuxiliaryHeater2 AuxiliaryHeater1 ClutchUnit RampControl InformationSystem1 SuspensionSystemController2 OilSensor VehicleDynamicStability ExhaustEmissionController TransmissionDisplay2 TransmissionDisplay1 ClimateControl2 WaterPumpController RearAxleSteeringController LightingOperatorControl SeatController1 IgnitionController2 IgnitionController1 TirePressureController CabController2 CabController1 PneumaticSystemController SuspensionSystemController1 HydraulicPumpController EnduranceBrakingSystem RetarderExhaustEngine2 OnBoardDiagnosticUnit HeadwayController RetarderExhaustEngine1 CabDisplay1 ManagementComputer VirtualTerminal OffVehicleGateway PowerTakeOffFront HitchControl AuxiliaryValveControl BodyController TractorTrailerBridge1 StarterSystem ElectricalSystem VehicleSecurity VehicleNavigation AerodynamicControl ElectricalChargingSystem ClimateControl1 TripRecorder InstrumentCluster SuspensionDriveAxle2 SuspensionDriveAxle1 SuspensionSteerAxle SteeringController FuelSystem CruiseControl RetarderDriveline RetarderEngine BrakesDriveAxle2 BrakesDriveAxle1 BrakesSystemController BrakesSteerAxle AxleDrive2 AxleDrive1 AxleSteering PowerTakeOff ShiftConsoleSecondary ShiftConsolePrimary Transmission2 Transmission1 Engine2 Engine1

BO_ 3221225472 VECTOR__INDEPENDENT_SIG_MSG: 0 Vector__XXX
 SG_ FailureSpecificB1Counter : 0|16@1+ (0.1,0) [0|6425.5] "hr" Vector__XXX
 SG_ SysGreatestB1Counter : 0|16@1+ (0.1,0) [0|6425.5] "hr" Vector__XXX
 SG_ SysCumulativeContinuousMITime : 0|32@1+ (0.05,0) [0|210554060.75] "hr" Vector__XXX
 SG_ RegulationDescription : 0|8@1+ (1,0) [0|255] "" Vector__XXX
 SG_ SysIncompleteMonitorCount : 0|16@1+ (1,0) [0|64512] "" Vector__XXX
 SG_ SysMalIndActivationMode : 0|4@1+ (1,0) [0|15] "" Vector__XXX
 SG_ SysMalIndDisplayStrategy : 0|2@1+ (1,0) [0|3] "" Vector__XXX
 SG_ SysContinuousMalfunctionInd : 0|2@1+ (1,0) [0|3] "" Vector__XXX
 SG_ SysNonRoadworthyCompCount : 0|8@1+ (1,0) [0|250] "" Vector__XXX
 SG_ VehicleCurrentMIAccumTime : 0|16@1+ (1,0) [0|64255] "min" Vector__XXX
 SG_ VehicleIncompleteMonitorCount : 0|16@1+ (1,0) [0|64255] "" Vector__XXX
 SG_ VehicleMalfunctionIndActMode : 0|4@1+ (1,0) [0|15] "" Vector__XXX
 SG_ VehicleMalfunctionIndStrategy : 0|2@1+ (1,0) [0|3] "" Vector__XXX
 SG_ VehicleContinuousMalfunctionInd : 0|2@1+ (1,0) [0|3] "" Vector__XXX
 SG_ VehicleNonRoadworthyCompCount : 0|8@1+ (1,0) [0|250] "" Vector__XXX
 SG_ PMNTEDeficiencyAreaStatus : 0|2@1+ (1,0) [0|3] "" Vector__XXX
 SG_ MnfcPMNTECarveOutAreaStatus : 0|2@1+ (1,0) [0|3] "" Vector__XXX
 SG_ PMNTEControlAreaStatus : 0|2@1+ (1,0) [0|3] "" Vector__XXX
 SG_ NOxNTEDeficiencyAreaStatus : 0|2@1+ (1,0) [0|3] "" Vector__XXX
 SG_ MnfcNOxNTECarveOutAreaStatus : 0|2@1+ (1,0) [0|3] "" Vector__XXX
 SG_ NOxNTEControlAreaStatus : 0|2@1+ (1,0) [0|3] "" Vector__XXX
 SG_ AECDEngineHours1Timer2 : 0|32@1+ (1,0) [0|4294967295] "min" Vector__XXX
 SG_ AECDEngineHours1Timer1 : 0|32@1+ (1,0) [0|4294967295] "min" Vector__XXX
 SG_ AECDNumber1 : 0|8@1+ (1,0) [0|250] "" Vector__XXX
 SG_ BatteryMainSwitchHoldState : 0|2@1+ (1,0) [0|3] "" Vector__XXX
 SG_ Joystick3XAxisDetentPosStatus : 0|2@1+ (1,0) [0|3] "" Vector__XXX
 SG_ Joystick3Button9PressedStatus : 0|2@1+ (1,0) [0|3] "" Vector__XXX
 SG_ Joystick3Button10PressedStatus : 0|2@1+ (1,0) [0|3] "" Vector__XXX
 SG_ Joystick3Button11PressedStatus : 0|2@1+ (1,0) [0|3] "" Vector__XXX
 SG_ Joystick3Button12PressedStatus : 0|2@1+ (1,0) [0|3] "" Vector__XXX
 SG_ Joystick3YAxisDetentPosStatus : 0|2@1+ (1,0) [0|3] "" Vector__XXX
 SG_ Joystick3YAxisPos : 0|10@1+ (1,0) [0|102] "%" Vector__XXX
 SG_ Jystck3YAxsLvrFrwrdPstvPosStatus : 0|2@1+ (1,0) [0|3] "" Vector__XXX
 SG_ Jystck3YAxsLvrBckNgtivePosStatus : 0|2@1+ (1,0) [0|3] "" Vector__XXX
 SG_ Joystick3YAxisNeutralPosStatus : 0|2@1+ (1,0) [0|3] "" Vector__XXX
 SG_ Joystick3XAxisPos : 0|10@1+ (1,0) [0|102] "%" Vector__XXX
 SG_ Jystck3XAxsLvrRghtPstvePosStatus : 0|2@1+ (1,0) [0|3] "" Vector__XXX
 SG_ Jystck3XAxsLvrLftNgtivePosStatus : 0|2@1+ (1,0) [0|3] "" Vector__XXX
 SG_ Joystick3XAxisNeutralPosStatus : 0|2@1+ (1,0) [0|3] "" Vector__XXX
 SG_ Joystick3Button5PressedStatus : 0|2@1+ (1,0) [0|3] "" Vector__XXX
 SG_ Joystick3Button6PressedStatus : 0|2@1+ (1,0) [0|3] "" Vector__XXX
 SG_ Joystick3Button7PressedStatus : 0|2@1+ (1,0) [0|3] "" Vector__XXX
 SG_ Joystick3Button8PressedStatus : 0|2@1+ (1,0) [0|3] "" Vector__XXX
 SG_ Joystick3Button1PressedStatus : 0|2@1+ (1,0) [0|3] "" Vector__XXX
 SG_ Joystick3Button2PressedStatus : 0|2@1+ (1,0) [0|3] "" Vector__XXX
 SG_ Joystick3Button3PressedStatus : 0|2@1+ (1,0) [0|3] "" Vector__XXX
 SG_ Joystick3Button4PressedStatus : 0|2@1+ (1,0) [0|3] "" Vector__XXX
 SG_ Joystick2XAxisDetentPosStatus : 0|2@1+ (1,0) [0|3] "" Vector__XXX
 SG_ Joystick2YAxisDetentPosStatus : 0|2@1+ (1,0) [0|3] "" Vector__XXX
 SG_ Joystick2YAxisPos : 0|10@1+ (1,0) [0|102] "%" Vector__XXX
 SG_ Jystck2YAxsLvrFrwrdPstvPosStatus : 0|2@1+ (1,0) [0|3] "" Vector__XXX
 SG_ Jystck2YAxsLvrBckNgtivePosStatus : 0|2@1+ (1,0) [0|3] "" Vector__XXX
 SG_ Joystick2YAxisNeutralPosStatus : 0|2@1+ (1,0) [0|3] "" Vector__XXX
 SG_ Joystick2XAxisPos : 0|10@1+ (1,0) [0|102] "%" Vector__XXX
 SG_ Jystck2XAxsLvrRghtPstvePosStatus : 0|2@1+ (1,0) [0|3] "" Vector__XXX
 SG_ Jystck2XAxsLvrLftNgtivePosStatus : 0|2@1+ (1,0) [0|3] "" Vector__XXX
 SG_ Joystick2XAxisNeutralPosStatus : 0|2@1+ (1,0) [0|3] "" Vector__XXX
 SG_ Joystick2Button9PressedStatus : 0|2@1+ (1,0) [0|3] "" Vector__XXX
 SG_ Joystick2Button10PressedStatus : 0|2@1+ (1,0) [0|3] "" Vector__XXX
 SG_ Joystick2Button11PressedStatus : 0|2@1+ (1,0) [0|3] "" Vector__XXX
 SG_ Joystick2Button12PressedStatus : 0|2@1+ (1,0) [0|3] "" Vector__XXX
 SG_ Joystick2Button5PressedStatus : 0|2@1+ (1,0) [0|3] "" Vector__XXX
 SG_ Joystick2Button6PressedStatus : 0|2@1+ (1,0) [0|3] "" Vector__XXX
 SG_ Joystick2Button7PressedStatus : 0|2@1+ (1,0) [0|3] "" Vector__XXX
 SG_ Joystick2Button8PressedStatus : 0|2@1+ (1,0) [0|3] "" Vector__XXX
 SG_ Joystick2Button1PressedStatus : 0|2@1+ (1,0) [0|3] "" Vector__XXX
 SG_ Joystick2Button2PressedStatus : 0|2@1+ (1,0) [0|3] "" Vector__XXX
 SG_ Joystick2Button3PressedStatus : 0|2@1+ (1,0) [0|3] "" Vector__XXX
 SG_ Joystick2Button4PressedStatus : 0|2@1+ (1,0) [0|3] "" Vector__XXX
 SG_ Joystick1XAxisDetentPosStatus : 0|2@1+ (1,0) [0|3] "" Vector__XXX
 SG_ Joystick1YAxisDetentPosStatus : 0|2@1+ (1,0) [0|3] "" Vector__XXX
 SG_ Joystick1YAxisPos : 0|10@1+ (1,0) [0|102] "%" Vector__XXX
 SG_ Jystck1YAxsLvrFrwrdPstvPosStatus : 0|2@1+ (1,0) [0|3] "" Vector__XXX
 SG_ Jystck1YAxsLvrBckNgtivePosStatus : 0|2@1+ (1,0) [0|3] "" Vector__XXX
 SG_ Joystick1YAxisNeutralPosStatus : 0|2@1+ (1,0) [0|3] "" Vector__XXX
 SG_ Joystick1XAxisPos : 0|10@1+ (1,0) [0|102] "%" Vector__XXX
 SG_ Joystick1Button9PressedStatus : 0|2@1+ (1,0) [0|3] "" Vector__XXX
 SG_ Joystick1Button10PressedStatus : 0|2@1+ (1,0) [0|3] "" Vector__XXX
 SG_ Joystick1Button11PressedStatus : 0|2@1+ (1,0) [0|3] "" Vector__XXX
 SG_ Joystick1Button12PressedStatus : 0|2@1+ (1,0) [0|3] "" Vector__XXX
 SG_ Joystick1Button5PressedStatus : 0|2@1+ (1,0) [0|3] "" Vector__XXX
 SG_ Joystick1Button6PressedStatus : 0|2@1+ (1,0) [0|3] "" Vector__XXX
 SG_ Joystick1Button7PressedStatus : 0|2@1+ (1,0) [0|3] "" Vector__XXX
 SG_ Joystick1Button8PressedStatus : 0|2@1+ (1,0) [0|3] "" Vector__XXX
 SG_ Joystick1Button1PressedStatus : 0|2@1+ (1,0) [0|3] "" Vector__XXX
 SG_ Joystick1Button2PressedStatus : 0|2@1+ (1,0) [0|3] "" Vector__XXX
 SG_ Joystick1Button3PressedStatus : 0|2@1+ (1,0) [0|3] "" Vector__XXX
 SG_ Joystick1Button4PressedStatus : 0|2@1+ (1,0) [0|3] "" Vector__XXX
 SG_ Jystck1XAxsLvrRghtPstvePosStatus : 0|2@1+ (1,0) [0|3] "" Vector__XXX
 SG_ Jystck1XAxsLvrLftNgtivePosStatus : 0|2@1+ (1,0) [0|3] "" Vector__XXX
 SG_ Joystick1XAxisNeutralPosStatus : 0|2@1+ (1,0) [0|3] "" Vector__XXX
 SG_ ParkingBrakeRedWarningSignal : 0|2@1+ (1,0) [0|3] "" Vector__XXX
 SG_ ParkBrakeReleaseInhibitStatus : 0|2@1+ (1,0) [0|3] "" Vector__XXX
 SG_ ParkingBrakeActuator : 0|2@1+ (1,0) [0|3] "" Vector__XXX
 SG_ BrakeSecondPress : 0|8@1+ (4,0) [0|1000] "kPa" Vector__XXX
 SG_ BrakePrimaryPress : 0|8@1+ (4,0) [0|1000] "kPa" Vector__XXX
 SG_ BrakeAppPress : 0|8@1+ (4,0) [0|1000] "kPa" Vector__XXX
 SG_ AuxPumpPress : 0|8@1+ (16,0) [0|4000] "kPa" Vector__XXX
 SG_ Aftrtrtmnt1DslOxdtnCtlystDffPrss : 0|5@1+ (1,0) [0|31] "" Vector__XXX
 SG_ Aftrtrtmnt1DslOxdtnCtlystOtltGsT : 0|5@1+ (1,0) [0|31] "" Vector__XXX
 SG_ Aftrtrtmnt1DslOxdtnCtlystIntkGsT : 0|5@1+ (1,0) [0|31] "" Vector__XXX
 SG_ Aftrtrtmnt1DslOxdtnCtlystDffPrss : 0|16@1+ (0.1,0) [0|6425.5] "kPa" Vector__XXX
 SG_ Aftrtrtmnt1DslOxdtnCtlystOtltGsT : 0|16@1+ (0.03125,-273) [-273|1734.96875] "deg C" Vector__XXX
 SG_ Aftrtrtmnt1DslOxdtnCtlystIntkGsT : 0|16@1+ (0.03125,-273) [-273|1734.96875] "deg C" Vector__XXX
 SG_ DTCWarnLampSupportStatus : 0|2@1+ (1,0) [0|3] "" Vector__XXX
 SG_ DTCWarnLampSupportFlash : 0|2@1+ (1,0) [0|3] "" Vector__XXX
 SG_ DTCStopLampSupportStatus : 0|2@1+ (1,0) [0|3] "" Vector__XXX
 SG_ DTCStopLampSupportFlash : 0|2@1+ (1,0) [0|3] "" Vector__XXX
 SG_ DTCProtectLampSupportStatus : 0|2@1+ (1,0) [0|3] "" Vector__XXX
 SG_ DTCProtectLampSupportFlash : 0|2@1+ (1,0) [0|3] "" Vector__XXX
 SG_ DTCMilSupportStatus : 0|2@1+ (1,0) [0|3] "" Vector__XXX
 SG_ DTCMilSupportFlash : 0|2@1+ (1,0) [0|3] "" Vector__XXX
 SG_ DTC1 : 0|32@1+ (1,0) [0|4294967295] "" Vector__XXX
 SG_ DataDictionaryMethod : 0|21@1+ (1,0) [0|2097151] "" Vector__XXX
 SG_ DataDictionaryManufacturerCode : 0|11@1+ (1,0) [0|2047] "" Vector__XXX
 SG_ EngExhstGsOxygnSnsrClsdLpOprtnBn : 0|4@1+ (1,0) [0|15] "" Vector__XXX
 SG_ ShorttermFuelTrimBank2 : 0|16@1+ (1,-100) [-100|100] "%" Vector__XXX
 SG_ LongtermFuelTrimBank2 : 0|16@1+ (1,-100) [-100|100] "%" Vector__XXX
 SG_ EngExhstGsOxygnSnsrClsdLpOprtnBn : 0|4@1+ (1,0) [0|15] "" Vector__XXX
 SG_ ShorttermFuelTrimBank1 : 0|16@1+ (1,-100) [-100|100] "%" Vector__XXX
 SG_ LongtermFuelTrimBank1 : 0|16@1+ (1,-100) [-100|100] "%" Vector__XXX
 SG_ EngSpdSensor1TimingPatternStatus : 0|2@1+ (1,0) [0|3] "" Vector__XXX
 SG_ EngSpdSensor2TimingPatternStatus : 0|2@1+ (1,0) [0|3] "" Vector__XXX
 SG_ EngSpdSensor3TimingPatternStatus : 0|2@1+ (1,0) [0|3] "" Vector__XXX
 SG_ EngSpeed3 : 0|16@1+ (0.5,0) [0|32127.5] "rpm" Vector__XXX
 SG_ EngSpeed2 : 0|16@1+ (0.5,0) [0|32127.5] "rpm" Vector__XXX
 SG_ EngSpeed1 : 0|16@1+ (0.5,0) [0|32127.5] "rpm" Vector__XXX
 SG_ DsredEngCoolantThermostatOpening : 0|8@1+ (1,0) [0|100] "%" Vector__XXX
 SG_ DesiredEngCoolantPumpOutletTemp : 0|8@1+ (1,-40) [-40|210] "deg C" Vector__XXX
 SG_ EngCoolantThermostatMode : 0|2@1+ (1,0) [0|3] "" Vector__XXX
 SG_ AuxI_OChannel19 : 0|8@1+ (1,0) [0|250] "" Vector__XXX
 SG_ AuxI_OChannel20 : 0|8@1+ (1,0) [0|250] "" Vector__XXX
 SG_ AuxI_OChannel21 : 0|8@1+ (1,0) [0|250] "" Vector__XXX
 SG_ AuxI_OChannel22 : 0|8@1+ (1,0) [0|250] "" Vector__XXX
 SG_ AuxI_OChannel15 : 0|8@1+ (1,0) [0|250] "" Vector__XXX
 SG_ AuxI_OChannel16 : 0|8@1+ (1,0) [0|250] "" Vector__XXX
 SG_ AuxI_OChannel17 : 0|8@1+ (1,0) [0|250] "" Vector__XXX
 SG_ AuxI_OChannel18 : 0|8@1+ (1,0) [0|250] "" Vector__XXX
 SG_ AuxI_OChannel11 : 0|8@1+ (1,0) [0|250] "" Vector__XXX
 SG_ AuxI_OChannel12 : 0|8@1+ (1,0) [0|250] "" Vector__XXX
 SG_ AuxI_OChannel13 : 0|8@1+ (1,0) [0|250] "" Vector__XXX
 SG_ AuxI_OChannel14 : 0|8@1+ (1,0) [0|250] "" Vector__XXX
 SG_ AuxI_OChannel7 : 0|8@1+ (1,0) [0|250] "" Vector__XXX
 SG_ AuxI_OChannel8 : 0|8@1+ (1,0) [0|250] "" Vector__XXX
 SG_ AuxI_OChannel9 : 0|8@1+ (1,0) [0|250] "" Vector__XXX
 SG_ AuxI_OChannel10 : 0|8@1+ (1,0) [0|250] "" Vector__XXX
 SG_ AuxI_OChannel3 : 0|16@1+ (1,0) [0|64255] "counts" Vector__XXX
 SG_ AuxI_OChannel4 : 0|16@1+ (1,0) [0|64255] "counts" Vector__XXX
 SG_ AuxI_OChannel5 : 0|16@1+ (1,0) [0|64255] "counts" Vector__XXX
 SG_ AuxI_OChannel6 : 0|16@1+ (1,0) [0|64255] "counts" Vector__XXX
 SG_ Aftertreatment1AirEnableActuator : 0|2@1+ (1,0) [0|3] "" Vector__XXX
 SG_ Aftertreatment1PurgeAirActuator : 0|2@1+ (1,0) [0|3] "" Vector__XXX
 SG_ Aftrtrtmnt1AtmizationAirActuator : 0|2@1+ (1,0) [0|3] "" Vector__XXX
 SG_ Aftertreatment1AirSystemRelay : 0|2@1+ (1,0) [0|3] "" Vector__XXX
 SG_ Aftrtratment1AirPressActuatorPos : 0|8@1+ (0.4,0) [0|100] "%" Vector__XXX
 SG_ Aftertreatment1AirPressCtrl : 0|16@1+ (0.0025,0) [0|160.6375] "%" Vector__XXX
 SG_ Aftertreatment1PurgeAirPress : 0|16@1+ (0.1,0) [0|6425.5] "kPa" Vector__XXX
 SG_ Aftertreatment1SupplyAirPress : 0|16@1+ (0.1,0) [0|6425.5] "kPa" Vector__XXX
 SG_ Aftertreatment1SecondAirPress : 0|16@1+ (0.1,0) [0|6425.5] "kPa" Vector__XXX
 SG_ Aftertreatment1SecondAirMassFlow : 0|16@1+ (0.2,0) [0|12851] "kg/h per bit" Vector__XXX
 SG_ Aftertreatment1SecondAirTemp : 0|16@1+ (0.03125,-273) [-273|1734.96875] "deg C" Vector__XXX
 SG_ Aftrtreatment1SecondAirDiffPress : 0|16@1+ (0.0078124659559567,-250) [-250|251.99] "kPa" Vector__XXX
 SG_ Aftrtrtmnt1FlInjector1HeaterCtrl : 0|8@1+ (1,0) [0|100] "%" Vector__XXX
 SG_ Aftrtreatment1FuelEnableActuator : 0|2@1+ (1,0) [0|3] "" Vector__XXX
 SG_ Aftrtreatment1RegenerationStatus : 0|2@1+ (1,0) [0|3] "" Vector__XXX
 SG_ Aftertreatment1Ignt : 0|2@1+ (1,0) [0|3] "" Vector__XXX
 SG_ Aftertreatment1FuelDrainActuator : 0|2@1+ (1,0) [0|3] "" Vector__XXX
 SG_ Aftertreatment1FuelPress1Ctrl : 0|16@1+ (1,0) [0|160.6375] "%" Vector__XXX
 SG_ Aftertreatment1FuelRate : 0|16@1+ (0.05,0) [0|3212.75] "L/h" Vector__XXX
 SG_ Aftertreatment1FuelPress1 : 0|16@1+ (0.1,0) [0|6425.5] "kPa" Vector__XXX
 SG_ Aftrtrtmnt1HydrcrbnDsrIntkFlTemp : 0|8@1+ (1,-40) [-40|210] "deg C" Vector__XXX
 SG_ Aftrtrtmnt1FelPress2ActuatorCtrl : 0|16@1+ (1,0) [0|160.6375] "%" Vector__XXX
 SG_ Aftrtrtmnt1FlFlwDverterValveCtrl : 0|2@1+ (1,0) [0|3] "" Vector__XXX
 SG_ Aftertreatment1FuelPumpRelayCtrl : 0|2@1+ (1,0) [0|3] "" Vector__XXX
 SG_ Aftertreatment1FuelPress2 : 0|16@1+ (0.1,0) [0|6425.5] "kPa" Vector__XXX
 SG_ DslParticulateFilterOutletPress1 : 0|16@1+ (0.1,0) [0|6425.5] "kPa" Vector__XXX
 SG_ DslParticulateFilterIntakePress1 : 0|16@1+ (0.1,0) [0|6425.5] "kPa" Vector__XXX
 SG_ Aftrtrtmnt1AvrgTmBtwnActvRgnrtns : 0|32@1+ (1,0) [0|4211081215] "s" Vector__XXX
 SG_ Aftrtrtmnt1TtlNmbrOfActvRgnrtnMn : 0|32@1+ (1.0199203187298,0) [0|4294967295] "counts" Vector__XXX
 SG_ Aftrtrtmnt1TtlNmbrOfActvRgnrtnIn : 0|32@1+ (1.0199203187298,0) [0|4294967295] "counts" Vector__XXX
 SG_ Aftrtrtmnt1TtlNmbrOfPssvRgnrtons : 0|32@1+ (1.0199203187298,0) [0|4294967295] "counts" Vector__XXX
 SG_ Aftrtrtmnt1TtlPssvRgnerationTime : 0|32@1+ (1,0) [0|4211081215] "s" Vector__XXX
 SG_ Aftrtrtmnt1TtlNmbrOfActvRgnrtons : 0|32@1+ (1,0) [0|4294967295] "counts" Vector__XXX
 SG_ Aftertreatment1TotalDisabledTime : 0|32@1+ (1,0) [0|4211081215] "s" Vector__XXX
 SG_ Aftrtrtmnt1TotalRegenerationTime : 0|32@1+ (1,0) [0|4211081215] "s" Vector__XXX
 SG_ Aftertreatment1TotalFuelUsed : 0|32@1+ (0.5,0) [0|2105540607.5] "L" Vector__XXX
 SG_ Aftrtrtmnt1IntkOxygnSnsrPrlmnryF : 0|5@1+ (1,0) [0|31] "" Vector__XXX
 SG_ Aftrtrtmnt1IntkNOxSnsrPrlmnryFMI : 0|5@1+ (1,0) [0|31] "" Vector__XXX
 SG_ Aftrtrtmnt1IntkGsSnsorHeaterCtrl : 0|2@1+ (1,0) [0|3] "" Vector__XXX
 SG_ Aftrtrtmnt1IntkGsSnsrHtrPrlmnryF : 0|5@1+ (1,0) [0|31] "" Vector__XXX
 SG_ Aftrtrtmnt1IntkWdRngO2RdngStable : 0|2@1+ (1,0) [0|3] "" Vector__XXX
 SG_ Aftrtrtmnt1IntkeNOxReadingStable : 0|2@1+ (1,0) [0|3] "" Vector__XXX
 SG_ Aftrtrtmnt1IntakeGasSensorAtTemp : 0|2@1+ (1,0) [0|3] "" Vector__XXX
 SG_ Aftrtrtmnt1IntkGsSnsrPowerStatus : 0|2@1+ (1,0) [0|3] "" Vector__XXX
 SG_ Aftertreatment1IntakeO2 : 0|16@1+ (0.00051357870982803,-12) [-12|21] "%" Vector__XXX
 SG_ Aftertreatment1IntakeNOx : 0|16@1+ (0.05,-200) [-200|3012.75] "ppm" Vector__XXX
 SG_ Aftrtrtmnt1DslPrtcltFltrIntkGsTm : 0|5@1+ (1,0) [0|31] "" Vector__XXX
 SG_ Aftrtrtmnt1ExhstGsTmp1PrlmnryFMI : 0|5@1+ (1,0) [0|31] "" Vector__XXX
 SG_ Aftertreatment1ExhaustGasTemp1 : 0|16@1+ (0.03125,-273) [-273|1734.96875] "deg C" Vector__XXX
 SG_ Aftrtrtmnt1DslPrtcltFltrIntkGsTm : 0|16@1+ (0.03125,-273) [-273|1734.96875] "deg C" Vector__XXX
 SG_ AntitheftRandomNumber : 0|56@1+ (1,0) [0|255] "per byte" Vector__XXX
 SG_ AntitheftComponentStatusStates : 0|2@1+ (1,0) [0|3] "" Vector__XXX
 SG_ AntthftEncryptnSdPrsentIndicator : 0|2@1+ (1,0) [0|3] "" Vector__XXX
 SG_ AntitheftModifyPwdStates : 0|2@1+ (1,0) [0|3] "" Vector__XXX
 SG_ AntitheftPwdValidIndicator : 0|2@1+ (1,0) [0|3] "" Vector__XXX
 SG_ AntitheftPwdRepresentation : 0|56@1+ (1,0) [0|255] "per byte" Vector__XXX
 SG_ AntitheftCmdStates : 0|3@1+ (1,0) [0|7] "" Vector__XXX
 SG_ AntitheftDesiredExitModeStates : 0|2@1+ (1,0) [0|3] "" Vector__XXX
 SG_ AntthftEncryptionIndicatorStates : 0|2@1+ (1,0) [0|3] "" Vector__XXX
 SG_ EngAltWinding3Temp : 0|8@1+ (1,-40) [-40|210] "deg C" Vector__XXX
 SG_ EngAltWinding2Temp : 0|8@1+ (1,-40) [-40|210] "deg C" Vector__XXX
 SG_ EngAltWinding1Temp : 0|8@1+ (1,-40) [-40|210] "deg C" Vector__XXX
 SG_ EngAltBearing2Temp : 0|8@1+ (1,-40) [-40|210] "deg C" Vector__XXX
 SG_ EngAltBearing1Temp : 0|8@1+ (1,-40) [-40|210] "deg C" Vector__XXX
 SG_ LevelPresetRearAxleRight : 0|16@1+ (1,-3200) [-3200|3225.5] "mm" Vector__XXX
 SG_ LevelPresetRearAxleLeft : 0|16@1+ (1,-3200) [-3200|3225.5] "mm" Vector__XXX
 SG_ LevelPresetFrontAxleRight : 0|16@1+ (1,-3200) [-3200|3225.5] "mm" Vector__XXX
 SG_ LevelPresetFrontAxleLeft : 0|16@1+ (1,-3200) [-3200|3225.5] "mm" Vector__XXX
 SG_ ElctrncShckAbsrbrCtrlMdLft_TgAxl : 0|2@1+ (1,0) [0|3] "" Vector__XXX
 SG_ ElctrncShckAbsrbrCtrlMdeRearAxle : 0|2@1+ (1,0) [0|3] "" Vector__XXX
 SG_ ElctrncShckAbsrbrCtrlMdFrontAxle : 0|2@1+ (1,0) [0|3] "" Vector__XXX
 SG_ DamperStiffnessLift_TagAxle : 0|8@1+ (1,0) [0|100] "%" Vector__XXX
 SG_ DamperStiffnessRearAxle : 0|8@1+ (1,0) [0|100] "%" Vector__XXX
 SG_ DamperStiffnessFrontAxle : 0|8@1+ (1,0) [0|100] "%" Vector__XXX
 SG_ TestLimitMinimum : 0|16@1+ (1,0) [0|64255] "" Vector__XXX
 SG_ TestLimitMaximum : 0|16@1+ (1,0) [0|64255] "" Vector__XXX
 SG_ TestValue : 0|16@1+ (1,0) [0|64255] "" Vector__XXX
 SG_ SlotId : 0|16@1+ (1,0) [0|64255] "" Vector__XXX
 SG_ TestIdentifier : 0|8@1+ (1,0) [0|255] "" Vector__XXX
 SG_ Aftrtrtmnt1DslPrtcltFltrIntrmdtG : 0|5@1+ (1,0) [0|31] "" Vector__XXX
 SG_ Aftrtrtmnt1DslPrtcltFltrIntrmdtG : 0|16@1+ (0.03125,-273) [-273|1734.96875] "deg C" Vector__XXX
 SG_ Aftrtrtmnt1DslPrtcltFltrDltPrssP : 0|5@1+ (1,0) [0|31] "" Vector__XXX
 SG_ Aftrtrtmnt1DslPrtcltFltrDffPress : 0|16@1+ (0.1,0) [0|6425.5] "kPa" Vector__XXX
 SG_ Aftrtrtmnt1ExhstGsTmp2PrlmnryFMI : 0|5@1+ (1,0) [0|31] "" Vector__XXX
 SG_ Aftertreatment1ExhaustGasTemp2 : 0|16@1+ (0.03125,-273) [-273|1734.96875] "deg C" Vector__XXX
 SG_ Aftrtrtmnt1OtltOxygnSnsrPrlmnryF : 0|5@1+ (1,0) [0|31] "" Vector__XXX
 SG_ Aftrtrtmnt1OtltNOxSnsrPrlmnryFMI : 0|5@1+ (1,0) [0|31] "" Vector__XXX
 SG_ Aftrtrtmnt1OtltGsSnsorHeaterCtrl : 0|2@1+ (1,0) [0|3] "" Vector__XXX
 SG_ Aftrtrtmnt1OtltGsSnsrHtrPrlmnryF : 0|5@1+ (1,0) [0|31] "" Vector__XXX
 SG_ Aftrtrtmnt1OtltWdRngO2RdngStable : 0|2@1+ (1,0) [0|3] "" Vector__XXX
 SG_ Aftrtrtmnt1OtletNOxReadingStable : 0|2@1+ (1,0) [0|3] "" Vector__XXX
 SG_ Aftrtrtmnt1OutletGasSensorAtTemp : 0|2@1+ (1,0) [0|3] "" Vector__XXX
 SG_ Aftrtrtmnt1OtltGsSnsrPowerStatus : 0|2@1+ (1,0) [0|3] "" Vector__XXX
 SG_ Aftertreatment1OutletO2 : 0|16@1+ (0.00051357870982803,-12) [-12|21] "%" Vector__XXX
 SG_ Aftertreatment1OutletNOx : 0|16@1+ (0.05,-200) [-200|3012.75] "ppm" Vector__XXX
 SG_ Aftrtrtmnt1DslPrtcltFltrOtltGsTm : 0|16@1+ (0.03125,-273) [-273|1734.96875] "deg C" Vector__XXX
 SG_ Aftrtrtmnt1DslPrtcltFltrOtltExhs : 0|5@1+ (1,0) [0|31] "" Vector__XXX
 SG_ Aftrtrtmnt1ExhstGsTmp3PrlmnryFMI : 0|5@1+ (1,0) [0|31] "" Vector__XXX
 SG_ Aftertreatment1ExhaustGasTemp3 : 0|16@1+ (0.03125,-273) [-273|1734.96875] "deg C" Vector__XXX
 SG_ DslPrtclateFilter1AshLoadPercent : 0|8@1+ (1,0) [0|250] "%" Vector__XXX
 SG_ DslPrtcltFltr1TmSncLstActvRgnrtn : 0|32@1+ (1,0) [0|4211081215] "s" Vector__XXX
 SG_ DslPrtclteFilter1SootLoadPercent : 0|8@1+ (1,0) [0|250] "%" Vector__XXX
 SG_ Aftrtrtmnt1DslPrtcltFltrStLdRgnr : 0|16@1+ (1,0) [0|160.6375] "%" Vector__XXX
 SG_ Aftrtrtmnt1TrpNmbrOfActvRgnrtnMn : 0|32@1+ (1.0199203187298,0) [0|4294967295] "counts" Vector__XXX
 SG_ Aftrtrtmnt1TrpNmbrOfActvRgnrtnIn : 0|32@1+ (1.0199203187298,0) [0|4294967295] "counts" Vector__XXX
 SG_ Aftrtrtmnt1TrpNmbrOfPssvRgnrtons : 0|32@1+ (1.0199203187298,0) [0|4294967295] "counts" Vector__XXX
 SG_ Aftrtrtmnt1TrpPssvRgnerationTime : 0|32@1+ (1,0) [0|4211081215] "s" Vector__XXX
 SG_ Aftrtrtmnt1TrpNmbrOfActvRgnrtons : 0|32@1+ (1.0199203187298,0) [0|4294967295] "counts" Vector__XXX
 SG_ Aftertreatment1TripDisabledTime : 0|32@1+ (1,0) [0|4211081215] "s" Vector__XXX
 SG_ Aftrtrtmnt1TrpActvRgnerationTime : 0|32@1+ (1,0) [0|4211081215] "s" Vector__XXX
 SG_ Aftertreatment1TripFuelUsed : 0|32@1+ (0.5,0) [0|2105540607.5] "L" Vector__XXX
 SG_ Aftertreatment2AirEnableActuator : 0|2@1+ (1,0) [0|3] "" Vector__XXX
 SG_ Aftertreatment2PurgeAirActuator : 0|2@1+ (1,0) [0|3] "" Vector__XXX
 SG_ Aftrtrtmnt2AtmizationAirActuator : 0|2@1+ (1,0) [0|3] "" Vector__XXX
 SG_ Aftertreatment2AirSystemRelay : 0|2@1+ (1,0) [0|3] "" Vector__XXX
 SG_ Aftrtratment2AirPressActuatorPos : 0|8@1+ (0.4,0) [0|100] "%" Vector__XXX
 SG_ Aftertreatment2AirPressCtrl : 0|16@1+ (0.0025,0) [0|160.6375] "%" Vector__XXX
 SG_ Aftertreatment2PurgeAirPress : 0|16@1+ (0.1,0) [0|6425.5] "kPa" Vector__XXX
 SG_ Aftertreatment2SupplyAirPress : 0|16@1+ (0.1,0) [0|6425.5] "kPa" Vector__XXX
 SG_ Aftertreatment2SecondAirPress : 0|16@1+ (0.1,0) [0|6425.5] "kPa" Vector__XXX
 SG_ Aftertreatment2SecondAirMassFlow : 0|16@1+ (0.2,0) [0|12851] "kg/h per bit" Vector__XXX
 SG_ Aftertreatment2SecondAirTemp : 0|16@1+ (0.03125,-273) [-273|1734.96875] "deg C" Vector__XXX
 SG_ Aftrtreatment2SecondAirDiffPress : 0|16@1+ (0.0078124659559567,-250) [-250|251.99] "kPa" Vector__XXX
 SG_ Aftrtrtmnt2FlInjector1HeaterCtrl : 0|8@1+ (1,0) [0|100] "%" Vector__XXX
 SG_ Aftrtreatment2FuelEnableActuator : 0|2@1+ (1,0) [0|3] "" Vector__XXX
 SG_ Aftrtreatment2RegenerationStatus : 0|2@1+ (1,0) [0|3] "" Vector__XXX
 SG_ Aftertreatment2Ignt : 0|2@1+ (1,0) [0|3] "" Vector__XXX
 SG_ Aftertreatment2FuelDrainActuator : 0|2@1+ (1,0) [0|3] "" Vector__XXX
 SG_ Aftertreatment2FuelPress1Ctrl : 0|16@1+ (1,0) [0|160.6375] "%" Vector__XXX
 SG_ Aftertreatment2FuelRate : 0|16@1+ (0.05,0) [0|3212.75] "L/h" Vector__XXX
 SG_ Aftertreatment2FuelPress1 : 0|16@1+ (0.1,0) [0|6425.5] "kPa" Vector__XXX
 SG_ DslParticulateFilterOutletPress2 : 0|16@1+ (0.1,0) [0|6425.5] "kPa" Vector__XXX
 SG_ DslParticulateFilterIntakePress2 : 0|16@1+ (0.1,0) [0|6425.5] "kPa" Vector__XXX
 SG_ Aftrtrtmnt2AvrgTmBtwnActvRgnrtns : 0|32@1+ (1,0) [0|4211081215] "s" Vector__XXX
 SG_ Aftrtrtmnt2TtlNmbrOfActvRgnrtnMn : 0|32@1+ (1.0199203187298,0) [0|4294967295] "counts" Vector__XXX
 SG_ Aftrtrtmnt2TtlNmbrOfActvRgnrtnIn : 0|32@1+ (1.0199203187298,0) [0|4294967295] "counts" Vector__XXX
 SG_ Aftrtrtmnt2TtlNmbrOfPssvRgnrtons : 0|32@1+ (1.0199203187298,0) [0|4294967295] "counts" Vector__XXX
 SG_ Aftrtrtmnt2TtlPssvRgnerationTime : 0|32@1+ (1,0) [0|4211081215] "s" Vector__XXX
 SG_ Aftrtrtmnt2TtlNmbrOfActvRgnrtons : 0|32@1+ (1.0199203187298,0) [0|4294967295] "counts" Vector__XXX
 SG_ Aftertreatment2TotalDisabledTime : 0|32@1+ (1,0) [0|4211081215] "s" Vector__XXX
 SG_ Aftrtrtmnt2TotalRegenerationTime : 0|32@1+ (1,0) [0|4211081215] "s" Vector__XXX
 SG_ Aftertreatment2TotalFuelUsed : 0|32@1+ (1,0) [0|2105540607.5] "L" Vector__XXX
 SG_ Aftrtrtmnt2IntkOxygnSnsrPrlmnryF : 0|5@1+ (1,0) [0|31] "" Vector__XXX
 SG_ Aftrtrtmnt2IntkNOxSnsrPrlmnryFMI : 0|5@1+ (1,0) [0|31] "" Vector__XXX
 SG_ Aftrtrtmnt2IntkGsSnsorHeaterCtrl : 0|2@1+ (1,0) [0|3] "" Vector__XXX
 SG_ Aftrtrtmnt2IntkGsSnsrHtrPrlmnryF : 0|5@1+ (1,0) [0|31] "" Vector__XXX
 SG_ Aftrtrtmnt2IntkWdRngO2RdngStable : 0|2@1+ (1,0) [0|3] "" Vector__XXX
 SG_ Aftrtrtmnt2IntkeNOxReadingStable : 0|2@1+ (1,0) [0|3] "" Vector__XXX
 SG_ Aftrtrtmnt2IntakeGasSensorAtTemp : 0|2@1+ (1,0) [0|3] "" Vector__XXX
 SG_ Aftrtrtmnt2IntkGsSnsrPowerStatus : 0|2@1+ (1,0) [0|3] "" Vector__XXX
 SG_ Aftertreatment2IntakeO2 : 0|16@1+ (0.00051357870982803,-12) [-12|21] "%" Vector__XXX
 SG_ Aftertreatment2IntakeNOx : 0|16@1+ (0.05,-200) [-200|3012.75] "ppm" Vector__XXX
 SG_ Aftrtrtmnt2DslPrtcltFltrIntkGsTm : 0|5@1+ (1,0) [0|31] "" Vector__XXX
 SG_ Aftrtrtmnt2ExhstGsTmp1PrlmnryFMI : 0|5@1+ (1,0) [0|31] "" Vector__XXX
 SG_ Aftertreatment2ExhaustGasTemp1 : 0|16@1+ (0.03125,-273) [-273|1734.96875] "deg C" Vector__XXX
 SG_ Aftrtrtmnt2DslPrtcltFltrIntkGsTm : 0|16@1+ (0.03125,-273) [-273|1734.96875] "deg C" Vector__XXX
 SG_ Aftrtrtmnt2DslPrtcltFltrIntrmdtG : 0|5@1+ (1,0) [0|31] "" Vector__XXX
 SG_ Aftrtrtmnt2DslPrtcltFltrIntrmdtG : 0|16@1+ (0.03125,-273) [-273|1734.96875] "deg C" Vector__XXX
 SG_ Aftrtrtmnt2DslPrtcltFltrDltPrssP : 0|5@1+ (1,0) [0|31] "" Vector__XXX
 SG_ Aftrtrtmnt2DslPrtcltFltrDffPress : 0|16@1+ (0.1,0) [0|6425.5] "kPa" Vector__XXX
 SG_ Aftrtrtmnt2ExhstGsTmp2PrlmnryFMI : 0|5@1+ (1,0) [0|31] "" Vector__XXX
 SG_ Aftertreatment2ExhaustGasTemp2 : 0|16@1+ (0.03125,-273) [-273|1734.96875] "deg C" Vector__XXX
 SG_ Aftrtrtmnt2OtltOxygnSnsrPrlmnryF : 0|5@1+ (1,0) [0|31] "" Vector__XXX
 SG_ Aftrtrtmnt2OtltNOxSnsrPrlmnryFMI : 0|5@1+ (1,0) [0|31] "" Vector__XXX
 SG_ Aftrtrtmnt2OtltGsSnsorHeaterCtrl : 0|2@1+ (1,0) [0|3] "" Vector__XXX
 SG_ Aftrtrtmnt2OtltGsSnsrHtrPrlmnryF : 0|5@1+ (1,0) [0|31] "" Vector__XXX
 SG_ Aftrtrtmnt2OtltWdRngO2RdngStable : 0|2@1+ (1,0) [0|3] "" Vector__XXX
 SG_ Aftrtrtmnt2OtletNOxReadingStable : 0|2@1+ (1,0) [0|3] "" Vector__XXX
 SG_ Aftrtrtmnt2OutletGasSensorAtTemp : 0|2@1+ (1,0) [0|3] "" Vector__XXX
 SG_ Aftrtrtmnt2OtltGsSnsrPowerStatus : 0|2@1+ (1,0) [0|3] "" Vector__XXX
 SG_ Aftertreatment2OutletO2 : 0|16@1+ (0.00051357870982803,-12) [-12|21] "%" Vector__XXX
 SG_ Aftertreatment2OutletNOx : 0|16@1+ (0.05,-200) [-200|3012.75] "ppm" Vector__XXX
 SG_ Aftrtrtmnt2DslPrtcltFltrOtltGsTm : 0|16@1+ (0.03125,-273) [-273|1734.96875] "deg C" Vector__XXX
 SG_ Aftrtrtmnt2DslPrtcltFltrExhstGsT : 0|5@1+ (1,0) [0|31] "" Vector__XXX
 SG_ Aftrtrtmnt2ExhstGsTmp3PrlmnryFMI : 0|5@1+ (1,0) [0|31] "" Vector__XXX
 SG_ Aftertreatment2ExhaustGasTemp3 : 0|16@1+ (0.03125,-273) [-273|1734.96875] "deg C" Vector__XXX
 SG_ Aftrtrtmnt2DslPrtcltFltrStLdRgnr : 0|16@1+ (1,0) [0|160.6375] "%" Vector__XXX
 SG_ DslPrtcltFltr2TmSncLstActvRgnrtn : 0|32@1+ (1,0) [0|4211081215] "s" Vector__XXX
 SG_ DslPrtclateFilter2AshLoadPercent : 0|8@1+ (1,0) [0|250] "%" Vector__XXX
 SG_ DslPrtclteFilter2SootLoadPercent : 0|8@1+ (1,0) [0|250] "%" Vector__XXX
 SG_ Aftrtrtmnt2TrpNmbrOfActvRgnrtnMn : 0|32@1+ (1.0199203187298,0) [0|4294967295] "counts" Vector__XXX
 SG_ Aftrtrtmnt2TrpNmbrOfActvRgnrtnIn : 0|32@1+ (1.0199203187298,0) [0|4294967295] "counts" Vector__XXX
 SG_ Aftrtrtmnt2TrpNmbrOfPssvRgnrtons : 0|32@1+ (1.0199203187298,0) [0|4294967295] "counts" Vector__XXX
 SG_ Aftrtrtmnt2TrpPssvRgnerationTime : 0|32@1+ (1,0) [0|4211081215] "s" Vector__XXX
 SG_ Aftrtrtmnt2TrpNmbrOfActvRgnrtons : 0|32@1+ (1.0199203187298,0) [0|4294967295] "counts" Vector__XXX
 SG_ Aftertreatment2TripDisabledTime : 0|32@1+ (1,0) [0|4211081215] "s" Vector__XXX
 SG_ Aftrtrtmnt2TrpActvRgnerationTime : 0|32@1+ (1,0) [0|4211081215] "s" Vector__XXX
 SG_ Aftertreatment2TripFuelUsed : 0|32@1+ (0.5,0) [0|2105540607.5] "L" Vector__XXX
 SG_ EngDerateRq : 0|8@1+ (1,0) [0|100] "%" Vector__XXX
 SG_ EngEmergencyShutdownIndication : 0|2@1+ (1,0) [0|3] "" Vector__XXX
 SG_ EngControlledShutdownRq : 0|2@1+ (1,0) [0|3] "" Vector__XXX
 SG_ EngCoolantCirculatingPumpCtrl : 0|2@1+ (1,0) [0|3] "" Vector__XXX
 SG_ EngBlock_CoolantPreheaterCtrl : 0|2@1+ (1,0) [0|3] "" Vector__XXX
 SG_ EngElctrclSystmPwrCnsrvationCtrl : 0|2@1+ (1,0) [0|3] "" Vector__XXX
 SG_ EngOilPreheaterCtrl : 0|2@1+ (1,0) [0|3] "" Vector__XXX
 SG_ EngOilPrimingPumpCtrl : 0|2@1+ (1,0) [0|3] "" Vector__XXX
 SG_ EngFuelShutoffValveLeakTestCtrl : 0|2@1+ (1,0) [0|3] "" Vector__XXX
 SG_ EngFuelShutoff2Ctrl : 0|2@1+ (1,0) [0|3] "" Vector__XXX
 SG_ EngFuelShutoff1Ctrl : 0|2@1+ (1,0) [0|3] "" Vector__XXX
 SG_ EngFuelShutoffVentCtrl : 0|2@1+ (1,0) [0|3] "" Vector__XXX
 SG_ TimeRemainingInEngOperatingState : 0|16@1+ (1,0) [0|64255] "s" Vector__XXX
 SG_ FuelPumpPrimerCtrl : 0|2@1+ (1,0) [0|3] "" Vector__XXX
 SG_ EngOperatingState : 0|4@1+ (1,0) [0|15] "" Vector__XXX
 SG_ EngExhstGsRcrcltn1MxerIntakeTemp : 0|16@1+ (0.03125,-273) [-273|1734.96875] "deg C" Vector__XXX
 SG_ EngExhstVlvActationSystemOilTemp : 0|16@1+ (0.03125,-273) [-273|1734.96875] "deg C" Vector__XXX
 SG_ EngCoolantThermostatOpening : 0|8@1+ (0.4,0) [0|100] "%" Vector__XXX
 SG_ EngCoolantPumpOutletTemp : 0|8@1+ (1,-40) [-40|210] "deg C" Vector__XXX
 SG_ EngCoolantTemp2 : 0|8@1+ (1,-40) [-40|210] "deg C" Vector__XXX
 SG_ NetVehicleWeightChange : 0|24@1+ (1,-16449535) [-16449535|16449535] "kg" Vector__XXX
 SG_ GrossCombinationWeight : 0|24@1+ (1,0) [0|32899070] "kg" Vector__XXX
 SG_ ValveAssemblySupplyPress : 0|16@1+ (5,0) [0|321275] "kPa" Vector__XXX
 SG_ ValveAssemblyLoadSensePress : 0|16@1+ (5,0) [0|321275] "kPa" Vector__XXX
 SG_ ValvePilotPress : 0|8@1+ (16,0) [0|4000] "kPa" Vector__XXX
 SG_ ValveLoadSensePress : 0|16@1+ (5,0) [0|321275] "kPa" Vector__XXX
 SG_ BellowPressRearAxleRight : 0|16@1+ (0.1,0) [0|6425.5] "kPa" Vector__XXX
 SG_ BellowPressRearAxleLeft : 0|16@1+ (0.1,0) [0|6425.5] "kPa" Vector__XXX
 SG_ BellowPressFrontAxleRight : 0|16@1+ (0.1,0) [0|6425.5] "kPa" Vector__XXX
 SG_ BellowPressFrontAxleLeft : 0|16@1+ (0.1,0) [0|6425.5] "kPa" Vector__XXX
 SG_ RelativeLevelRearAxleRight : 0|16@1+ (0.1,-3200) [-3200|3225.5] "mm" Vector__XXX
 SG_ RelativeLevelRearAxleLeft : 0|16@1+ (0.1,-3200) [-3200|3225.5] "mm" Vector__XXX
 SG_ RelativeLevelFrontAxleRight : 0|16@1+ (0.1,-3200) [-3200|3225.5] "mm" Vector__XXX
 SG_ RelativeLevelFrontAxleLeft : 0|16@1+ (0.1,-3200) [-3200|3225.5] "mm" Vector__XXX
 SG_ MemoryLevelRq : 0|4@1+ (1,0) [0|15] "" Vector__XXX
 SG_ PrhbitAutomaticAirSuspensionCtrl : 0|2@1+ (1,0) [0|3] "" Vector__XXX
 SG_ SpeedDependentLevelCtrlRq : 0|2@1+ (1,0) [0|3] "" Vector__XXX
 SG_ AllowLevelCtrlDuringBrakingCmd : 0|2@1+ (1,0) [0|3] "" Vector__XXX
 SG_ ProhibitAirSuspensionCtrl : 0|2@1+ (1,0) [0|3] "" Vector__XXX
 SG_ KneelingCmdRearAxle : 0|2@1+ (1,0) [0|3] "" Vector__XXX
 SG_ KneelingCmdFrontAxle : 0|2@1+ (1,0) [0|3] "" Vector__XXX
 SG_ DamperStiffnessRqLift_TagAxle : 0|8@1+ (1,0) [0|100] "%" Vector__XXX
 SG_ DamperStiffnessRqRearAxle : 0|8@1+ (1,0) [0|100] "%" Vector__XXX
 SG_ DamperStiffnessRqFrontAxle : 0|8@1+ (1,0) [0|100] "%" Vector__XXX
 SG_ LiftAxle2PosCmd : 0|2@1+ (1,0) [0|3] "" Vector__XXX
 SG_ LiftAxle1PosCmd : 0|2@1+ (1,0) [0|3] "" Vector__XXX
 SG_ LevelCtrlModeRq : 0|4@1+ (1,0) [0|15] "" Vector__XXX
 SG_ NominalLevelRqRearAxle : 0|4@1+ (1,0) [0|15] "" Vector__XXX
 SG_ NominalLevelRqFrontAxle : 0|4@1+ (1,0) [0|15] "" Vector__XXX
 SG_ KneelingCtrlModeRq : 0|2@1+ (1,0) [0|3] "" Vector__XXX
 SG_ KneelingRqRightSide : 0|2@1+ (1,0) [0|3] "" Vector__XXX
 SG_ TestLimitMinimum : 0|16@1+ (1,0) [0|64255] "" Vector__XXX
 SG_ TestLimitMaximum : 0|16@1+ (1,0) [0|64255] "" Vector__XXX
 SG_ TestValue : 0|16@1+ (1,0) [0|64255] "" Vector__XXX
 SG_ TestIdentifier : 0|8@1+ (1,0) [1|64] "" Vector__XXX
 SG_ TestIdentifier : 0|8@1+ (1,0) [1|64] "" Vector__XXX
 SG_ DTC1 : 0|32@1+ (1,0) [0|4294967295] "" Vector__XXX
 SG_ DTC1 : 0|32@1+ (1,0) [0|4294967295] "" Vector__XXX
 SG_ DTC1 : 0|32@1+ (1,0) [0|4294967295] "" Vector__XXX
 SG_ DTC1 : 0|32@1+ (1,0) [0|4294967295] "" Vector__XXX
 SG_ DTC1 : 0|32@1+ (1,0) [0|4294967295] "" Vector__XXX
 SG_ DTC1 : 0|32@1+ (1,0) [0|4294967295] "" Vector__XXX
 SG_ DTC1 : 0|32@1+ (1,0) [0|4294967295] "" Vector__XXX
 SG_ DTC1 : 0|32@1+ (1,0) [0|4294967295] "" Vector__XXX
 SG_ DTC1 : 0|32@1+ (1,0) [0|4294967295] "" Vector__XXX
 SG_ DTC1 : 0|32@1+ (1,0) [0|4294967295] "" Vector__XXX
 SG_ DTC1 : 0|32@1+ (1,0) [0|4294967295] "" Vector__XXX
 SG_ DTC1 : 0|32@1+ (1,0) [0|4294967295] "" Vector__XXX
 SG_ DTC1 : 0|32@1+ (1,0) [0|4294967295] "" Vector__XXX
 SG_ DTC1 : 0|32@1+ (1,0) [0|4294967295] "" Vector__XXX
 SG_ DTC1 : 0|32@1+ (1,0) [0|4294967295] "" Vector__XXX
 SG_ DTC1 : 0|32@1+ (1,0) [0|4294967295] "" Vector__XXX
 SG_ DTC1 : 0|32@1+ (1,0) [0|4294967295] "" Vector__XXX
 SG_ DTC1 : 0|32@1+ (1,0) [0|4294967295] "" Vector__XXX
 SG_ DTC1 : 0|32@1+ (1,0) [0|4294967295] "" Vector__XXX
 SG_ DTC1 : 0|32@1+ (1,0) [0|4294967295] "" Vector__XXX
 SG_ DTC1 : 0|32@1+ (1,0) [0|4294967295] "" Vector__XXX
 SG_ DTC1 : 0|32@1+ (1,0) [0|4294967295] "" Vector__XXX

CM_ SG_ 3221225472 FailureSpecificB1Counter "The Failure Specific B1 Counter provides an individual B1 counter";
CM_ SG_ 3221225472 SysGreatestB1Counter "System Greatest B1 Counter";
CM_ SG_ 3221225472 SysCumulativeContinuousMITime "System Cumulative Continuous MI Time";
CM_ SG_ 3221225472 RegulationDescription "Global Technical Regulation Description";
CM_ SG_ 3221225472 SysIncompleteMonitorCount "System Incomplete Monitor Count";
CM_ SG_ 3221225472 SysMalIndActivationMode "System Malfunction Indicator Status";
CM_ SG_ 3221225472 SysMalIndDisplayStrategy "System Malfunction Indicator Display";
CM_ SG_ 3221225472 SysContinuousMalfunctionInd "System Continuous Malfunction Indicator";
CM_ SG_ 3221225472 SysNonRoadworthyCompCount "System Non-Roadworthy Component Count";
CM_ SG_ 3221225472 VehicleCurrentMIAccumTime "Vehicle Current MI Accumulated Time";
CM_ SG_ 3221225472 VehicleIncompleteMonitorCount "Vehicle Incomplete Monitor Count";
CM_ SG_ 3221225472 VehicleMalfunctionIndActMode "Vehicle Malfunction Indicator Status ";
CM_ SG_ 3221225472 VehicleMalfunctionIndStrategy "Vehicle Malfunction Indicator Display Strategy ";
CM_ SG_ 3221225472 VehicleContinuousMalfunctionInd "Vehicle Continuous Malfunction Indicator";
CM_ SG_ 3221225472 VehicleNonRoadworthyCompCount "Vehicle Non-Roadworthy Component Count";
CM_ SG_ 3221225472 PMNTEDeficiencyAreaStatus "Status of engine operation within the PM NTE Deficiency Area";
CM_ SG_ 3221225472 MnfcPMNTECarveOutAreaStatus "Status of engine operation within the manufacturer specific PM NTE carve out area";
CM_ SG_ 3221225472 PMNTEControlAreaStatus "Status of engine operation within the bounded region of the engine's torque and speed map.";
CM_ SG_ 3221225472 NOxNTEDeficiencyAreaStatus "Status of engine operation within the NOx NTE Deficiency Area";
CM_ SG_ 3221225472 MnfcNOxNTECarveOutAreaStatus "Status of engine operation within the bounded region of the engine's torque and speed map.";
CM_ SG_ 3221225472 NOxNTEControlAreaStatus "Status of engine operation within the bounded region of the engine's torque and speed map.";
CM_ SG_ 3221225472 AECDEngineHours1Timer2 "The total engine running hours recorded in the second timer for the EI-AECD";
CM_ SG_ 3221225472 AECDEngineHours1Timer1 "The total engine running hours recorded in the first timer for the EI-AECD";
CM_ SG_ 3221225472 AECDNumber1 "The manufacturer assigned number for the specific EI-AECD";
CM_ SG_ 3221225472 BatteryMainSwitchHoldState "Parameter indicating whether the battery main switch is held due to an external request or not. The state battery main";
CM_ SG_ 3221225472 Joystick3XAxisDetentPosStatus "Reports when the current joystick position is in the detent position for that axis of travel.";
CM_ SG_ 3221225472 Joystick3Button9PressedStatus "Reports when the joystick button has been pressed.";
CM_ SG_ 3221225472 Joystick3Button10PressedStatus "Reports when the joystick button has been pressed.";
CM_ SG_ 3221225472 Joystick3Button11PressedStatus "Reports when the joystick button has been pressed.";
CM_ SG_ 3221225472 Joystick3Button12PressedStatus "Reports when the joystick button has been pressed.";
CM_ SG_ 3221225472 Joystick3YAxisDetentPosStatus "Reports when the current joystick position is in the detent position for that axis of travel.";
CM_ SG_ 3221225472 Joystick3YAxisPos "The position of the joystick in the relative motion of travel from the neutral position. Position value of 0 is Neutral and";
CM_ SG_ 3221225472 Jystck3YAxsLvrFrwrdPstvPosStatus "Reports when the current joystick position is on the positive travel side (forward, right, clockwise, up) relative to the";
CM_ SG_ 3221225472 Jystck3YAxsLvrBckNgtivePosStatus "Reports when the current joystick position is on the negative travel side (back, left, counterclockwise, down) relative to the";
CM_ SG_ 3221225472 Joystick3YAxisNeutralPosStatus "Reports when the current joystick position is in the neutral position for that axis of travel. The neutral position";
CM_ SG_ 3221225472 Joystick3XAxisPos "The position of the joystick in the relative motion of travel from the neutral position. Position value of 0 is Neutral and";
CM_ SG_ 3221225472 Jystck3XAxsLvrRghtPstvePosStatus "Reports when the current joystick position is on the positive travel side (forward, right, clockwise, up) relative to the";
CM_ SG_ 3221225472 Jystck3XAxsLvrLftNgtivePosStatus "Reports when the current joystick position is on the negative travel side (back, left, counterclockwise, down) relative to the";
CM_ SG_ 3221225472 Joystick3XAxisNeutralPosStatus "Reports when the current joystick position is in the neutral position for that axis of travel. The neutral position";
CM_ SG_ 3221225472 Joystick3Button5PressedStatus "Reports when the joystick button has been pressed.";
CM_ SG_ 3221225472 Joystick3Button6PressedStatus "Reports when the joystick button has been pressed.";
CM_ SG_ 3221225472 Joystick3Button7PressedStatus "Reports when the joystick button has been pressed.";
CM_ SG_ 3221225472 Joystick3Button8PressedStatus "Reports when the joystick button has been pressed.";
CM_ SG_ 3221225472 Joystick3Button1PressedStatus "Reports when the joystick button has been pressed.";
CM_ SG_ 3221225472 Joystick3Button2PressedStatus "Reports when the joystick button has been pressed.";
CM_ SG_ 3221225472 Joystick3Button3PressedStatus "Reports when the joystick button has been pressed.";
CM_ SG_ 3221225472 Joystick3Button4PressedStatus "Reports when the joystick button has been pressed.";
CM_ SG_ 3221225472 Joystick2XAxisDetentPosStatus "Reports when the current joystick position is in the detent position for that axis of travel.";
CM_ SG_ 3221225472 Joystick2YAxisDetentPosStatus "Reports when the current joystick position is in the detent position for that axis of travel.";
CM_ SG_ 3221225472 Joystick2YAxisPos "The position of the joystick in the relative motion of travel from the neutral position. Position value of 0 is Neutral and";
CM_ SG_ 3221225472 Jystck2YAxsLvrFrwrdPstvPosStatus "Reports when the current joystick position is on the positive travel side (forward, right, clockwise, up) relative to the";
CM_ SG_ 3221225472 Jystck2YAxsLvrBckNgtivePosStatus "Reports when the current joystick position is on the negative travel side (back, left, counterclockwise, down) relative to the";
CM_ SG_ 3221225472 Joystick2YAxisNeutralPosStatus "Reports when the current joystick position is in the neutral position for that axis of travel. The neutral position";
CM_ SG_ 3221225472 Joystick2XAxisPos "The position of the joystick in the relative motion of travel from the neutral position. Position value of 0 is Neutral and";
CM_ SG_ 3221225472 Jystck2XAxsLvrRghtPstvePosStatus "Reports when the current joystick position is on the positive travel side (forward, right, clockwise, up) relative to the";
CM_ SG_ 3221225472 Jystck2XAxsLvrLftNgtivePosStatus "Reports when the current joystick position is on the negative travel side (back, left, counterclockwise, down) relative to the";
CM_ SG_ 3221225472 Joystick2XAxisNeutralPosStatus "Reports when the current joystick position is in the neutral position for that axis of travel. The neutral position";
CM_ SG_ 3221225472 Joystick2Button9PressedStatus "Reports when the joystick button has been pressed.";
CM_ SG_ 3221225472 Joystick2Button10PressedStatus "Reports when the joystick button has been pressed.";
CM_ SG_ 3221225472 Joystick2Button11PressedStatus "Reports when the joystick button has been pressed.";
CM_ SG_ 3221225472 Joystick2Button12PressedStatus "Reports when the joystick button has been pressed.";
CM_ SG_ 3221225472 Joystick2Button5PressedStatus "Reports when the joystick button has been pressed.";
CM_ SG_ 3221225472 Joystick2Button6PressedStatus "Reports when the joystick button has been pressed.";
CM_ SG_ 3221225472 Joystick2Button7PressedStatus "Reports when the joystick button has been pressed.";
CM_ SG_ 3221225472 Joystick2Button8PressedStatus "Reports when the joystick button has been pressed.";
CM_ SG_ 3221225472 Joystick2Button1PressedStatus "Reports when the joystick button has been pressed.";
CM_ SG_ 3221225472 Joystick2Button2PressedStatus "Reports when the joystick button has been pressed.";
CM_ SG_ 3221225472 Joystick2Button3PressedStatus "Reports when the joystick button has been pressed.";
CM_ SG_ 3221225472 Joystick2Button4PressedStatus "Reports when the joystick button has been pressed.";
CM_ SG_ 3221225472 Joystick1XAxisDetentPosStatus "Reports when the current joystick position is in the detent position for that axis of travel.";
CM_ SG_ 3221225472 Joystick1YAxisDetentPosStatus "Reports when the current joystick position is in the detent position for that axis of travel.";
CM_ SG_ 3221225472 Joystick1YAxisPos "The position of the joystick in the relative motion of travel from the neutral position. Position value of 0 is Neutral and";
CM_ SG_ 3221225472 Jystck1YAxsLvrFrwrdPstvPosStatus "Reports when the current joystick position is on the positive travel side (forward, right, clockwise, up) relative to the";
CM_ SG_ 3221225472 Jystck1YAxsLvrBckNgtivePosStatus "Reports when the current joystick position is on the negative travel side (back, left, counterclockwise, down) relative to the";
CM_ SG_ 3221225472 Joystick1YAxisNeutralPosStatus "Reports when the current joystick position is in the neutral position for that axis of travel. The neutral position";
CM_ SG_ 3221225472 Joystick1XAxisPos "The position of the joystick in the relative motion of travel from the neutral position. Position value of 0 is Neutral and";
CM_ SG_ 3221225472 Joystick1Button9PressedStatus "Reports when the joystick button has been pressed.";
CM_ SG_ 3221225472 Joystick1Button10PressedStatus "Reports when the joystick button has been pressed.";
CM_ SG_ 3221225472 Joystick1Button11PressedStatus "Reports when the joystick button has been pressed.";
CM_ SG_ 3221225472 Joystick1Button12PressedStatus "Reports when the joystick button has been pressed.";
CM_ SG_ 3221225472 Joystick1Button5PressedStatus "Reports when the joystick button has been pressed.";
CM_ SG_ 3221225472 Joystick1Button6PressedStatus "Reports when the joystick button has been pressed.";
CM_ SG_ 3221225472 Joystick1Button7PressedStatus "Reports when the joystick button has been pressed.";
CM_ SG_ 3221225472 Joystick1Button8PressedStatus "Reports when the joystick button has been pressed.";
CM_ SG_ 3221225472 Joystick1Button1PressedStatus "Reports when the joystick button has been pressed.";
CM_ SG_ 3221225472 Joystick1Button2PressedStatus "Reports when the joystick button has been pressed.";
CM_ SG_ 3221225472 Joystick1Button3PressedStatus "Reports when the joystick button has been pressed.";
CM_ SG_ 3221225472 Joystick1Button4PressedStatus "Reports when the joystick button has been pressed.";
CM_ SG_ 3221225472 Jystck1XAxsLvrRghtPstvePosStatus "Reports when the current joystick position is on the positive travel side (forward, right, clockwise, up) relative to the";
CM_ SG_ 3221225472 Jystck1XAxsLvrLftNgtivePosStatus "Reports when the current joystick position is on the negative travel side (back, left, counterclockwise, down) relative to the";
CM_ SG_ 3221225472 Joystick1XAxisNeutralPosStatus "Reports when the current joystick position is in the neutral position for that axis of travel. The neutral position";
CM_ SG_ 3221225472 ParkingBrakeRedWarningSignal "This parameter commands the Parking Brake red optical warning signal.";
CM_ SG_ 3221225472 ParkBrakeReleaseInhibitStatus "This parameter provides reports on the status of the Park Brake Release Inhibit function.";
CM_ SG_ 3221225472 ParkingBrakeActuator "Signal which indicates the current state of the actuator(s) that control the parking brake (see also SPN 70).";
CM_ SG_ 3221225472 BrakeSecondPress "Gage pressure of air in the secondary, or service side, of the air brake system.";
CM_ SG_ 3221225472 BrakePrimaryPress "Gage pressure of air in the primary, or supply side, of the air brake system.";
CM_ SG_ 3221225472 BrakeAppPress "Gage pressure of compressed air or fluid in vehicle braking system measured at the brake chamber when brake shoe (or";
CM_ SG_ 3221225472 AuxPumpPress "Gage pressure of auxiliary water pump driven as a PTO device.";
CM_ SG_ 3221225472 Aftrtrtmnt1DslOxdtnCtlystDffPrss "Used to identify the applicable J1939-73 FMI detected in the diesel oxidation catalyst differential pressure sensor by theExhaust differential pressure measured between the intake and exhaust of a diesel oxidation catalyst in exhaust bank 1.";
CM_ SG_ 3221225472 Aftrtrtmnt1DslOxdtnCtlystOtltGsT "Used to identify the applicable J1939-73 FMI detected in the diesel oxidation catalyst outlet gas temperature sensor byTemperature of engine combustion byproducts leaving the diesel oxidation catalyst exhaust in exhaust bank 1. This";
CM_ SG_ 3221225472 Aftrtrtmnt1DslOxdtnCtlystIntkGsT "Used to identify the applicable J1939-73 FMI detected in the diesel oxidation catalyst intake gas temperature sensor byTemperature of engine combustion byproducts entering the diesel oxidation catalyst in exhaust bank 1. This diesel";
CM_ SG_ 3221225472 DTCWarnLampSupportStatus "Lamp support status";
CM_ SG_ 3221225472 DTCWarnLampSupportFlash "Lamp support status";
CM_ SG_ 3221225472 DTCStopLampSupportStatus "Lamp support status";
CM_ SG_ 3221225472 DTCStopLampSupportFlash "Lamp support status";
CM_ SG_ 3221225472 DTCProtectLampSupportStatus "Lamp support status";
CM_ SG_ 3221225472 DTCProtectLampSupportFlash "Lamp support status";
CM_ SG_ 3221225472 DTCMilSupportStatus "Lamp support status";
CM_ SG_ 3221225472 DTCMilSupportFlash "Lamp support status";
CM_ SG_ 3221225472 DTC1 "Diagnostic Trouble CodeDiagnostic Trouble CodeDiagnostic Trouble CodeDiagnostic Trouble CodeDiagnostic Trouble CodeDiagnostic Trouble CodeDiagnostic Trouble CodeDiagnostic Trouble CodeDiagnostic Trouble CodeDiagnostic Trouble CodeDiagnostic Trouble CodeDiagnostic Trouble CodeDiagnostic Trouble CodeDiagnostic Trouble CodeDiagnostic Trouble CodeDiagnostic Trouble CodeDiagnostic Trouble CodeDiagnostic Trouble CodeDiagnostic Trouble CodeDiagnostic Trouble CodeDiagnostic Trouble CodeDiagnostic Trouble CodeDiagnostic Trouble Code";
CM_ SG_ 3221225472 DataDictionaryMethod "A manufacturer defined code to define the proprietary communications method. The structure and interpretation of the";
CM_ SG_ 3221225472 DataDictionaryManufacturerCode "The J1939 Manufacturer Code (see J1939 Table B10) associated with the manufacturer who defined the proprietary";
CM_ SG_ 3221225472 EngExhstGsOxygnSnsrClsdLpOprtnBn "This parameter indicates the status of the bank 2 O2 sensor feedback closed loop operationThis parameter indicates the status of the bank 1 O2 sensor feedback closed loop operation";
CM_ SG_ 3221225472 ShorttermFuelTrimBank2 "This parameter is the short-term percent change in fueling based on the O2 sensor feedback for cylinder bank 2, based";
CM_ SG_ 3221225472 LongtermFuelTrimBank2 "This parameter is the long-term percent change in fueling based on the O2 sensor feedback for cylinder bank 2, based on";
CM_ SG_ 3221225472 ShorttermFuelTrimBank1 "This parameter is the short-term percent change in fueling based on the O2 sensor feedback for cylinder bank 1, based";
CM_ SG_ 3221225472 LongtermFuelTrimBank1 "This parameter is the long-term percent change in fueling based on the O2 sensor feedback for cylinder bank 1, based on";
CM_ SG_ 3221225472 EngSpdSensor1TimingPatternStatus "This is the timing pattern status of the engine speed sensor signal for sensor 1. The sensor may be sending a speed";
CM_ SG_ 3221225472 EngSpdSensor2TimingPatternStatus "This is the timing pattern status of the engine speed sensor signal for sensor 2. The sensor may be sending a speed";
CM_ SG_ 3221225472 EngSpdSensor3TimingPatternStatus "This is the timing pattern status of the engine speed sensor signal for sensor 3. The sensor may be sending a speed";
CM_ SG_ 3221225472 EngSpeed3 "The engine speed as measured by speed sensor 3.";
CM_ SG_ 3221225472 EngSpeed2 "The engine speed as measured by speed sensor 2";
CM_ SG_ 3221225472 EngSpeed1 "The engine speed as measured by speed sensor 1.";
CM_ SG_ 3221225472 DsredEngCoolantThermostatOpening "Indicates the desired position of the engine coolant control valve. 0% represents the thermostat allows flow to";
CM_ SG_ 3221225472 DesiredEngCoolantPumpOutletTemp "Desired engine coolant temperature of the engine to an electronic thermostat. If the electronic thermostat valve is";
CM_ SG_ 3221225472 EngCoolantThermostatMode "Specifies if the engine coolant thermostat valve will operate in temperature control mode or position control mode.";
CM_ SG_ 3221225472 AuxI_OChannel19 "Identifies the current value of auxiliary input/output channels that are configured uniquely per application.";
CM_ SG_ 3221225472 AuxI_OChannel20 "Identifies the current value of auxiliary input/output channels that are configured uniquely per application.";
CM_ SG_ 3221225472 AuxI_OChannel21 "Identifies the current value of auxiliary input/output channels that are configured uniquely per application.";
CM_ SG_ 3221225472 AuxI_OChannel22 "Identifies the current value of auxiliary input/output channels that are configured uniquely per application.";
CM_ SG_ 3221225472 AuxI_OChannel15 "Identifies the current value of auxiliary input/output channels that are configured uniquely per application.";
CM_ SG_ 3221225472 AuxI_OChannel16 "Identifies the current value of auxiliary input/output channels that are configured uniquely per application.";
CM_ SG_ 3221225472 AuxI_OChannel17 "Identifies the current value of auxiliary input/output channels that are configured uniquely per application.";
CM_ SG_ 3221225472 AuxI_OChannel18 "Identifies the current value of auxiliary input/output channels that are configured uniquely per application.";
CM_ SG_ 3221225472 AuxI_OChannel11 "Identifies the current value of auxiliary input/output channels that are configured uniquely per application.";
CM_ SG_ 3221225472 AuxI_OChannel12 "Identifies the current value of auxiliary input/output channels that are configured uniquely per application.";
CM_ SG_ 3221225472 AuxI_OChannel13 "Identifies the current value of auxiliary input/output channels that are configured uniquely per application.";
CM_ SG_ 3221225472 AuxI_OChannel14 "Identifies the current value of auxiliary input/output channels that are configured uniquely per application.";
CM_ SG_ 3221225472 AuxI_OChannel7 "Identifies the current value of auxiliary input/output channels that are configured uniquely per application.";
CM_ SG_ 3221225472 AuxI_OChannel8 "Identifies the current value of auxiliary input/output channels that are configured uniquely per application.";
CM_ SG_ 3221225472 AuxI_OChannel9 "Identifies the current value of auxiliary input/output channels that are configured uniquely per application.";
CM_ SG_ 3221225472 AuxI_OChannel10 "Identifies the current value of auxiliary input/output channels that are configured uniquely per application.";
CM_ SG_ 3221225472 AuxI_OChannel3 "Identifies the current value of auxiliary input/output channels that are configured uniquely per application.";
CM_ SG_ 3221225472 AuxI_OChannel4 "Identifies the current value of auxiliary input/output channels that are configured uniquely per application.";
CM_ SG_ 3221225472 AuxI_OChannel5 "Identifies the current value of auxiliary input/output channels that are configured uniquely per application.";
CM_ SG_ 3221225472 AuxI_OChannel6 "Identifies the current value of auxiliary input/output channels that are configured uniquely per application.";
CM_ SG_ 3221225472 Aftertreatment1AirEnableActuator "Indicates whether aftertreatment 1 air enable actuator is on or off";
CM_ SG_ 3221225472 Aftertreatment1PurgeAirActuator "Indicates whether aftertreatment 1 purge air actuator is on or off";
CM_ SG_ 3221225472 Aftrtrtmnt1AtmizationAirActuator "Indicates whether aftertreatment 1 atomization air actuator is on or off";
CM_ SG_ 3221225472 Aftertreatment1AirSystemRelay "Indicates whether aftertreatment 1 air system relay is on or off";
CM_ SG_ 3221225472 Aftrtratment1AirPressActuatorPos "Position of the aftertreatment 1 air pressure actuator as measured by a position feedback sensor.";
CM_ SG_ 3221225472 Aftertreatment1AirPressCtrl "Position that the controller is commanding the aftertreatment 1 air pressure control to maintain. 0% = fully closed, 100% =";
CM_ SG_ 3221225472 Aftertreatment1PurgeAirPress "Pressure of the purge air supply for aftertreatment 1";
CM_ SG_ 3221225472 Aftertreatment1SupplyAirPress "Pressure of the supply air for aftertreatment 1. Supply air is the air supplied from a pneumatic line for an air-assisted or";
CM_ SG_ 3221225472 Aftertreatment1SecondAirPress "Pressure of the secondary air for aftertreatment 1. Secondary air is air provided to the exhaust system (per SAE J2403).";
CM_ SG_ 3221225472 Aftertreatment1SecondAirMassFlow "Indicates the secondary air mass flow for aftertreatment 1. Secondary air is the air provided to the exhaust system (per";
CM_ SG_ 3221225472 Aftertreatment1SecondAirTemp "Indicates the secondary air temperature for aftertreatment 1. Secondary air is air provided to the exhaust system (per";
CM_ SG_ 3221225472 Aftrtreatment1SecondAirDiffPress "Indicates the secondary air differential pressure for aftertreatment 1. Secondary air is air provided to the exhaust system";
CM_ SG_ 3221225472 Aftrtrtmnt1FlInjector1HeaterCtrl "Heating level that the controller is commanding the aftertreatment 1 fuel injector 1 heater control to maintain. 0% = off,";
CM_ SG_ 3221225472 Aftrtreatment1FuelEnableActuator "Indicates whether aftertreatment 1 fuel enable actuator is on or off";
CM_ SG_ 3221225472 Aftrtreatment1RegenerationStatus "Indicates whether regeneration is active or inactive in aftertreatment 1.";
CM_ SG_ 3221225472 Aftertreatment1Ignt "Indicates whether aftertreatment 1 ignition circuit is energized by the ECM.";
CM_ SG_ 3221225472 Aftertreatment1FuelDrainActuator "Indicates whether aftertreatment 1 fuel drain actuator is on or off";
CM_ SG_ 3221225472 Aftertreatment1FuelPress1Ctrl "Position that the controller is commanding the aftertreatment 1 fuel pressure control to maintain. 0% = fully closed, 100%";
CM_ SG_ 3221225472 Aftertreatment1FuelRate "Rate of fuel being delivered to aftertreatment 1 for regeneration";
CM_ SG_ 3221225472 Aftertreatment1FuelPress1 "First fuel pressure measurement for the aftertreatment 1 system";
CM_ SG_ 3221225472 Aftrtrtmnt1HydrcrbnDsrIntkFlTemp "Measured temperature of the intake fuel to the hydrocarbon dosing device";
CM_ SG_ 3221225472 Aftrtrtmnt1FelPress2ActuatorCtrl "Indicates how the device is controlling the aftertreatment 1 fuel pressure 2 regulating control valve. 0% = fully closed,";
CM_ SG_ 3221225472 Aftrtrtmnt1FlFlwDverterValveCtrl "Indicates how the device is controlling the aftertreatment 1 fuel flow diverter valve. When this valve is on it diverts fuel flow";
CM_ SG_ 3221225472 Aftertreatment1FuelPumpRelayCtrl "Indicates how the device is controlling the aftertreatment 1 fuel pump relay.";
CM_ SG_ 3221225472 Aftertreatment1FuelPress2 "Second fuel pressure measurement for the aftertreatment 1 system";
CM_ SG_ 3221225472 DslParticulateFilterOutletPress1 "This parameter indicates the diesel particulate filter outlet gage pressure 1 (bank 1).";
CM_ SG_ 3221225472 DslParticulateFilterIntakePress1 "This parameter indicates the diesel particulate filter intake gage pressure 1 (bank 1).";
CM_ SG_ 3221225472 Aftrtrtmnt1AvrgTmBtwnActvRgnrtns "Indicates the average time since last reset between active regenerations, that have not been forced to occur by manual";
CM_ SG_ 3221225472 Aftrtrtmnt1TtlNmbrOfActvRgnrtnMn "Total number of aftertreatment device 1 active regeneration manual requests by the operator over the lifetime of the";
CM_ SG_ 3221225472 Aftrtrtmnt1TtlNmbrOfActvRgnrtnIn "Total number of aftertreatment device 1 active regeneration inhibit requests by the operator over the lifetime of the device.";
CM_ SG_ 3221225472 Aftrtrtmnt1TtlNmbrOfPssvRgnrtons "Total number of passive regenerations by aftertreatment device 1 over the lifetime of the device.";
CM_ SG_ 3221225472 Aftrtrtmnt1TtlPssvRgnerationTime "Total amount of time that aftertreatment device 1 has been in passive regeneration over the lifetime of the device.";
CM_ SG_ 3221225472 Aftrtrtmnt1TtlNmbrOfActvRgnrtons "Total number of active regenerations by aftertreatment device 1 over the lifetime of the device.";
CM_ SG_ 3221225472 Aftertreatment1TotalDisabledTime "Total amount of time that aftertreatment 1 regeneration has been manually disabled.";
CM_ SG_ 3221225472 Aftrtrtmnt1TotalRegenerationTime "Total amount of time that aftertreatment device 1 has been regenerating over the lifetime of the device.";
CM_ SG_ 3221225472 Aftertreatment1TotalFuelUsed "Total amount of fuel used by aftertreatment device 1 over the lifetime of the device.";
CM_ SG_ 3221225472 Aftrtrtmnt1IntkOxygnSnsrPrlmnryF "Used to identify the applicable J1939-73 FMI detected in the aftertreatment intake oxygen sensor by the manufacturer’s";
CM_ SG_ 3221225472 Aftrtrtmnt1IntkNOxSnsrPrlmnryFMI "Used to identify the applicable J1939-73 FMI detected in the aftertreatment intake NOx sensor by the manufacturer’s";
CM_ SG_ 3221225472 Aftrtrtmnt1IntkGsSnsorHeaterCtrl "Indicates the heater status in the warm-up process. Upon receiving a power-up command, the gas sensor ramps up";
CM_ SG_ 3221225472 Aftrtrtmnt1IntkGsSnsrHtrPrlmnryF "Used to identify the applicable J1939-73 FMI detected in the heater of the intake exhaust gas sensor, either NOx or O2,";
CM_ SG_ 3221225472 Aftrtrtmnt1IntkWdRngO2RdngStable "Indicates that the %O2 reading of the aftertreatment intake gas sensor, either NOx or O2, is stable as determined by the";
CM_ SG_ 3221225472 Aftrtrtmnt1IntkeNOxReadingStable "Indicates that the NOx reading of the aftertreatment intake NOx sensor is stable as determined by the manufacturer’s";
CM_ SG_ 3221225472 Aftrtrtmnt1IntakeGasSensorAtTemp "Indicates that the heater element of the aftertreatment intake gas sensor, either NOx or O2, is within the manufacturer’s";
CM_ SG_ 3221225472 Aftrtrtmnt1IntkGsSnsrPowerStatus "Indicates that the power supplied to the aftertreatment intake gas sensor, either NOx or O2, is within the manufacturer’s";
CM_ SG_ 3221225472 Aftertreatment1IntakeO2 "The actual oxidation factor (%O2) of the gas within the exhaust stream. For positive values, the parameter represents the";
CM_ SG_ 3221225472 Aftertreatment1IntakeNOx "The amount of combined NO and NO2 in the exhaust entering the aftertreatment system measured by a NOx sensor at";
CM_ SG_ 3221225472 Aftrtrtmnt1DslPrtcltFltrIntkGsTm "Used to identify the applicable J1939-73 FMI detected in the diesel particulate filter intake gas temperature sensor by theTemperature of engine combustion byproducts entering the diesel particulate filter in exhaust bank 1.";
CM_ SG_ 3221225472 Aftrtrtmnt1ExhstGsTmp1PrlmnryFMI "Used to identify the applicable J1939-73 FMI detected in the exhaust gas temperature 1 sensor by the manufacturer’s";
CM_ SG_ 3221225472 Aftertreatment1ExhaustGasTemp1 "The reading from the exhaust gas temperature sensor located farthest upstream in the aftertreatment system in exhaust";
CM_ SG_ 3221225472 AntitheftRandomNumber "A seven byte random numeric code provided by the component in response to an anti-theft request. This parameter is";
CM_ SG_ 3221225472 AntitheftComponentStatusStates "Indicates whether or not the component can be started.";
CM_ SG_ 3221225472 AntthftEncryptnSdPrsentIndicator "Indicates the presence of the encryption seed random number.";
CM_ SG_ 3221225472 AntitheftModifyPwdStates "This parameter is used to indicate whether a password request was successfully performed, or if the request could not be";
CM_ SG_ 3221225472 AntitheftPwdValidIndicator "Indicates the presence of a validated password.";
CM_ SG_ 3221225472 AntitheftPwdRepresentation "This parameter is the seven byte numeric code (i.e., ‘encrypted password’ or ‘key’) that is generated based on the";
CM_ SG_ 3221225472 AntitheftCmdStates "This parameter is used to identify the specific requests being sent to the component.";
CM_ SG_ 3221225472 AntitheftDesiredExitModeStates "This parameter is used to specify the desired triggers that are to be used by the component in deciding when to transition";
CM_ SG_ 3221225472 AntthftEncryptionIndicatorStates "This parameter is used to indicate if a random number seed is being requested, or if an encrypted password is being";
CM_ SG_ 3221225472 EngAltWinding3Temp "Temperature of the windings inside the alternator.";
CM_ SG_ 3221225472 EngAltWinding2Temp "Temperature of the windings inside the alternator.";
CM_ SG_ 3221225472 EngAltWinding1Temp "Temperature of the windings inside the alternator.";
CM_ SG_ 3221225472 EngAltBearing2Temp "Temperature of the bearing inside the alternator. Bearing 2 is the right or front bearing.";
CM_ SG_ 3221225472 EngAltBearing1Temp "Temperature of the bearing inside the alternator. Bearing 1 is the left or rear bearing.";
CM_ SG_ 3221225472 LevelPresetRearAxleRight "Set value for nominal level 'preset level' at the right side of the rear axle. This value is referred to 'Normal level 1'. For";
CM_ SG_ 3221225472 LevelPresetRearAxleLeft "Set value for nominal level 'preset level' at the left side of the rear axle. This value is referred to 'Normal level 1'. For";
CM_ SG_ 3221225472 LevelPresetFrontAxleRight "Set value for nominal level 'preset level' at the right side of the front axle. This value is referred to 'Normal level 1'. For";
CM_ SG_ 3221225472 LevelPresetFrontAxleLeft "Set value for nominal level 'preset level' at the left side of the front axle. This value is referred to 'Normal level 1'. For";
CM_ SG_ 3221225472 ElctrncShckAbsrbrCtrlMdLft_TgAxl "Signal which indicates the current mode of operation of the electronic shock absorber control at the lift/tag axle.";
CM_ SG_ 3221225472 ElctrncShckAbsrbrCtrlMdeRearAxle "Signal which indicates the current mode of operation of the electronic shock absorber control at the rear axle.";
CM_ SG_ 3221225472 ElctrncShckAbsrbrCtrlMdFrontAxle "Signal which indicates the current mode of operation of the electronic shock absorber control at the front axle.";
CM_ SG_ 3221225472 DamperStiffnessLift_TagAxle "Damper stiffness information of the shock absorber control at the lift of tag axle";
CM_ SG_ 3221225472 DamperStiffnessRearAxle "Damper stiffness information of the shock absorber control at the rear axle";
CM_ SG_ 3221225472 DamperStiffnessFrontAxle "Damper stiffness information of the shock absorber control at the front axle";
CM_ SG_ 3221225472 TestLimitMinimum "The test value must be greater than or equal to Test Limit Minimum in order for the test to passThe threshold which the test value must be above to pass the test.";
CM_ SG_ 3221225472 TestLimitMaximum "The test value must be less than or equal to Test Limit Maximum in order for the test to pass.The threshold which the test value must be below to pass the test.";
CM_ SG_ 3221225472 TestValue "The test value collected during the test.The test value collected during the test.";
CM_ SG_ 3221225472 SlotId "The SLOT Identifer is used to determine the multiplier and offset to be used to scale the test value.";
CM_ SG_ 3221225472 TestIdentifier "Test IdentifierDesignates the test to be run.Designates the test to be run.";
CM_ SG_ 3221225472 Aftrtrtmnt1DslPrtcltFltrIntrmdtG "Used to identify the applicable J1939-73 FMI detected in the diesel particulate filter intermediate gas temperature sensorTemperature of engine combustion byproducts at a mid-point in the diesel particulate filter in exhaust bank 1.";
CM_ SG_ 3221225472 Aftrtrtmnt1DslPrtcltFltrDltPrssP "Used to identify the applicable J1939-73 FMI detected in the diesel particulate filter differential pressure sensor by the";
CM_ SG_ 3221225472 Aftrtrtmnt1DslPrtcltFltrDffPress "Exhaust differential pressure measured between the intake and exhaust of a diesel particulate filter in exhaust bank 1.";
CM_ SG_ 3221225472 Aftrtrtmnt1ExhstGsTmp2PrlmnryFMI "Used to identify the applicable J1939-73 FMI detected in the exhaust gas temperature 2 sensor by the manufacturer’s";
CM_ SG_ 3221225472 Aftertreatment1ExhaustGasTemp2 "The reading from the exhaust gas temperature sensor located midstream of the other two temperature sensors in the";
CM_ SG_ 3221225472 Aftrtrtmnt1OtltOxygnSnsrPrlmnryF "Used to identify the applicable J1939-73 FMI detected in the aftertreatment outlet oxygen sensor by the manufacturer’s";
CM_ SG_ 3221225472 Aftrtrtmnt1OtltNOxSnsrPrlmnryFMI "Used to identify the applicable J1939-73 FMI detected in the aftertreatment outlet NOx sensor by the manufacturer’s";
CM_ SG_ 3221225472 Aftrtrtmnt1OtltGsSnsorHeaterCtrl "Indicates the heater status in the warm-up process. Upon receiving a power-up command, the gas sensor ramps up";
CM_ SG_ 3221225472 Aftrtrtmnt1OtltGsSnsrHtrPrlmnryF "Used to identify the applicable J1939-73 FMI detected in the heater of the outlet exhaust gas sensor, either NOx or O2, by";
CM_ SG_ 3221225472 Aftrtrtmnt1OtltWdRngO2RdngStable "Indicates that the %O2 reading of the aftertreatment outlet gas sensor, either NOx or O2, is stable as determined by the";
CM_ SG_ 3221225472 Aftrtrtmnt1OtletNOxReadingStable "Indicates that the NOx reading of the aftertreatment outlet NOx sensor is stable as determined by the manufacturer’s";
CM_ SG_ 3221225472 Aftrtrtmnt1OutletGasSensorAtTemp "Indicates that the heater element of the aftertreatment outlet gas sensor, either NOx or O2, is within the manufacturer’s";
CM_ SG_ 3221225472 Aftrtrtmnt1OtltGsSnsrPowerStatus "Indicates that the power supplied to the aftertreatment outlet gas sensor, either NOx or O2, is within the manufacturer’s";
CM_ SG_ 3221225472 Aftertreatment1OutletO2 "The actual oxidation factor (%O2) of the gas within the exhaust stream. For positive values, the parameter represents the";
CM_ SG_ 3221225472 Aftertreatment1OutletNOx "The amount of combined NO and NO2 in the exhaust entering the aftertreatment system measured by a NOx sensor at";
CM_ SG_ 3221225472 Aftrtrtmnt1DslPrtcltFltrOtltGsTm "Temperature of engine combustion byproducts leaving the diesel particulate filter exhaust in exhaust bank 1.";
CM_ SG_ 3221225472 Aftrtrtmnt1DslPrtcltFltrOtltExhs "Used to identify the applicable J1939-73 FMI detected in the diesel particulate filter outlet gas temperature sensor by the";
CM_ SG_ 3221225472 Aftrtrtmnt1ExhstGsTmp3PrlmnryFMI "Used to identify the applicable J1939-73 FMI detected in the exhaust gas temperature 3 sensor by the manufacturer’s";
CM_ SG_ 3221225472 Aftertreatment1ExhaustGasTemp3 "The reading from the exhaust gas temperature sensor located farthest downstream in the aftertreatment system in";
CM_ SG_ 3221225472 DslPrtclateFilter1AshLoadPercent "Indicates the ash load percent of diesel particulate filter 1. 100% is the level at which diesel particulate filter ash service";
CM_ SG_ 3221225472 DslPrtcltFltr1TmSncLstActvRgnrtn "Indicates the time since the last active regeneration event of diesel particulate filter 1.";
CM_ SG_ 3221225472 DslPrtclteFilter1SootLoadPercent "Indicates the soot load percent of diesel particulate filter 1. 100% is the level at which active diesel particulate filter";
CM_ SG_ 3221225472 Aftrtrtmnt1DslPrtcltFltrStLdRgnr "This parameter indicates the value that will first cause DPF regeneration in aftertreatment 1. There may be multiple";
CM_ SG_ 3221225472 Aftrtrtmnt1TrpNmbrOfActvRgnrtnMn "Total number of Aftertreatment device 1 active regeneration manual requests by the operator during the current trip";
CM_ SG_ 3221225472 Aftrtrtmnt1TrpNmbrOfActvRgnrtnIn "Total number of aftertreatment device 1 active regeneration inhibit requests by the operator during the current trip period.";
CM_ SG_ 3221225472 Aftrtrtmnt1TrpNmbrOfPssvRgnrtons "Total number of passive regenerations by Aftertreatment device 1 during the current trip period.";
CM_ SG_ 3221225472 Aftrtrtmnt1TrpPssvRgnerationTime "Total amount of time that aftertreatment device 1 has been in passive regeneration during the current trip period.";
CM_ SG_ 3221225472 Aftrtrtmnt1TrpNmbrOfActvRgnrtons "Total number of active regenerations by Aftertreatment device 1 during the current trip period.";
CM_ SG_ 3221225472 Aftertreatment1TripDisabledTime "Total amount of time that aftertreatment 1 regeneration has been manually disabled during the current trip period.";
CM_ SG_ 3221225472 Aftrtrtmnt1TrpActvRgnerationTime "Total amount of time that aftertreatment device 1 has been in active regeneration during the current trip period.";
CM_ SG_ 3221225472 Aftertreatment1TripFuelUsed "Total amount of fuel used by aftertreatment device 1 during the current trip period.";
CM_ SG_ 3221225472 Aftertreatment2AirEnableActuator "Indicates whether aftertreatment 2 air enable actuator is on or off";
CM_ SG_ 3221225472 Aftertreatment2PurgeAirActuator "Indicates whether aftertreatment 2 purge air actuator is on or off";
CM_ SG_ 3221225472 Aftrtrtmnt2AtmizationAirActuator "Indicates whether aftertreatment 2 atomization air actuator is on or off";
CM_ SG_ 3221225472 Aftertreatment2AirSystemRelay "Indicates whether aftertreatment 2 air system relay is on or off";
CM_ SG_ 3221225472 Aftrtratment2AirPressActuatorPos "Position of the aftertreatment 2 air pressure actuator as measured by a position feedback sensor.";
CM_ SG_ 3221225472 Aftertreatment2AirPressCtrl "Position that the controller is commanding the aftertreatment 2 air pressure control to maintain. 0% = fully closed, 100% =";
CM_ SG_ 3221225472 Aftertreatment2PurgeAirPress "Pressure of the purge air supply for aftertreatment 2";
CM_ SG_ 3221225472 Aftertreatment2SupplyAirPress "Pressure of the supply air for aftertreatment 2. Supply air is the air supplied from a pneumatic line for an air-assisted or";
CM_ SG_ 3221225472 Aftertreatment2SecondAirPress "Pressure of the secondary air for aftertreatment 2. Secondary air is air provided to the exhaust system (per SAE J2403).";
CM_ SG_ 3221225472 Aftertreatment2SecondAirMassFlow "Indicates the secondary air mass flow for aftertreatment 2. Secondary air is the air provided to the exhaust system (per";
CM_ SG_ 3221225472 Aftertreatment2SecondAirTemp "Indicates the secondary air temperature for aftertreatment 2. Secondary air is air provided to the exhaust system (per";
CM_ SG_ 3221225472 Aftrtreatment2SecondAirDiffPress "Indicates the secondary air differential pressure for aftertreatment 2. Secondary air is air provided to the exhaust system";
CM_ SG_ 3221225472 Aftrtrtmnt2FlInjector1HeaterCtrl "Heating level that the controller is commanding the aftertreatment 2 fuel injector 1 heater control to maintain. 0% = off,";
CM_ SG_ 3221225472 Aftrtreatment2FuelEnableActuator "Indicates whether aftertreatment 2 fuel enable actuator is on or off";
CM_ SG_ 3221225472 Aftrtreatment2RegenerationStatus "Indicates whether regeneration is active or inactive in aftertreatment 2.";
CM_ SG_ 3221225472 Aftertreatment2Ignt "Indicates whether aftertreatment 2 ignition circuit is energized by the ECM.";
CM_ SG_ 3221225472 Aftertreatment2FuelDrainActuator "Indicates whether aftertreatment 2 fuel drain actuator is on or off";
CM_ SG_ 3221225472 Aftertreatment2FuelPress1Ctrl "Position that the controller is commanding the aftertreatment 2 fuel pressure control to maintain. 0% = fully closed, 100%";
CM_ SG_ 3221225472 Aftertreatment2FuelRate "Rate of fuel being delivered to aftertreatment 2 for regeneration";
CM_ SG_ 3221225472 Aftertreatment2FuelPress1 "Pressure of the fuel for Aftertreatment 2.";
CM_ SG_ 3221225472 DslParticulateFilterOutletPress2 "This parameter indicates the diesel particulate filter outlet gage pressure 2 (bank 2).";
CM_ SG_ 3221225472 DslParticulateFilterIntakePress2 "This parameter indicates the diesel particulate filter intake gage pressure 2 (bank 2).";
CM_ SG_ 3221225472 Aftrtrtmnt2AvrgTmBtwnActvRgnrtns "Indicates the average time since last reset between active regenerations, that have not been forced to occur by manual";
CM_ SG_ 3221225472 Aftrtrtmnt2TtlNmbrOfActvRgnrtnMn "Total number of Aftertreatment device 2 active regeneration manual requests by the operator over the lifetime of the";
CM_ SG_ 3221225472 Aftrtrtmnt2TtlNmbrOfActvRgnrtnIn "Total number of Aftertreatment device 2 active regeneration inhibit requests by the operator over the lifetime of the";
CM_ SG_ 3221225472 Aftrtrtmnt2TtlNmbrOfPssvRgnrtons "Total number of passive regenerations by Aftertreatment device 2 over the lifetime of the device.";
CM_ SG_ 3221225472 Aftrtrtmnt2TtlPssvRgnerationTime "Total amount of time that Aftertreatment device 2 has been in passive regeneration over the lifetime of the device.";
CM_ SG_ 3221225472 Aftrtrtmnt2TtlNmbrOfActvRgnrtons "Total number of active regenerations by aftertreatment device 2 over the lifetime of the device.";
CM_ SG_ 3221225472 Aftertreatment2TotalDisabledTime "Total amount of time that aftertreatment 2 regeneration has been manually disabled.";
CM_ SG_ 3221225472 Aftrtrtmnt2TotalRegenerationTime "Total amount of time that aftertreatment device 2 has been regenerating over the lifetime of the device.";
CM_ SG_ 3221225472 Aftertreatment2TotalFuelUsed "Total amount of fuel used by aftertreatment device 2 over the lifetime of the device.";
CM_ SG_ 3221225472 Aftrtrtmnt2IntkOxygnSnsrPrlmnryF "Used to identify the applicable J1939-73 FMI detected in the aftertreatment intake oxygen sensor by the manufacturer’s";
CM_ SG_ 3221225472 Aftrtrtmnt2IntkNOxSnsrPrlmnryFMI "Used to identify the applicable J1939-73 FMI detected in the aftertreatment intake NOx sensor by the manufacturer’s";
CM_ SG_ 3221225472 Aftrtrtmnt2IntkGsSnsorHeaterCtrl "Indicates the heater status in the warm-up process. Upon receiving a power-up command, the gas sensor ramps up";
CM_ SG_ 3221225472 Aftrtrtmnt2IntkGsSnsrHtrPrlmnryF "Used to identify the applicable J1939-73 FMI detected in the heater of the intake exhaust gas sensor, either NOx or O2,";
CM_ SG_ 3221225472 Aftrtrtmnt2IntkWdRngO2RdngStable "Indicates that the %O2 reading of the aftertreatment intake gas sensor, either NOx or O2, is stable as determined by the";
CM_ SG_ 3221225472 Aftrtrtmnt2IntkeNOxReadingStable "Indicates that the NOx reading of the aftertreatment intake NOx sensor is stable as determined by the manufacturer’s";
CM_ SG_ 3221225472 Aftrtrtmnt2IntakeGasSensorAtTemp "Indicates that the heater element of the aftertreatment intake gas sensor, either NOx or O2, is within the manufacturer’s";
CM_ SG_ 3221225472 Aftrtrtmnt2IntkGsSnsrPowerStatus "Indicates that the power supplied to the aftertreatment intake gas sensor, either NOx or O2, is within the manufacturer’s";
CM_ SG_ 3221225472 Aftertreatment2IntakeO2 "The actual oxidation factor (%O2) of the gas within the exhaust stream. For positive values, the parameter represents the";
CM_ SG_ 3221225472 Aftertreatment2IntakeNOx "The amount of combined NO and NO2 in the exhaust entering the aftertreatment system measured by a NOx sensor at";
CM_ SG_ 3221225472 Aftrtrtmnt2DslPrtcltFltrIntkGsTm "Used to identify the applicable J1939-73 FMI detected in the diesel particulate filter intake gas temperature sensor by theTemperature of engine combustion byproducts entering the diesel particulate filter in exhaust bank 2. (For a single";
CM_ SG_ 3221225472 Aftrtrtmnt2ExhstGsTmp1PrlmnryFMI "Used to identify the applicable J1939-73 FMI detected in the exhaust gas temperature 1 sensor by the manufacturer’s";
CM_ SG_ 3221225472 Aftertreatment2ExhaustGasTemp1 "The reading from the exhaust gas temperature sensor located farthest upstream in the aftertreatment system in exhaust";
CM_ SG_ 3221225472 Aftrtrtmnt2DslPrtcltFltrIntrmdtG "Used to identify the applicable J1939-73 FMI detected in the diesel particulate filter intermediate gas temperature sensorTemperature of engine combustion byproducts at a mid-point in the diesel particulate filter in exhaust bank 2. (For a";
CM_ SG_ 3221225472 Aftrtrtmnt2DslPrtcltFltrDltPrssP "Used to identify the applicable J1939-73 FMI detected in the diesel particulate filter differential pressure sensor by the";
CM_ SG_ 3221225472 Aftrtrtmnt2DslPrtcltFltrDffPress "Exhaust differential pressure measured between the intake and exhaust of a diesel particulate filter in exhaust bank 2.";
CM_ SG_ 3221225472 Aftrtrtmnt2ExhstGsTmp2PrlmnryFMI "Used to identify the applicable J1939-73 FMI detected in the exhaust gas temperature 2 sensor by the manufacturer’s";
CM_ SG_ 3221225472 Aftertreatment2ExhaustGasTemp2 "The reading from the exhaust gas temperature sensor located midstream of the other two temperature sensors in the";
CM_ SG_ 3221225472 Aftrtrtmnt2OtltOxygnSnsrPrlmnryF "Used to identify the applicable J1939-73 FMI detected in the aftertreatment outlet oxygen sensor by the manufacturer’s";
CM_ SG_ 3221225472 Aftrtrtmnt2OtltNOxSnsrPrlmnryFMI "Used to identify the applicable J1939-73 FMI detected in the aftertreatment outlet NOx sensor by the manufacturer’s";
CM_ SG_ 3221225472 Aftrtrtmnt2OtltGsSnsorHeaterCtrl "Indicates the heater status in the warm-up process. Upon receiving a power-up command, the gas sensor ramps up";
CM_ SG_ 3221225472 Aftrtrtmnt2OtltGsSnsrHtrPrlmnryF "Used to identify the applicable J1939-73 FMI detected in the heater of the outlet exhaust gas sensor, either NOx or O2, by";
CM_ SG_ 3221225472 Aftrtrtmnt2OtltWdRngO2RdngStable "Indicates that the %O2 reading of the aftertreatment outlet gas sensor, either NOx or O2, is stable as determined by the";
CM_ SG_ 3221225472 Aftrtrtmnt2OtletNOxReadingStable "Indicates that the NOx reading of the aftertreatment outlet NOx sensor is stable as determined by the manufacturer’s";
CM_ SG_ 3221225472 Aftrtrtmnt2OutletGasSensorAtTemp "Indicates that the heater element of the aftertreatment outlet gas sensor, either NOx or O2, is within the manufacturer’s";
CM_ SG_ 3221225472 Aftrtrtmnt2OtltGsSnsrPowerStatus "Indicates that the power supplied to the aftertreatment outlet gas sensor, either NOx or O2, is within the manufacturer’s";
CM_ SG_ 3221225472 Aftertreatment2OutletO2 "The actual oxidation factor (%O2) of the gas within the exhaust stream. For positive values, the parameter represents the";
CM_ SG_ 3221225472 Aftertreatment2OutletNOx "The amount of combined NO and NO2 in the exhaust entering the aftertreatment system measured by a NOx sensor at";
CM_ SG_ 3221225472 Aftrtrtmnt2DslPrtcltFltrOtltGsTm "Temperature of engine combustion byproducts leaving the diesel particulate filter exhaust in exhaust bank 2. (For a";
CM_ SG_ 3221225472 Aftrtrtmnt2DslPrtcltFltrExhstGsT "Used to identify the applicable J1939-73 FMI detected in the diesel particulate filter outlet gas temperature sensor by the";
CM_ SG_ 3221225472 Aftrtrtmnt2ExhstGsTmp3PrlmnryFMI "Used to identify the applicable J1939-73 FMI detected in the exhaust gas temperature 3 sensor by the manufacturer’s";
CM_ SG_ 3221225472 Aftertreatment2ExhaustGasTemp3 "The reading from the exhaust gas temperature sensor located farthest downstream in the aftertreatment system in";
CM_ SG_ 3221225472 Aftrtrtmnt2DslPrtcltFltrStLdRgnr "This parameter indicates the value that will first cause DPF regeneration in aftertreatment 2. There may be multiple";
CM_ SG_ 3221225472 DslPrtcltFltr2TmSncLstActvRgnrtn "Indicates the time since the last active regeneration event of diesel particulate filter 2.";
CM_ SG_ 3221225472 DslPrtclateFilter2AshLoadPercent "Indicates the ash load percent of diesel particulate filter 2. 100% is the level at which diesel particulate filter ash service";
CM_ SG_ 3221225472 DslPrtclteFilter2SootLoadPercent "Indicates the soot load percent of diesel particulate filter 2. 100% is the level at which active diesel particulate filter";
CM_ SG_ 3221225472 Aftrtrtmnt2TrpNmbrOfActvRgnrtnMn "Total number of aftertreatment device 2 active regeneration manual requests by the operator during the current trip";
CM_ SG_ 3221225472 Aftrtrtmnt2TrpNmbrOfActvRgnrtnIn "Total number of aftertreatment device 2 active regeneration inhibit requests by the operator during the current trip period.";
CM_ SG_ 3221225472 Aftrtrtmnt2TrpNmbrOfPssvRgnrtons "Total number of passive regenerations by aftertreatment device 2 during the current trip period.";
CM_ SG_ 3221225472 Aftrtrtmnt2TrpPssvRgnerationTime "Total amount of time that aftertreatment device 2 has been in passive regeneration during the current trip period.";
CM_ SG_ 3221225472 Aftrtrtmnt2TrpNmbrOfActvRgnrtons "Total number of active regenerations by aftertreatment device 2 during the current trip period.";
CM_ SG_ 3221225472 Aftertreatment2TripDisabledTime "Total amount of time that aftertreatment 2 regeneration has been manually disabled during the current trip period.";
CM_ SG_ 3221225472 Aftrtrtmnt2TrpActvRgnerationTime "Total amount of time that aftertreatment device 2 has been in active regeneration during the current trip period.";
CM_ SG_ 3221225472 Aftertreatment2TripFuelUsed "Total amount of fuel used by aftertreatment device 2 during the current trip period.";
CM_ SG_ 3221225472 EngDerateRq "This parameter is a derate request made from the engine control system to an external system, where the engine is";
CM_ SG_ 3221225472 EngEmergencyShutdownIndication "A signal issued by the engine control system to a user or external system indicating that it is immediately shutting the";
CM_ SG_ 3221225472 EngControlledShutdownRq "A signal issued by the engine control system to a user or external system requesting for a controlled shutdown. This";
CM_ SG_ 3221225472 EngCoolantCirculatingPumpCtrl "Control setting for an electrically actuated engine coolant circulating pump.";
CM_ SG_ 3221225472 EngBlock_CoolantPreheaterCtrl "Control setting for an electrically actuated engine block or coolant pre-heating device.";
CM_ SG_ 3221225472 EngElctrclSystmPwrCnsrvationCtrl "Control setting for cutting power to various devices when the engine is not in use. Useful if it is desired to keep the";
CM_ SG_ 3221225472 EngOilPreheaterCtrl "Control setting for an electrically actuated oil pre-heating device.";
CM_ SG_ 3221225472 EngOilPrimingPumpCtrl "This control is used to activate a pump that lubricates the engine, particularly prior to initial engine startup.";
CM_ SG_ 3221225472 EngFuelShutoffValveLeakTestCtrl "Control setting for fuel shutoff valve proving system test. Typically, this type of system can only be used with a dual fuel";
CM_ SG_ 3221225472 EngFuelShutoff2Ctrl "Control setting for fuel shutoff 2. First instance is SPN 632. For a dual fuel shutoff system, this SPN is representative of";
CM_ SG_ 3221225472 EngFuelShutoff1Ctrl "Control setting for fuel shutoff 1. The second instance is SPN 2807. For a single fuel shutoff system, this represents its";
CM_ SG_ 3221225472 EngFuelShutoffVentCtrl "Control setting for a fuel shutoff vent. Typically, for a dual fuel shutoff system, the vent line is located between them and";
CM_ SG_ 3221225472 TimeRemainingInEngOperatingState "This parameter is used to indicate the time remaining in the current engine operating state, based on the state defined in";
CM_ SG_ 3221225472 FuelPumpPrimerCtrl "Parameter used to activate or deactivate a priming system on the fuel transfer system. The fuel priming system is a";
CM_ SG_ 3221225472 EngOperatingState "This parameter is used to indicate the current state, or mode, of operation by the engine. This is a status parameter.";
CM_ SG_ 3221225472 EngExhstGsRcrcltn1MxerIntakeTemp "The temperature of the EGR gas entering the intake mixer, measured after the intake throttle when provided.";
CM_ SG_ 3221225472 EngExhstVlvActationSystemOilTemp "The temperature of the oil in the hydraulic system that powers the engine exhaust valve actuation system";
CM_ SG_ 3221225472 EngCoolantThermostatOpening "The current position of the Thermostat used to regulate the temperature of the engine coolant. 0% represents the";
CM_ SG_ 3221225472 EngCoolantPumpOutletTemp "The actual value of engine coolant temperature at the coolant pump outlet";
CM_ SG_ 3221225472 EngCoolantTemp2 "Second temperature of liquid found in the engine cooling system. See also SPN 110.";
CM_ SG_ 3221225472 NetVehicleWeightChange "Identifies the net vehicle weight change from the time of last vehicle net weight zeroing.";
CM_ SG_ 3221225472 GrossCombinationWeight "Total weight of the truck and all the trailers with on-board scales.";
CM_ SG_ 3221225472 ValveAssemblySupplyPress "Pressure of the hydraulic supply port to a valve assembly.";
CM_ SG_ 3221225472 ValveAssemblyLoadSensePress "The maximum pressure of a valve assembly's current collective load sense pressures where a valve assembly can";
CM_ SG_ 3221225472 ValvePilotPress "Pressure of a valve's pilot supply port.";
CM_ SG_ 3221225472 ValveLoadSensePress "The maximum of the currently measured pressures of a valve's work port A and work port B.";
CM_ SG_ 3221225472 BellowPressRearAxleRight "Information of the pressure of the air suspension bellow at the right side of the rear axle";
CM_ SG_ 3221225472 BellowPressRearAxleLeft "Information of the pressure of the air suspension bellow at the left side of the rear axle";
CM_ SG_ 3221225472 BellowPressFrontAxleRight "Information of the pressure of the air suspension bellow at the right side of the front axle";
CM_ SG_ 3221225472 BellowPressFrontAxleLeft "Information of the pressure of the air suspension bellow at the left side of the front axle";
CM_ SG_ 3221225472 RelativeLevelRearAxleRight "Information of the height at the left side of the rear axle referred to normal level 1. For explanations of normal level 1 see";
CM_ SG_ 3221225472 RelativeLevelRearAxleLeft "Information of the height at the left side of the rear axle referred to normal level 1. For explanations of normal level 1 see";
CM_ SG_ 3221225472 RelativeLevelFrontAxleRight "Information of the height at the right side of the front axle referred to normal level 1. For explanations of normal level 1";
CM_ SG_ 3221225472 RelativeLevelFrontAxleLeft "Information of the height at the left side of the front axle referred to normal level 1.";
CM_ SG_ 3221225472 MemoryLevelRq "Signal which indicates that the air suspension control requests a memory level or a memory level shall be stored.";
CM_ SG_ 3221225472 PrhbitAutomaticAirSuspensionCtrl "[Ed note - description needs to be reviewed and adjusted as necessary]";
CM_ SG_ 3221225472 SpeedDependentLevelCtrlRq "This parameter activates speed dependent level control in suspension system.";
CM_ SG_ 3221225472 AllowLevelCtrlDuringBrakingCmd "This parameter overides the inhibit of level control during braking.";
CM_ SG_ 3221225472 ProhibitAirSuspensionCtrl "This parameter is an external request to the air suspension control system to prohibit all air suspension control. If the";
CM_ SG_ 3221225472 KneelingCmdRearAxle "Command signal to activate the kneeling functionality at the rear axle of the vehicle.";
CM_ SG_ 3221225472 KneelingCmdFrontAxle "Command signal to activate the kneeling functionality at the front axle of the vehicle";
CM_ SG_ 3221225472 DamperStiffnessRqLift_TagAxle "Demand value for the shock absorber control at the lift or tag axle";
CM_ SG_ 3221225472 DamperStiffnessRqRearAxle "Demand value for the shock absorber control at the rear axle.";
CM_ SG_ 3221225472 DamperStiffnessRqFrontAxle "Demand value for the shock absorber control at the front axle.";
CM_ SG_ 3221225472 LiftAxle2PosCmd "Signal to command the position / load condition of lift / tag axle #2. Numbering of lift/tag axles starts at front axle.";
CM_ SG_ 3221225472 LiftAxle1PosCmd "Signal to command the position/load condition of lift/tag axle #1. Numbering of lift/tag axles starts at front axle.";
CM_ SG_ 3221225472 LevelCtrlModeRq "Command signal to activate a level control mode";
CM_ SG_ 3221225472 NominalLevelRqRearAxle "Command signal to activate a level of the rear axle programmed and/or memorized in the ECU. For explanations of";
CM_ SG_ 3221225472 NominalLevelRqFrontAxle "Command signal to activate a level of the front axle programmed and/or memorized in the ECU For explanations of";
CM_ SG_ 3221225472 KneelingCtrlModeRq "Command signal to select the kneeling functionality";
CM_ SG_ 3221225472 KneelingRqRightSide "Command signal to activate the kneeling functionality on the right side of the vehicle";
BA_DEF_ SG_  "SigType" ENUM  "Default","Range","RangeSigned","ASCII","Discrete","Control","ReferencePGN","DTC","StringDelimiter","StringLength","StringLengthControl";
BA_DEF_ SG_  "GenSigStartValue" INT 0 10000;
BA_DEF_ SG_  "GenSigSendType" ENUM  "Cyclic","OnWrite","reserved","OnChange","reserved","reserved","reserved","NoSigSendType";
BA_DEF_ SG_  "GenSigILSupport" ENUM  "Yes","No";
BA_DEF_ SG_  "GenSigEVName" STRING ;
BA_DEF_ SG_  "SPN" INT 0 524287;
BA_DEF_ SG_  "SAEDocument" STRING ;
BA_DEF_ BO_  "GenMsgILSupport" ENUM  "Yes","No";
BA_DEF_ BO_  "GenMsgRequestable" INT 0 1;
BA_DEF_ BO_  "GenMsgSendType" ENUM  "cyclic","reserved","cyclicIfActive","reserved","reserved","reserved","reserved","reserved","noMsgSendType";
BA_DEF_ BO_  "VFrameFormat" ENUM  "StandardCAN","ExtendedCAN","reserved","J1939PG";
BA_DEF_ BO_  "SingleFrame" INT 0 1;
BA_DEF_ BO_  "GenMsgCycleTime" INT 0 3600000;
BA_DEF_ BO_  "SAE_Document" STRING ;
BA_DEF_ SG_  "SystemSignalLongSymbol" STRING ;
BA_DEF_DEF_  "SigType" "Default";
BA_DEF_DEF_  "GenSigStartValue" 0;
BA_DEF_DEF_  "GenSigSendType" "NoSigSendType";
BA_DEF_DEF_  "GenSigILSupport" "Yes";
BA_DEF_DEF_  "GenSigEVName" "Env@Nodename_@Signame";
BA_DEF_DEF_  "SPN" 0;
BA_DEF_DEF_  "SAEDocument" "";
BA_DEF_DEF_  "GenMsgILSupport" "Yes";
BA_DEF_DEF_  "GenMsgRequestable" 1;
BA_DEF_DEF_  "GenMsgSendType" "noMsgSendType";
BA_DEF_DEF_  "VFrameFormat" "J1939PG";
BA_DEF_DEF_  "SingleFrame" 1;
BA_DEF_DEF_  "GenMsgCycleTime" 0;
BA_DEF_DEF_  "SAE_Document" "";
BA_DEF_DEF_  "SystemSignalLongSymbol" "";
BA_ "SAEDocument" SG_ 3221225472 FailureSpecificB1Counter "J1939_73";
BA_ "SPN" SG_ 3221225472 FailureSpecificB1Counter 4147;
BA_ "SigType" SG_ 3221225472 FailureSpecificB1Counter 1;
BA_ "SAEDocument" SG_ 3221225472 SysGreatestB1Counter "J1939_73";
BA_ "SPN" SG_ 3221225472 SysGreatestB1Counter 4146;
BA_ "SigType" SG_ 3221225472 SysGreatestB1Counter 1;
BA_ "SAEDocument" SG_ 3221225472 SysCumulativeContinuousMITime "J1939_73";
BA_ "SPN" SG_ 3221225472 SysCumulativeContinuousMITime 4145;
BA_ "SigType" SG_ 3221225472 SysCumulativeContinuousMITime 1;
BA_ "SAEDocument" SG_ 3221225472 RegulationDescription "J1939_73";
BA_ "SPN" SG_ 3221225472 RegulationDescription 4144;
BA_ "SigType" SG_ 3221225472 RegulationDescription 8;
BA_ "SAEDocument" SG_ 3221225472 SysIncompleteMonitorCount "J1939_73";
BA_ "SPN" SG_ 3221225472 SysIncompleteMonitorCount 4143;
BA_ "SigType" SG_ 3221225472 SysIncompleteMonitorCount 1;
BA_ "SAEDocument" SG_ 3221225472 SysMalIndActivationMode "J1939_73";
BA_ "SPN" SG_ 3221225472 SysMalIndActivationMode 4142;
BA_ "SAEDocument" SG_ 3221225472 SysMalIndDisplayStrategy "J1939_73";
BA_ "SPN" SG_ 3221225472 SysMalIndDisplayStrategy 4141;
BA_ "SigType" SG_ 3221225472 SysMalIndDisplayStrategy 4;
BA_ "SAEDocument" SG_ 3221225472 SysContinuousMalfunctionInd "J1939_73";
BA_ "SPN" SG_ 3221225472 SysContinuousMalfunctionInd 4140;
BA_ "SigType" SG_ 3221225472 SysContinuousMalfunctionInd 4;
BA_ "SAEDocument" SG_ 3221225472 SysNonRoadworthyCompCount "J1939_73";
BA_ "SPN" SG_ 3221225472 SysNonRoadworthyCompCount 4139;
BA_ "SigType" SG_ 3221225472 SysNonRoadworthyCompCount 1;
BA_ "SAEDocument" SG_ 3221225472 VehicleCurrentMIAccumTime "J1939_73";
BA_ "SPN" SG_ 3221225472 VehicleCurrentMIAccumTime 4138;
BA_ "SigType" SG_ 3221225472 VehicleCurrentMIAccumTime 1;
BA_ "SAEDocument" SG_ 3221225472 VehicleIncompleteMonitorCount "J1939_73";
BA_ "SPN" SG_ 3221225472 VehicleIncompleteMonitorCount 4137;
BA_ "SigType" SG_ 3221225472 VehicleIncompleteMonitorCount 1;
BA_ "SAEDocument" SG_ 3221225472 VehicleMalfunctionIndActMode "J1939_73";
BA_ "SPN" SG_ 3221225472 VehicleMalfunctionIndActMode 4136;
BA_ "SigType" SG_ 3221225472 VehicleMalfunctionIndActMode 4;
BA_ "SAEDocument" SG_ 3221225472 VehicleMalfunctionIndStrategy "J1939_73";
BA_ "SPN" SG_ 3221225472 VehicleMalfunctionIndStrategy 4135;
BA_ "SigType" SG_ 3221225472 VehicleMalfunctionIndStrategy 4;
BA_ "SAEDocument" SG_ 3221225472 VehicleContinuousMalfunctionInd "J1939_73";
BA_ "SPN" SG_ 3221225472 VehicleContinuousMalfunctionInd 4134;
BA_ "SigType" SG_ 3221225472 VehicleContinuousMalfunctionInd 4;
BA_ "SAEDocument" SG_ 3221225472 VehicleNonRoadworthyCompCount "J1939_73";
BA_ "SPN" SG_ 3221225472 VehicleNonRoadworthyCompCount 4133;
BA_ "SigType" SG_ 3221225472 VehicleNonRoadworthyCompCount 1;
BA_ "SAEDocument" SG_ 3221225472 PMNTEDeficiencyAreaStatus "J1939_73";
BA_ "SPN" SG_ 3221225472 PMNTEDeficiencyAreaStatus 4132;
BA_ "SigType" SG_ 3221225472 PMNTEDeficiencyAreaStatus 4;
BA_ "SAEDocument" SG_ 3221225472 MnfcPMNTECarveOutAreaStatus "J1939_73";
BA_ "SPN" SG_ 3221225472 MnfcPMNTECarveOutAreaStatus 4131;
BA_ "SigType" SG_ 3221225472 MnfcPMNTECarveOutAreaStatus 4;
BA_ "SAEDocument" SG_ 3221225472 PMNTEControlAreaStatus "J1939_73";
BA_ "SPN" SG_ 3221225472 PMNTEControlAreaStatus 4130;
BA_ "SigType" SG_ 3221225472 PMNTEControlAreaStatus 4;
BA_ "SAEDocument" SG_ 3221225472 NOxNTEDeficiencyAreaStatus "J1939_73";
BA_ "SPN" SG_ 3221225472 NOxNTEDeficiencyAreaStatus 4129;
BA_ "SigType" SG_ 3221225472 NOxNTEDeficiencyAreaStatus 4;
BA_ "SAEDocument" SG_ 3221225472 MnfcNOxNTECarveOutAreaStatus "J1939_73";
BA_ "SPN" SG_ 3221225472 MnfcNOxNTECarveOutAreaStatus 4128;
BA_ "SigType" SG_ 3221225472 MnfcNOxNTECarveOutAreaStatus 4;
BA_ "SAEDocument" SG_ 3221225472 NOxNTEControlAreaStatus "J1939_73";
BA_ "SPN" SG_ 3221225472 NOxNTEControlAreaStatus 4127;
BA_ "SigType" SG_ 3221225472 NOxNTEControlAreaStatus 4;
BA_ "SAEDocument" SG_ 3221225472 AECDEngineHours1Timer2 "J1939_73";
BA_ "SPN" SG_ 3221225472 AECDEngineHours1Timer2 4126;
BA_ "SigType" SG_ 3221225472 AECDEngineHours1Timer2 1;
BA_ "SAEDocument" SG_ 3221225472 AECDEngineHours1Timer1 "J1939_73";
BA_ "SPN" SG_ 3221225472 AECDEngineHours1Timer1 4125;
BA_ "SigType" SG_ 3221225472 AECDEngineHours1Timer1 1;
BA_ "SAEDocument" SG_ 3221225472 AECDNumber1 "J1939_73";
BA_ "SPN" SG_ 3221225472 AECDNumber1 4124;
BA_ "SigType" SG_ 3221225472 AECDNumber1 1;
BA_ "SAEDocument" SG_ 3221225472 BatteryMainSwitchHoldState "J1939-71";
BA_ "SPN" SG_ 3221225472 BatteryMainSwitchHoldState 1681;
BA_ "SigType" SG_ 3221225472 BatteryMainSwitchHoldState 4;
BA_ "SAEDocument" SG_ 3221225472 Joystick3XAxisDetentPosStatus "J1939-71";
BA_ "SPN" SG_ 3221225472 Joystick3XAxisDetentPosStatus 2754;
BA_ "SigType" SG_ 3221225472 Joystick3XAxisDetentPosStatus 4;
BA_ "SAEDocument" SG_ 3221225472 Joystick3Button9PressedStatus "J1939-71";
BA_ "SPN" SG_ 3221225472 Joystick3Button9PressedStatus 2767;
BA_ "SigType" SG_ 3221225472 Joystick3Button9PressedStatus 4;
BA_ "SAEDocument" SG_ 3221225472 Joystick3Button10PressedStatus "J1939-71";
BA_ "SPN" SG_ 3221225472 Joystick3Button10PressedStatus 2768;
BA_ "SigType" SG_ 3221225472 Joystick3Button10PressedStatus 4;
BA_ "SAEDocument" SG_ 3221225472 Joystick3Button11PressedStatus "J1939-71";
BA_ "SPN" SG_ 3221225472 Joystick3Button11PressedStatus 2769;
BA_ "SigType" SG_ 3221225472 Joystick3Button11PressedStatus 4;
BA_ "SAEDocument" SG_ 3221225472 Joystick3Button12PressedStatus "J1939-71";
BA_ "SPN" SG_ 3221225472 Joystick3Button12PressedStatus 2770;
BA_ "SigType" SG_ 3221225472 Joystick3Button12PressedStatus 4;
BA_ "SAEDocument" SG_ 3221225472 Joystick3YAxisDetentPosStatus "J1939-71";
BA_ "SPN" SG_ 3221225472 Joystick3YAxisDetentPosStatus 2755;
BA_ "SigType" SG_ 3221225472 Joystick3YAxisDetentPosStatus 4;
BA_ "SAEDocument" SG_ 3221225472 Joystick3YAxisPos "J1939-71";
BA_ "SPN" SG_ 3221225472 Joystick3YAxisPos 2735;
BA_ "SAEDocument" SG_ 3221225472 Jystck3YAxsLvrFrwrdPstvPosStatus "J1939-71";
BA_ "SPN" SG_ 3221225472 Jystck3YAxsLvrFrwrdPstvPosStatus 2740;
BA_ "SigType" SG_ 3221225472 Jystck3YAxsLvrFrwrdPstvPosStatus 4;
BA_ "SAEDocument" SG_ 3221225472 Jystck3YAxsLvrBckNgtivePosStatus "J1939-71";
BA_ "SPN" SG_ 3221225472 Jystck3YAxsLvrBckNgtivePosStatus 2745;
BA_ "SigType" SG_ 3221225472 Jystck3YAxsLvrBckNgtivePosStatus 4;
BA_ "SAEDocument" SG_ 3221225472 Joystick3YAxisNeutralPosStatus "J1939-71";
BA_ "SPN" SG_ 3221225472 Joystick3YAxisNeutralPosStatus 2750;
BA_ "SigType" SG_ 3221225472 Joystick3YAxisNeutralPosStatus 4;
BA_ "SAEDocument" SG_ 3221225472 Joystick3XAxisPos "J1939-71";
BA_ "SPN" SG_ 3221225472 Joystick3XAxisPos 2734;
BA_ "SAEDocument" SG_ 3221225472 Jystck3XAxsLvrRghtPstvePosStatus "J1939-71";
BA_ "SPN" SG_ 3221225472 Jystck3XAxsLvrRghtPstvePosStatus 2739;
BA_ "SigType" SG_ 3221225472 Jystck3XAxsLvrRghtPstvePosStatus 4;
BA_ "SAEDocument" SG_ 3221225472 Jystck3XAxsLvrLftNgtivePosStatus "J1939-71";
BA_ "SPN" SG_ 3221225472 Jystck3XAxsLvrLftNgtivePosStatus 2744;
BA_ "SigType" SG_ 3221225472 Jystck3XAxsLvrLftNgtivePosStatus 4;
BA_ "SAEDocument" SG_ 3221225472 Joystick3XAxisNeutralPosStatus "J1939-71";
BA_ "SPN" SG_ 3221225472 Joystick3XAxisNeutralPosStatus 2749;
BA_ "SigType" SG_ 3221225472 Joystick3XAxisNeutralPosStatus 4;
BA_ "SAEDocument" SG_ 3221225472 Joystick3Button5PressedStatus "J1939-71";
BA_ "SPN" SG_ 3221225472 Joystick3Button5PressedStatus 2763;
BA_ "SigType" SG_ 3221225472 Joystick3Button5PressedStatus 4;
BA_ "SAEDocument" SG_ 3221225472 Joystick3Button6PressedStatus "J1939-71";
BA_ "SPN" SG_ 3221225472 Joystick3Button6PressedStatus 2764;
BA_ "SigType" SG_ 3221225472 Joystick3Button6PressedStatus 4;
BA_ "SAEDocument" SG_ 3221225472 Joystick3Button7PressedStatus "J1939-71";
BA_ "SPN" SG_ 3221225472 Joystick3Button7PressedStatus 2765;
BA_ "SigType" SG_ 3221225472 Joystick3Button7PressedStatus 4;
BA_ "SAEDocument" SG_ 3221225472 Joystick3Button8PressedStatus "J1939-71";
BA_ "SPN" SG_ 3221225472 Joystick3Button8PressedStatus 2766;
BA_ "SigType" SG_ 3221225472 Joystick3Button8PressedStatus 4;
BA_ "SAEDocument" SG_ 3221225472 Joystick3Button1PressedStatus "J1939-71";
BA_ "SPN" SG_ 3221225472 Joystick3Button1PressedStatus 2759;
BA_ "SigType" SG_ 3221225472 Joystick3Button1PressedStatus 4;
BA_ "SAEDocument" SG_ 3221225472 Joystick3Button2PressedStatus "J1939-71";
BA_ "SPN" SG_ 3221225472 Joystick3Button2PressedStatus 2760;
BA_ "SigType" SG_ 3221225472 Joystick3Button2PressedStatus 4;
BA_ "SAEDocument" SG_ 3221225472 Joystick3Button3PressedStatus "J1939-71";
BA_ "SPN" SG_ 3221225472 Joystick3Button3PressedStatus 2761;
BA_ "SigType" SG_ 3221225472 Joystick3Button3PressedStatus 4;
BA_ "SAEDocument" SG_ 3221225472 Joystick3Button4PressedStatus "J1939-71";
BA_ "SPN" SG_ 3221225472 Joystick3Button4PressedStatus 2762;
BA_ "SigType" SG_ 3221225472 Joystick3Button4PressedStatus 4;
BA_ "SAEDocument" SG_ 3221225472 Joystick2XAxisDetentPosStatus "J1939-71";
BA_ "SPN" SG_ 3221225472 Joystick2XAxisDetentPosStatus 2717;
BA_ "SigType" SG_ 3221225472 Joystick2XAxisDetentPosStatus 4;
BA_ "SAEDocument" SG_ 3221225472 Joystick2YAxisDetentPosStatus "J1939-71";
BA_ "SPN" SG_ 3221225472 Joystick2YAxisDetentPosStatus 2718;
BA_ "SigType" SG_ 3221225472 Joystick2YAxisDetentPosStatus 4;
BA_ "SAEDocument" SG_ 3221225472 Joystick2YAxisPos "J1939-71";
BA_ "SPN" SG_ 3221225472 Joystick2YAxisPos 2698;
BA_ "SAEDocument" SG_ 3221225472 Jystck2YAxsLvrFrwrdPstvPosStatus "J1939-71";
BA_ "SPN" SG_ 3221225472 Jystck2YAxsLvrFrwrdPstvPosStatus 2703;
BA_ "SigType" SG_ 3221225472 Jystck2YAxsLvrFrwrdPstvPosStatus 4;
BA_ "SAEDocument" SG_ 3221225472 Jystck2YAxsLvrBckNgtivePosStatus "J1939-71";
BA_ "SPN" SG_ 3221225472 Jystck2YAxsLvrBckNgtivePosStatus 2708;
BA_ "SigType" SG_ 3221225472 Jystck2YAxsLvrBckNgtivePosStatus 4;
BA_ "SAEDocument" SG_ 3221225472 Joystick2YAxisNeutralPosStatus "J1939-71";
BA_ "SPN" SG_ 3221225472 Joystick2YAxisNeutralPosStatus 2713;
BA_ "SigType" SG_ 3221225472 Joystick2YAxisNeutralPosStatus 4;
BA_ "SAEDocument" SG_ 3221225472 Joystick2XAxisPos "J1939-71";
BA_ "SPN" SG_ 3221225472 Joystick2XAxisPos 2697;
BA_ "SAEDocument" SG_ 3221225472 Jystck2XAxsLvrRghtPstvePosStatus "J1939-71";
BA_ "SPN" SG_ 3221225472 Jystck2XAxsLvrRghtPstvePosStatus 2702;
BA_ "SigType" SG_ 3221225472 Jystck2XAxsLvrRghtPstvePosStatus 4;
BA_ "SAEDocument" SG_ 3221225472 Jystck2XAxsLvrLftNgtivePosStatus "J1939-71";
BA_ "SPN" SG_ 3221225472 Jystck2XAxsLvrLftNgtivePosStatus 2707;
BA_ "SigType" SG_ 3221225472 Jystck2XAxsLvrLftNgtivePosStatus 4;
BA_ "SAEDocument" SG_ 3221225472 Joystick2XAxisNeutralPosStatus "J1939-71";
BA_ "SPN" SG_ 3221225472 Joystick2XAxisNeutralPosStatus 2712;
BA_ "SigType" SG_ 3221225472 Joystick2XAxisNeutralPosStatus 4;
BA_ "SAEDocument" SG_ 3221225472 Joystick2Button9PressedStatus "J1939-71";
BA_ "SPN" SG_ 3221225472 Joystick2Button9PressedStatus 2730;
BA_ "SigType" SG_ 3221225472 Joystick2Button9PressedStatus 4;
BA_ "SAEDocument" SG_ 3221225472 Joystick2Button10PressedStatus "J1939-71";
BA_ "SPN" SG_ 3221225472 Joystick2Button10PressedStatus 2731;
BA_ "SigType" SG_ 3221225472 Joystick2Button10PressedStatus 4;
BA_ "SAEDocument" SG_ 3221225472 Joystick2Button11PressedStatus "J1939-71";
BA_ "SPN" SG_ 3221225472 Joystick2Button11PressedStatus 2732;
BA_ "SigType" SG_ 3221225472 Joystick2Button11PressedStatus 4;
BA_ "SAEDocument" SG_ 3221225472 Joystick2Button12PressedStatus "J1939-71";
BA_ "SPN" SG_ 3221225472 Joystick2Button12PressedStatus 2733;
BA_ "SigType" SG_ 3221225472 Joystick2Button12PressedStatus 4;
BA_ "SAEDocument" SG_ 3221225472 Joystick2Button5PressedStatus "J1939-71";
BA_ "SPN" SG_ 3221225472 Joystick2Button5PressedStatus 2726;
BA_ "SigType" SG_ 3221225472 Joystick2Button5PressedStatus 4;
BA_ "SAEDocument" SG_ 3221225472 Joystick2Button6PressedStatus "J1939-71";
BA_ "SPN" SG_ 3221225472 Joystick2Button6PressedStatus 2727;
BA_ "SigType" SG_ 3221225472 Joystick2Button6PressedStatus 4;
BA_ "SAEDocument" SG_ 3221225472 Joystick2Button7PressedStatus "J1939-71";
BA_ "SPN" SG_ 3221225472 Joystick2Button7PressedStatus 2728;
BA_ "SigType" SG_ 3221225472 Joystick2Button7PressedStatus 4;
BA_ "SAEDocument" SG_ 3221225472 Joystick2Button8PressedStatus "J1939-71";
BA_ "SPN" SG_ 3221225472 Joystick2Button8PressedStatus 2729;
BA_ "SigType" SG_ 3221225472 Joystick2Button8PressedStatus 4;
BA_ "SAEDocument" SG_ 3221225472 Joystick2Button1PressedStatus "J1939-71";
BA_ "SPN" SG_ 3221225472 Joystick2Button1PressedStatus 2722;
BA_ "SigType" SG_ 3221225472 Joystick2Button1PressedStatus 4;
BA_ "SAEDocument" SG_ 3221225472 Joystick2Button2PressedStatus "J1939-71";
BA_ "SPN" SG_ 3221225472 Joystick2Button2PressedStatus 2723;
BA_ "SigType" SG_ 3221225472 Joystick2Button2PressedStatus 4;
BA_ "SAEDocument" SG_ 3221225472 Joystick2Button3PressedStatus "J1939-71";
BA_ "SPN" SG_ 3221225472 Joystick2Button3PressedStatus 2724;
BA_ "SigType" SG_ 3221225472 Joystick2Button3PressedStatus 4;
BA_ "SAEDocument" SG_ 3221225472 Joystick2Button4PressedStatus "J1939-71";
BA_ "SPN" SG_ 3221225472 Joystick2Button4PressedStatus 2725;
BA_ "SigType" SG_ 3221225472 Joystick2Button4PressedStatus 4;
BA_ "SAEDocument" SG_ 3221225472 Joystick1XAxisDetentPosStatus "J1939-71";
BA_ "SPN" SG_ 3221225472 Joystick1XAxisDetentPosStatus 2680;
BA_ "SigType" SG_ 3221225472 Joystick1XAxisDetentPosStatus 4;
BA_ "SAEDocument" SG_ 3221225472 Joystick1YAxisDetentPosStatus "J1939-71";
BA_ "SPN" SG_ 3221225472 Joystick1YAxisDetentPosStatus 2681;
BA_ "SigType" SG_ 3221225472 Joystick1YAxisDetentPosStatus 4;
BA_ "SAEDocument" SG_ 3221225472 Joystick1YAxisPos "J1939-71";
BA_ "SPN" SG_ 3221225472 Joystick1YAxisPos 2661;
BA_ "SAEDocument" SG_ 3221225472 Jystck1YAxsLvrFrwrdPstvPosStatus "J1939-71";
BA_ "SPN" SG_ 3221225472 Jystck1YAxsLvrFrwrdPstvPosStatus 2666;
BA_ "SigType" SG_ 3221225472 Jystck1YAxsLvrFrwrdPstvPosStatus 4;
BA_ "SAEDocument" SG_ 3221225472 Jystck1YAxsLvrBckNgtivePosStatus "J1939-71";
BA_ "SPN" SG_ 3221225472 Jystck1YAxsLvrBckNgtivePosStatus 2671;
BA_ "SigType" SG_ 3221225472 Jystck1YAxsLvrBckNgtivePosStatus 4;
BA_ "SAEDocument" SG_ 3221225472 Joystick1YAxisNeutralPosStatus "J1939-71";
BA_ "SPN" SG_ 3221225472 Joystick1YAxisNeutralPosStatus 2676;
BA_ "SigType" SG_ 3221225472 Joystick1YAxisNeutralPosStatus 4;
BA_ "SAEDocument" SG_ 3221225472 Joystick1XAxisPos "J1939-71";
BA_ "SPN" SG_ 3221225472 Joystick1XAxisPos 2660;
BA_ "SAEDocument" SG_ 3221225472 Joystick1Button9PressedStatus "J1939-71";
BA_ "SPN" SG_ 3221225472 Joystick1Button9PressedStatus 2693;
BA_ "SigType" SG_ 3221225472 Joystick1Button9PressedStatus 4;
BA_ "SAEDocument" SG_ 3221225472 Joystick1Button10PressedStatus "J1939-71";
BA_ "SPN" SG_ 3221225472 Joystick1Button10PressedStatus 2694;
BA_ "SigType" SG_ 3221225472 Joystick1Button10PressedStatus 4;
BA_ "SAEDocument" SG_ 3221225472 Joystick1Button11PressedStatus "J1939-71";
BA_ "SPN" SG_ 3221225472 Joystick1Button11PressedStatus 2695;
BA_ "SigType" SG_ 3221225472 Joystick1Button11PressedStatus 4;
BA_ "SAEDocument" SG_ 3221225472 Joystick1Button12PressedStatus "J1939-71";
BA_ "SPN" SG_ 3221225472 Joystick1Button12PressedStatus 2696;
BA_ "SigType" SG_ 3221225472 Joystick1Button12PressedStatus 4;
BA_ "SAEDocument" SG_ 3221225472 Joystick1Button5PressedStatus "J1939-71";
BA_ "SPN" SG_ 3221225472 Joystick1Button5PressedStatus 2689;
BA_ "SigType" SG_ 3221225472 Joystick1Button5PressedStatus 4;
BA_ "SAEDocument" SG_ 3221225472 Joystick1Button6PressedStatus "J1939-71";
BA_ "SPN" SG_ 3221225472 Joystick1Button6PressedStatus 2690;
BA_ "SigType" SG_ 3221225472 Joystick1Button6PressedStatus 4;
BA_ "SAEDocument" SG_ 3221225472 Joystick1Button7PressedStatus "J1939-71";
BA_ "SPN" SG_ 3221225472 Joystick1Button7PressedStatus 2691;
BA_ "SigType" SG_ 3221225472 Joystick1Button7PressedStatus 4;
BA_ "SAEDocument" SG_ 3221225472 Joystick1Button8PressedStatus "J1939-71";
BA_ "SPN" SG_ 3221225472 Joystick1Button8PressedStatus 2692;
BA_ "SigType" SG_ 3221225472 Joystick1Button8PressedStatus 4;
BA_ "SAEDocument" SG_ 3221225472 Joystick1Button1PressedStatus "J1939-71";
BA_ "SPN" SG_ 3221225472 Joystick1Button1PressedStatus 2685;
BA_ "SigType" SG_ 3221225472 Joystick1Button1PressedStatus 4;
BA_ "SAEDocument" SG_ 3221225472 Joystick1Button2PressedStatus "J1939-71";
BA_ "SPN" SG_ 3221225472 Joystick1Button2PressedStatus 2686;
BA_ "SigType" SG_ 3221225472 Joystick1Button2PressedStatus 4;
BA_ "SAEDocument" SG_ 3221225472 Joystick1Button3PressedStatus "J1939-71";
BA_ "SPN" SG_ 3221225472 Joystick1Button3PressedStatus 2687;
BA_ "SigType" SG_ 3221225472 Joystick1Button3PressedStatus 4;
BA_ "SAEDocument" SG_ 3221225472 Joystick1Button4PressedStatus "J1939-71";
BA_ "SPN" SG_ 3221225472 Joystick1Button4PressedStatus 2688;
BA_ "SigType" SG_ 3221225472 Joystick1Button4PressedStatus 4;
BA_ "SAEDocument" SG_ 3221225472 Jystck1XAxsLvrRghtPstvePosStatus "J1939-71";
BA_ "SPN" SG_ 3221225472 Jystck1XAxsLvrRghtPstvePosStatus 2665;
BA_ "SigType" SG_ 3221225472 Jystck1XAxsLvrRghtPstvePosStatus 4;
BA_ "SAEDocument" SG_ 3221225472 Jystck1XAxsLvrLftNgtivePosStatus "J1939-71";
BA_ "SPN" SG_ 3221225472 Jystck1XAxsLvrLftNgtivePosStatus 2670;
BA_ "SigType" SG_ 3221225472 Jystck1XAxsLvrLftNgtivePosStatus 4;
BA_ "SAEDocument" SG_ 3221225472 Joystick1XAxisNeutralPosStatus "J1939-71";
BA_ "SPN" SG_ 3221225472 Joystick1XAxisNeutralPosStatus 2675;
BA_ "SigType" SG_ 3221225472 Joystick1XAxisNeutralPosStatus 4;
BA_ "SAEDocument" SG_ 3221225472 ParkingBrakeRedWarningSignal "J1939-71";
BA_ "SPN" SG_ 3221225472 ParkingBrakeRedWarningSignal 3557;
BA_ "SigType" SG_ 3221225472 ParkingBrakeRedWarningSignal 5;
BA_ "SAEDocument" SG_ 3221225472 ParkBrakeReleaseInhibitStatus "J1939-71";
BA_ "SPN" SG_ 3221225472 ParkBrakeReleaseInhibitStatus 3808;
BA_ "SigType" SG_ 3221225472 ParkBrakeReleaseInhibitStatus 4;
BA_ "SAEDocument" SG_ 3221225472 ParkingBrakeActuator "J1939-71";
BA_ "SPN" SG_ 3221225472 ParkingBrakeActuator 619;
BA_ "SigType" SG_ 3221225472 ParkingBrakeActuator 4;
BA_ "SAEDocument" SG_ 3221225472 BrakeSecondPress "J1939-71";
BA_ "SPN" SG_ 3221225472 BrakeSecondPress 118;
BA_ "SigType" SG_ 3221225472 BrakeSecondPress 1;
BA_ "SAEDocument" SG_ 3221225472 BrakePrimaryPress "J1939-71";
BA_ "SPN" SG_ 3221225472 BrakePrimaryPress 117;
BA_ "SigType" SG_ 3221225472 BrakePrimaryPress 1;
BA_ "SAEDocument" SG_ 3221225472 BrakeAppPress "J1939-71";
BA_ "SPN" SG_ 3221225472 BrakeAppPress 116;
BA_ "SigType" SG_ 3221225472 BrakeAppPress 1;
BA_ "SAEDocument" SG_ 3221225472 AuxPumpPress "J1939-71";
BA_ "SPN" SG_ 3221225472 AuxPumpPress 73;
BA_ "SigType" SG_ 3221225472 AuxPumpPress 1;
BA_ "SAEDocument" SG_ 3221225472 Aftrtrtmnt1DslOxdtnCtlystDffPrss "J1939-71";
BA_ "SPN" SG_ 3221225472 Aftrtrtmnt1DslOxdtnCtlystDffPrss 4767;
BA_ "SigType" SG_ 3221225472 Aftrtrtmnt1DslOxdtnCtlystDffPrss 1;
BA_ "SAEDocument" SG_ 3221225472 Aftrtrtmnt1DslOxdtnCtlystOtltGsT "J1939-71";
BA_ "SPN" SG_ 3221225472 Aftrtrtmnt1DslOxdtnCtlystOtltGsT 4766;
BA_ "SigType" SG_ 3221225472 Aftrtrtmnt1DslOxdtnCtlystOtltGsT 1;
BA_ "SAEDocument" SG_ 3221225472 Aftrtrtmnt1DslOxdtnCtlystIntkGsT "J1939-71";
BA_ "SPN" SG_ 3221225472 Aftrtrtmnt1DslOxdtnCtlystIntkGsT 4765;
BA_ "SigType" SG_ 3221225472 Aftrtrtmnt1DslOxdtnCtlystIntkGsT 1;
BA_ "SAEDocument" SG_ 3221225472 DTCWarnLampSupportStatus "J1939_73";
BA_ "SPN" SG_ 3221225472 DTCWarnLampSupportStatus 4115;
BA_ "SigType" SG_ 3221225472 DTCWarnLampSupportStatus 4;
BA_ "SAEDocument" SG_ 3221225472 DTCWarnLampSupportFlash "J1939_73";
BA_ "SPN" SG_ 3221225472 DTCWarnLampSupportFlash 4119;
BA_ "SigType" SG_ 3221225472 DTCWarnLampSupportFlash 4;
BA_ "SAEDocument" SG_ 3221225472 DTCStopLampSupportStatus "J1939_73";
BA_ "SPN" SG_ 3221225472 DTCStopLampSupportStatus 4114;
BA_ "SigType" SG_ 3221225472 DTCStopLampSupportStatus 4;
BA_ "SAEDocument" SG_ 3221225472 DTCStopLampSupportFlash "J1939_73";
BA_ "SPN" SG_ 3221225472 DTCStopLampSupportFlash 4118;
BA_ "SigType" SG_ 3221225472 DTCStopLampSupportFlash 4;
BA_ "SAEDocument" SG_ 3221225472 DTCProtectLampSupportStatus "J1939_73";
BA_ "SPN" SG_ 3221225472 DTCProtectLampSupportStatus 4116;
BA_ "SigType" SG_ 3221225472 DTCProtectLampSupportStatus 4;
BA_ "SAEDocument" SG_ 3221225472 DTCProtectLampSupportFlash "J1939_73";
BA_ "SPN" SG_ 3221225472 DTCProtectLampSupportFlash 4120;
BA_ "SigType" SG_ 3221225472 DTCProtectLampSupportFlash 4;
BA_ "SAEDocument" SG_ 3221225472 DTCMilSupportStatus "J1939_73";
BA_ "SPN" SG_ 3221225472 DTCMilSupportStatus 4113;
BA_ "SAEDocument" SG_ 3221225472 DTCMilSupportFlash "J1939_73";
BA_ "SPN" SG_ 3221225472 DTCMilSupportFlash 4117;
BA_ "SAEDocument" SG_ 3221225472 DTC1 "J1939-73";
BA_ "SigType" SG_ 3221225472 DTC1 7;
BA_ "SAEDocument" SG_ 3221225472 DataDictionaryMethod "J1939-71";
BA_ "SPN" SG_ 3221225472 DataDictionaryMethod 4181;
BA_ "SAEDocument" SG_ 3221225472 DataDictionaryManufacturerCode "J1939-71";
BA_ "SPN" SG_ 3221225472 DataDictionaryManufacturerCode 4180;
BA_ "SAEDocument" SG_ 3221225472 EngExhstGsOxygnSnsrClsdLpOprtnBn "J1939-71";
BA_ "SPN" SG_ 3221225472 EngExhstGsOxygnSnsrClsdLpOprtnBn 4240;
BA_ "SAEDocument" SG_ 3221225472 ShorttermFuelTrimBank2 "J1939-71";
BA_ "SPN" SG_ 3221225472 ShorttermFuelTrimBank2 4238;
BA_ "SAEDocument" SG_ 3221225472 LongtermFuelTrimBank2 "J1939-71";
BA_ "SPN" SG_ 3221225472 LongtermFuelTrimBank2 4239;
BA_ "SAEDocument" SG_ 3221225472 ShorttermFuelTrimBank1 "J1939-71";
BA_ "SPN" SG_ 3221225472 ShorttermFuelTrimBank1 4236;
BA_ "SAEDocument" SG_ 3221225472 LongtermFuelTrimBank1 "J1939-71";
BA_ "SPN" SG_ 3221225472 LongtermFuelTrimBank1 4237;
BA_ "SAEDocument" SG_ 3221225472 EngSpdSensor1TimingPatternStatus "J1939-71";
BA_ "SPN" SG_ 3221225472 EngSpdSensor1TimingPatternStatus 4203;
BA_ "SigType" SG_ 3221225472 EngSpdSensor1TimingPatternStatus 5;
BA_ "SAEDocument" SG_ 3221225472 EngSpdSensor2TimingPatternStatus "J1939-71";
BA_ "SPN" SG_ 3221225472 EngSpdSensor2TimingPatternStatus 4204;
BA_ "SigType" SG_ 3221225472 EngSpdSensor2TimingPatternStatus 5;
BA_ "SAEDocument" SG_ 3221225472 EngSpdSensor3TimingPatternStatus "J1939-71";
BA_ "SPN" SG_ 3221225472 EngSpdSensor3TimingPatternStatus 4205;
BA_ "SigType" SG_ 3221225472 EngSpdSensor3TimingPatternStatus 5;
BA_ "SAEDocument" SG_ 3221225472 EngSpeed3 "J1939-71";
BA_ "SPN" SG_ 3221225472 EngSpeed3 4202;
BA_ "SigType" SG_ 3221225472 EngSpeed3 1;
BA_ "SAEDocument" SG_ 3221225472 EngSpeed2 "J1939-71";
BA_ "SPN" SG_ 3221225472 EngSpeed2 723;
BA_ "SigType" SG_ 3221225472 EngSpeed2 1;
BA_ "SAEDocument" SG_ 3221225472 EngSpeed1 "J1939-71";
BA_ "SPN" SG_ 3221225472 EngSpeed1 4201;
BA_ "SigType" SG_ 3221225472 EngSpeed1 1;
BA_ "SAEDocument" SG_ 3221225472 DsredEngCoolantThermostatOpening "J1939-71";
BA_ "SPN" SG_ 3221225472 DsredEngCoolantThermostatOpening 4197;
BA_ "SAEDocument" SG_ 3221225472 DesiredEngCoolantPumpOutletTemp "J1939-71";
BA_ "SPN" SG_ 3221225472 DesiredEngCoolantPumpOutletTemp 4196;
BA_ "SigType" SG_ 3221225472 DesiredEngCoolantPumpOutletTemp 1;
BA_ "SAEDocument" SG_ 3221225472 EngCoolantThermostatMode "J1939-71";
BA_ "SPN" SG_ 3221225472 EngCoolantThermostatMode 4195;
BA_ "SigType" SG_ 3221225472 EngCoolantThermostatMode 5;
BA_ "SAEDocument" SG_ 3221225472 AuxI_OChannel19 "J1939-71";
BA_ "SPN" SG_ 3221225472 AuxI_OChannel19 4174;
BA_ "SAEDocument" SG_ 3221225472 AuxI_OChannel20 "J1939-71";
BA_ "SPN" SG_ 3221225472 AuxI_OChannel20 4173;
BA_ "SAEDocument" SG_ 3221225472 AuxI_OChannel21 "J1939-71";
BA_ "SPN" SG_ 3221225472 AuxI_OChannel21 4172;
BA_ "SAEDocument" SG_ 3221225472 AuxI_OChannel22 "J1939-71";
BA_ "SPN" SG_ 3221225472 AuxI_OChannel22 4171;
BA_ "SAEDocument" SG_ 3221225472 AuxI_OChannel15 "J1939-71";
BA_ "SPN" SG_ 3221225472 AuxI_OChannel15 4170;
BA_ "SAEDocument" SG_ 3221225472 AuxI_OChannel16 "J1939-71";
BA_ "SPN" SG_ 3221225472 AuxI_OChannel16 4169;
BA_ "SAEDocument" SG_ 3221225472 AuxI_OChannel17 "J1939-71";
BA_ "SPN" SG_ 3221225472 AuxI_OChannel17 4168;
BA_ "SAEDocument" SG_ 3221225472 AuxI_OChannel18 "J1939-71";
BA_ "SPN" SG_ 3221225472 AuxI_OChannel18 4167;
BA_ "SAEDocument" SG_ 3221225472 AuxI_OChannel11 "J1939-71";
BA_ "SPN" SG_ 3221225472 AuxI_OChannel11 4166;
BA_ "SAEDocument" SG_ 3221225472 AuxI_OChannel12 "J1939-71";
BA_ "SPN" SG_ 3221225472 AuxI_OChannel12 4165;
BA_ "SAEDocument" SG_ 3221225472 AuxI_OChannel13 "J1939-71";
BA_ "SPN" SG_ 3221225472 AuxI_OChannel13 4164;
BA_ "SAEDocument" SG_ 3221225472 AuxI_OChannel14 "J1939-71";
BA_ "SPN" SG_ 3221225472 AuxI_OChannel14 4163;
BA_ "SAEDocument" SG_ 3221225472 AuxI_OChannel7 "J1939-71";
BA_ "SPN" SG_ 3221225472 AuxI_OChannel7 4162;
BA_ "SAEDocument" SG_ 3221225472 AuxI_OChannel8 "J1939-71";
BA_ "SPN" SG_ 3221225472 AuxI_OChannel8 4161;
BA_ "SAEDocument" SG_ 3221225472 AuxI_OChannel9 "J1939-71";
BA_ "SPN" SG_ 3221225472 AuxI_OChannel9 4160;
BA_ "SAEDocument" SG_ 3221225472 AuxI_OChannel10 "J1939-71";
BA_ "SPN" SG_ 3221225472 AuxI_OChannel10 4159;
BA_ "SAEDocument" SG_ 3221225472 AuxI_OChannel3 "J1939-71";
BA_ "SPN" SG_ 3221225472 AuxI_OChannel3 4158;
BA_ "SAEDocument" SG_ 3221225472 AuxI_OChannel4 "J1939-71";
BA_ "SPN" SG_ 3221225472 AuxI_OChannel4 4157;
BA_ "SAEDocument" SG_ 3221225472 AuxI_OChannel5 "J1939-71";
BA_ "SPN" SG_ 3221225472 AuxI_OChannel5 4156;
BA_ "SAEDocument" SG_ 3221225472 AuxI_OChannel6 "J1939-71";
BA_ "SPN" SG_ 3221225472 AuxI_OChannel6 4155;
BA_ "SAEDocument" SG_ 3221225472 Aftertreatment1AirEnableActuator "J1939-71";
BA_ "SPN" SG_ 3221225472 Aftertreatment1AirEnableActuator 3489;
BA_ "SigType" SG_ 3221225472 Aftertreatment1AirEnableActuator 5;
BA_ "SAEDocument" SG_ 3221225472 Aftertreatment1PurgeAirActuator "J1939-71";
BA_ "SPN" SG_ 3221225472 Aftertreatment1PurgeAirActuator 3490;
BA_ "SigType" SG_ 3221225472 Aftertreatment1PurgeAirActuator 5;
BA_ "SAEDocument" SG_ 3221225472 Aftrtrtmnt1AtmizationAirActuator "J1939-71";
BA_ "SPN" SG_ 3221225472 Aftrtrtmnt1AtmizationAirActuator 3491;
BA_ "SigType" SG_ 3221225472 Aftrtrtmnt1AtmizationAirActuator 5;
BA_ "SAEDocument" SG_ 3221225472 Aftertreatment1AirSystemRelay "J1939-71";
BA_ "SPN" SG_ 3221225472 Aftertreatment1AirSystemRelay 3492;
BA_ "SigType" SG_ 3221225472 Aftertreatment1AirSystemRelay 5;
BA_ "SAEDocument" SG_ 3221225472 Aftrtratment1AirPressActuatorPos "J1939-71";
BA_ "SPN" SG_ 3221225472 Aftrtratment1AirPressActuatorPos 3488;
BA_ "SigType" SG_ 3221225472 Aftrtratment1AirPressActuatorPos 1;
BA_ "SAEDocument" SG_ 3221225472 Aftertreatment1AirPressCtrl "J1939-71";
BA_ "SPN" SG_ 3221225472 Aftertreatment1AirPressCtrl 3487;
BA_ "SigType" SG_ 3221225472 Aftertreatment1AirPressCtrl 1;
BA_ "SAEDocument" SG_ 3221225472 Aftertreatment1PurgeAirPress "J1939-71";
BA_ "SPN" SG_ 3221225472 Aftertreatment1PurgeAirPress 3486;
BA_ "SigType" SG_ 3221225472 Aftertreatment1PurgeAirPress 1;
BA_ "SAEDocument" SG_ 3221225472 Aftertreatment1SupplyAirPress "J1939-71";
BA_ "SPN" SG_ 3221225472 Aftertreatment1SupplyAirPress 3485;
BA_ "SigType" SG_ 3221225472 Aftertreatment1SupplyAirPress 1;
BA_ "SAEDocument" SG_ 3221225472 Aftertreatment1SecondAirPress "J1939-71";
BA_ "SPN" SG_ 3221225472 Aftertreatment1SecondAirPress 3837;
BA_ "SigType" SG_ 3221225472 Aftertreatment1SecondAirPress 1;
BA_ "SAEDocument" SG_ 3221225472 Aftertreatment1SecondAirMassFlow "J1939-71";
BA_ "SPN" SG_ 3221225472 Aftertreatment1SecondAirMassFlow 3832;
BA_ "SigType" SG_ 3221225472 Aftertreatment1SecondAirMassFlow 1;
BA_ "SAEDocument" SG_ 3221225472 Aftertreatment1SecondAirTemp "J1939-71";
BA_ "SPN" SG_ 3221225472 Aftertreatment1SecondAirTemp 3831;
BA_ "SigType" SG_ 3221225472 Aftertreatment1SecondAirTemp 1;
BA_ "SAEDocument" SG_ 3221225472 Aftrtreatment1SecondAirDiffPress "J1939-71";
BA_ "SPN" SG_ 3221225472 Aftrtreatment1SecondAirDiffPress 3830;
BA_ "SigType" SG_ 3221225472 Aftrtreatment1SecondAirDiffPress 1;
BA_ "SAEDocument" SG_ 3221225472 Aftrtrtmnt1FlInjector1HeaterCtrl "J1939-71";
BA_ "SPN" SG_ 3221225472 Aftrtrtmnt1FlInjector1HeaterCtrl 4301;
BA_ "SAEDocument" SG_ 3221225472 Aftrtreatment1FuelEnableActuator "J1939-71";
BA_ "SPN" SG_ 3221225472 Aftrtreatment1FuelEnableActuator 3482;
BA_ "SigType" SG_ 3221225472 Aftrtreatment1FuelEnableActuator 5;
BA_ "SAEDocument" SG_ 3221225472 Aftrtreatment1RegenerationStatus "J1939-71";
BA_ "SPN" SG_ 3221225472 Aftrtreatment1RegenerationStatus 3483;
BA_ "SigType" SG_ 3221225472 Aftrtreatment1RegenerationStatus 5;
BA_ "SAEDocument" SG_ 3221225472 Aftertreatment1Ignt "J1939-71";
BA_ "SPN" SG_ 3221225472 Aftertreatment1Ignt 3484;
BA_ "SigType" SG_ 3221225472 Aftertreatment1Ignt 5;
BA_ "SAEDocument" SG_ 3221225472 Aftertreatment1FuelDrainActuator "J1939-71";
BA_ "SPN" SG_ 3221225472 Aftertreatment1FuelDrainActuator 4097;
BA_ "SigType" SG_ 3221225472 Aftertreatment1FuelDrainActuator 5;
BA_ "SAEDocument" SG_ 3221225472 Aftertreatment1FuelPress1Ctrl "J1939-71";
BA_ "SPN" SG_ 3221225472 Aftertreatment1FuelPress1Ctrl 3479;
BA_ "SAEDocument" SG_ 3221225472 Aftertreatment1FuelRate "J1939-71";
BA_ "SPN" SG_ 3221225472 Aftertreatment1FuelRate 3481;
BA_ "SigType" SG_ 3221225472 Aftertreatment1FuelRate 1;
BA_ "SAEDocument" SG_ 3221225472 Aftertreatment1FuelPress1 "J1939-71";
BA_ "SPN" SG_ 3221225472 Aftertreatment1FuelPress1 3480;
BA_ "SigType" SG_ 3221225472 Aftertreatment1FuelPress1 1;
BA_ "SAEDocument" SG_ 3221225472 Aftrtrtmnt1HydrcrbnDsrIntkFlTemp "J1939-71";
BA_ "SPN" SG_ 3221225472 Aftrtrtmnt1HydrcrbnDsrIntkFlTemp 5456;
BA_ "SigType" SG_ 3221225472 Aftrtrtmnt1HydrcrbnDsrIntkFlTemp 1;
BA_ "SAEDocument" SG_ 3221225472 Aftrtrtmnt1FelPress2ActuatorCtrl "J1939-71";
BA_ "SPN" SG_ 3221225472 Aftrtrtmnt1FelPress2ActuatorCtrl 5425;
BA_ "SAEDocument" SG_ 3221225472 Aftrtrtmnt1FlFlwDverterValveCtrl "J1939-71";
BA_ "SPN" SG_ 3221225472 Aftrtrtmnt1FlFlwDverterValveCtrl 5424;
BA_ "SigType" SG_ 3221225472 Aftrtrtmnt1FlFlwDverterValveCtrl 5;
BA_ "SAEDocument" SG_ 3221225472 Aftertreatment1FuelPumpRelayCtrl "J1939-71";
BA_ "SPN" SG_ 3221225472 Aftertreatment1FuelPumpRelayCtrl 5423;
BA_ "SigType" SG_ 3221225472 Aftertreatment1FuelPumpRelayCtrl 5;
BA_ "SAEDocument" SG_ 3221225472 Aftertreatment1FuelPress2 "J1939-71";
BA_ "SPN" SG_ 3221225472 Aftertreatment1FuelPress2 4077;
BA_ "SigType" SG_ 3221225472 Aftertreatment1FuelPress2 1;
BA_ "SAEDocument" SG_ 3221225472 DslParticulateFilterOutletPress1 "J1939-71";
BA_ "SPN" SG_ 3221225472 DslParticulateFilterOutletPress1 3610;
BA_ "SigType" SG_ 3221225472 DslParticulateFilterOutletPress1 1;
BA_ "SAEDocument" SG_ 3221225472 DslParticulateFilterIntakePress1 "J1939-71";
BA_ "SPN" SG_ 3221225472 DslParticulateFilterIntakePress1 3609;
BA_ "SigType" SG_ 3221225472 DslParticulateFilterIntakePress1 1;
BA_ "SAEDocument" SG_ 3221225472 Aftrtrtmnt1AvrgTmBtwnActvRgnrtns "J1939-71";
BA_ "SPN" SG_ 3221225472 Aftrtrtmnt1AvrgTmBtwnActvRgnrtns 5454;
BA_ "SAEDocument" SG_ 3221225472 Aftrtrtmnt1TtlNmbrOfActvRgnrtnMn "J1939-71";
BA_ "SPN" SG_ 3221225472 Aftrtrtmnt1TtlNmbrOfActvRgnrtnMn 3728;
BA_ "SigType" SG_ 3221225472 Aftrtrtmnt1TtlNmbrOfActvRgnrtnMn 1;
BA_ "SAEDocument" SG_ 3221225472 Aftrtrtmnt1TtlNmbrOfActvRgnrtnIn "J1939-71";
BA_ "SPN" SG_ 3221225472 Aftrtrtmnt1TtlNmbrOfActvRgnrtnIn 3727;
BA_ "SigType" SG_ 3221225472 Aftrtrtmnt1TtlNmbrOfActvRgnrtnIn 1;
BA_ "SAEDocument" SG_ 3221225472 Aftrtrtmnt1TtlNmbrOfPssvRgnrtons "J1939-71";
BA_ "SPN" SG_ 3221225472 Aftrtrtmnt1TtlNmbrOfPssvRgnrtons 3726;
BA_ "SigType" SG_ 3221225472 Aftrtrtmnt1TtlNmbrOfPssvRgnrtons 1;
BA_ "SAEDocument" SG_ 3221225472 Aftrtrtmnt1TtlPssvRgnerationTime "J1939-71";
BA_ "SPN" SG_ 3221225472 Aftrtrtmnt1TtlPssvRgnerationTime 3725;
BA_ "SigType" SG_ 3221225472 Aftrtrtmnt1TtlPssvRgnerationTime 1;
BA_ "SAEDocument" SG_ 3221225472 Aftrtrtmnt1TtlNmbrOfActvRgnrtons "J1939-71";
BA_ "SPN" SG_ 3221225472 Aftrtrtmnt1TtlNmbrOfActvRgnrtons 3525;
BA_ "SAEDocument" SG_ 3221225472 Aftertreatment1TotalDisabledTime "J1939-71";
BA_ "SPN" SG_ 3221225472 Aftertreatment1TotalDisabledTime 3524;
BA_ "SigType" SG_ 3221225472 Aftertreatment1TotalDisabledTime 1;
BA_ "SAEDocument" SG_ 3221225472 Aftrtrtmnt1TotalRegenerationTime "J1939-71";
BA_ "SPN" SG_ 3221225472 Aftrtrtmnt1TotalRegenerationTime 3523;
BA_ "SigType" SG_ 3221225472 Aftrtrtmnt1TotalRegenerationTime 1;
BA_ "SAEDocument" SG_ 3221225472 Aftertreatment1TotalFuelUsed "J1939-71";
BA_ "SPN" SG_ 3221225472 Aftertreatment1TotalFuelUsed 3522;
BA_ "SigType" SG_ 3221225472 Aftertreatment1TotalFuelUsed 1;
BA_ "SAEDocument" SG_ 3221225472 Aftrtrtmnt1IntkOxygnSnsrPrlmnryF "J1939-71";
BA_ "SPN" SG_ 3221225472 Aftrtrtmnt1IntkOxygnSnsrPrlmnryF 3225;
BA_ "SAEDocument" SG_ 3221225472 Aftrtrtmnt1IntkNOxSnsrPrlmnryFMI "J1939-71";
BA_ "SPN" SG_ 3221225472 Aftrtrtmnt1IntkNOxSnsrPrlmnryFMI 3224;
BA_ "SAEDocument" SG_ 3221225472 Aftrtrtmnt1IntkGsSnsorHeaterCtrl "J1939-71";
BA_ "SPN" SG_ 3221225472 Aftrtrtmnt1IntkGsSnsorHeaterCtrl 3223;
BA_ "SigType" SG_ 3221225472 Aftrtrtmnt1IntkGsSnsorHeaterCtrl 5;
BA_ "SAEDocument" SG_ 3221225472 Aftrtrtmnt1IntkGsSnsrHtrPrlmnryF "J1939-71";
BA_ "SPN" SG_ 3221225472 Aftrtrtmnt1IntkGsSnsrHtrPrlmnryF 3222;
BA_ "SAEDocument" SG_ 3221225472 Aftrtrtmnt1IntkWdRngO2RdngStable "J1939-71";
BA_ "SPN" SG_ 3221225472 Aftrtrtmnt1IntkWdRngO2RdngStable 3221;
BA_ "SigType" SG_ 3221225472 Aftrtrtmnt1IntkWdRngO2RdngStable 5;
BA_ "SAEDocument" SG_ 3221225472 Aftrtrtmnt1IntkeNOxReadingStable "J1939-71";
BA_ "SPN" SG_ 3221225472 Aftrtrtmnt1IntkeNOxReadingStable 3220;
BA_ "SigType" SG_ 3221225472 Aftrtrtmnt1IntkeNOxReadingStable 5;
BA_ "SAEDocument" SG_ 3221225472 Aftrtrtmnt1IntakeGasSensorAtTemp "J1939-71";
BA_ "SPN" SG_ 3221225472 Aftrtrtmnt1IntakeGasSensorAtTemp 3219;
BA_ "SigType" SG_ 3221225472 Aftrtrtmnt1IntakeGasSensorAtTemp 5;
BA_ "SAEDocument" SG_ 3221225472 Aftrtrtmnt1IntkGsSnsrPowerStatus "J1939-71";
BA_ "SPN" SG_ 3221225472 Aftrtrtmnt1IntkGsSnsrPowerStatus 3218;
BA_ "SigType" SG_ 3221225472 Aftrtrtmnt1IntkGsSnsrPowerStatus 5;
BA_ "SAEDocument" SG_ 3221225472 Aftertreatment1IntakeO2 "J1939-71";
BA_ "SPN" SG_ 3221225472 Aftertreatment1IntakeO2 3217;
BA_ "SigType" SG_ 3221225472 Aftertreatment1IntakeO2 1;
BA_ "SAEDocument" SG_ 3221225472 Aftertreatment1IntakeNOx "J1939-71";
BA_ "SPN" SG_ 3221225472 Aftertreatment1IntakeNOx 3216;
BA_ "SigType" SG_ 3221225472 Aftertreatment1IntakeNOx 1;
BA_ "SAEDocument" SG_ 3221225472 Aftrtrtmnt1DslPrtcltFltrIntkGsTm "J1939-71";
BA_ "SPN" SG_ 3221225472 Aftrtrtmnt1DslPrtcltFltrIntkGsTm 3242;
BA_ "SigType" SG_ 3221225472 Aftrtrtmnt1DslPrtcltFltrIntkGsTm 1;
BA_ "SAEDocument" SG_ 3221225472 Aftrtrtmnt1ExhstGsTmp1PrlmnryFMI "J1939-71";
BA_ "SPN" SG_ 3221225472 Aftrtrtmnt1ExhstGsTmp1PrlmnryFMI 3243;
BA_ "SAEDocument" SG_ 3221225472 Aftertreatment1ExhaustGasTemp1 "J1939-71";
BA_ "SPN" SG_ 3221225472 Aftertreatment1ExhaustGasTemp1 3241;
BA_ "SigType" SG_ 3221225472 Aftertreatment1ExhaustGasTemp1 1;
BA_ "SAEDocument" SG_ 3221225472 AntitheftRandomNumber "J1939-71";
BA_ "SPN" SG_ 3221225472 AntitheftRandomNumber 1198;
BA_ "SAEDocument" SG_ 3221225472 AntitheftComponentStatusStates "J1939-71";
BA_ "SPN" SG_ 3221225472 AntitheftComponentStatusStates 1196;
BA_ "SigType" SG_ 3221225472 AntitheftComponentStatusStates 5;
BA_ "SAEDocument" SG_ 3221225472 AntthftEncryptnSdPrsentIndicator "J1939-71";
BA_ "SPN" SG_ 3221225472 AntthftEncryptnSdPrsentIndicator 1194;
BA_ "SigType" SG_ 3221225472 AntthftEncryptnSdPrsentIndicator 5;
BA_ "SAEDocument" SG_ 3221225472 AntitheftModifyPwdStates "J1939-71";
BA_ "SPN" SG_ 3221225472 AntitheftModifyPwdStates 1197;
BA_ "SigType" SG_ 3221225472 AntitheftModifyPwdStates 5;
BA_ "SAEDocument" SG_ 3221225472 AntitheftPwdValidIndicator "J1939-71";
BA_ "SPN" SG_ 3221225472 AntitheftPwdValidIndicator 1195;
BA_ "SigType" SG_ 3221225472 AntitheftPwdValidIndicator 5;
BA_ "SAEDocument" SG_ 3221225472 AntitheftPwdRepresentation "J1939-71";
BA_ "SPN" SG_ 3221225472 AntitheftPwdRepresentation 1202;
BA_ "SAEDocument" SG_ 3221225472 AntitheftCmdStates "J1939-71";
BA_ "SPN" SG_ 3221225472 AntitheftCmdStates 1201;
BA_ "SAEDocument" SG_ 3221225472 AntitheftDesiredExitModeStates "J1939-71";
BA_ "SPN" SG_ 3221225472 AntitheftDesiredExitModeStates 1200;
BA_ "SigType" SG_ 3221225472 AntitheftDesiredExitModeStates 5;
BA_ "SAEDocument" SG_ 3221225472 AntthftEncryptionIndicatorStates "J1939-71";
BA_ "SPN" SG_ 3221225472 AntthftEncryptionIndicatorStates 1199;
BA_ "SigType" SG_ 3221225472 AntthftEncryptionIndicatorStates 5;
BA_ "SAEDocument" SG_ 3221225472 EngAltWinding3Temp "J1939-71";
BA_ "SPN" SG_ 3221225472 EngAltWinding3Temp 1126;
BA_ "SigType" SG_ 3221225472 EngAltWinding3Temp 1;
BA_ "SAEDocument" SG_ 3221225472 EngAltWinding2Temp "J1939-71";
BA_ "SPN" SG_ 3221225472 EngAltWinding2Temp 1125;
BA_ "SigType" SG_ 3221225472 EngAltWinding2Temp 1;
BA_ "SAEDocument" SG_ 3221225472 EngAltWinding1Temp "J1939-71";
BA_ "SPN" SG_ 3221225472 EngAltWinding1Temp 1124;
BA_ "SigType" SG_ 3221225472 EngAltWinding1Temp 1;
BA_ "SAEDocument" SG_ 3221225472 EngAltBearing2Temp "J1939-71";
BA_ "SPN" SG_ 3221225472 EngAltBearing2Temp 1123;
BA_ "SigType" SG_ 3221225472 EngAltBearing2Temp 1;
BA_ "SAEDocument" SG_ 3221225472 EngAltBearing1Temp "J1939-71";
BA_ "SPN" SG_ 3221225472 EngAltBearing1Temp 1122;
BA_ "SigType" SG_ 3221225472 EngAltBearing1Temp 1;
BA_ "SAEDocument" SG_ 3221225472 LevelPresetRearAxleRight "J1939-71";
BA_ "SPN" SG_ 3221225472 LevelPresetRearAxleRight 1735;
BA_ "SAEDocument" SG_ 3221225472 LevelPresetRearAxleLeft "J1939-71";
BA_ "SPN" SG_ 3221225472 LevelPresetRearAxleLeft 1758;
BA_ "SAEDocument" SG_ 3221225472 LevelPresetFrontAxleRight "J1939-71";
BA_ "SPN" SG_ 3221225472 LevelPresetFrontAxleRight 1757;
BA_ "SAEDocument" SG_ 3221225472 LevelPresetFrontAxleLeft "J1939-71";
BA_ "SPN" SG_ 3221225472 LevelPresetFrontAxleLeft 1732;
BA_ "SAEDocument" SG_ 3221225472 ElctrncShckAbsrbrCtrlMdLft_TgAxl "J1939-71";
BA_ "SPN" SG_ 3221225472 ElctrncShckAbsrbrCtrlMdLft_TgAxl 1831;
BA_ "SigType" SG_ 3221225472 ElctrncShckAbsrbrCtrlMdLft_TgAxl 4;
BA_ "SAEDocument" SG_ 3221225472 ElctrncShckAbsrbrCtrlMdeRearAxle "J1939-71";
BA_ "SPN" SG_ 3221225472 ElctrncShckAbsrbrCtrlMdeRearAxle 1832;
BA_ "SigType" SG_ 3221225472 ElctrncShckAbsrbrCtrlMdeRearAxle 4;
BA_ "SAEDocument" SG_ 3221225472 ElctrncShckAbsrbrCtrlMdFrontAxle "J1939-71";
BA_ "SPN" SG_ 3221225472 ElctrncShckAbsrbrCtrlMdFrontAxle 1833;
BA_ "SigType" SG_ 3221225472 ElctrncShckAbsrbrCtrlMdFrontAxle 4;
BA_ "SAEDocument" SG_ 3221225472 DamperStiffnessLift_TagAxle "J1939-71";
BA_ "SPN" SG_ 3221225472 DamperStiffnessLift_TagAxle 1731;
BA_ "SAEDocument" SG_ 3221225472 DamperStiffnessRearAxle "J1939-71";
BA_ "SPN" SG_ 3221225472 DamperStiffnessRearAxle 1730;
BA_ "SAEDocument" SG_ 3221225472 DamperStiffnessFrontAxle "J1939-71";
BA_ "SPN" SG_ 3221225472 DamperStiffnessFrontAxle 1729;
BA_ "SAEDocument" SG_ 3221225472 TestLimitMinimum "J1939-73";
BA_ "SPN" SG_ 3221225472 TestLimitMinimum 1228;
BA_ "SigType" SG_ 3221225472 TestLimitMinimum 1;
BA_ "SAEDocument" SG_ 3221225472 TestLimitMaximum "J1939-73";
BA_ "SPN" SG_ 3221225472 TestLimitMaximum 1227;
BA_ "SigType" SG_ 3221225472 TestLimitMaximum 1;
BA_ "SAEDocument" SG_ 3221225472 TestValue "J1939-73";
BA_ "SPN" SG_ 3221225472 TestValue 1226;
BA_ "SigType" SG_ 3221225472 TestValue 1;
BA_ "SAEDocument" SG_ 3221225472 SlotId "J1939_73";
BA_ "SPN" SG_ 3221225472 SlotId 4109;
BA_ "SigType" SG_ 3221225472 SlotId 1;
BA_ "SPN" SG_ 3221225472 TestIdentifier 1224;
BA_ "GenSigStartValue" SG_ 3221225472 TestIdentifier 1;
BA_ "SigType" SG_ 3221225472 TestIdentifier 1;
BA_ "SAEDocument" SG_ 3221225472 TestIdentifier "J1939-73";
BA_ "SAEDocument" SG_ 3221225472 Aftrtrtmnt1DslPrtcltFltrIntrmdtG "J1939-71";
BA_ "SPN" SG_ 3221225472 Aftrtrtmnt1DslPrtcltFltrIntrmdtG 3250;
BA_ "SigType" SG_ 3221225472 Aftrtrtmnt1DslPrtcltFltrIntrmdtG 1;
BA_ "SAEDocument" SG_ 3221225472 Aftrtrtmnt1DslPrtcltFltrDltPrssP "J1939-71";
BA_ "SPN" SG_ 3221225472 Aftrtrtmnt1DslPrtcltFltrDltPrssP 3253;
BA_ "SAEDocument" SG_ 3221225472 Aftrtrtmnt1DslPrtcltFltrDffPress "J1939-71";
BA_ "SPN" SG_ 3221225472 Aftrtrtmnt1DslPrtcltFltrDffPress 3251;
BA_ "SigType" SG_ 3221225472 Aftrtrtmnt1DslPrtcltFltrDffPress 1;
BA_ "SAEDocument" SG_ 3221225472 Aftrtrtmnt1ExhstGsTmp2PrlmnryFMI "J1939-71";
BA_ "SPN" SG_ 3221225472 Aftrtrtmnt1ExhstGsTmp2PrlmnryFMI 3252;
BA_ "SAEDocument" SG_ 3221225472 Aftertreatment1ExhaustGasTemp2 "J1939-71";
BA_ "SPN" SG_ 3221225472 Aftertreatment1ExhaustGasTemp2 3249;
BA_ "SigType" SG_ 3221225472 Aftertreatment1ExhaustGasTemp2 1;
BA_ "SAEDocument" SG_ 3221225472 Aftrtrtmnt1OtltOxygnSnsrPrlmnryF "J1939-71";
BA_ "SPN" SG_ 3221225472 Aftrtrtmnt1OtltOxygnSnsrPrlmnryF 3235;
BA_ "SAEDocument" SG_ 3221225472 Aftrtrtmnt1OtltNOxSnsrPrlmnryFMI "J1939-71";
BA_ "SPN" SG_ 3221225472 Aftrtrtmnt1OtltNOxSnsrPrlmnryFMI 3234;
BA_ "SAEDocument" SG_ 3221225472 Aftrtrtmnt1OtltGsSnsorHeaterCtrl "J1939-71";
BA_ "SPN" SG_ 3221225472 Aftrtrtmnt1OtltGsSnsorHeaterCtrl 3233;
BA_ "SigType" SG_ 3221225472 Aftrtrtmnt1OtltGsSnsorHeaterCtrl 5;
BA_ "SAEDocument" SG_ 3221225472 Aftrtrtmnt1OtltGsSnsrHtrPrlmnryF "J1939-71";
BA_ "SPN" SG_ 3221225472 Aftrtrtmnt1OtltGsSnsrHtrPrlmnryF 3232;
BA_ "SAEDocument" SG_ 3221225472 Aftrtrtmnt1OtltWdRngO2RdngStable "J1939-71";
BA_ "SPN" SG_ 3221225472 Aftrtrtmnt1OtltWdRngO2RdngStable 3231;
BA_ "SigType" SG_ 3221225472 Aftrtrtmnt1OtltWdRngO2RdngStable 5;
BA_ "SAEDocument" SG_ 3221225472 Aftrtrtmnt1OtletNOxReadingStable "J1939-71";
BA_ "SPN" SG_ 3221225472 Aftrtrtmnt1OtletNOxReadingStable 3230;
BA_ "SigType" SG_ 3221225472 Aftrtrtmnt1OtletNOxReadingStable 5;
BA_ "SAEDocument" SG_ 3221225472 Aftrtrtmnt1OutletGasSensorAtTemp "J1939-71";
BA_ "SPN" SG_ 3221225472 Aftrtrtmnt1OutletGasSensorAtTemp 3229;
BA_ "SigType" SG_ 3221225472 Aftrtrtmnt1OutletGasSensorAtTemp 5;
BA_ "SAEDocument" SG_ 3221225472 Aftrtrtmnt1OtltGsSnsrPowerStatus "J1939-71";
BA_ "SPN" SG_ 3221225472 Aftrtrtmnt1OtltGsSnsrPowerStatus 3228;
BA_ "SigType" SG_ 3221225472 Aftrtrtmnt1OtltGsSnsrPowerStatus 5;
BA_ "SAEDocument" SG_ 3221225472 Aftertreatment1OutletO2 "J1939-71";
BA_ "SPN" SG_ 3221225472 Aftertreatment1OutletO2 3227;
BA_ "SigType" SG_ 3221225472 Aftertreatment1OutletO2 1;
BA_ "SAEDocument" SG_ 3221225472 Aftertreatment1OutletNOx "J1939-71";
BA_ "SPN" SG_ 3221225472 Aftertreatment1OutletNOx 3226;
BA_ "SigType" SG_ 3221225472 Aftertreatment1OutletNOx 1;
BA_ "SAEDocument" SG_ 3221225472 Aftrtrtmnt1DslPrtcltFltrOtltGsTm "J1939-71";
BA_ "SPN" SG_ 3221225472 Aftrtrtmnt1DslPrtcltFltrOtltGsTm 3246;
BA_ "SigType" SG_ 3221225472 Aftrtrtmnt1DslPrtcltFltrOtltGsTm 1;
BA_ "SAEDocument" SG_ 3221225472 Aftrtrtmnt1DslPrtcltFltrOtltExhs "J1939-71";
BA_ "SPN" SG_ 3221225472 Aftrtrtmnt1DslPrtcltFltrOtltExhs 3248;
BA_ "SAEDocument" SG_ 3221225472 Aftrtrtmnt1ExhstGsTmp3PrlmnryFMI "J1939-71";
BA_ "SPN" SG_ 3221225472 Aftrtrtmnt1ExhstGsTmp3PrlmnryFMI 3247;
BA_ "SAEDocument" SG_ 3221225472 Aftertreatment1ExhaustGasTemp3 "J1939-71";
BA_ "SPN" SG_ 3221225472 Aftertreatment1ExhaustGasTemp3 3245;
BA_ "SigType" SG_ 3221225472 Aftertreatment1ExhaustGasTemp3 1;
BA_ "SAEDocument" SG_ 3221225472 DslPrtclateFilter1AshLoadPercent "J1939-71";
BA_ "SPN" SG_ 3221225472 DslPrtclateFilter1AshLoadPercent 3720;
BA_ "SigType" SG_ 3221225472 DslPrtclateFilter1AshLoadPercent 1;
BA_ "SAEDocument" SG_ 3221225472 DslPrtcltFltr1TmSncLstActvRgnrtn "J1939-71";
BA_ "SPN" SG_ 3221225472 DslPrtcltFltr1TmSncLstActvRgnrtn 3721;
BA_ "SigType" SG_ 3221225472 DslPrtcltFltr1TmSncLstActvRgnrtn 1;
BA_ "SAEDocument" SG_ 3221225472 DslPrtclteFilter1SootLoadPercent "J1939-71";
BA_ "SPN" SG_ 3221225472 DslPrtclteFilter1SootLoadPercent 3719;
BA_ "SigType" SG_ 3221225472 DslPrtclteFilter1SootLoadPercent 1;
BA_ "SAEDocument" SG_ 3221225472 Aftrtrtmnt1DslPrtcltFltrStLdRgnr "J1939-71";
BA_ "SPN" SG_ 3221225472 Aftrtrtmnt1DslPrtcltFltrStLdRgnr 5466;
BA_ "SAEDocument" SG_ 3221225472 Aftrtrtmnt1TrpNmbrOfActvRgnrtnMn "J1939-71";
BA_ "SPN" SG_ 3221225472 Aftrtrtmnt1TrpNmbrOfActvRgnrtnMn 3740;
BA_ "SigType" SG_ 3221225472 Aftrtrtmnt1TrpNmbrOfActvRgnrtnMn 1;
BA_ "SAEDocument" SG_ 3221225472 Aftrtrtmnt1TrpNmbrOfActvRgnrtnIn "J1939-71";
BA_ "SPN" SG_ 3221225472 Aftrtrtmnt1TrpNmbrOfActvRgnrtnIn 3739;
BA_ "SigType" SG_ 3221225472 Aftrtrtmnt1TrpNmbrOfActvRgnrtnIn 1;
BA_ "SAEDocument" SG_ 3221225472 Aftrtrtmnt1TrpNmbrOfPssvRgnrtons "J1939-71";
BA_ "SPN" SG_ 3221225472 Aftrtrtmnt1TrpNmbrOfPssvRgnrtons 3738;
BA_ "SigType" SG_ 3221225472 Aftrtrtmnt1TrpNmbrOfPssvRgnrtons 1;
BA_ "SAEDocument" SG_ 3221225472 Aftrtrtmnt1TrpPssvRgnerationTime "J1939-71";
BA_ "SPN" SG_ 3221225472 Aftrtrtmnt1TrpPssvRgnerationTime 3737;
BA_ "SigType" SG_ 3221225472 Aftrtrtmnt1TrpPssvRgnerationTime 1;
BA_ "SAEDocument" SG_ 3221225472 Aftrtrtmnt1TrpNmbrOfActvRgnrtons "J1939-71";
BA_ "SPN" SG_ 3221225472 Aftrtrtmnt1TrpNmbrOfActvRgnrtons 3736;
BA_ "SigType" SG_ 3221225472 Aftrtrtmnt1TrpNmbrOfActvRgnrtons 1;
BA_ "SAEDocument" SG_ 3221225472 Aftertreatment1TripDisabledTime "J1939-71";
BA_ "SPN" SG_ 3221225472 Aftertreatment1TripDisabledTime 3735;
BA_ "SigType" SG_ 3221225472 Aftertreatment1TripDisabledTime 1;
BA_ "SAEDocument" SG_ 3221225472 Aftrtrtmnt1TrpActvRgnerationTime "J1939-71";
BA_ "SPN" SG_ 3221225472 Aftrtrtmnt1TrpActvRgnerationTime 3734;
BA_ "SigType" SG_ 3221225472 Aftrtrtmnt1TrpActvRgnerationTime 1;
BA_ "SAEDocument" SG_ 3221225472 Aftertreatment1TripFuelUsed "J1939-71";
BA_ "SPN" SG_ 3221225472 Aftertreatment1TripFuelUsed 3733;
BA_ "SigType" SG_ 3221225472 Aftertreatment1TripFuelUsed 1;
BA_ "SAEDocument" SG_ 3221225472 Aftertreatment2AirEnableActuator "J1939-71";
BA_ "SPN" SG_ 3221225472 Aftertreatment2AirEnableActuator 3503;
BA_ "SigType" SG_ 3221225472 Aftertreatment2AirEnableActuator 5;
BA_ "SAEDocument" SG_ 3221225472 Aftertreatment2PurgeAirActuator "J1939-71";
BA_ "SPN" SG_ 3221225472 Aftertreatment2PurgeAirActuator 3504;
BA_ "SigType" SG_ 3221225472 Aftertreatment2PurgeAirActuator 5;
BA_ "SAEDocument" SG_ 3221225472 Aftrtrtmnt2AtmizationAirActuator "J1939-71";
BA_ "SPN" SG_ 3221225472 Aftrtrtmnt2AtmizationAirActuator 3505;
BA_ "SigType" SG_ 3221225472 Aftrtrtmnt2AtmizationAirActuator 5;
BA_ "SAEDocument" SG_ 3221225472 Aftertreatment2AirSystemRelay "J1939-71";
BA_ "SPN" SG_ 3221225472 Aftertreatment2AirSystemRelay 3506;
BA_ "SigType" SG_ 3221225472 Aftertreatment2AirSystemRelay 5;
BA_ "SAEDocument" SG_ 3221225472 Aftrtratment2AirPressActuatorPos "J1939-71";
BA_ "SPN" SG_ 3221225472 Aftrtratment2AirPressActuatorPos 3502;
BA_ "SigType" SG_ 3221225472 Aftrtratment2AirPressActuatorPos 1;
BA_ "SAEDocument" SG_ 3221225472 Aftertreatment2AirPressCtrl "J1939-71";
BA_ "SPN" SG_ 3221225472 Aftertreatment2AirPressCtrl 3501;
BA_ "SigType" SG_ 3221225472 Aftertreatment2AirPressCtrl 1;
BA_ "SAEDocument" SG_ 3221225472 Aftertreatment2PurgeAirPress "J1939-71";
BA_ "SPN" SG_ 3221225472 Aftertreatment2PurgeAirPress 3500;
BA_ "SigType" SG_ 3221225472 Aftertreatment2PurgeAirPress 1;
BA_ "SAEDocument" SG_ 3221225472 Aftertreatment2SupplyAirPress "J1939-71";
BA_ "SPN" SG_ 3221225472 Aftertreatment2SupplyAirPress 3499;
BA_ "SigType" SG_ 3221225472 Aftertreatment2SupplyAirPress 1;
BA_ "SAEDocument" SG_ 3221225472 Aftertreatment2SecondAirPress "J1939-71";
BA_ "SPN" SG_ 3221225472 Aftertreatment2SecondAirPress 3838;
BA_ "SigType" SG_ 3221225472 Aftertreatment2SecondAirPress 1;
BA_ "SAEDocument" SG_ 3221225472 Aftertreatment2SecondAirMassFlow "J1939-71";
BA_ "SPN" SG_ 3221225472 Aftertreatment2SecondAirMassFlow 3835;
BA_ "SigType" SG_ 3221225472 Aftertreatment2SecondAirMassFlow 1;
BA_ "SAEDocument" SG_ 3221225472 Aftertreatment2SecondAirTemp "J1939-71";
BA_ "SPN" SG_ 3221225472 Aftertreatment2SecondAirTemp 3834;
BA_ "SigType" SG_ 3221225472 Aftertreatment2SecondAirTemp 1;
BA_ "SAEDocument" SG_ 3221225472 Aftrtreatment2SecondAirDiffPress "J1939-71";
BA_ "SPN" SG_ 3221225472 Aftrtreatment2SecondAirDiffPress 3833;
BA_ "SigType" SG_ 3221225472 Aftrtreatment2SecondAirDiffPress 1;
BA_ "SAEDocument" SG_ 3221225472 Aftrtrtmnt2FlInjector1HeaterCtrl "J1939-71";
BA_ "SPN" SG_ 3221225472 Aftrtrtmnt2FlInjector1HeaterCtrl 4302;
BA_ "SAEDocument" SG_ 3221225472 Aftrtreatment2FuelEnableActuator "J1939-71";
BA_ "SPN" SG_ 3221225472 Aftrtreatment2FuelEnableActuator 3496;
BA_ "SigType" SG_ 3221225472 Aftrtreatment2FuelEnableActuator 5;
BA_ "SAEDocument" SG_ 3221225472 Aftrtreatment2RegenerationStatus "J1939-71";
BA_ "SPN" SG_ 3221225472 Aftrtreatment2RegenerationStatus 3497;
BA_ "SigType" SG_ 3221225472 Aftrtreatment2RegenerationStatus 5;
BA_ "SAEDocument" SG_ 3221225472 Aftertreatment2Ignt "J1939-71";
BA_ "SPN" SG_ 3221225472 Aftertreatment2Ignt 3498;
BA_ "SigType" SG_ 3221225472 Aftertreatment2Ignt 5;
BA_ "SAEDocument" SG_ 3221225472 Aftertreatment2FuelDrainActuator "J1939-71";
BA_ "SPN" SG_ 3221225472 Aftertreatment2FuelDrainActuator 4098;
BA_ "SigType" SG_ 3221225472 Aftertreatment2FuelDrainActuator 5;
BA_ "SAEDocument" SG_ 3221225472 Aftertreatment2FuelPress1Ctrl "J1939-71";
BA_ "SPN" SG_ 3221225472 Aftertreatment2FuelPress1Ctrl 3493;
BA_ "SAEDocument" SG_ 3221225472 Aftertreatment2FuelRate "J1939-71";
BA_ "SPN" SG_ 3221225472 Aftertreatment2FuelRate 3495;
BA_ "SigType" SG_ 3221225472 Aftertreatment2FuelRate 1;
BA_ "SAEDocument" SG_ 3221225472 Aftertreatment2FuelPress1 "J1939-71";
BA_ "SPN" SG_ 3221225472 Aftertreatment2FuelPress1 3494;
BA_ "SigType" SG_ 3221225472 Aftertreatment2FuelPress1 1;
BA_ "SAEDocument" SG_ 3221225472 DslParticulateFilterOutletPress2 "J1939-71";
BA_ "SPN" SG_ 3221225472 DslParticulateFilterOutletPress2 3612;
BA_ "SigType" SG_ 3221225472 DslParticulateFilterOutletPress2 1;
BA_ "SAEDocument" SG_ 3221225472 DslParticulateFilterIntakePress2 "J1939-71";
BA_ "SPN" SG_ 3221225472 DslParticulateFilterIntakePress2 3611;
BA_ "SigType" SG_ 3221225472 DslParticulateFilterIntakePress2 1;
BA_ "SAEDocument" SG_ 3221225472 Aftrtrtmnt2AvrgTmBtwnActvRgnrtns "J1939-71";
BA_ "SPN" SG_ 3221225472 Aftrtrtmnt2AvrgTmBtwnActvRgnrtns 5455;
BA_ "SAEDocument" SG_ 3221225472 Aftrtrtmnt2TtlNmbrOfActvRgnrtnMn "J1939-71";
BA_ "SPN" SG_ 3221225472 Aftrtrtmnt2TtlNmbrOfActvRgnrtnMn 3732;
BA_ "SigType" SG_ 3221225472 Aftrtrtmnt2TtlNmbrOfActvRgnrtnMn 1;
BA_ "SAEDocument" SG_ 3221225472 Aftrtrtmnt2TtlNmbrOfActvRgnrtnIn "J1939-71";
BA_ "SPN" SG_ 3221225472 Aftrtrtmnt2TtlNmbrOfActvRgnrtnIn 3731;
BA_ "SigType" SG_ 3221225472 Aftrtrtmnt2TtlNmbrOfActvRgnrtnIn 1;
BA_ "SAEDocument" SG_ 3221225472 Aftrtrtmnt2TtlNmbrOfPssvRgnrtons "J1939-71";
BA_ "SPN" SG_ 3221225472 Aftrtrtmnt2TtlNmbrOfPssvRgnrtons 3730;
BA_ "SigType" SG_ 3221225472 Aftrtrtmnt2TtlNmbrOfPssvRgnrtons 1;
BA_ "SAEDocument" SG_ 3221225472 Aftrtrtmnt2TtlPssvRgnerationTime "J1939-71";
BA_ "SPN" SG_ 3221225472 Aftrtrtmnt2TtlPssvRgnerationTime 3729;
BA_ "SigType" SG_ 3221225472 Aftrtrtmnt2TtlPssvRgnerationTime 1;
BA_ "SAEDocument" SG_ 3221225472 Aftrtrtmnt2TtlNmbrOfActvRgnrtons "J1939-71";
BA_ "SPN" SG_ 3221225472 Aftrtrtmnt2TtlNmbrOfActvRgnrtons 3529;
BA_ "SigType" SG_ 3221225472 Aftrtrtmnt2TtlNmbrOfActvRgnrtons 1;
BA_ "SAEDocument" SG_ 3221225472 Aftertreatment2TotalDisabledTime "J1939-71";
BA_ "SPN" SG_ 3221225472 Aftertreatment2TotalDisabledTime 3528;
BA_ "SAEDocument" SG_ 3221225472 Aftrtrtmnt2TotalRegenerationTime "J1939-71";
BA_ "SPN" SG_ 3221225472 Aftrtrtmnt2TotalRegenerationTime 3527;
BA_ "SAEDocument" SG_ 3221225472 Aftertreatment2TotalFuelUsed "J1939-71";
BA_ "SPN" SG_ 3221225472 Aftertreatment2TotalFuelUsed 3526;
BA_ "SAEDocument" SG_ 3221225472 Aftrtrtmnt2IntkOxygnSnsrPrlmnryF "J1939-71";
BA_ "SPN" SG_ 3221225472 Aftrtrtmnt2IntkOxygnSnsrPrlmnryF 3264;
BA_ "SAEDocument" SG_ 3221225472 Aftrtrtmnt2IntkNOxSnsrPrlmnryFMI "J1939-71";
BA_ "SPN" SG_ 3221225472 Aftrtrtmnt2IntkNOxSnsrPrlmnryFMI 3263;
BA_ "SAEDocument" SG_ 3221225472 Aftrtrtmnt2IntkGsSnsorHeaterCtrl "J1939-71";
BA_ "SPN" SG_ 3221225472 Aftrtrtmnt2IntkGsSnsorHeaterCtrl 3262;
BA_ "SigType" SG_ 3221225472 Aftrtrtmnt2IntkGsSnsorHeaterCtrl 5;
BA_ "SAEDocument" SG_ 3221225472 Aftrtrtmnt2IntkGsSnsrHtrPrlmnryF "J1939-71";
BA_ "SPN" SG_ 3221225472 Aftrtrtmnt2IntkGsSnsrHtrPrlmnryF 3261;
BA_ "SAEDocument" SG_ 3221225472 Aftrtrtmnt2IntkWdRngO2RdngStable "J1939-71";
BA_ "SPN" SG_ 3221225472 Aftrtrtmnt2IntkWdRngO2RdngStable 3260;
BA_ "SigType" SG_ 3221225472 Aftrtrtmnt2IntkWdRngO2RdngStable 5;
BA_ "SAEDocument" SG_ 3221225472 Aftrtrtmnt2IntkeNOxReadingStable "J1939-71";
BA_ "SPN" SG_ 3221225472 Aftrtrtmnt2IntkeNOxReadingStable 3259;
BA_ "SigType" SG_ 3221225472 Aftrtrtmnt2IntkeNOxReadingStable 5;
BA_ "SAEDocument" SG_ 3221225472 Aftrtrtmnt2IntakeGasSensorAtTemp "J1939-71";
BA_ "SPN" SG_ 3221225472 Aftrtrtmnt2IntakeGasSensorAtTemp 3258;
BA_ "SigType" SG_ 3221225472 Aftrtrtmnt2IntakeGasSensorAtTemp 5;
BA_ "SAEDocument" SG_ 3221225472 Aftrtrtmnt2IntkGsSnsrPowerStatus "J1939-71";
BA_ "SPN" SG_ 3221225472 Aftrtrtmnt2IntkGsSnsrPowerStatus 3257;
BA_ "SigType" SG_ 3221225472 Aftrtrtmnt2IntkGsSnsrPowerStatus 5;
BA_ "SAEDocument" SG_ 3221225472 Aftertreatment2IntakeO2 "J1939-71";
BA_ "SPN" SG_ 3221225472 Aftertreatment2IntakeO2 3256;
BA_ "SigType" SG_ 3221225472 Aftertreatment2IntakeO2 1;
BA_ "SAEDocument" SG_ 3221225472 Aftertreatment2IntakeNOx "J1939-71";
BA_ "SPN" SG_ 3221225472 Aftertreatment2IntakeNOx 3255;
BA_ "SigType" SG_ 3221225472 Aftertreatment2IntakeNOx 1;
BA_ "SAEDocument" SG_ 3221225472 Aftrtrtmnt2DslPrtcltFltrIntkGsTm "J1939-71";
BA_ "SPN" SG_ 3221225472 Aftrtrtmnt2DslPrtcltFltrIntkGsTm 3276;
BA_ "SigType" SG_ 3221225472 Aftrtrtmnt2DslPrtcltFltrIntkGsTm 1;
BA_ "SAEDocument" SG_ 3221225472 Aftrtrtmnt2ExhstGsTmp1PrlmnryFMI "J1939-71";
BA_ "SPN" SG_ 3221225472 Aftrtrtmnt2ExhstGsTmp1PrlmnryFMI 3277;
BA_ "SAEDocument" SG_ 3221225472 Aftertreatment2ExhaustGasTemp1 "J1939-71";
BA_ "SPN" SG_ 3221225472 Aftertreatment2ExhaustGasTemp1 3275;
BA_ "SigType" SG_ 3221225472 Aftertreatment2ExhaustGasTemp1 1;
BA_ "SAEDocument" SG_ 3221225472 Aftrtrtmnt2DslPrtcltFltrIntrmdtG "J1939-71";
BA_ "SPN" SG_ 3221225472 Aftrtrtmnt2DslPrtcltFltrIntrmdtG 3284;
BA_ "SigType" SG_ 3221225472 Aftrtrtmnt2DslPrtcltFltrIntrmdtG 1;
BA_ "SAEDocument" SG_ 3221225472 Aftrtrtmnt2DslPrtcltFltrDltPrssP "J1939-71";
BA_ "SPN" SG_ 3221225472 Aftrtrtmnt2DslPrtcltFltrDltPrssP 3287;
BA_ "SAEDocument" SG_ 3221225472 Aftrtrtmnt2DslPrtcltFltrDffPress "J1939-71";
BA_ "SPN" SG_ 3221225472 Aftrtrtmnt2DslPrtcltFltrDffPress 3285;
BA_ "SigType" SG_ 3221225472 Aftrtrtmnt2DslPrtcltFltrDffPress 1;
BA_ "SAEDocument" SG_ 3221225472 Aftrtrtmnt2ExhstGsTmp2PrlmnryFMI "J1939-71";
BA_ "SPN" SG_ 3221225472 Aftrtrtmnt2ExhstGsTmp2PrlmnryFMI 3286;
BA_ "SAEDocument" SG_ 3221225472 Aftertreatment2ExhaustGasTemp2 "J1939-71";
BA_ "SPN" SG_ 3221225472 Aftertreatment2ExhaustGasTemp2 3283;
BA_ "SigType" SG_ 3221225472 Aftertreatment2ExhaustGasTemp2 1;
BA_ "SAEDocument" SG_ 3221225472 Aftrtrtmnt2OtltOxygnSnsrPrlmnryF "J1939-71";
BA_ "SPN" SG_ 3221225472 Aftrtrtmnt2OtltOxygnSnsrPrlmnryF 3274;
BA_ "SAEDocument" SG_ 3221225472 Aftrtrtmnt2OtltNOxSnsrPrlmnryFMI "J1939-71";
BA_ "SPN" SG_ 3221225472 Aftrtrtmnt2OtltNOxSnsrPrlmnryFMI 3273;
BA_ "SAEDocument" SG_ 3221225472 Aftrtrtmnt2OtltGsSnsorHeaterCtrl "J1939-71";
BA_ "SPN" SG_ 3221225472 Aftrtrtmnt2OtltGsSnsorHeaterCtrl 3272;
BA_ "SigType" SG_ 3221225472 Aftrtrtmnt2OtltGsSnsorHeaterCtrl 5;
BA_ "SAEDocument" SG_ 3221225472 Aftrtrtmnt2OtltGsSnsrHtrPrlmnryF "J1939-71";
BA_ "SPN" SG_ 3221225472 Aftrtrtmnt2OtltGsSnsrHtrPrlmnryF 3271;
BA_ "SAEDocument" SG_ 3221225472 Aftrtrtmnt2OtltWdRngO2RdngStable "J1939-71";
BA_ "SPN" SG_ 3221225472 Aftrtrtmnt2OtltWdRngO2RdngStable 3270;
BA_ "SigType" SG_ 3221225472 Aftrtrtmnt2OtltWdRngO2RdngStable 5;
BA_ "SAEDocument" SG_ 3221225472 Aftrtrtmnt2OtletNOxReadingStable "J1939-71";
BA_ "SPN" SG_ 3221225472 Aftrtrtmnt2OtletNOxReadingStable 3269;
BA_ "SigType" SG_ 3221225472 Aftrtrtmnt2OtletNOxReadingStable 5;
BA_ "SAEDocument" SG_ 3221225472 Aftrtrtmnt2OutletGasSensorAtTemp "J1939-71";
BA_ "SPN" SG_ 3221225472 Aftrtrtmnt2OutletGasSensorAtTemp 3268;
BA_ "SigType" SG_ 3221225472 Aftrtrtmnt2OutletGasSensorAtTemp 5;
BA_ "SAEDocument" SG_ 3221225472 Aftrtrtmnt2OtltGsSnsrPowerStatus "J1939-71";
BA_ "SPN" SG_ 3221225472 Aftrtrtmnt2OtltGsSnsrPowerStatus 3267;
BA_ "SigType" SG_ 3221225472 Aftrtrtmnt2OtltGsSnsrPowerStatus 5;
BA_ "SAEDocument" SG_ 3221225472 Aftertreatment2OutletO2 "J1939-71";
BA_ "SPN" SG_ 3221225472 Aftertreatment2OutletO2 3266;
BA_ "SigType" SG_ 3221225472 Aftertreatment2OutletO2 1;
BA_ "SAEDocument" SG_ 3221225472 Aftertreatment2OutletNOx "J1939-71";
BA_ "SPN" SG_ 3221225472 Aftertreatment2OutletNOx 3265;
BA_ "SigType" SG_ 3221225472 Aftertreatment2OutletNOx 1;
BA_ "SAEDocument" SG_ 3221225472 Aftrtrtmnt2DslPrtcltFltrOtltGsTm "J1939-71";
BA_ "SPN" SG_ 3221225472 Aftrtrtmnt2DslPrtcltFltrOtltGsTm 3280;
BA_ "SigType" SG_ 3221225472 Aftrtrtmnt2DslPrtcltFltrOtltGsTm 1;
BA_ "SAEDocument" SG_ 3221225472 Aftrtrtmnt2DslPrtcltFltrExhstGsT "J1939-71";
BA_ "SPN" SG_ 3221225472 Aftrtrtmnt2DslPrtcltFltrExhstGsT 3282;
BA_ "SAEDocument" SG_ 3221225472 Aftrtrtmnt2ExhstGsTmp3PrlmnryFMI "J1939-71";
BA_ "SPN" SG_ 3221225472 Aftrtrtmnt2ExhstGsTmp3PrlmnryFMI 3281;
BA_ "SAEDocument" SG_ 3221225472 Aftertreatment2ExhaustGasTemp3 "J1939-71";
BA_ "SPN" SG_ 3221225472 Aftertreatment2ExhaustGasTemp3 3279;
BA_ "SigType" SG_ 3221225472 Aftertreatment2ExhaustGasTemp3 1;
BA_ "SAEDocument" SG_ 3221225472 Aftrtrtmnt2DslPrtcltFltrStLdRgnr "J1939-71";
BA_ "SPN" SG_ 3221225472 Aftrtrtmnt2DslPrtcltFltrStLdRgnr 5467;
BA_ "SAEDocument" SG_ 3221225472 DslPrtcltFltr2TmSncLstActvRgnrtn "J1939-71";
BA_ "SPN" SG_ 3221225472 DslPrtcltFltr2TmSncLstActvRgnrtn 3724;
BA_ "SigType" SG_ 3221225472 DslPrtcltFltr2TmSncLstActvRgnrtn 1;
BA_ "SAEDocument" SG_ 3221225472 DslPrtclateFilter2AshLoadPercent "J1939-71";
BA_ "SPN" SG_ 3221225472 DslPrtclateFilter2AshLoadPercent 3723;
BA_ "SigType" SG_ 3221225472 DslPrtclateFilter2AshLoadPercent 1;
BA_ "SAEDocument" SG_ 3221225472 DslPrtclteFilter2SootLoadPercent "J1939-71";
BA_ "SPN" SG_ 3221225472 DslPrtclteFilter2SootLoadPercent 3722;
BA_ "SigType" SG_ 3221225472 DslPrtclteFilter2SootLoadPercent 1;
BA_ "SAEDocument" SG_ 3221225472 Aftrtrtmnt2TrpNmbrOfActvRgnrtnMn "J1939-71";
BA_ "SPN" SG_ 3221225472 Aftrtrtmnt2TrpNmbrOfActvRgnrtnMn 3748;
BA_ "SigType" SG_ 3221225472 Aftrtrtmnt2TrpNmbrOfActvRgnrtnMn 1;
BA_ "SAEDocument" SG_ 3221225472 Aftrtrtmnt2TrpNmbrOfActvRgnrtnIn "J1939-71";
BA_ "SPN" SG_ 3221225472 Aftrtrtmnt2TrpNmbrOfActvRgnrtnIn 3747;
BA_ "SigType" SG_ 3221225472 Aftrtrtmnt2TrpNmbrOfActvRgnrtnIn 1;
BA_ "SAEDocument" SG_ 3221225472 Aftrtrtmnt2TrpNmbrOfPssvRgnrtons "J1939-71";
BA_ "SPN" SG_ 3221225472 Aftrtrtmnt2TrpNmbrOfPssvRgnrtons 3746;
BA_ "SigType" SG_ 3221225472 Aftrtrtmnt2TrpNmbrOfPssvRgnrtons 1;
BA_ "SAEDocument" SG_ 3221225472 Aftrtrtmnt2TrpPssvRgnerationTime "J1939-71";
BA_ "SPN" SG_ 3221225472 Aftrtrtmnt2TrpPssvRgnerationTime 3745;
BA_ "SigType" SG_ 3221225472 Aftrtrtmnt2TrpPssvRgnerationTime 1;
BA_ "SAEDocument" SG_ 3221225472 Aftrtrtmnt2TrpNmbrOfActvRgnrtons "J1939-71";
BA_ "SPN" SG_ 3221225472 Aftrtrtmnt2TrpNmbrOfActvRgnrtons 3744;
BA_ "SigType" SG_ 3221225472 Aftrtrtmnt2TrpNmbrOfActvRgnrtons 1;
BA_ "SAEDocument" SG_ 3221225472 Aftertreatment2TripDisabledTime "J1939-71";
BA_ "SPN" SG_ 3221225472 Aftertreatment2TripDisabledTime 3743;
BA_ "SigType" SG_ 3221225472 Aftertreatment2TripDisabledTime 1;
BA_ "SAEDocument" SG_ 3221225472 Aftrtrtmnt2TrpActvRgnerationTime "J1939-71";
BA_ "SPN" SG_ 3221225472 Aftrtrtmnt2TrpActvRgnerationTime 3742;
BA_ "SigType" SG_ 3221225472 Aftrtrtmnt2TrpActvRgnerationTime 1;
BA_ "SAEDocument" SG_ 3221225472 Aftertreatment2TripFuelUsed "J1939-71";
BA_ "SPN" SG_ 3221225472 Aftertreatment2TripFuelUsed 3741;
BA_ "SigType" SG_ 3221225472 Aftertreatment2TripFuelUsed 1;
BA_ "SAEDocument" SG_ 3221225472 EngDerateRq "J1939-71";
BA_ "SPN" SG_ 3221225472 EngDerateRq 3644;
BA_ "SAEDocument" SG_ 3221225472 EngEmergencyShutdownIndication "J1939-71";
BA_ "SPN" SG_ 3221225472 EngEmergencyShutdownIndication 3607;
BA_ "SigType" SG_ 3221225472 EngEmergencyShutdownIndication 5;
BA_ "SAEDocument" SG_ 3221225472 EngControlledShutdownRq "J1939-71";
BA_ "SPN" SG_ 3221225472 EngControlledShutdownRq 3606;
BA_ "SigType" SG_ 3221225472 EngControlledShutdownRq 5;
BA_ "SAEDocument" SG_ 3221225472 EngCoolantCirculatingPumpCtrl "J1939-71";
BA_ "SPN" SG_ 3221225472 EngCoolantCirculatingPumpCtrl 3605;
BA_ "SigType" SG_ 3221225472 EngCoolantCirculatingPumpCtrl 5;
BA_ "SAEDocument" SG_ 3221225472 EngBlock_CoolantPreheaterCtrl "J1939-71";
BA_ "SPN" SG_ 3221225472 EngBlock_CoolantPreheaterCtrl 3604;
BA_ "SigType" SG_ 3221225472 EngBlock_CoolantPreheaterCtrl 5;
BA_ "SAEDocument" SG_ 3221225472 EngElctrclSystmPwrCnsrvationCtrl "J1939-71";
BA_ "SPN" SG_ 3221225472 EngElctrclSystmPwrCnsrvationCtrl 3603;
BA_ "SigType" SG_ 3221225472 EngElctrclSystmPwrCnsrvationCtrl 5;
BA_ "SAEDocument" SG_ 3221225472 EngOilPreheaterCtrl "J1939-71";
BA_ "SPN" SG_ 3221225472 EngOilPreheaterCtrl 3602;
BA_ "SigType" SG_ 3221225472 EngOilPreheaterCtrl 5;
BA_ "SAEDocument" SG_ 3221225472 EngOilPrimingPumpCtrl "J1939-71";
BA_ "SPN" SG_ 3221225472 EngOilPrimingPumpCtrl 3589;
BA_ "SigType" SG_ 3221225472 EngOilPrimingPumpCtrl 5;
BA_ "SAEDocument" SG_ 3221225472 EngFuelShutoffValveLeakTestCtrl "J1939-71";
BA_ "SPN" SG_ 3221225472 EngFuelShutoffValveLeakTestCtrl 3601;
BA_ "SigType" SG_ 3221225472 EngFuelShutoffValveLeakTestCtrl 5;
BA_ "SAEDocument" SG_ 3221225472 EngFuelShutoff2Ctrl "J1939-71";
BA_ "SPN" SG_ 3221225472 EngFuelShutoff2Ctrl 2807;
BA_ "SigType" SG_ 3221225472 EngFuelShutoff2Ctrl 5;
BA_ "SAEDocument" SG_ 3221225472 EngFuelShutoff1Ctrl "J1939-71";
BA_ "SPN" SG_ 3221225472 EngFuelShutoff1Ctrl 632;
BA_ "SigType" SG_ 3221225472 EngFuelShutoff1Ctrl 5;
BA_ "SAEDocument" SG_ 3221225472 EngFuelShutoffVentCtrl "J1939-71";
BA_ "SPN" SG_ 3221225472 EngFuelShutoffVentCtrl 3608;
BA_ "SigType" SG_ 3221225472 EngFuelShutoffVentCtrl 5;
BA_ "SAEDocument" SG_ 3221225472 TimeRemainingInEngOperatingState "J1939-71";
BA_ "SPN" SG_ 3221225472 TimeRemainingInEngOperatingState 3544;
BA_ "SAEDocument" SG_ 3221225472 FuelPumpPrimerCtrl "J1939-71";
BA_ "SPN" SG_ 3221225472 FuelPumpPrimerCtrl 4082;
BA_ "SigType" SG_ 3221225472 FuelPumpPrimerCtrl 5;
BA_ "SAEDocument" SG_ 3221225472 EngOperatingState "J1939-71";
BA_ "SPN" SG_ 3221225472 EngOperatingState 3543;
BA_ "SAEDocument" SG_ 3221225472 EngExhstGsRcrcltn1MxerIntakeTemp "J1939-71";
BA_ "SPN" SG_ 3221225472 EngExhstGsRcrcltn1MxerIntakeTemp 5020;
BA_ "SigType" SG_ 3221225472 EngExhstGsRcrcltn1MxerIntakeTemp 1;
BA_ "SAEDocument" SG_ 3221225472 EngExhstVlvActationSystemOilTemp "J1939-71";
BA_ "SPN" SG_ 3221225472 EngExhstVlvActationSystemOilTemp 4288;
BA_ "SigType" SG_ 3221225472 EngExhstVlvActationSystemOilTemp 1;
BA_ "SAEDocument" SG_ 3221225472 EngCoolantThermostatOpening "J1939-71";
BA_ "SPN" SG_ 3221225472 EngCoolantThermostatOpening 4194;
BA_ "SigType" SG_ 3221225472 EngCoolantThermostatOpening 1;
BA_ "SAEDocument" SG_ 3221225472 EngCoolantPumpOutletTemp "J1939-71";
BA_ "SPN" SG_ 3221225472 EngCoolantPumpOutletTemp 4193;
BA_ "SigType" SG_ 3221225472 EngCoolantPumpOutletTemp 1;
BA_ "SAEDocument" SG_ 3221225472 EngCoolantTemp2 "J1939-71";
BA_ "SPN" SG_ 3221225472 EngCoolantTemp2 4076;
BA_ "SigType" SG_ 3221225472 EngCoolantTemp2 1;
BA_ "SAEDocument" SG_ 3221225472 NetVehicleWeightChange "J1939-71";
BA_ "SPN" SG_ 3221225472 NetVehicleWeightChange 413;
BA_ "SAEDocument" SG_ 3221225472 GrossCombinationWeight "J1939-71";
BA_ "SPN" SG_ 3221225472 GrossCombinationWeight 417;
BA_ "SAEDocument" SG_ 3221225472 ValveAssemblySupplyPress "J1939-71";
BA_ "SPN" SG_ 3221225472 ValveAssemblySupplyPress 4089;
BA_ "SigType" SG_ 3221225472 ValveAssemblySupplyPress 1;
BA_ "SAEDocument" SG_ 3221225472 ValveAssemblyLoadSensePress "J1939-71";
BA_ "SPN" SG_ 3221225472 ValveAssemblyLoadSensePress 4088;
BA_ "SigType" SG_ 3221225472 ValveAssemblyLoadSensePress 1;
BA_ "SAEDocument" SG_ 3221225472 ValvePilotPress "J1939-71";
BA_ "SPN" SG_ 3221225472 ValvePilotPress 4087;
BA_ "SigType" SG_ 3221225472 ValvePilotPress 1;
BA_ "SAEDocument" SG_ 3221225472 ValveLoadSensePress "J1939-71";
BA_ "SPN" SG_ 3221225472 ValveLoadSensePress 4086;
BA_ "SigType" SG_ 3221225472 ValveLoadSensePress 1;
BA_ "SAEDocument" SG_ 3221225472 BellowPressRearAxleRight "J1939-71";
BA_ "SPN" SG_ 3221225472 BellowPressRearAxleRight 1728;
BA_ "SigType" SG_ 3221225472 BellowPressRearAxleRight 1;
BA_ "SAEDocument" SG_ 3221225472 BellowPressRearAxleLeft "J1939-71";
BA_ "SPN" SG_ 3221225472 BellowPressRearAxleLeft 1727;
BA_ "SigType" SG_ 3221225472 BellowPressRearAxleLeft 1;
BA_ "SAEDocument" SG_ 3221225472 BellowPressFrontAxleRight "J1939-71";
BA_ "SPN" SG_ 3221225472 BellowPressFrontAxleRight 1726;
BA_ "SigType" SG_ 3221225472 BellowPressFrontAxleRight 1;
BA_ "SAEDocument" SG_ 3221225472 BellowPressFrontAxleLeft "J1939-71";
BA_ "SPN" SG_ 3221225472 BellowPressFrontAxleLeft 1725;
BA_ "SigType" SG_ 3221225472 BellowPressFrontAxleLeft 1;
BA_ "SAEDocument" SG_ 3221225472 RelativeLevelRearAxleRight "J1939-71";
BA_ "SPN" SG_ 3221225472 RelativeLevelRearAxleRight 1723;
BA_ "SigType" SG_ 3221225472 RelativeLevelRearAxleRight 1;
BA_ "SAEDocument" SG_ 3221225472 RelativeLevelRearAxleLeft "J1939-71";
BA_ "SPN" SG_ 3221225472 RelativeLevelRearAxleLeft 1724;
BA_ "SigType" SG_ 3221225472 RelativeLevelRearAxleLeft 1;
BA_ "SAEDocument" SG_ 3221225472 RelativeLevelFrontAxleRight "J1939-71";
BA_ "SPN" SG_ 3221225472 RelativeLevelFrontAxleRight 1722;
BA_ "SigType" SG_ 3221225472 RelativeLevelFrontAxleRight 1;
BA_ "SAEDocument" SG_ 3221225472 RelativeLevelFrontAxleLeft "J1939-71";
BA_ "SPN" SG_ 3221225472 RelativeLevelFrontAxleLeft 1721;
BA_ "SigType" SG_ 3221225472 RelativeLevelFrontAxleLeft 1;
BA_ "SAEDocument" SG_ 3221225472 MemoryLevelRq "J1939-71";
BA_ "SPN" SG_ 3221225472 MemoryLevelRq 5433;
BA_ "SAEDocument" SG_ 3221225472 PrhbitAutomaticAirSuspensionCtrl "J1939-71";
BA_ "SPN" SG_ 3221225472 PrhbitAutomaticAirSuspensionCtrl 5274;
BA_ "SigType" SG_ 3221225472 PrhbitAutomaticAirSuspensionCtrl 5;
BA_ "SAEDocument" SG_ 3221225472 SpeedDependentLevelCtrlRq "J1939-71";
BA_ "SPN" SG_ 3221225472 SpeedDependentLevelCtrlRq 5295;
BA_ "SigType" SG_ 3221225472 SpeedDependentLevelCtrlRq 5;
BA_ "SAEDocument" SG_ 3221225472 AllowLevelCtrlDuringBrakingCmd "J1939-71";
BA_ "SPN" SG_ 3221225472 AllowLevelCtrlDuringBrakingCmd 5293;
BA_ "SigType" SG_ 3221225472 AllowLevelCtrlDuringBrakingCmd 5;
BA_ "SAEDocument" SG_ 3221225472 ProhibitAirSuspensionCtrl "J1939-71";
BA_ "SPN" SG_ 3221225472 ProhibitAirSuspensionCtrl 3215;
BA_ "SigType" SG_ 3221225472 ProhibitAirSuspensionCtrl 5;
BA_ "SAEDocument" SG_ 3221225472 KneelingCmdRearAxle "J1939-71";
BA_ "SPN" SG_ 3221225472 KneelingCmdRearAxle 1829;
BA_ "SigType" SG_ 3221225472 KneelingCmdRearAxle 5;
BA_ "SAEDocument" SG_ 3221225472 KneelingCmdFrontAxle "J1939-71";
BA_ "SPN" SG_ 3221225472 KneelingCmdFrontAxle 1830;
BA_ "SigType" SG_ 3221225472 KneelingCmdFrontAxle 5;
BA_ "SAEDocument" SG_ 3221225472 DamperStiffnessRqLift_TagAxle "J1939-71";
BA_ "SPN" SG_ 3221225472 DamperStiffnessRqLift_TagAxle 1720;
BA_ "SAEDocument" SG_ 3221225472 DamperStiffnessRqRearAxle "J1939-71";
BA_ "SPN" SG_ 3221225472 DamperStiffnessRqRearAxle 1719;
BA_ "SAEDocument" SG_ 3221225472 DamperStiffnessRqFrontAxle "J1939-71";
BA_ "SPN" SG_ 3221225472 DamperStiffnessRqFrontAxle 1718;
BA_ "SAEDocument" SG_ 3221225472 LiftAxle2PosCmd "J1939-71";
BA_ "SPN" SG_ 3221225472 LiftAxle2PosCmd 1828;
BA_ "SigType" SG_ 3221225472 LiftAxle2PosCmd 5;
BA_ "SAEDocument" SG_ 3221225472 LiftAxle1PosCmd "J1939-71";
BA_ "SPN" SG_ 3221225472 LiftAxle1PosCmd 1752;
BA_ "SigType" SG_ 3221225472 LiftAxle1PosCmd 5;
BA_ "SAEDocument" SG_ 3221225472 LevelCtrlModeRq "J1939-71";
BA_ "SPN" SG_ 3221225472 LevelCtrlModeRq 1753;
BA_ "SAEDocument" SG_ 3221225472 NominalLevelRqRearAxle "J1939-71";
BA_ "SPN" SG_ 3221225472 NominalLevelRqRearAxle 1750;
BA_ "SAEDocument" SG_ 3221225472 NominalLevelRqFrontAxle "J1939-71";
BA_ "SPN" SG_ 3221225472 NominalLevelRqFrontAxle 1751;
BA_ "SAEDocument" SG_ 3221225472 KneelingCtrlModeRq "J1939-71";
BA_ "SPN" SG_ 3221225472 KneelingCtrlModeRq 1747;
BA_ "SigType" SG_ 3221225472 KneelingCtrlModeRq 5;
BA_ "SAEDocument" SG_ 3221225472 KneelingRqRightSide "J1939-71";
BA_ "SPN" SG_ 3221225472 KneelingRqRightSide 1748;
BA_ "SigType" SG_ 3221225472 KneelingRqRightSide 5;
VAL_ 3221225472 PMNTEDeficiencyAreaStatus 3 "NotAvailable" 2 "Reserved" 1 "InsideControlArea" 0 "OutsideControlArea" ;
VAL_ 3221225472 MnfcPMNTECarveOutAreaStatus 3 "NotAvailable" 2 "Reserved" 1 "InsideControlArea" 0 "OutsideControlArea" ;
VAL_ 3221225472 PMNTEControlAreaStatus 3 "NotAvailable" 2 "Reserved" 1 "InsideControlArea" 0 "OutsideControlArea" ;
VAL_ 3221225472 NOxNTEDeficiencyAreaStatus 3 "NotAvailable" 2 "Reserved" 1 "InsideControlArea" 0 "OutsideControlArea" ;
VAL_ 3221225472 MnfcNOxNTECarveOutAreaStatus 3 "NotAvailable" 2 "Reserved" 1 "InsideControlArea" 0 "OutsideControlArea" ;
VAL_ 3221225472 NOxNTEControlAreaStatus 3 "NotAvailable" 2 "Reserved" 1 "InsideControlArea" 0 "OutsideControlArea" ;
VAL_ 3221225472 BatteryMainSwitchHoldState 3 "Dont care/take no action" 2 "Reserved" 1 "Battery main switch held" 0 "Battery main switch not held" ;
VAL_ 3221225472 Joystick3XAxisDetentPosStatus 3 "Not Available" 2 "Error Indicator" 1 "In the Detent Position" 0 "Not in the Detent Position" ;
VAL_ 3221225472 Joystick3Button9PressedStatus 3 "Not Available" 2 "Error Indicator" 1 "Button pressed" 0 "Button not pressed" ;
VAL_ 3221225472 Joystick3Button10PressedStatus 3 "Not Available" 2 "Error Indicator" 1 "Button pressed" 0 "Button not pressed" ;
VAL_ 3221225472 Joystick3Button11PressedStatus 3 "Not Available" 2 "Error Indicator" 1 "Button pressed" 0 "Button not pressed" ;
VAL_ 3221225472 Joystick3Button12PressedStatus 3 "Not Available" 2 "Error Indicator" 1 "Button pressed" 0 "Button not pressed" ;
VAL_ 3221225472 Joystick3YAxisDetentPosStatus 3 "Not Available" 2 "Error Indicator" 1 "In the Detent Position" 0 "Not in the Detent Position" ;
VAL_ 3221225472 Jystck3YAxsLvrFrwrdPstvPosStatus 3 "Not Available" 2 "Error Indicator" 1 "On positive side of Neutral" 0 "Not on Positive side of Neutral" ;
VAL_ 3221225472 Jystck3YAxsLvrBckNgtivePosStatus 3 "Not Available" 2 "Error Indicator" 1 "On negative side of Neutral" 0 "Not on negative side of Neutral" ;
VAL_ 3221225472 Joystick3YAxisNeutralPosStatus 3 "Not Available" 2 "Error Indicator" 1 "In Neutral Position" 0 "Not in Neutral Position" ;
VAL_ 3221225472 Jystck3XAxsLvrRghtPstvePosStatus 3 "Not Available" 2 "Error Indicator" 1 "On positive side of Neutral" 0 "Not on Positive side of Neutral" ;
VAL_ 3221225472 Jystck3XAxsLvrLftNgtivePosStatus 3 "Not Available" 2 "Error Indicator" 1 "On negative side of Neutral" 0 "Not on negative side of Neutral" ;
VAL_ 3221225472 Joystick3XAxisNeutralPosStatus 3 "Not Available" 2 "Error Indicator" 1 "In Neutral Position" 0 "Not in Neutral Position" ;
VAL_ 3221225472 Joystick3Button5PressedStatus 3 "Not Available" 2 "Error Indicator" 1 "Button pressed" 0 "Button not pressed" ;
VAL_ 3221225472 Joystick3Button6PressedStatus 3 "Not Available" 2 "Error Indicator" 1 "Button pressed" 0 "Button not pressed" ;
VAL_ 3221225472 Joystick3Button7PressedStatus 3 "Not Available" 2 "Error Indicator" 1 "Button pressed" 0 "Button not pressed" ;
VAL_ 3221225472 Joystick3Button8PressedStatus 3 "Not Available" 2 "Error Indicator" 1 "Button pressed" 0 "Button not pressed" ;
VAL_ 3221225472 Joystick3Button1PressedStatus 3 "Not Available" 2 "Error Indicator" 1 "Button pressed" 0 "Button not pressed" ;
VAL_ 3221225472 Joystick3Button2PressedStatus 3 "Not Available" 2 "Error Indicator" 1 "Button pressed" 0 "Button not pressed" ;
VAL_ 3221225472 Joystick3Button3PressedStatus 3 "Not Available" 2 "Error Indicator" 1 "Button pressed" 0 "Button not pressed" ;
VAL_ 3221225472 Joystick3Button4PressedStatus 3 "Not Available" 2 "Error Indicator" 1 "Button pressed" 0 "Button not pressed" ;
VAL_ 3221225472 Joystick2XAxisDetentPosStatus 3 "Not Available" 2 "Error Indicator" 1 "In the Detent Position" 0 "Not in the Detent Position" ;
VAL_ 3221225472 Joystick2YAxisDetentPosStatus 3 "Not Available" 2 "Error Indicator" 1 "In the Detent Position" 0 "Not in the Detent Position" ;
VAL_ 3221225472 Jystck2YAxsLvrFrwrdPstvPosStatus 3 "Not Available" 2 "Error Indicator" 1 "On positive side of Neutral" 0 "Not on Positive side of Neutral" ;
VAL_ 3221225472 Jystck2YAxsLvrBckNgtivePosStatus 3 "Not Available" 2 "Error Indicator" 1 "On negative side of Neutral" 0 "Not on negative side of Neutral" ;
VAL_ 3221225472 Joystick2YAxisNeutralPosStatus 3 "Not Available" 2 "Error Indicator" 1 "In Neutral Position" 0 "Not in Neutral Position" ;
VAL_ 3221225472 Jystck2XAxsLvrRghtPstvePosStatus 3 "Not Available" 2 "Error Indicator" 1 "On positive side of Neutral" 0 "Not on Positive side of Neutral" ;
VAL_ 3221225472 Jystck2XAxsLvrLftNgtivePosStatus 3 "Not Available" 2 "Error Indicator" 1 "On negative side of Neutral" 0 "Not on negative side of Neutral" ;
VAL_ 3221225472 Joystick2XAxisNeutralPosStatus 3 "Not Available" 2 "Error Indicator" 1 "In Neutral Position" 0 "Not in Neutral Position" ;
VAL_ 3221225472 Joystick2Button9PressedStatus 3 "Not Available" 2 "Error Indicator" 1 "Button pressed" 0 "Button not pressed" ;
VAL_ 3221225472 Joystick2Button10PressedStatus 3 "Not Available" 2 "Error Indicator" 1 "Button pressed" 0 "Button not pressed" ;
VAL_ 3221225472 Joystick2Button11PressedStatus 3 "Not Available" 2 "Error Indicator" 1 "Button pressed" 0 "Button not pressed" ;
VAL_ 3221225472 Joystick2Button12PressedStatus 3 "Not Available" 2 "Error Indicator" 1 "Button pressed" 0 "Button not pressed" ;
VAL_ 3221225472 Joystick2Button5PressedStatus 3 "Not Available" 2 "Error Indicator" 1 "Button pressed" 0 "Button not pressed" ;
VAL_ 3221225472 Joystick2Button6PressedStatus 3 "Not Available" 2 "Error Indicator" 1 "Button pressed" 0 "Button not pressed" ;
VAL_ 3221225472 Joystick2Button7PressedStatus 3 "Not Available" 2 "Error Indicator" 1 "Button pressed" 0 "Button not pressed" ;
VAL_ 3221225472 Joystick2Button8PressedStatus 3 "Not Available" 2 "Error Indicator" 1 "Button pressed" 0 "Button not pressed" ;
VAL_ 3221225472 Joystick2Button1PressedStatus 3 "Not Available" 2 "Error Indicator" 1 "Button pressed" 0 "Button not pressed" ;
VAL_ 3221225472 Joystick2Button2PressedStatus 3 "Not Available" 2 "Error Indicator" 1 "Button pressed" 0 "Button not pressed" ;
VAL_ 3221225472 Joystick2Button3PressedStatus 3 "Not Available" 2 "Error Indicator" 1 "Button pressed" 0 "Button not pressed" ;
VAL_ 3221225472 Joystick2Button4PressedStatus 3 "Not Available" 2 "Error Indicator" 1 "Button pressed" 0 "Button not pressed" ;
VAL_ 3221225472 Joystick1XAxisDetentPosStatus 3 "Not Available" 2 "Error Indicator" 1 "In the Detent Position" 0 "Not in the Detent Position" ;
VAL_ 3221225472 Joystick1YAxisDetentPosStatus 3 "Not Available" 2 "Error Indicator" 1 "In the Detent Position" 0 "Not in the Detent Position" ;
VAL_ 3221225472 Jystck1YAxsLvrFrwrdPstvPosStatus 3 "Not Available" 2 "Error Indicator" 1 "On positive side of Neutral" 0 "Not on Positive side of Neutral" ;
VAL_ 3221225472 Jystck1YAxsLvrBckNgtivePosStatus 3 "Not Available" 2 "Error Indicator" 1 "On negative side of Neutral" 0 "Not on negative side of Neutral" ;
VAL_ 3221225472 Joystick1YAxisNeutralPosStatus 3 "Not Available" 2 "Error Indicator" 1 "In Neutral Position" 0 "Not in Neutral Position" ;
VAL_ 3221225472 Joystick1Button9PressedStatus 3 "Not Available" 2 "Error Indicator" 1 "Button pressed" 0 "Button not pressed" ;
VAL_ 3221225472 Joystick1Button10PressedStatus 3 "Not Available" 2 "Error Indicator" 1 "Button pressed" 0 "Button not pressed" ;
VAL_ 3221225472 Joystick1Button11PressedStatus 3 "Not Available" 2 "Error Indicator" 1 "Button pressed" 0 "Button not pressed" ;
VAL_ 3221225472 Joystick1Button12PressedStatus 3 "Not Available" 2 "Error Indicator" 1 "Button pressed" 0 "Button not pressed" ;
VAL_ 3221225472 Joystick1Button5PressedStatus 3 "Not Available" 2 "Error Indicator" 1 "Button pressed" 0 "Button not pressed" ;
VAL_ 3221225472 Joystick1Button6PressedStatus 3 "Not Available" 2 "Error Indicator" 1 "Button pressed" 0 "Button not pressed" ;
VAL_ 3221225472 Joystick1Button7PressedStatus 3 "Not Available" 2 "Error Indicator" 1 "Button pressed" 0 "Button not pressed" ;
VAL_ 3221225472 Joystick1Button8PressedStatus 3 "Not Available" 2 "Error Indicator" 1 "Button pressed" 0 "Button not pressed" ;
VAL_ 3221225472 Joystick1Button1PressedStatus 3 "Not Available" 2 "Error Indicator" 1 "Button pressed" 0 "Button not pressed" ;
VAL_ 3221225472 Joystick1Button2PressedStatus 3 "Not Available" 2 "Error Indicator" 1 "Button pressed" 0 "Button not pressed" ;
VAL_ 3221225472 Joystick1Button3PressedStatus 3 "Not Available" 2 "Error Indicator" 1 "Button pressed" 0 "Button not pressed" ;
VAL_ 3221225472 Joystick1Button4PressedStatus 3 "Not Available" 2 "Error Indicator" 1 "Button pressed" 0 "Button not pressed" ;
VAL_ 3221225472 Jystck1XAxsLvrRghtPstvePosStatus 3 "Not Available" 2 "Error Indicator" 1 "On positive side of Neutral" 0 "Not on Positive side of Neutral" ;
VAL_ 3221225472 Jystck1XAxsLvrLftNgtivePosStatus 3 "Not Available" 2 "Error Indicator" 1 "On negative side of Neutral" 0 "Not on negative side of Neutral" ;
VAL_ 3221225472 Joystick1XAxisNeutralPosStatus 3 "Not Available" 2 "Error Indicator" 1 "In Neutral Position" 0 "Not in Neutral Position" ;
VAL_ 3221225472 ParkingBrakeRedWarningSignal 3 "Take no action" 2 "Reserved" 1 "on" 0 "off" ;
VAL_ 3221225472 ParkBrakeReleaseInhibitStatus 3 "Unavailable" 2 "Error" 1 "ParkBrakeReleaseIsInhibited" 0 "ParkBrakeReleaseIsNotInhibited" ;
VAL_ 3221225472 ParkingBrakeActuator 3 "Not available" 2 "Error" 1 "Parking brake actuator active" 0 "Parking brake actuator inactive" ;
VAL_ 3221225472 DTCWarnLampSupportStatus 3 "Unavailable" 2 "Reserved" 1 "LampOn" 0 "LampOff" ;
VAL_ 3221225472 DTCWarnLampSupportFlash 3 "Unavailable" 2 "Reserved" 1 "FastFlash" 0 "SlowFlash" ;
VAL_ 3221225472 DTCStopLampSupportStatus 3 "Unavailable" 2 "Reserved" 1 "LampOn" 0 "LampOff" ;
VAL_ 3221225472 DTCStopLampSupportFlash 3 "Unavailable" 2 "Reserved" 1 "FastFlash" 0 "SlowFlash" ;
VAL_ 3221225472 DTCProtectLampSupportStatus 3 "Unavailable" 2 "Reserved" 1 "LampOn" 0 "LampOff" ;
VAL_ 3221225472 DTCProtectLampSupportFlash 3 "Unavailable" 2 "Reserved" 1 "FastFlash" 0 "SlowFlash" ;
VAL_ 3221225472 DTCMilSupportStatus 3 "Unavailable" 2 "ShortMI" 1 "LampOn" 0 "LampOff" ;
VAL_ 3221225472 DTCMilSupportFlash 3 "Unavailable" 2 "Class_C_DTC" 1 "FastFlash" 0 "SlowFlash" ;
VAL_ 3221225472 EngExhstGsOxygnSnsrClsdLpOprtnBn 15 "not supported" 4 "Closed loop but fault with at least one oxygen sensor  may be using single oxygen sensor for fuel control" 3 "Open loop  due to detected system fault" 2 "Open loop due to driving conditions eg power enrichment deceleration enleanment" 1 "Closed loop  using oxygen sensors as feedback for fuel control" 0 "Open loop  has not yet satisfied conditions to go closed loop" ;
VAL_ 3221225472 EngSpdSensor1TimingPatternStatus 3 "Not available" 2 "Error" 1 "OK" 0 "Not OK" ;
VAL_ 3221225472 EngSpdSensor2TimingPatternStatus 3 "Not available" 2 "Error" 1 "OK" 0 "Not OK" ;
VAL_ 3221225472 EngSpdSensor3TimingPatternStatus 3 "Not available" 2 "Error" 1 "OK" 0 "Not OK" ;
VAL_ 3221225472 EngCoolantThermostatMode 3 "dont care/reserved" 2 "reserved" 1 "position control mode used for service only" 0 "temperature control mode" ;
VAL_ 3221225472 Aftertreatment1AirEnableActuator 3 "not available" 2 "reserved for SAE assignment" 1 "active" 0 "not active" ;
VAL_ 3221225472 Aftertreatment1PurgeAirActuator 3 "not available" 2 "reserved for SAE assignment" 1 "active" 0 "not active" ;
VAL_ 3221225472 Aftrtrtmnt1AtmizationAirActuator 3 "not available" 2 "reserved for SAE assignment" 1 "active" 0 "not active" ;
VAL_ 3221225472 Aftertreatment1AirSystemRelay 3 "not available" 2 "reserved for SAE assignment" 1 "active" 0 "not active" ;
VAL_ 3221225472 Aftrtreatment1FuelEnableActuator 3 "not available" 2 "reserved for SAE assignment" 1 "active" 0 "not active" ;
VAL_ 3221225472 Aftrtreatment1RegenerationStatus 3 "not available" 2 "reserved for SAE assignment" 1 "active" 0 "not active" ;
VAL_ 3221225472 Aftertreatment1Ignt 3 "not available" 2 "reserved for SAE assignment" 1 "active" 0 "not active" ;
VAL_ 3221225472 Aftertreatment1FuelDrainActuator 3 "not available" 2 "reserved for SAE assignment" 1 "active" 0 "not active" ;
VAL_ 3221225472 Aftrtrtmnt1FlFlwDverterValveCtrl 3 "not available" 2 "reserved for SAE assignment" 1 "on" 0 "off" ;
VAL_ 3221225472 Aftertreatment1FuelPumpRelayCtrl 3 "not available" 2 "reserved for SAE assignment" 1 "on" 0 "off" ;
VAL_ 3221225472 Aftrtrtmnt1IntkGsSnsorHeaterCtrl 3 "Heater off" 2 "Preheat 1" 1 "Preheat 2" 0 "Automatic" ;
VAL_ 3221225472 Aftrtrtmnt1IntkWdRngO2RdngStable 3 "Not available" 2 "Error" 1 "Stable" 0 "Not stable" ;
VAL_ 3221225472 Aftrtrtmnt1IntkeNOxReadingStable 3 "Not available" 2 "Error" 1 "Stable" 0 "Not stable" ;
VAL_ 3221225472 Aftrtrtmnt1IntkGsSnsrPowerStatus 3 "Not available" 2 "Error" 1 "In range" 0 "Not in range" ;
VAL_ 3221225472 AntitheftComponentStatusStates 3 "Not defined" 2 "Blocked" 1 "Locked" 0 "Unlocked" ;
VAL_ 3221225472 AntthftEncryptnSdPrsentIndicator 3 "Not available" 2 "Error" 1 "Random number is present" 0 "Random number is not present" ;
VAL_ 3221225472 AntitheftModifyPwdStates 3 "Notvalid" 2 "EmptyOfPwdsThsSttIndctsThtCmpnn" 1 "FullofPwds" 0 "OkThsSttIndctsThtRqWsSccssfllyP" ;
VAL_ 3221225472 AntitheftPwdValidIndicator 3 "Not available" 2 "Error" 1 "Password is a validated password" 0 "Password is not a validated password" ;
VAL_ 3221225472 AntitheftCmdStates 5 "Login" 4 "CheckStatus" 3 "LockorUnlock" 2 "ChangePassword" 1 "DeletePassword" 0 "AddPassword" ;
VAL_ 3221225472 AntitheftDesiredExitModeStates 3 "NotAvailable" 2 "Not defined" 1 "LockWhenKeyOff" 0 "LockUponOperatorRequest" ;
VAL_ 3221225472 AntthftEncryptionIndicatorStates 3 "NotAvailable" 2 "Not defined" 1 "EncryptedCodePresent" 0 "EncryptionSeedRequest" ;
VAL_ 3221225472 ElctrncShckAbsrbrCtrlMdLft_TgAxl 3 "Not available" 2 "Error" 1 "Normal operation dampers active" 0 "Normal operation dampers passive" ;
VAL_ 3221225472 ElctrncShckAbsrbrCtrlMdeRearAxle 3 "Not available" 2 "Error" 1 "Normal operation dampers active" 0 "Normal operation dampers passive" ;
VAL_ 3221225472 ElctrncShckAbsrbrCtrlMdFrontAxle 3 "Not available" 2 "Error" 1 "Normal operation dampers active" 0 "Normal operation dampers passive" ;
VAL_ 3221225472 TestIdentifier 250 "Last Measured Scaled Results" 249 "Command Standard Test" 247 "All scaled test results" ;
VAL_ 3221225472 Aftrtrtmnt1OtltGsSnsorHeaterCtrl 3 "Heater off" 2 "Preheat 1" 1 "Preheat 2" 0 "Automatic" ;
VAL_ 3221225472 Aftrtrtmnt1OtltWdRngO2RdngStable 3 "Not available" 2 "Error" 1 "Stable" 0 "Not stable" ;
VAL_ 3221225472 Aftrtrtmnt1OtletNOxReadingStable 3 "Not available" 2 "Error" 1 "Stable" 0 "Not stable" ;
VAL_ 3221225472 Aftrtrtmnt1OutletGasSensorAtTemp 3 "Not available" 2 "Error" 1 "In range" 0 "Not in range" ;
VAL_ 3221225472 Aftrtrtmnt1OtltGsSnsrPowerStatus 3 "Not available" 2 "Error" 1 "In range" 0 "Not in range" ;
VAL_ 3221225472 Aftertreatment2AirEnableActuator 3 "not available" 2 "reserved for SAE assignment" 1 "active" 0 "not active" ;
VAL_ 3221225472 Aftertreatment2PurgeAirActuator 3 "not available" 2 "reserved for SAE assignment" 1 "active" 0 "not active" ;
VAL_ 3221225472 Aftrtrtmnt2AtmizationAirActuator 3 "not available" 2 "reserved for SAE assignment" 1 "active" 0 "not active" ;
VAL_ 3221225472 Aftertreatment2AirSystemRelay 3 "not available" 2 "reserved for SAE assignment" 1 "active" 0 "not active" ;
VAL_ 3221225472 Aftrtreatment2FuelEnableActuator 3 "not available" 2 "reserved for SAE assignment" 1 "active" 0 "not active" ;
VAL_ 3221225472 Aftrtreatment2RegenerationStatus 3 "not available" 2 "reserved for SAE assignment" 1 "active" 0 "not active" ;
VAL_ 3221225472 Aftertreatment2Ignt 3 "not available" 2 "reserved for SAE assignment" 1 "active" 0 "not active" ;
VAL_ 3221225472 Aftertreatment2FuelDrainActuator 3 "not available" 2 "reserved for SAE assignment" 1 "active" 0 "not active" ;
VAL_ 3221225472 Aftrtrtmnt2IntkGsSnsorHeaterCtrl 3 "Heater off" 2 "Preheat 1" 1 "Preheat 2" 0 "Automatic" ;
VAL_ 3221225472 Aftrtrtmnt2IntkWdRngO2RdngStable 3 "Not available" 2 "Error" 1 "Stable" 0 "Not stable" ;
VAL_ 3221225472 Aftrtrtmnt2IntkeNOxReadingStable 3 "Not available" 2 "Error" 1 "Stable" 0 "Not stable" ;
VAL_ 3221225472 Aftrtrtmnt2IntakeGasSensorAtTemp 3 "Not available" 2 "Error" 1 "In range" 0 "Not in range" ;
VAL_ 3221225472 Aftrtrtmnt2IntkGsSnsrPowerStatus 3 "Not available" 2 "Error" 1 "In range" 0 "Not in range" ;
VAL_ 3221225472 Aftrtrtmnt2OtltGsSnsorHeaterCtrl 3 "Heater off" 2 "Preheat 1" 1 "Preheat 2" 0 "Automatic" ;
VAL_ 3221225472 Aftrtrtmnt2OtltWdRngO2RdngStable 3 "Not available" 2 "Error" 1 "Stable" 0 "Not stable" ;
VAL_ 3221225472 Aftrtrtmnt2OtletNOxReadingStable 3 "Not available" 2 "Error" 1 "Stable" 0 "Not stable" ;
VAL_ 3221225472 Aftrtrtmnt2OutletGasSensorAtTemp 3 "Not available" 2 "Error" 1 "In range" 0 "Not in range" ;
VAL_ 3221225472 Aftrtrtmnt2OtltGsSnsrPowerStatus 3 "Not available" 2 "Error" 1 "In range" 0 "Not in range" ;
VAL_ 3221225472 EngEmergencyShutdownIndication 3 "Dont care / take no action" 2 "Reserved" 1 "On Shutdown Requested" 0 "Off No Shutdown Requested" ;
VAL_ 3221225472 EngControlledShutdownRq 3 "Dont care / take no action" 2 "Reserved" 1 "On Shutdown Requested" 0 "Off No Shutdown Requested" ;
VAL_ 3221225472 EngCoolantCirculatingPumpCtrl 3 "Dont care / take no action" 2 "Reserved" 1 "On" 0 "Off" ;
VAL_ 3221225472 EngBlock_CoolantPreheaterCtrl 3 "Unavailable" 2 "Reserved" 1 "On" 0 "Off" ;
VAL_ 3221225472 EngElctrclSystmPwrCnsrvationCtrl 3 "Unavailable" 2 "Reserved" 1 "On" 0 "Off" ;
VAL_ 3221225472 EngOilPreheaterCtrl 3 "Dont care / take no action" 2 "Reserved" 1 "On" 0 "Off" ;
VAL_ 3221225472 EngOilPrimingPumpCtrl 3 "unavailable" 2 "Reserved" 1 "On" 0 "Off" ;
VAL_ 3221225472 EngFuelShutoffValveLeakTestCtrl 3 "Dont care / take no action" 2 "Reserved" 1 "On test in process / test complete" 0 "Off reset / no test in process" ;
VAL_ 3221225472 EngFuelShutoff2Ctrl 3 "Dont care / take no action" 2 "Reserved" 1 "Closed no fuel supplied to engine" 0 "Open fuel supplied to engine" ;
VAL_ 3221225472 EngFuelShutoff1Ctrl 3 "Dont care / take no action" 2 "Reserved" 1 "Closed no fuel supplied to engine" 0 "Open fuel supplied to engine" ;
VAL_ 3221225472 EngFuelShutoffVentCtrl 3 "Dont care / take no action" 2 "Reserved" 1 "Open vent open" 0 "Closed vent closed" ;
VAL_ 3221225472 FuelPumpPrimerCtrl 3 "Unavailable" 2 "Reserved" 1 "Activate" 0 "Deactivate" ;
VAL_ 3221225472 PrhbitAutomaticAirSuspensionCtrl 3 "Not available" 2 "Error indicator" 1 "Request prohibit automatic air suspension control" 0 "No request" ;
VAL_ 3221225472 SpeedDependentLevelCtrlRq 3 "Dont care/take no action" 2 "Reserved" 1 "Activate" 0 "Deactivate" ;
VAL_ 3221225472 AllowLevelCtrlDuringBrakingCmd 3 "Dont care/take no action" 2 "Reserved" 1 "Allow level control during braking" 0 "Disallow level control during braking normal operation" ;
VAL_ 3221225472 ProhibitAirSuspensionCtrl 3 "Not available" 2 "Error indicator" 1 "Request prohibit air suspension control" 0 "No request" ;
VAL_ 3221225472 KneelingCmdRearAxle 3 "Dont care/take no action" 2 "Reserved" 1 "Activate kneeling" 0 "Deactivate kneeling" ;
VAL_ 3221225472 KneelingCmdFrontAxle 3 "Dont care/take no action" 2 "Reserved" 1 "Activate kneeling" 0 "Deactivate kneeling" ;
VAL_ 3221225472 LiftAxle2PosCmd 3 "Dont care/take no action" 2 "Reserved" 1 "Lift axle position up / tag axle unladen" 0 "Lift axle position down / tag axle laden" ;
VAL_ 3221225472 LiftAxle1PosCmd 3 "Dont care/take no action" 2 "Reserved" 1 "Lift axle position up / tag axle unladen" 0 "Lift axle position down / tag axle laden" ;
VAL_ 3221225472 LevelCtrlModeRq 15 "Dont care/take no action" 14 "Reserved" 9 "1101 Not defined" 8 "Exhaust bellows" 7 "Traction help  load reduce ie reduce axle load of driven axle to normal load condition" 6 "Optimum traction 2 ie the pressure at the driven axle is controlled at a fixed value 2" 5 "Optimum traction 1 ie the pressure at the driven axle is controlled at a fixed value 1" 4 "Pressure ratio 2 ie the ratio between the pressures at the driven axle and at the third axle is controlled so that" 3 "Pressure ratio 1 ie the ratio between the pressures at the driven axle and at the third axle is controlled so that" 2 "Load fixing ie the driven axle is loaded to a value defined by the driver" 1 "Traction help load transfer ie the driven axle is loaded to a maximum value given by legislation or design" 0 "Normal operation ie the system performs a pure control of the vehicle height" ;
VAL_ 3221225472 NominalLevelRqRearAxle 10 "Lower Request Continuously lowering front axle as long as active" 15 "Dont care/take no action" 14 "Reserved" 9 "Raise Request Continuously raising front axle as long as active" 8 "Stop level changeie the level change in process shall be stopped immediately" 7 "Lower Levelie the lowest level to be controlled" 6 "Upper Levelie the highest level to be controlled" 5 "Customer Levelie a level to be defined by customer via parameter setting" 4 "Preset Levelie a level to be defined externally via CAN" 3 "Normal Level 3ie a level permitted for driving for example to lift the vehicle in case of offroad" 2 "Normal Level 2ie a level permitted for driving for example to lower the vehicle in case of high speed" 1 "Normal Level 1ie the level prescribed for normal driving given by design" 0 "No level request" ;
VAL_ 3221225472 NominalLevelRqFrontAxle 10 "Lower Request Continuously lowering front axle as long as active" 15 "Dont care/take no action" 14 "Reserved" 9 "Raise Request Continuously raising front axle as long as active" 8 "Stop level changeie the level change in process shall be stopped immediately" 7 "Lower Levelie the lowest level to be controlled" 6 "Upper Levelie the highest level to be controlled" 5 "Customer Levelie a level to be defined by customer via parameter setting" 4 "Preset Levelie a level to be defined externally via CAN" 3 "Normal Level 3ie a level permitted for driving for example to lift the vehicle in case of offroad" 2 "Normal Level 2ie a level permitted for driving for example to lower the vehicle in case of high speed" 1 "Normal Level 1ie the level prescribed for normal driving given by design" 0 "No level request" ;
VAL_ 3221225472 KneelingCtrlModeRq 3 "Dont care/take no action" 2 "Reserved" 1 "Manually actuated" 0 "Automatically actuated" ;
VAL_ 3221225472 KneelingRqRightSide 3 "Dont care/take no action" 2 "Reserved" 1 "Kneeling request" 0 "No kneeling request" ;
