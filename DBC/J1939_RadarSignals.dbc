VERSION ""

NS_ :

BS_:

BU_: Turbocharger OnBoardDataLogger OffBoardDiagnosticTool2 OffBoardDiagnosticTool1 FileServer ParkingBrakeController SeatControl2 FanDriveController SteeringColumnUnit CommunicationUnitRadio CommunicationUnitSatellite CommunicationUnitCellular PropulsionBatteryCharger ChassisController2 ChassisController1 EngineValveControl AuxiliaryHeater2 AuxiliaryHeater1 ClutchUnit RampControl InformationSystem1 SuspensionSystemController2 OilSensor VehicleDynamicStability ExhaustEmissionController TransmissionDisplay2 TransmissionDisplay1 ClimateControl2 WaterPumpController RearAxleSteeringController LightingOperatorControl SeatController1 IgnitionController2 IgnitionController1 TirePressureController CabController2 CabController1 PneumaticSystemController SuspensionSystemController1 HydraulicPumpController EnduranceBrakingSystem RetarderExhaustEngine2 OnBoardDiagnosticUnit HeadwayController RetarderExhaustEngine1 CabDisplay1 ManagementComputer VirtualTerminal OffVehicleGateway PowerTakeOffFront HitchControl AuxiliaryValveControl BodyController TractorTrailerBridge1 StarterSystem ElectricalSystem VehicleSecurity VehicleNavigation AerodynamicControl ElectricalChargingSystem ClimateControl1 TripRecorder InstrumentCluster SuspensionDriveAxle2 SuspensionDriveAxle1 SuspensionSteerAxle SteeringController FuelSystem CruiseControl RetarderDriveline RetarderEngine BrakesDriveAxle2 BrakesDriveAxle1 BrakesSystemController BrakesSteerAxle AxleDrive2 AxleDrive1 AxleSteering PowerTakeOff ShiftConsoleSecondary ShiftConsolePrimary Transmission2 Transmission1 Engine2 Engine1

BO_ 3221225472 VECTOR__INDEPENDENT_SIG_MSG: 0 Vector__XXX
 SG_ Joystick9YAxisPos : 0|10@1+ (1,0) [0|102] "%" Vector__XXX
 SG_ Jystck9YAxsLvrFrwrdPstvPosStatus : 0|2@1+ (1,0) [0|3] "" Vector__XXX
 SG_ Jystck9YAxsLvrBckNgtivePosStatus : 0|2@1+ (1,0) [0|3] "" Vector__XXX
 SG_ Joystick9YAxisNeutralPosStatus : 0|2@1+ (1,0) [0|3] "" Vector__XXX
 SG_ Joystick9XAxisPos : 0|10@1+ (1,0) [0|102] "%" Vector__XXX
 SG_ Jystck9XAxsLvrRghtPstvePosStatus : 0|2@1+ (1,0) [0|3] "" Vector__XXX
 SG_ Jystck9XAxsLvrLftNgtivePosStatus : 0|2@1+ (1,0) [0|3] "" Vector__XXX
 SG_ Joystick9XAxisNeutralPosStatus : 0|2@1+ (1,0) [0|3] "" Vector__XXX
 SG_ Joystick8Button9PressedStatus : 0|2@1+ (1,0) [0|3] "" Vector__XXX
 SG_ Joystick8Button10PressedStatus : 0|2@1+ (1,0) [0|3] "" Vector__XXX
 SG_ Joystick8Button11PressedStatus : 0|2@1+ (1,0) [0|3] "" Vector__XXX
 SG_ Joystick8Button12PressedStatus : 0|2@1+ (1,0) [0|3] "" Vector__XXX
 SG_ Joystick8Button5PressedStatus : 0|2@1+ (1,0) [0|3] "" Vector__XXX
 SG_ Joystick8Button6PressedStatus : 0|2@1+ (1,0) [0|3] "" Vector__XXX
 SG_ Joystick8Button7PressedStatus : 0|2@1+ (1,0) [0|3] "" Vector__XXX
 SG_ Joystick8Button8PressedStatus : 0|2@1+ (1,0) [0|3] "" Vector__XXX
 SG_ Joystick8Button1PressedStatus : 0|2@1+ (1,0) [0|3] "" Vector__XXX
 SG_ Joystick8Button2PressedStatus : 0|2@1+ (1,0) [0|3] "" Vector__XXX
 SG_ Joystick8Button3PressedStatus : 0|2@1+ (1,0) [0|3] "" Vector__XXX
 SG_ Joystick8Button4PressedStatus : 0|2@1+ (1,0) [0|3] "" Vector__XXX
 SG_ Joystick8XAxisDetentPosStatus : 0|2@1+ (1,0) [0|3] "" Vector__XXX
 SG_ Joystick8YAxisDetentPosStatus : 0|2@1+ (1,0) [0|3] "" Vector__XXX
 SG_ Joystick8YAxisPos : 0|10@1+ (1,0) [0|102] "%" Vector__XXX
 SG_ Jystck8YAxsLvrFrwrdPstvPosStatus : 0|2@1+ (1,0) [0|3] "" Vector__XXX
 SG_ Jystck8YAxsLvrBckNgtivePosStatus : 0|2@1+ (1,0) [0|3] "" Vector__XXX
 SG_ Joystick8YAxisNeutralPosStatus : 0|2@1+ (1,0) [0|3] "" Vector__XXX
 SG_ Joystick8XAxisPos : 0|10@1+ (1,0) [0|102] "%" Vector__XXX
 SG_ Jystck8XAxsLvrRghtPstvePosStatus : 0|2@1+ (1,0) [0|3] "" Vector__XXX
 SG_ Jystck8XAxsLvrLftNgtivePosStatus : 0|2@1+ (1,0) [0|3] "" Vector__XXX
 SG_ Joystick8XAxisNeutralPosStatus : 0|2@1+ (1,0) [0|3] "" Vector__XXX
 SG_ Joystick7Button9PressedStatus : 0|2@1+ (1,0) [0|3] "" Vector__XXX
 SG_ Joystick7Button10PressedStatus : 0|2@1+ (1,0) [0|3] "" Vector__XXX
 SG_ Joystick7Button11PressedStatus : 0|2@1+ (1,0) [0|3] "" Vector__XXX
 SG_ Joystick7Button12PressedStatus : 0|2@1+ (1,0) [0|3] "" Vector__XXX
 SG_ Joystick7Button5PressedStatus : 0|2@1+ (1,0) [0|3] "" Vector__XXX
 SG_ Joystick7Button6PressedStatus : 0|2@1+ (1,0) [0|3] "" Vector__XXX
 SG_ Joystick7Button7PressedStatus : 0|2@1+ (1,0) [0|3] "" Vector__XXX
 SG_ Joystick7Button8PressedStatus : 0|2@1+ (1,0) [0|3] "" Vector__XXX
 SG_ Joystick7Button1PressedStatus : 0|2@1+ (1,0) [0|3] "" Vector__XXX
 SG_ Joystick7Button2PressedStatus : 0|2@1+ (1,0) [0|3] "" Vector__XXX
 SG_ Joystick7Button3PressedStatus : 0|2@1+ (1,0) [0|3] "" Vector__XXX
 SG_ Joystick7Button4PressedStatus : 0|2@1+ (1,0) [0|3] "" Vector__XXX
 SG_ Joystick7XAxisDetentPosStatus : 0|2@1+ (1,0) [0|3] "" Vector__XXX
 SG_ Joystick7YAxisDetentPosStatus : 0|2@1+ (1,0) [0|3] "" Vector__XXX
 SG_ Joystick7YAxisPos : 0|10@1+ (1,0) [0|102] "%" Vector__XXX
 SG_ Jystck7YAxsLvrFrwrdPstvPosStatus : 0|2@1+ (1,0) [0|3] "" Vector__XXX
 SG_ Jystck7YAxsLvrBckNgtivePosStatus : 0|2@1+ (1,0) [0|3] "" Vector__XXX
 SG_ Joystick7YAxisNeutralPosStatus : 0|2@1+ (1,0) [0|3] "" Vector__XXX
 SG_ Joystick7XAxisPos : 0|10@1+ (1,0) [0|102] "%" Vector__XXX
 SG_ Jystck7XAxsLvrRghtPstvePosStatus : 0|2@1+ (1,0) [0|3] "" Vector__XXX
 SG_ Jystck7XAxsLvrLftNgtivePosStatus : 0|2@1+ (1,0) [0|3] "" Vector__XXX
 SG_ Joystick7XAxisNeutralPosStatus : 0|2@1+ (1,0) [0|3] "" Vector__XXX
 SG_ Joystick6Button9PressedStatus : 0|2@1+ (1,0) [0|3] "" Vector__XXX
 SG_ Joystick6Button10PressedStatus : 0|2@1+ (1,0) [0|3] "" Vector__XXX
 SG_ Joystick6Button11PressedStatus : 0|2@1+ (1,0) [0|3] "" Vector__XXX
 SG_ Joystick6Button12PressedStatus : 0|2@1+ (1,0) [0|3] "" Vector__XXX
 SG_ Joystick6Button5PressedStatus : 0|2@1+ (1,0) [0|3] "" Vector__XXX
 SG_ Joystick6Button6PressedStatus : 0|2@1+ (1,0) [0|3] "" Vector__XXX
 SG_ Joystick6Button7PressedStatus : 0|2@1+ (1,0) [0|3] "" Vector__XXX
 SG_ Joystick6Button8PressedStatus : 0|2@1+ (1,0) [0|3] "" Vector__XXX
 SG_ Joystick6Button1PressedStatus : 0|2@1+ (1,0) [0|3] "" Vector__XXX
 SG_ Joystick6Button2PressedStatus : 0|2@1+ (1,0) [0|3] "" Vector__XXX
 SG_ Joystick6Button3PressedStatus : 0|2@1+ (1,0) [0|3] "" Vector__XXX
 SG_ Joystick6Button4PressedStatus : 0|2@1+ (1,0) [0|3] "" Vector__XXX
 SG_ Joystick6XAxisDetentPosStatus : 0|2@1+ (1,0) [0|3] "" Vector__XXX
 SG_ Joystick6YAxisDetentPosStatus : 0|2@1+ (1,0) [0|3] "" Vector__XXX
 SG_ Joystick6YAxisPos : 0|10@1+ (1,0) [0|102] "%" Vector__XXX
 SG_ Jystck6YAxsLvrFrwrdPstvPosStatus : 0|2@1+ (1,0) [0|3] "" Vector__XXX
 SG_ Jystck6YAxsLvrBckNgtivePosStatus : 0|2@1+ (1,0) [0|3] "" Vector__XXX
 SG_ Joystick6YAxisNeutralPosStatus : 0|2@1+ (1,0) [0|3] "" Vector__XXX
 SG_ Joystick6XAxisPos : 0|10@1+ (1,0) [0|102] "%" Vector__XXX
 SG_ Jystck6XAxsLvrRghtPstvePosStatus : 0|2@1+ (1,0) [0|3] "" Vector__XXX
 SG_ Jystck6XAxsLvrLftNgtivePosStatus : 0|2@1+ (1,0) [0|3] "" Vector__XXX
 SG_ Joystick6XAxisNeutralPosStatus : 0|2@1+ (1,0) [0|3] "" Vector__XXX
 SG_ Joystick5Button9PressedStatus : 0|2@1+ (1,0) [0|3] "" Vector__XXX
 SG_ Joystick5Button10PressedStatus : 0|2@1+ (1,0) [0|3] "" Vector__XXX
 SG_ Joystick5Button11PressedStatus : 0|2@1+ (1,0) [0|3] "" Vector__XXX
 SG_ Joystick5Button12PressedStatus : 0|2@1+ (1,0) [0|3] "" Vector__XXX
 SG_ Joystick5Button5PressedStatus : 0|2@1+ (1,0) [0|3] "" Vector__XXX
 SG_ Joystick5Button6PressedStatus : 0|2@1+ (1,0) [0|3] "" Vector__XXX
 SG_ Joystick5Button7PressedStatus : 0|2@1+ (1,0) [0|3] "" Vector__XXX
 SG_ Joystick5Button8PressedStatus : 0|2@1+ (1,0) [0|3] "" Vector__XXX
 SG_ Joystick5Button1PressedStatus : 0|2@1+ (1,0) [0|3] "" Vector__XXX
 SG_ Joystick5Button2PressedStatus : 0|2@1+ (1,0) [0|3] "" Vector__XXX
 SG_ Joystick5Button3PressedStatus : 0|2@1+ (1,0) [0|3] "" Vector__XXX
 SG_ Joystick5Button4PressedStatus : 0|2@1+ (1,0) [0|3] "" Vector__XXX
 SG_ Joystick5XAxisDetentPosStatus : 0|2@1+ (1,0) [0|3] "" Vector__XXX
 SG_ Joystick5YAxisDetentPosStatus : 0|2@1+ (1,0) [0|3] "" Vector__XXX
 SG_ Joystick5YAxisPos : 0|10@1+ (1,0) [0|102] "%" Vector__XXX
 SG_ Jystck5YAxsLvrFrwrdPstvPosStatus : 0|2@1+ (1,0) [0|3] "" Vector__XXX
 SG_ Jystck5YAxsLvrBckNgtivePosStatus : 0|2@1+ (1,0) [0|3] "" Vector__XXX
 SG_ Joystick5YAxisNeutralPosStatus : 0|2@1+ (1,0) [0|3] "" Vector__XXX
 SG_ Joystick5XAxisPos : 0|10@1+ (1,0) [0|102] "%" Vector__XXX
 SG_ Jystck5XAxsLvrRghtPstvePosStatus : 0|2@1+ (1,0) [0|3] "" Vector__XXX
 SG_ Jystck5XAxsLvrLftNgtivePosStatus : 0|2@1+ (1,0) [0|3] "" Vector__XXX
 SG_ Joystick5XAxisNeutralPosStatus : 0|2@1+ (1,0) [0|3] "" Vector__XXX
 SG_ Joystick4Button9PressedStatus : 0|2@1+ (1,0) [0|3] "" Vector__XXX
 SG_ Joystick4Button10PressedStatus : 0|2@1+ (1,0) [0|3] "" Vector__XXX
 SG_ Joystick4Button11PressedStatus : 0|2@1+ (1,0) [0|3] "" Vector__XXX
 SG_ Joystick4Button12PressedStatus : 0|2@1+ (1,0) [0|3] "" Vector__XXX
 SG_ Joystick4Button5PressedStatus : 0|2@1+ (1,0) [0|3] "" Vector__XXX
 SG_ Joystick4Button6PressedStatus : 0|2@1+ (1,0) [0|3] "" Vector__XXX
 SG_ Joystick4Button7PressedStatus : 0|2@1+ (1,0) [0|3] "" Vector__XXX
 SG_ Joystick4Button8PressedStatus : 0|2@1+ (1,0) [0|3] "" Vector__XXX
 SG_ Joystick4Button1PressedStatus : 0|2@1+ (1,0) [0|3] "" Vector__XXX
 SG_ Joystick4Button2PressedStatus : 0|2@1+ (1,0) [0|3] "" Vector__XXX
 SG_ Joystick4Button3PressedStatus : 0|2@1+ (1,0) [0|3] "" Vector__XXX
 SG_ Joystick4Button4PressedStatus : 0|2@1+ (1,0) [0|3] "" Vector__XXX
 SG_ Joystick4XAxisDetentPosStatus : 0|2@1+ (1,0) [0|3] "" Vector__XXX
 SG_ Joystick4YAxisDetentPosStatus : 0|2@1+ (1,0) [0|3] "" Vector__XXX
 SG_ Joystick4YAxisPos : 0|10@1+ (1,0) [0|102] "%" Vector__XXX
 SG_ Jystck4YAxsLvrFrwrdPstvPosStatus : 0|2@1+ (1,0) [0|3] "" Vector__XXX
 SG_ Jystck4YAxsLvrBckNgtivePosStatus : 0|2@1+ (1,0) [0|3] "" Vector__XXX
 SG_ Joystick4YAxisNeutralPosStatus : 0|2@1+ (1,0) [0|3] "" Vector__XXX
 SG_ Joystick4XAxisPos : 0|10@1+ (1,0) [0|102] "%" Vector__XXX
 SG_ Jystck4XAxsLvrRghtPstvePosStatus : 0|2@1+ (1,0) [0|3] "" Vector__XXX
 SG_ Jystck4XAxsLvrLftNgtivePosStatus : 0|2@1+ (1,0) [0|3] "" Vector__XXX
 SG_ Joystick4XAxisNeutralPosStatus : 0|2@1+ (1,0) [0|3] "" Vector__XXX
 SG_ Joystick10Button9PressedStatus : 0|2@1+ (1,0) [0|3] "" Vector__XXX
 SG_ Joystick10Button10PressedStatus : 0|2@1+ (1,0) [0|3] "" Vector__XXX
 SG_ Joystick10Button11PressedStatus : 0|2@1+ (1,0) [0|3] "" Vector__XXX
 SG_ Joystick10Button12PressedStatus : 0|2@1+ (1,0) [0|3] "" Vector__XXX
 SG_ Joystick10Button5PressedStatus : 0|2@1+ (1,0) [0|3] "" Vector__XXX
 SG_ Joystick10Button6PressedStatus : 0|2@1+ (1,0) [0|3] "" Vector__XXX
 SG_ Joystick10Button7PressedStatus : 0|2@1+ (1,0) [0|3] "" Vector__XXX
 SG_ Joystick10Button8PressedStatus : 0|2@1+ (1,0) [0|3] "" Vector__XXX
 SG_ Joystick10Button1PressedStatus : 0|2@1+ (1,0) [0|3] "" Vector__XXX
 SG_ Joystick10Button2PressedStatus : 0|2@1+ (1,0) [0|3] "" Vector__XXX
 SG_ Joystick10Button3PressedStatus : 0|2@1+ (1,0) [0|3] "" Vector__XXX
 SG_ Joystick10Button4PressedStatus : 0|2@1+ (1,0) [0|3] "" Vector__XXX
 SG_ Joystick10XAxisDetentPosStatus : 0|2@1+ (1,0) [0|3] "" Vector__XXX
 SG_ Joystick10YAxisDetentPosStatus : 0|2@1+ (1,0) [0|3] "" Vector__XXX
 SG_ Joystick10YAxisPos : 0|10@1+ (1,0) [0|102] "%" Vector__XXX
 SG_ Jystck10YAxsLvrFrwrdPstvPsStatus : 0|2@1+ (1,0) [0|3] "" Vector__XXX
 SG_ Jystck10YAxsLvrBckNgtvePosStatus : 0|2@1+ (1,0) [0|3] "" Vector__XXX
 SG_ Joystick10YAxisNeutralPosStatus : 0|2@1+ (1,0) [0|3] "" Vector__XXX
 SG_ Joystick10XAxisPos : 0|10@1+ (1,0) [0|102] "%" Vector__XXX
 SG_ Jystck10XAxsLvrRghtPstvPosStatus : 0|2@1+ (1,0) [0|3] "" Vector__XXX
 SG_ Jystck10XAxsLvrLftNgtvePosStatus : 0|2@1+ (1,0) [0|3] "" Vector__XXX
 SG_ Joystick10XAxisNeutralPosStatus : 0|2@1+ (1,0) [0|3] "" Vector__XXX
 SG_ PssngrArbgDctivationSwitchStatus : 0|2@1+ (1,0) [0|3] "" Vector__XXX
 SG_ Beltlock10Status : 0|2@1+ (1,0) [0|3] "" Vector__XXX
 SG_ Beltlock9Status : 0|2@1+ (1,0) [0|3] "" Vector__XXX
 SG_ Beltlock8Status : 0|2@1+ (1,0) [0|3] "" Vector__XXX
 SG_ Beltlock7Status : 0|2@1+ (1,0) [0|3] "" Vector__XXX
 SG_ Beltlock6Status : 0|2@1+ (1,0) [0|3] "" Vector__XXX
 SG_ Beltlock5Status : 0|2@1+ (1,0) [0|3] "" Vector__XXX
 SG_ Beltlock4Status : 0|2@1+ (1,0) [0|3] "" Vector__XXX
 SG_ Beltlock3Status : 0|2@1+ (1,0) [0|3] "" Vector__XXX
 SG_ PassengerBeltlockStatus : 0|2@1+ (1,0) [0|3] "" Vector__XXX
 SG_ DriverBeltlockStatus : 0|2@1+ (1,0) [0|3] "" Vector__XXX
 SG_ BatteryCharger2OutputCurrent : 0|16@1+ (0.05,-1600) [-1600|1612.75] "A" Vector__XXX
 SG_ BatteryCharger2OutputVoltage : 0|16@1+ (0.05,0) [0|3212.75] "V" Vector__XXX
 SG_ BatteryCharger2PowerLineState : 0|2@1+ (1,0) [0|3] "" Vector__XXX
 SG_ BatteryCharger2State : 0|4@1+ (1,0) [0|15] "" Vector__XXX
 SG_ BatteryCharger1OutputCurrent : 0|16@1+ (0.05,-1600) [-1600|1612.75] "A" Vector__XXX
 SG_ BatteryCharger1OutputVoltage : 0|16@1+ (0.05,0) [0|3212.75] "V" Vector__XXX
 SG_ BatteryCharger1PowerLineState : 0|2@1+ (1,0) [0|3] "" Vector__XXX
 SG_ BatteryCharger1State : 0|4@1+ (1,0) [0|15] "" Vector__XXX
 SG_ Aftrtrtmnt2ThrWyCtlystDffGasTemp : 0|16@1+ (0.03125,-273) [-273|1734.96875] "deg C" Vector__XXX
 SG_ Aftrtrtmnt1ThrWyCtlystDffGasTemp : 0|16@1+ (0.03125,-273) [-273|1734.96875] "deg C" Vector__XXX
 SG_ Aftrtrtmnt2GsOxdtnCtlystDffGsTmp : 0|16@1+ (0.03125,-273) [-273|1734.96875] "deg C" Vector__XXX
 SG_ Aftrtrtmnt1GsOxdtnCtlystDffGsTmp : 0|16@1+ (0.03125,-273) [-273|1734.96875] "deg C" Vector__XXX
 SG_ Aftrtrtmnt2WrmUpDslOxdtnCtlystOt : 0|16@1+ (0.03125,-273) [-273|1734.96875] "deg C" Vector__XXX
 SG_ Aftrtrtmnt2WrmUpDslOxdtnCtlystIn : 0|16@1+ (0.03125,-273) [-273|1734.96875] "deg C" Vector__XXX
 SG_ Aftrtrtmnt2ThrWyCtlytcCnvrtrDffP : 0|5@1+ (1,0) [0|31] "" Vector__XXX
 SG_ Aftrtrtmnt2ThrWyCtlytcCnvrtrOtlt : 0|5@1+ (1,0) [0|31] "" Vector__XXX
 SG_ Aftrtrtmnt2ThrWyCtlytcCnvrtrIntk : 0|5@1+ (1,0) [0|31] "" Vector__XXX
 SG_ Aftrtrtmnt2ThrWyCtlytcCnvrtrDffP : 0|16@1+ (0.1,0) [0|6425.5] "kPa" Vector__XXX
 SG_ Aftrtrtmnt2ThrWyCtlytcCnvrtrOtlt : 0|16@1+ (0.03125,-273) [-273|1734.96875] "deg C" Vector__XXX
 SG_ Aftrtrtmnt2ThrWyCtlytcCnvrtrIntk : 0|16@1+ (0.03125,-273) [-273|1734.96875] "deg C" Vector__XXX
 SG_ Aftrtrtmnt2OtltGsNOxSnsrNH3Crrct : 0|8@1+ (0.5,0) [0|125] "%" Vector__XXX
 SG_ Aftrtrtmnt2OtltGsNOxSnsrNO2Crrct : 0|8@1+ (0.5,0) [0|125] "%" Vector__XXX
 SG_ Aftrtrtmnt2OtltGsNOxSnsrCrrctnOf : 0|8@1+ (0.5,0) [0|125] "%/bar" Vector__XXX
 SG_ Aftrtrtmnt2OtltGsNOxSnsrCrrctnOf : 0|8@1+ (0.5,0) [0|125] "%/bar" Vector__XXX
 SG_ Aftrtrtmnt2OtltGsNOxSnsrNwPrtDvt : 0|8@1+ (1,-125) [-125|125] "ppm" Vector__XXX
 SG_ Aftrtrtmnt2OtltGsNOxSnsrNwPrtDvt : 0|16@1+ (0.003112598241382,-100) [-100|100] "%" Vector__XXX
 SG_ Aftrtrtmnt2OtltGsNOxSnsrHtrRatio : 0|16@1+ (0.001,0) [0|64.255] "" Vector__XXX
 SG_ Aftrtrtmnt2IntkGsNOxSnsrNH3Crrct : 0|8@1+ (0.5,0) [0|125] "%" Vector__XXX
 SG_ Aftrtrtmnt2IntkGsNOxSnsrNO2Crrct : 0|8@1+ (0.5,0) [0|125] "%" Vector__XXX
 SG_ Aftrtrtmnt2IntkGsNOxSnsrCrrctnOf : 0|8@1+ (0.5,0) [0|125] "%/bar" Vector__XXX
 SG_ Aftrtrtmnt2IntkGsNOxSnsrCrrctnOf : 0|8@1+ (0.5,0) [0|125] "%/bar" Vector__XXX
 SG_ Aftrtrtmnt2IntkGsNOxSnsrNwPrtDvt : 0|8@1+ (1,-125) [-125|125] "ppm" Vector__XXX
 SG_ Aftrtrtmnt2IntkGsNOxSnsrNwPrtDvt : 0|16@1+ (0.003112598241382,-100) [-100|100] "%" Vector__XXX
 SG_ Aftrtrtmnt2IntkGsNOxSnsrHtrRatio : 0|16@1+ (0.001,0) [0|64.255] "" Vector__XXX
 SG_ Aftertreatment2FuelPress2Ctrl : 0|16@1+ (1,0) [0|160.6375] "%" Vector__XXX
 SG_ Aftrtrtmnt2FlFlwDverterValveCtrl : 0|2@1+ (1,0) [0|3] "" Vector__XXX
 SG_ Aftertreatment2FuelPumpRelayCtrl : 0|2@1+ (1,0) [0|3] "" Vector__XXX
 SG_ Aftertreatment2FuelPress2 : 0|16@1+ (0.1,0) [0|6425.5] "kPa" Vector__XXX
 SG_ Aftrtrtmnt2DslPrtcltFltrStStndrd : 0|16@1+ (1,0) [0|160.6375] "%" Vector__XXX
 SG_ Aftrtrtmnt2DslPrtcltFltrStMnClbO : 0|16@1+ (1,0) [0|160.6375] "%" Vector__XXX
 SG_ Aftrtrtmnt1WrmUpDslOxdtnCtlystOt : 0|16@1+ (0.03125,-273) [-273|1734.96875] "deg C" Vector__XXX
 SG_ Aftrtrtmnt1WrmUpDslOxdtnCtlystIn : 0|16@1+ (0.03125,-273) [-273|1734.96875] "deg C" Vector__XXX
 SG_ Aftrtrtmnt1ThrWyCtlytcCnvrtrDffP : 0|5@1+ (1,0) [0|31] "" Vector__XXX
 SG_ Aftrtrtmnt1ThrWyCtlytcCnvrtrOtlt : 0|5@1+ (1,0) [0|31] "" Vector__XXX
 SG_ Aftrtrtmnt1ThrWyCtlytcCnvrtrIntk : 0|5@1+ (1,0) [0|31] "" Vector__XXX
 SG_ Aftrtrtmnt1ThrWyCtlytcCnvrtrDffP : 0|16@1+ (0.1,0) [0|6425.5] "kPa" Vector__XXX
 SG_ Aftrtrtmnt1ThrWyCtlytcCnvrtrOtlt : 0|16@1+ (0.03125,-273) [-273|1734.96875] "deg C" Vector__XXX
 SG_ Aftrtrtmnt1ThrWyCtlytcCnvrtrIntk : 0|16@1+ (0.03125,-273) [-273|1734.96875] "deg C" Vector__XXX
 SG_ Aftrtrtmnt1SCRCtlystRgntTnk1HtrP : 0|5@1+ (1,0) [0|31] "" Vector__XXX
 SG_ AftrtrtmntSCROprtrIndcmntSverity : 0|3@1+ (1,0) [0|7] "" Vector__XXX
 SG_ Aftrtrtmnt1SCRCtlystRgntTnk1TmpP : 0|5@1+ (1,0) [0|31] "" Vector__XXX
 SG_ Aftrtrtmnt1DEFTnkLwLvelIndicator : 0|3@1+ (1,0) [0|7] "" Vector__XXX
 SG_ Aftrtrtmnt1SCRCtlystTnkLvlPrlmnr : 0|5@1+ (1,0) [0|31] "" Vector__XXX
 SG_ Aftrtrtmnt1SCRCatalystTankLevel2 : 0|16@1+ (0.1,0) [0|6425.5] "mm" Vector__XXX
 SG_ Aftrtratment1SCRCatalystTankTemp : 0|8@1+ (1,-40) [-40|210] "deg C" Vector__XXX
 SG_ Aftrtrtment1SCRCatalystTankLevel : 0|8@1+ (0.4,0) [0|100] "%" Vector__XXX
 SG_ Aftrtrtmnt1SCRCtalystTankHeater : 0|8@1+ (0.4,0) [0|100] "%" Vector__XXX
 SG_ Aftrtrtmnt1OtltGsNOxSnsrNH3Crrct : 0|8@1+ (0.5,0) [0|125] "%" Vector__XXX
 SG_ Aftrtrtmnt1OtltGsNOxSnsrNO2Crrct : 0|8@1+ (0.5,0) [0|125] "%" Vector__XXX
 SG_ Aftrtrtmnt1OtltGsNOxSnsrCrrctnOf : 0|8@1+ (0.5,0) [0|125] "%/bar" Vector__XXX
 SG_ Aftrtrtmnt1OtltGsNOxSnsrCrrctnOf : 0|8@1+ (0.5,0) [0|125] "%/bar" Vector__XXX
 SG_ Aftrtrtmnt1OtltGsNOxSnsrNwPrtDvt : 0|8@1+ (1,-125) [-125|125] "ppm" Vector__XXX
 SG_ Aftrtrtmnt1OtltGsNOxSnsrNwPrtDvt : 0|16@1+ (0.003112598241382,-100) [-100|100] "%" Vector__XXX
 SG_ Aftrtrtmnt1OtltGsNOxSnsrHtrRatio : 0|16@1+ (0.001,0) [0|64.255] "" Vector__XXX
 SG_ Aftrtrtmnt1IntkGsNOxSnsrNH3Crrct : 0|8@1+ (0.5,0) [0|125] "%" Vector__XXX
 SG_ Aftrtrtmnt1IntkGsNOxSnsrNO2Crrct : 0|8@1+ (0.5,0) [0|125] "%" Vector__XXX
 SG_ Aftrtrtmnt1IntkGsNOxSnsrCrrctnOf : 0|8@1+ (0.5,0) [0|125] "%/bar" Vector__XXX
 SG_ Aftrtrtmnt1IntkGsNOxSnsrCrrctnOf : 0|8@1+ (0.5,0) [0|125] "%/bar" Vector__XXX
 SG_ Aftrtrtmnt1IntkGsNOxSnsrNwPrtDvt : 0|8@1+ (1,-125) [-125|125] "ppm" Vector__XXX
 SG_ Aftrtrtmnt1IntkGsNOxSnsrNwPrtDvt : 0|16@1+ (0.003112598241382,-100) [-100|100] "%" Vector__XXX
 SG_ Aftrtrtmnt1IntkGsNOxSnsrHtrRatio : 0|16@1+ (0.001,0) [0|64.255] "" Vector__XXX
 SG_ Aftrtrtmnt1DslPrtcltFltrStStndrd : 0|16@1+ (1,0) [0|160.6375] "%" Vector__XXX
 SG_ Aftrtrtmnt1DslPrtcltFltrStMnClbO : 0|16@1+ (1,0) [0|160.6375] "%" Vector__XXX
 SG_ ArmrestSwitchMatrix2Switch2 : 0|2@1+ (1,0) [0|3] "" Vector__XXX
 SG_ ArmrestSwitchMatrix2Switch1 : 0|2@1+ (1,0) [0|3] "" Vector__XXX
 SG_ ArmrestSwitchMatrixSwitch2 : 0|2@1+ (1,0) [0|3] "" Vector__XXX
 SG_ ArmrestSwitchMatrixSwitch1 : 0|2@1+ (1,0) [0|3] "" Vector__XXX
 SG_ AngularRateMeasurementLatency : 0|8@1+ (0.5,0) [0|125] "ms" Vector__XXX
 SG_ YawRateExRangeFigureOfMerit : 0|2@1+ (1,0) [0|3] "" Vector__XXX
 SG_ RollRateExRangeFigureOfMerit : 0|2@1+ (1,0) [0|3] "" Vector__XXX
 SG_ PitchRateExRangeFigureOfMerit : 0|2@1+ (1,0) [0|3] "" Vector__XXX
 SG_ YawRateExRange : 0|16@1+ (0.0077969340907322,-250) [-250|250.992] "deg/sec" Vector__XXX
 SG_ RollRateExRange : 0|16@1+ (0.0077969340907322,-250) [-250|250.992] "deg/sec" Vector__XXX
 SG_ PitchRateExRange : 0|16@1+ (0.0077969340907322,-250) [-250|250.992] "deg/sec" Vector__XXX
 SG_ Aftrtrtmnt2NOxAdsrbrDSOxRgnrtnSt : 0|2@1+ (1,0) [0|3] "" Vector__XXX
 SG_ Aftrtrtmnt2NOxAdsrbrDNOxRgnrtnSt : 0|2@1+ (1,0) [0|3] "" Vector__XXX
 SG_ Aftrtrtmnt1NOxAdsrbrDSOxRgnrtnSt : 0|2@1+ (1,0) [0|3] "" Vector__XXX
 SG_ Aftrtrtmnt1NOxAdsrbrDNOxRgnrtnSt : 0|2@1+ (1,0) [0|3] "" Vector__XXX
 SG_ Aftrtrtmnt2SCRCtlystCnvrsnEffcnc : 0|8@1+ (0.4,0) [0|100] "%" Vector__XXX
 SG_ Aftrtrtmnt2SCRCmmnddCtlystRgntCn : 0|16@1+ (1,0) [0|3212.75] "L/h" Vector__XXX
 SG_ Aftrtrtmnt2SCRAvrgCtlystRgntCnsm : 0|16@1+ (0.05,0) [0|3212.75] "L/h" Vector__XXX
 SG_ Aftrtrtmnt2SCRCtlystRgntTnk2HtrP : 0|5@1+ (1,0) [0|31] "" Vector__XXX
 SG_ Aftrtrtmnt2SCRCtlystRgntTnk2Hter : 0|4@1+ (1,0) [0|15] "" Vector__XXX
 SG_ Aftrtrtmnt2SCRRgntTnk2TmpPrlmnry : 0|5@1+ (1,0) [0|31] "" Vector__XXX
 SG_ Aftrtrtmnt2SCRCtlystRgntTnk2LvlP : 0|5@1+ (1,0) [0|31] "" Vector__XXX
 SG_ Aftrtrtmnt2SCRCtlystRgntTnk2Lvl2 : 0|16@1+ (1,0) [0|6425.5] "mm" Vector__XXX
 SG_ Aftrtrtmnt2SCRCtlystRgntTnk2Temp : 0|8@1+ (1,-40) [-40|210] "deg C" Vector__XXX
 SG_ Aftrtrtmnt2SCRCtlystRgntTnk2Lvel : 0|8@1+ (0.4,0) [0|100] "%" Vector__XXX
 SG_ Aftrtrtmnt2SCRCtlystRgntTnk1HtrP : 0|5@1+ (1,0) [0|31] "" Vector__XXX
 SG_ Aftrtrtmnt2SCRCtalystTankHeater : 0|8@1+ (0.4,0) [0|100] "%" Vector__XXX
 SG_ Aftrtrtmnt2SCRCtlystRgntTnk1TmpP : 0|5@1+ (1,0) [0|31] "" Vector__XXX
 SG_ Aftrtrtmnt2SCRCtlystTnkLvlPrlmnr : 0|5@1+ (1,0) [0|31] "" Vector__XXX
 SG_ Aftrtrtmnt2SCRCatalystTankLevel2 : 0|16@1+ (0.1,0) [0|6425.5] "mm" Vector__XXX
 SG_ Aftrtratment2SCRCatalystTankTemp : 0|8@1+ (1,-40) [-40|210] "deg C" Vector__XXX
 SG_ Aftrtrtment2SCRCatalystTankLevel : 0|8@1+ (0.4,0) [0|100] "%" Vector__XXX
 SG_ Aftrtrtmnt2SCRCtlystRgntTnkDrnVl : 0|8@1+ (1,0) [0|100] "%" Vector__XXX
 SG_ Aftrtrtmnt2SCRCtlystRgntPmpState : 0|2@1+ (1,0) [0|3] "" Vector__XXX
 SG_ Aftrtrtmnt2SCRCtlystRgntTnkFllVl : 0|8@1+ (1,0) [0|100] "%" Vector__XXX
 SG_ Aftrtrtmnt2SCRCtlystRgntRtrnVlve : 0|8@1+ (1,0) [0|100] "%" Vector__XXX
 SG_ Aftrtrtmnt2SCRCtlystRgntPmpDrvPr : 0|8@1+ (1,0) [0|100] "%" Vector__XXX
 SG_ Aftrtrtmnt2SCRCtlystRgntPmpMtrSp : 0|16@1+ (0.5,0) [0|32127.5] "rpm" Vector__XXX
 SG_ Aftrtrtmnt2SCRCtalystReagentType : 0|4@1+ (1,0) [0|15] "" Vector__XXX
 SG_ Aftrtrtmnt2SCRCtlystRgntPrprtsPr : 0|5@1+ (1,0) [0|31] "" Vector__XXX
 SG_ Aftrtrtmnt2SCRCtlystRgntTmp2Prlm : 0|5@1+ (1,0) [0|31] "" Vector__XXX
 SG_ Aftrtrtmnt2SCRCtlystRgntCndctvty : 0|8@1+ (5,0) [0|1250] "microSiemens/mm" Vector__XXX
 SG_ Aftrtrtmnt2SCRCtlystRgntCncntrtn : 0|8@1+ (0.25,0) [0|62.5] "%" Vector__XXX
 SG_ Aftrtrtmnt2SCRCtlystReagentTemp2 : 0|8@1+ (1,-40) [-40|210] "deg C" Vector__XXX
 SG_ Aftrtrtmnt2SCRCtlystOtltGsTmpPrl : 0|5@1+ (1,0) [0|31] "" Vector__XXX
 SG_ Aftrtrtmnt2SCRCtlystOtletGasTemp : 0|16@1+ (0.03125,-273) [-273|1734.96875] "deg C" Vector__XXX
 SG_ Aftrtrtmnt2SCRCtlystIntkGsTmpPrl : 0|5@1+ (1,0) [0|31] "" Vector__XXX
 SG_ Aftrtrtmnt2SCRCtlystIntkeGasTemp : 0|16@1+ (0.03125,-273) [-273|1734.96875] "deg C" Vector__XXX
 SG_ Aftrtrtmnt2SCRCtlystExhstGsDffPr : 0|5@1+ (1,0) [0|31] "" Vector__XXX
 SG_ Aftrtrtmnt2SCRCtlystExhstGsDffPr : 0|16@1+ (0.1,0) [0|6425.5] "kPa" Vector__XXX
 SG_ Aftrtrtmnt2SCRCtlystTnk2HaterCmd : 0|8@1+ (1,0) [0|100] "%" Vector__XXX
 SG_ Aftrtrtmnt2SCRCtlystTnkHeaterCmd : 0|8@1+ (1,0) [0|100] "%" Vector__XXX
 SG_ Aftrtrtmnt2SCRCtlystRgntLnHater4 : 0|2@1+ (1,0) [0|3] "" Vector__XXX
 SG_ Aftrtrtmnt2SCRCtlystRgntLnHater3 : 0|2@1+ (1,0) [0|3] "" Vector__XXX
 SG_ Aftrtrtmnt2SCRCtlystRgntLnHater2 : 0|2@1+ (1,0) [0|3] "" Vector__XXX
 SG_ Aftrtrtmnt2SCRCtlystRgntLnHater1 : 0|2@1+ (1,0) [0|3] "" Vector__XXX
 SG_ Aftrtrtmnt2SCRDoserHeatingModeRq : 0|3@1+ (1,0) [0|7] "" Vector__XXX
 SG_ Aftrtrtmnt2SCRDsrFltSppressionRq : 0|2@1+ (1,0) [0|3] "" Vector__XXX
 SG_ Aftrtrtmnt2SCRRqstdRgntQnttyFrIn : 0|16@1+ (0.1,0) [0|6425.5] "g" Vector__XXX
 SG_ Aftrtrtmnt2SCRSystmRquestedState : 0|4@1+ (1,0) [0|15] "" Vector__XXX
 SG_ Aftrtrtmnt2SCRRqstdDsngRgntQntty : 0|16@1+ (0.3,0) [0|19276.5] "g/h" Vector__XXX
 SG_ Aftrtrtmnt2SCRCtlystRgntLnHtr4Pr : 0|5@1+ (1,0) [0|31] "" Vector__XXX
 SG_ Aftrtrtmnt2SCRCtlystRgntLnHtr4St : 0|2@1+ (1,0) [0|3] "" Vector__XXX
 SG_ Aftrtrtmnt2SCRCtlystRgntLnHtr3Pr : 0|5@1+ (1,0) [0|31] "" Vector__XXX
 SG_ Aftrtrtmnt2SCRCtlystRgntLnHtr3St : 0|2@1+ (1,0) [0|3] "" Vector__XXX
 SG_ Aftrtrtmnt2SCRCtlystRgntLnHtr2Pr : 0|5@1+ (1,0) [0|31] "" Vector__XXX
 SG_ Aftrtrtmnt2SCRCtlystRgntLnHtr2St : 0|2@1+ (1,0) [0|3] "" Vector__XXX
 SG_ Aftrtrtmnt2SCRCtlystRgntLnHtr1Pr : 0|5@1+ (1,0) [0|31] "" Vector__XXX
 SG_ Aftrtrtmnt2SCRCtlystRgntLnHtr1St : 0|2@1+ (1,0) [0|3] "" Vector__XXX
 SG_ Aftrtrtmnt2SCRFeedbackCtrlStatus : 0|3@1+ (1,0) [0|7] "" Vector__XXX
 SG_ Aftrtrtmnt2SCRDsngVlvExhstTmpRdc : 0|3@1+ (1,0) [0|7] "" Vector__XXX
 SG_ Aftrtrtment2SCRDosingReagentTemp : 0|8@1+ (1,-40) [-40|210] "deg C" Vector__XXX
 SG_ Aftrtrtmnt2SCRDsngAirAssistValve : 0|8@1+ (1,0) [0|100] "%" Vector__XXX
 SG_ Aftrtrtmnt2SCRDsngArAssstAbsPrss : 0|8@1+ (8,0) [0|2000] "kPa" Vector__XXX
 SG_ Aftrtrtmnt2SCRDsngRagentAbsPress : 0|8@1+ (8,0) [0|2000] "kPa" Vector__XXX
 SG_ Aftrtrtmnt2SCRActlRgntQnttyOfInt : 0|16@1+ (0.1,0) [0|6425.5] "g" Vector__XXX
 SG_ Aftertreatment2SCRSystemState : 0|4@1+ (1,0) [0|15] "" Vector__XXX
 SG_ Aftrtrtmnt2SCRActlDsngRgntQntity : 0|16@1+ (0.3,0) [0|19276.5] "g/h" Vector__XXX
 SG_ Aftrtrtmnt2OtltNH3GsSnsrHterCtrl : 0|2@1+ (1,0) [0|3] "" Vector__XXX
 SG_ Aftrtrtmnt2OtltNH3GsSnsrHtrPrlmn : 0|5@1+ (1,0) [0|31] "" Vector__XXX
 SG_ Aftrtrtmnt2OtltNH3GsSensorAtTemp : 0|2@1+ (1,0) [0|3] "" Vector__XXX
 SG_ Aftrtrtmnt2OtltNH3GsSnsrPwrInRng : 0|2@1+ (1,0) [0|3] "" Vector__XXX
 SG_ Aftrtrtmnt2OtletNH3ReadingStable : 0|2@1+ (1,0) [0|3] "" Vector__XXX
 SG_ Aftrtrtmnt2OtltNH3SnsrPrlmnryFMI : 0|5@1+ (1,0) [0|31] "" Vector__XXX
 SG_ Aftertreatment2OutletNH3 : 0|16@1+ (0.3,0) [0|19276.5] "g/h" Vector__XXX
 SG_ Aftrtrtmnt2GsOxdtnCtlystDffPrssP : 0|5@1+ (1,0) [0|31] "" Vector__XXX
 SG_ Aftrtrtmnt2GsOxdtnCtlystOtltGsTm : 0|5@1+ (1,0) [0|31] "" Vector__XXX
 SG_ Aftrtrtmnt2GsOxdtnCtlystIntkGsTm : 0|5@1+ (1,0) [0|31] "" Vector__XXX
 SG_ Aftrtrtmnt2GsOxdtnCtlystDffPress : 0|16@1+ (0.1,0) [0|6425.5] "kPa" Vector__XXX
 SG_ Aftrtrtmnt2GsOxdtnCtlystOtltGsTm : 0|16@1+ (0.03125,-273) [-273|1734.96875] "deg C" Vector__XXX
 SG_ Aftrtrtmnt2GsOxdtnCtlystIntkGsTm : 0|16@1+ (0.03125,-273) [-273|1734.96875] "deg C" Vector__XXX
 SG_ Aftrtrtmnt2DslOxdtnCtlystOtltGsT : 0|5@1+ (1,0) [0|31] "" Vector__XXX
 SG_ Aftrtrtmnt2DslOxdtnCtlystIntkGsT : 0|5@1+ (1,0) [0|31] "" Vector__XXX
 SG_ Aftrtrtmnt2DslOxdtnCtlystDffPrss : 0|16@1+ (0.5,0) [0|32127.5] "kPa" Vector__XXX
 SG_ Aftrtrtmnt2DslOxdtnCtlystOtltGsT : 0|16@1+ (0.03125,-273) [-273|1734.96875] "deg C" Vector__XXX
 SG_ Aftrtrtmnt2DslOxdtnCtlystIntkGsT : 0|16@1+ (0.03125,-273) [-273|1734.96875] "deg C" Vector__XXX
 SG_ Aftrtrtmnt2DslOxdtnCtlystDffPrss : 0|5@1+ (1,0) [0|31] "" Vector__XXX
 SG_ Aftrtrtmnt1SCRCtlystRgntTnk2HtrP : 0|5@1+ (1,0) [0|31] "" Vector__XXX
 SG_ Aftrtrtmnt1SCRCtlystRgntTnk2Hter : 0|8@1+ (0.4,0) [0|100] "%" Vector__XXX
 SG_ Aftrtrtmnt1SCRRgntTnk2TmpPrlmnry : 0|5@1+ (1,0) [0|31] "" Vector__XXX
 SG_ Aftrtrtmnt1SCRCtlystRgntTnk2LvlP : 0|5@1+ (1,0) [0|31] "" Vector__XXX
 SG_ Aftrtrtmnt1SCRCtlystRgntTnk2Lvl2 : 0|16@1+ (1,0) [0|6425.5] "mm" Vector__XXX
 SG_ Aftrtrtmnt1SCRCtlystRgntTnk2Temp : 0|8@1+ (1,-40) [-40|210] "deg C" Vector__XXX
 SG_ Aftrtrtmnt1SCRCtlystRgntTnk2Lvel : 0|8@1+ (0.4,0) [0|100] "%" Vector__XXX
 SG_ Aftrtrtmnt1SCRCtlystRgntTnkDrnVl : 0|8@1+ (1,0) [0|100] "%" Vector__XXX
 SG_ Aftrtrtmnt1SCRCtlystRgntPmpState : 0|2@1+ (1,0) [0|3] "" Vector__XXX
 SG_ Aftrtrtmnt1SCRCtlystRgntTnkFllVl : 0|8@1+ (1,0) [0|100] "%" Vector__XXX
 SG_ Aftrtrtmnt1SCRCtlystRgntRtrnVlve : 0|8@1+ (1,0) [0|100] "%" Vector__XXX
 SG_ Aftrtrtmnt1SCRCtlystRgntPmpDrvPr : 0|8@1+ (1,0) [0|100] "%" Vector__XXX
 SG_ Aftrtrtmnt1SCRCtlystRgntPmpMtrSp : 0|16@1+ (0.5,0) [0|32127.5] "rpm" Vector__XXX
 SG_ Aftrtrtmnt1SCRCtlystOtltGsTmpPrl : 0|5@1+ (1,0) [0|31] "" Vector__XXX
 SG_ Aftrtrtmnt1SCRCtlystOtletGasTemp : 0|16@1+ (0.03125,-273) [-273|1734.96875] "deg C" Vector__XXX
 SG_ Aftrtrtmnt1SCRCtlystIntkGsTmpPrl : 0|5@1+ (1,0) [0|31] "" Vector__XXX
 SG_ Aftrtrtmnt1SCRCtlystIntkeGasTemp : 0|16@1+ (0.03125,-273) [-273|1734.96875] "deg C" Vector__XXX
 SG_ Aftrtrtmnt1SCRCtlystExhstGsDffPr : 0|5@1+ (1,0) [0|31] "" Vector__XXX
 SG_ Aftrtrtmnt1SCRCtlystExhstGsDffPr : 0|16@1+ (0.1,0) [0|6425.5] "kPa" Vector__XXX
 SG_ Aftrtrtmnt1SCRCtlystTnk2HaterCmd : 0|8@1+ (1,0) [0|100] "%" Vector__XXX
 SG_ Aftrtrtmnt1SCRCtlystTnkHeaterCmd : 0|8@1+ (1,0) [0|100] "%" Vector__XXX
 SG_ Aftrtrtmnt1SCRCtlystRgntLnHater4 : 0|2@1+ (1,0) [0|3] "" Vector__XXX
 SG_ Aftrtrtmnt1SCRCtlystRgntLnHater3 : 0|2@1+ (1,0) [0|3] "" Vector__XXX
 SG_ Aftrtrtmnt1SCRCtlystRgntLnHater2 : 0|2@1+ (1,0) [0|3] "" Vector__XXX
 SG_ Aftrtrtmnt1SCRCtlystRgntLnHater1 : 0|2@1+ (1,0) [0|3] "" Vector__XXX
 SG_ Aftrtrtmnt1SCRDoserHeatingModeRq : 0|3@1+ (1,0) [0|7] "" Vector__XXX
 SG_ Aftrtrtmnt1SCRDsrFltSppressionRq : 0|2@1+ (1,0) [0|3] "" Vector__XXX
 SG_ Aftrtrtmnt1SCRRqstdRgntQnttyFrIn : 0|16@1+ (0.1,0) [0|6425.5] "g" Vector__XXX
 SG_ Aftrtrtmnt1SCRSystmRquestedState : 0|4@1+ (1,0) [0|15] "" Vector__XXX
 SG_ Aftrtrtmnt1SCRRqstdDsngRgntQntty : 0|16@1+ (0.3,0) [0|19276.5] "g/h" Vector__XXX
 SG_ Aftrtrtmnt1SCRCtlystRgntLnHtr4Pr : 0|5@1+ (1,0) [0|31] "" Vector__XXX
 SG_ Aftrtrtmnt1SCRCtlystRgntLnHtr4St : 0|2@1+ (1,0) [0|3] "" Vector__XXX
 SG_ Aftrtrtmnt1SCRCtlystRgntLnHtr3Pr : 0|5@1+ (1,0) [0|31] "" Vector__XXX
 SG_ Aftrtrtmnt1SCRCtlystRgntLnHtr3St : 0|2@1+ (1,0) [0|3] "" Vector__XXX
 SG_ Aftrtrtmnt1SCRCtlystRgntLnHtr2Pr : 0|5@1+ (1,0) [0|31] "" Vector__XXX
 SG_ Aftrtrtmnt1SCRCtlystRgntLnHtr2St : 0|2@1+ (1,0) [0|3] "" Vector__XXX
 SG_ Aftrtrtmnt1SCRCtlystRgntLnHtr1Pr : 0|5@1+ (1,0) [0|31] "" Vector__XXX
 SG_ Aftrtrtmnt1SCRCtlystRgntLnHtr1St : 0|2@1+ (1,0) [0|3] "" Vector__XXX
 SG_ Aftrtrtmnt1SCRFeedbackCtrlStatus : 0|3@1+ (1,0) [0|7] "" Vector__XXX
 SG_ Aftrtrtmnt1SCRDsngVlvExhstTmpRdc : 0|3@1+ (1,0) [0|7] "" Vector__XXX
 SG_ Aftrtrtment1SCRDosingReagentTemp : 0|8@1+ (1,-40) [-40|210] "deg C" Vector__XXX
 SG_ Aftrtrtmnt1SCRDsngAirAssistValve : 0|8@1+ (1,0) [0|100] "%" Vector__XXX
 SG_ Aftrtrtmnt1SCRDsngArAssstAbsPrss : 0|8@1+ (8,0) [0|2000] "kPa" Vector__XXX
 SG_ Aftrtrtmnt1SCRDsngRagentAbsPress : 0|8@1+ (8,0) [0|2000] "kPa" Vector__XXX
 SG_ Aftrtrtmnt1SCRActlRgntQnttyOfInt : 0|16@1+ (0.1,0) [0|6425.5] "g" Vector__XXX
 SG_ Aftertreatment1SCRSystemState : 0|4@1+ (1,0) [0|15] "" Vector__XXX
 SG_ Aftrtrtmnt1SCRActlDsngRgntQntity : 0|16@1+ (0.3,0) [0|19276.5] "g/h" Vector__XXX
 SG_ Aftrtrtmnt1OtltNH3GsSnsrHterCtrl : 0|2@1+ (1,0) [0|3] "" Vector__XXX
 SG_ Aftrtrtmnt1OtltNH3GsSnsrHtrPrlmn : 0|5@1+ (1,0) [0|31] "" Vector__XXX
 SG_ Aftrtrtmnt1OtltNH3GsSensorAtTemp : 0|2@1+ (1,0) [0|3] "" Vector__XXX
 SG_ Aftrtrtmnt1OtltNH3GsSnsrPwrInRng : 0|2@1+ (1,0) [0|3] "" Vector__XXX
 SG_ Aftrtrtmnt1OtletNH3ReadingStable : 0|2@1+ (1,0) [0|3] "" Vector__XXX
 SG_ Aftrtrtmnt1OtltNH3SnsrPrlmnryFMI : 0|5@1+ (1,0) [0|31] "" Vector__XXX
 SG_ Aftertreatment1OutletNH3 : 0|16@1+ (0.3,0) [0|19276.5] "g/h" Vector__XXX
 SG_ Aftrtrtmnt1GsOxdtnCtlystDffPrssP : 0|5@1+ (1,0) [0|31] "" Vector__XXX
 SG_ Aftrtrtmnt1GsOxdtnCtlystOtltGsTm : 0|5@1+ (1,0) [0|31] "" Vector__XXX
 SG_ Aftrtrtmnt1GsOxdtnCtlystIntkGsTm : 0|5@1+ (1,0) [0|31] "" Vector__XXX
 SG_ Aftrtrtmnt1GsOxdtnCtlystDffPress : 0|16@1+ (0.1,0) [0|6425.5] "kPa" Vector__XXX
 SG_ Aftrtrtmnt1GsOxdtnCtlystOtltGsTm : 0|16@1+ (0.03125,-273) [-273|1734.96875] "deg C" Vector__XXX
 SG_ Aftrtrtmnt1GsOxdtnCtlystIntkGsTm : 0|16@1+ (0.03125,-273) [-273|1734.96875] "deg C" Vector__XXX

CM_ SG_ 3221225472 Joystick9YAxisPos "The position of the joystick in the relative motion of travel from the neutral position. Position value of 0 is Neutral and";
CM_ SG_ 3221225472 Jystck9YAxsLvrFrwrdPstvPosStatus "Reports when the current joystick position is on the positive travel side (forward, right, clockwise, up) relative to the";
CM_ SG_ 3221225472 Jystck9YAxsLvrBckNgtivePosStatus "Reports when the current joystick position is on the negative travel side (back, left, counterclockwise, down) relative to the";
CM_ SG_ 3221225472 Joystick9YAxisNeutralPosStatus "Reports when the current joystick position is in the neutral position for that axis of travel. The neutral position";
CM_ SG_ 3221225472 Joystick9XAxisPos "The position of the joystick in the relative motion of travel from the neutral position. Position value of 0 is Neutral and";
CM_ SG_ 3221225472 Jystck9XAxsLvrRghtPstvePosStatus "Reports when the current joystick position is on the positive travel side (forward, right, clockwise, up) relative to the";
CM_ SG_ 3221225472 Jystck9XAxsLvrLftNgtivePosStatus "Reports when the current joystick position is on the negative travel side (back, left, counterclockwise, down) relative to the";
CM_ SG_ 3221225472 Joystick9XAxisNeutralPosStatus "Reports when the current joystick position is in the neutral position for that axis of travel. The neutral position";
CM_ SG_ 3221225472 Joystick8Button9PressedStatus "Reports when the joystick button has been pressed.";
CM_ SG_ 3221225472 Joystick8Button10PressedStatus "Reports when the joystick button has been pressed.";
CM_ SG_ 3221225472 Joystick8Button11PressedStatus "Reports when the joystick button has been pressed.";
CM_ SG_ 3221225472 Joystick8Button12PressedStatus "Reports when the joystick button has been pressed.";
CM_ SG_ 3221225472 Joystick8Button5PressedStatus "Reports when the joystick button has been pressed.";
CM_ SG_ 3221225472 Joystick8Button6PressedStatus "Reports when the joystick button has been pressed.";
CM_ SG_ 3221225472 Joystick8Button7PressedStatus "Reports when the joystick button has been pressed.";
CM_ SG_ 3221225472 Joystick8Button8PressedStatus "Reports when the joystick button has been pressed.";
CM_ SG_ 3221225472 Joystick8Button1PressedStatus "Reports when the joystick button has been pressed.";
CM_ SG_ 3221225472 Joystick8Button2PressedStatus "Reports when the joystick button has been pressed.";
CM_ SG_ 3221225472 Joystick8Button3PressedStatus "Reports when the joystick button has been pressed.";
CM_ SG_ 3221225472 Joystick8Button4PressedStatus "Reports when the joystick button has been pressed.";
CM_ SG_ 3221225472 Joystick8XAxisDetentPosStatus "Reports when the current joystick position is in the detent position for that axis of travel.";
CM_ SG_ 3221225472 Joystick8YAxisDetentPosStatus "Reports when the current joystick position is in the detent position for that axis of travel.";
CM_ SG_ 3221225472 Joystick8YAxisPos "The position of the joystick in the relative motion of travel from the neutral position. Position value of 0 is Neutral and";
CM_ SG_ 3221225472 Jystck8YAxsLvrFrwrdPstvPosStatus "Reports when the current joystick position is on the positive travel side (forward, right, clockwise, up) relative to the";
CM_ SG_ 3221225472 Jystck8YAxsLvrBckNgtivePosStatus "Reports when the current joystick position is on the negative travel side (back, left, counterclockwise, down) relative to the";
CM_ SG_ 3221225472 Joystick8YAxisNeutralPosStatus "Reports when the current joystick position is in the neutral position for that axis of travel. The neutral position";
CM_ SG_ 3221225472 Joystick8XAxisPos "The position of the joystick in the relative motion of travel from the neutral position. Position value of 0 is Neutral and";
CM_ SG_ 3221225472 Jystck8XAxsLvrRghtPstvePosStatus "Reports when the current joystick position is on the positive travel side (forward, right, clockwise, up) relative to the";
CM_ SG_ 3221225472 Jystck8XAxsLvrLftNgtivePosStatus "Reports when the current joystick position is on the negative travel side (back, left, counterclockwise, down) relative to the";
CM_ SG_ 3221225472 Joystick8XAxisNeutralPosStatus "Reports when the current joystick position is in the neutral position for that axis of travel. The neutral position";
CM_ SG_ 3221225472 Joystick7Button9PressedStatus "Reports when the joystick button has been pressed.";
CM_ SG_ 3221225472 Joystick7Button10PressedStatus "Reports when the joystick button has been pressed.";
CM_ SG_ 3221225472 Joystick7Button11PressedStatus "Reports when the joystick button has been pressed.";
CM_ SG_ 3221225472 Joystick7Button12PressedStatus "Reports when the joystick button has been pressed.";
CM_ SG_ 3221225472 Joystick7Button5PressedStatus "Reports when the joystick button has been pressed.";
CM_ SG_ 3221225472 Joystick7Button6PressedStatus "Reports when the joystick button has been pressed.";
CM_ SG_ 3221225472 Joystick7Button7PressedStatus "Reports when the joystick button has been pressed.";
CM_ SG_ 3221225472 Joystick7Button8PressedStatus "Reports when the joystick button has been pressed.";
CM_ SG_ 3221225472 Joystick7Button1PressedStatus "Reports when the joystick button has been pressed.";
CM_ SG_ 3221225472 Joystick7Button2PressedStatus "Reports when the joystick button has been pressed.";
CM_ SG_ 3221225472 Joystick7Button3PressedStatus "Reports when the joystick button has been pressed.";
CM_ SG_ 3221225472 Joystick7Button4PressedStatus "Reports when the joystick button has been pressed.";
CM_ SG_ 3221225472 Joystick7XAxisDetentPosStatus "Reports when the current joystick position is in the detent position for that axis of travel.";
CM_ SG_ 3221225472 Joystick7YAxisDetentPosStatus "Reports when the current joystick position is in the detent position for that axis of travel.";
CM_ SG_ 3221225472 Joystick7YAxisPos "The position of the joystick in the relative motion of travel from the neutral position. Position value of 0 is Neutral and";
CM_ SG_ 3221225472 Jystck7YAxsLvrFrwrdPstvPosStatus "Reports when the current joystick position is on the positive travel side (forward, right, clockwise, up) relative to the";
CM_ SG_ 3221225472 Jystck7YAxsLvrBckNgtivePosStatus "Reports when the current joystick position is on the negative travel side (back, left, counterclockwise, down) relative to the";
CM_ SG_ 3221225472 Joystick7YAxisNeutralPosStatus "Reports when the current joystick position is in the neutral position for that axis of travel. The neutral position";
CM_ SG_ 3221225472 Joystick7XAxisPos "The position of the joystick in the relative motion of travel from the neutral position. Position value of 0 is Neutral and";
CM_ SG_ 3221225472 Jystck7XAxsLvrRghtPstvePosStatus "Reports when the current joystick position is on the positive travel side (forward, right, clockwise, up) relative to the";
CM_ SG_ 3221225472 Jystck7XAxsLvrLftNgtivePosStatus "Reports when the current joystick position is on the negative travel side (back, left, counterclockwise, down) relative to the";
CM_ SG_ 3221225472 Joystick7XAxisNeutralPosStatus "Reports when the current joystick position is in the neutral position for that axis of travel. The neutral position";
CM_ SG_ 3221225472 Joystick6Button9PressedStatus "Reports when the joystick button has been pressed.";
CM_ SG_ 3221225472 Joystick6Button10PressedStatus "Reports when the joystick button has been pressed.";
CM_ SG_ 3221225472 Joystick6Button11PressedStatus "Reports when the joystick button has been pressed.";
CM_ SG_ 3221225472 Joystick6Button12PressedStatus "Reports when the joystick button has been pressed.";
CM_ SG_ 3221225472 Joystick6Button5PressedStatus "Reports when the joystick button has been pressed.";
CM_ SG_ 3221225472 Joystick6Button6PressedStatus "Reports when the joystick button has been pressed.";
CM_ SG_ 3221225472 Joystick6Button7PressedStatus "Reports when the joystick button has been pressed.";
CM_ SG_ 3221225472 Joystick6Button8PressedStatus "Reports when the joystick button has been pressed.";
CM_ SG_ 3221225472 Joystick6Button1PressedStatus "Reports when the joystick button has been pressed.";
CM_ SG_ 3221225472 Joystick6Button2PressedStatus "Reports when the joystick button has been pressed.";
CM_ SG_ 3221225472 Joystick6Button3PressedStatus "Reports when the joystick button has been pressed.";
CM_ SG_ 3221225472 Joystick6Button4PressedStatus "Reports when the joystick button has been pressed.";
CM_ SG_ 3221225472 Joystick6XAxisDetentPosStatus "Reports when the current joystick position is in the detent position for that axis of travel.";
CM_ SG_ 3221225472 Joystick6YAxisDetentPosStatus "Reports when the current joystick position is in the detent position for that axis of travel.";
CM_ SG_ 3221225472 Joystick6YAxisPos "The position of the joystick in the relative motion of travel from the neutral position. Position value of 0 is Neutral and";
CM_ SG_ 3221225472 Jystck6YAxsLvrFrwrdPstvPosStatus "Reports when the current joystick position is on the positive travel side (forward, right, clockwise, up) relative to the";
CM_ SG_ 3221225472 Jystck6YAxsLvrBckNgtivePosStatus "Reports when the current joystick position is on the negative travel side (back, left, counterclockwise, down) relative to the";
CM_ SG_ 3221225472 Joystick6YAxisNeutralPosStatus "Reports when the current joystick position is in the neutral position for that axis of travel. The neutral position";
CM_ SG_ 3221225472 Joystick6XAxisPos "The position of the joystick in the relative motion of travel from the neutral position. Position value of 0 is Neutral and";
CM_ SG_ 3221225472 Jystck6XAxsLvrRghtPstvePosStatus "Reports when the current joystick position is on the positive travel side (forward, right, clockwise, up) relative to the";
CM_ SG_ 3221225472 Jystck6XAxsLvrLftNgtivePosStatus "Reports when the current joystick position is on the negative travel side (back, left, counterclockwise, down) relative to the";
CM_ SG_ 3221225472 Joystick6XAxisNeutralPosStatus "Reports when the current joystick position is in the neutral position for that axis of travel. The neutral position";
CM_ SG_ 3221225472 Joystick5Button9PressedStatus "Reports when the joystick button has been pressed.";
CM_ SG_ 3221225472 Joystick5Button10PressedStatus "Reports when the joystick button has been pressed.";
CM_ SG_ 3221225472 Joystick5Button11PressedStatus "Reports when the joystick button has been pressed.";
CM_ SG_ 3221225472 Joystick5Button12PressedStatus "Reports when the joystick button has been pressed.";
CM_ SG_ 3221225472 Joystick5Button5PressedStatus "Reports when the joystick button has been pressed.";
CM_ SG_ 3221225472 Joystick5Button6PressedStatus "Reports when the joystick button has been pressed.";
CM_ SG_ 3221225472 Joystick5Button7PressedStatus "Reports when the joystick button has been pressed.";
CM_ SG_ 3221225472 Joystick5Button8PressedStatus "Reports when the joystick button has been pressed.";
CM_ SG_ 3221225472 Joystick5Button1PressedStatus "Reports when the joystick button has been pressed.";
CM_ SG_ 3221225472 Joystick5Button2PressedStatus "Reports when the joystick button has been pressed.";
CM_ SG_ 3221225472 Joystick5Button3PressedStatus "Reports when the joystick button has been pressed.";
CM_ SG_ 3221225472 Joystick5Button4PressedStatus "Reports when the joystick button has been pressed.";
CM_ SG_ 3221225472 Joystick5XAxisDetentPosStatus "Reports when the current joystick position is in the detent position for that axis of travel.";
CM_ SG_ 3221225472 Joystick5YAxisDetentPosStatus "Reports when the current joystick position is in the detent position for that axis of travel.";
CM_ SG_ 3221225472 Joystick5YAxisPos "The position of the joystick in the relative motion of travel from the neutral position. Position value of 0 is Neutral and";
CM_ SG_ 3221225472 Jystck5YAxsLvrFrwrdPstvPosStatus "Reports when the current joystick position is on the positive travel side (forward, right, clockwise, up) relative to the";
CM_ SG_ 3221225472 Jystck5YAxsLvrBckNgtivePosStatus "Reports when the current joystick position is on the negative travel side (back, left, counterclockwise, down) relative to the";
CM_ SG_ 3221225472 Joystick5YAxisNeutralPosStatus "Reports when the current joystick position is in the neutral position for that axis of travel. The neutral position";
CM_ SG_ 3221225472 Joystick5XAxisPos "The position of the joystick in the relative motion of travel from the neutral position. Position value of 0 is Neutral and";
CM_ SG_ 3221225472 Jystck5XAxsLvrRghtPstvePosStatus "Reports when the current joystick position is on the positive travel side (forward, right, clockwise, up) relative to the";
CM_ SG_ 3221225472 Jystck5XAxsLvrLftNgtivePosStatus "Reports when the current joystick position is on the negative travel side (back, left, counterclockwise, down) relative to the";
CM_ SG_ 3221225472 Joystick5XAxisNeutralPosStatus "Reports when the current joystick position is in the neutral position for that axis of travel. The neutral position";
CM_ SG_ 3221225472 Joystick4Button9PressedStatus "Reports when the joystick button has been pressed.";
CM_ SG_ 3221225472 Joystick4Button10PressedStatus "Reports when the joystick button has been pressed.";
CM_ SG_ 3221225472 Joystick4Button11PressedStatus "Reports when the joystick button has been pressed.";
CM_ SG_ 3221225472 Joystick4Button12PressedStatus "Reports when the joystick button has been pressed.";
CM_ SG_ 3221225472 Joystick4Button5PressedStatus "Reports when the joystick button has been pressed.";
CM_ SG_ 3221225472 Joystick4Button6PressedStatus "Reports when the joystick button has been pressed.";
CM_ SG_ 3221225472 Joystick4Button7PressedStatus "Reports when the joystick button has been pressed.";
CM_ SG_ 3221225472 Joystick4Button8PressedStatus "Reports when the joystick button has been pressed.";
CM_ SG_ 3221225472 Joystick4Button1PressedStatus "Reports when the joystick button has been pressed.";
CM_ SG_ 3221225472 Joystick4Button2PressedStatus "Reports when the joystick button has been pressed.";
CM_ SG_ 3221225472 Joystick4Button3PressedStatus "Reports when the joystick button has been pressed.";
CM_ SG_ 3221225472 Joystick4Button4PressedStatus "Reports when the joystick button has been pressed.";
CM_ SG_ 3221225472 Joystick4XAxisDetentPosStatus "Reports when the current joystick position is in the detent position for that axis of travel.";
CM_ SG_ 3221225472 Joystick4YAxisDetentPosStatus "Reports when the current joystick position is in the detent position for that axis of travel.";
CM_ SG_ 3221225472 Joystick4YAxisPos "The position of the joystick in the relative motion of travel from the neutral position. Position value of 0 is Neutral and";
CM_ SG_ 3221225472 Jystck4YAxsLvrFrwrdPstvPosStatus "Reports when the current joystick position is on the positive travel side (forward, right, clockwise, up) relative to the";
CM_ SG_ 3221225472 Jystck4YAxsLvrBckNgtivePosStatus "Reports when the current joystick position is on the negative travel side (back, left, counterclockwise, down) relative to the";
CM_ SG_ 3221225472 Joystick4YAxisNeutralPosStatus "Reports when the current joystick position is in the neutral position for that axis of travel. The neutral position";
CM_ SG_ 3221225472 Joystick4XAxisPos "The position of the joystick in the relative motion of travel from the neutral position. Position value of 0 is Neutral and";
CM_ SG_ 3221225472 Jystck4XAxsLvrRghtPstvePosStatus "Reports when the current joystick position is on the positive travel side (forward, right, clockwise, up) relative to the";
CM_ SG_ 3221225472 Jystck4XAxsLvrLftNgtivePosStatus "Reports when the current joystick position is on the negative travel side (back, left, counterclockwise, down) relative to the";
CM_ SG_ 3221225472 Joystick4XAxisNeutralPosStatus "Reports when the current joystick position is in the neutral position for that axis of travel. The neutral position";
CM_ SG_ 3221225472 Joystick10Button9PressedStatus "Reports when the joystick button has been pressed.";
CM_ SG_ 3221225472 Joystick10Button10PressedStatus "Reports when the joystick button has been pressed.";
CM_ SG_ 3221225472 Joystick10Button11PressedStatus "Reports when the joystick button has been pressed.";
CM_ SG_ 3221225472 Joystick10Button12PressedStatus "Reports when the joystick button has been pressed.";
CM_ SG_ 3221225472 Joystick10Button5PressedStatus "Reports when the joystick button has been pressed.";
CM_ SG_ 3221225472 Joystick10Button6PressedStatus "Reports when the joystick button has been pressed.";
CM_ SG_ 3221225472 Joystick10Button7PressedStatus "Reports when the joystick button has been pressed.";
CM_ SG_ 3221225472 Joystick10Button8PressedStatus "Reports when the joystick button has been pressed.";
CM_ SG_ 3221225472 Joystick10Button1PressedStatus "Reports when the joystick button has been pressed.";
CM_ SG_ 3221225472 Joystick10Button2PressedStatus "Reports when the joystick button has been pressed.";
CM_ SG_ 3221225472 Joystick10Button3PressedStatus "Reports when the joystick button has been pressed.";
CM_ SG_ 3221225472 Joystick10Button4PressedStatus "Reports when the joystick button has been pressed.";
CM_ SG_ 3221225472 Joystick10XAxisDetentPosStatus "Reports when the current joystick position is in the detent position for that axis of travel.";
CM_ SG_ 3221225472 Joystick10YAxisDetentPosStatus "Reports when the current joystick position is in the detent position for that axis of travel.";
CM_ SG_ 3221225472 Joystick10YAxisPos "The position of the joystick in the relative motion of travel from the neutral position. Position value of 0 is Neutral and";
CM_ SG_ 3221225472 Jystck10YAxsLvrFrwrdPstvPsStatus "Reports when the current joystick position is on the positive travel side (forward, right, clockwise, up) relative to the";
CM_ SG_ 3221225472 Jystck10YAxsLvrBckNgtvePosStatus "Reports when the current joystick position is on the negative travel side (back, left, counterclockwise, down) relative to the";
CM_ SG_ 3221225472 Joystick10YAxisNeutralPosStatus "Reports when the current joystick position is in the neutral position for that axis of travel. The neutral position";
CM_ SG_ 3221225472 Joystick10XAxisPos "The position of the joystick in the relative motion of travel from the neutral position. Position value of 0 is Neutral and";
CM_ SG_ 3221225472 Jystck10XAxsLvrRghtPstvPosStatus "Reports when the current joystick position is on the positive travel side (forward, right, clockwise, up) relative to the";
CM_ SG_ 3221225472 Jystck10XAxsLvrLftNgtvePosStatus "Reports when the current joystick position is on the negative travel side (back, left, counterclockwise, down) relative to the";
CM_ SG_ 3221225472 Joystick10XAxisNeutralPosStatus "Reports when the current joystick position is in the neutral position for that axis of travel. The neutral position";
CM_ SG_ 3221225472 PssngrArbgDctivationSwitchStatus "State of switch used to deactivate Passenger Airbag manually.";
CM_ SG_ 3221225472 Beltlock10Status "State of switch used to determine if Beltlock 10 is buckled.";
CM_ SG_ 3221225472 Beltlock9Status "State of switch used to determine if Beltlock 9 is buckled.";
CM_ SG_ 3221225472 Beltlock8Status "State of switch used to determine if Beltlock 8 is buckled.";
CM_ SG_ 3221225472 Beltlock7Status "State of switch used to determine if Beltlock 7 is buckled.";
CM_ SG_ 3221225472 Beltlock6Status "State of switch used to determine if Beltlock 6 is buckled.";
CM_ SG_ 3221225472 Beltlock5Status "State of switch used to determine if Beltlock 5 is buckled.";
CM_ SG_ 3221225472 Beltlock4Status "State of switch used to determine if Beltlock 4 is buckled.";
CM_ SG_ 3221225472 Beltlock3Status "State of switch used to determine if Beltlock 3 is buckled.";
CM_ SG_ 3221225472 PassengerBeltlockStatus "State of switch used to determine if Passenger Beltlock is buckled.";
CM_ SG_ 3221225472 DriverBeltlockStatus "State of switch used to determine if Driver Beltlock is buckled.";
CM_ SG_ 3221225472 BatteryCharger2OutputCurrent "Output current of the battery charger connected to the main battery. If positive, this parameter shows the charging current";
CM_ SG_ 3221225472 BatteryCharger2OutputVoltage "Output voltage measured on the battery terminals of the offline battery charger connected to the auxiliary battery.";
CM_ SG_ 3221225472 BatteryCharger2PowerLineState "A state of the battery charger connection to the power line for the charger connected to the auxiliary battery.";
CM_ SG_ 3221225472 BatteryCharger2State "A state of the offline battery charger connected to the auxiliary battery.";
CM_ SG_ 3221225472 BatteryCharger1OutputCurrent "Output current of the battery charger connected to the main battery. If positive, this parameter shows the charging current";
CM_ SG_ 3221225472 BatteryCharger1OutputVoltage "Output voltage measured on the battery terminals of the battery charger connected to the main battery.";
CM_ SG_ 3221225472 BatteryCharger1PowerLineState "A state of the battery charger connection to the power line for the charger connected to the main battery.";
CM_ SG_ 3221225472 BatteryCharger1State "A state of the battery charger connected to the main battery.";
CM_ SG_ 3221225472 Aftrtrtmnt2ThrWyCtlystDffGasTemp "The differential engine combustion byproducts gas temperature measured between the intake and outlet of the three way";
CM_ SG_ 3221225472 Aftrtrtmnt1ThrWyCtlystDffGasTemp "The differential engine combustion byproducts gas temperature measured between the intake and outlet of the three way";
CM_ SG_ 3221225472 Aftrtrtmnt2GsOxdtnCtlystDffGsTmp "The differential engine combustion byproducts gas temperature measured between the intake and outlet of the gas";
CM_ SG_ 3221225472 Aftrtrtmnt1GsOxdtnCtlystDffGsTmp "The differential engine combustion byproducts gas temperature measured between the intake and outlet of the gas";
CM_ SG_ 3221225472 Aftrtrtmnt2WrmUpDslOxdtnCtlystOt "Temperature of engine combustion byproducts leaving the warm up Diesel Oxidation Catalyst in exhaust bank 2. This";
CM_ SG_ 3221225472 Aftrtrtmnt2WrmUpDslOxdtnCtlystIn "Temperature of engine combustion byproducts entering the warm up Diesel Oxidation Catalyst in exhaust bank 2. This";
CM_ SG_ 3221225472 Aftrtrtmnt2ThrWyCtlytcCnvrtrDffP "Used to identify the applicable J1939-73 FMI detected in the Three Way Catalytic Converter differential pressure sensorExhaust differential pressure measured between the intake and exhaust of a Three Way Catalytic Converter in exhaust";
CM_ SG_ 3221225472 Aftrtrtmnt2ThrWyCtlytcCnvrtrOtlt "Used to identify the applicable J1939-73 FMI detected in the Three Way Catalytic Converter outlet gas temperatureTemperature of engine combustion byproducts leaving the Three Way Catalytic Converter in exhaust bank 2.";
CM_ SG_ 3221225472 Aftrtrtmnt2ThrWyCtlytcCnvrtrIntk "Used to identify the applicable J1939-73 FMI detected in the Three Way Catalytic Converter intake gas temperatureTemperature of engine combustion byproducts entering the Three Way Catalytic Converter in exhaust bank 2.";
CM_ SG_ 3221225472 Aftrtrtmnt2OtltGsNOxSnsrNH3Crrct "Correction of NH3 at the NOx-signal to correct (recalculate) sensor signal on the Engine ECU side.";
CM_ SG_ 3221225472 Aftrtrtmnt2OtltGsNOxSnsrNO2Crrct "Correction of NO2 at the NOx-signal to correct (recalculate) sensor signal on the Engine ECU side.";
CM_ SG_ 3221225472 Aftrtrtmnt2OtltGsNOxSnsrCrrctnOf "Correction of pressure NOx-signal to correct (recalculate) sensor signal on the Engine ECU side.Correction of pressure Lambda-signal to correct (recalculate) sensor signal on the Engine ECU side.";
CM_ SG_ 3221225472 Aftrtrtmnt2OtltGsNOxSnsrNwPrtDvt "New part deviation NOx_Offset to correct (recalculate) sensor signal on the Engine ECU side.New part deviation NOx_Gain to correct (recalculate) sensor signal on the Engine ECU side.";
CM_ SG_ 3221225472 Aftrtrtmnt2OtltGsNOxSnsrHtrRatio "Heater ratio to determine temperature at sensor tip.";
CM_ SG_ 3221225472 Aftrtrtmnt2IntkGsNOxSnsrNH3Crrct "Correction of NH3 at the NOx-signal to correct (recalculate) sensor signal on the Engine ECU side.";
CM_ SG_ 3221225472 Aftrtrtmnt2IntkGsNOxSnsrNO2Crrct "Correction of NO2 at the NOx-signal to correct (recalculate) sensor signal on the Engine ECU side.";
CM_ SG_ 3221225472 Aftrtrtmnt2IntkGsNOxSnsrCrrctnOf "Correction of pressure NOx-signal to correct (recalculate) sensor signal on the Engine ECU side.Correction of pressure Lambda-signal to correct (recalculate) sensor signal on the Engine ECU side.";
CM_ SG_ 3221225472 Aftrtrtmnt2IntkGsNOxSnsrNwPrtDvt "New part deviation NOx_Offset to correct (recalculate) sensor signal on the Engine ECU side.New part deviation NOx_Gain to correct (recalculate) sensor signal on the Engine ECU side.";
CM_ SG_ 3221225472 Aftrtrtmnt2IntkGsNOxSnsrHtrRatio "Heater ratio to determine temperature at sensor tip.";
CM_ SG_ 3221225472 Aftertreatment2FuelPress2Ctrl "Indicates how the device is controlling the aftertreatment 2 fuel pressure 2 regulating control valve. 0% = fully closed,";
CM_ SG_ 3221225472 Aftrtrtmnt2FlFlwDverterValveCtrl "Indicates how the device is controlling the aftertreatment 2 fuel flow diverter valve. When this valve is on it diverts fuel flow";
CM_ SG_ 3221225472 Aftertreatment2FuelPumpRelayCtrl "Indicates how the device is controlling the aftertreatment 2 fuel pump relay.";
CM_ SG_ 3221225472 Aftertreatment2FuelPress2 "Second fuel pressure measurement for the aftertreatment 2 system.";
CM_ SG_ 3221225472 Aftrtrtmnt2DslPrtcltFltrStStndrd "Calibration offset for the soot standard deviation for Aftertreatment 2 Diesel Particulate Filter soot sensor.";
CM_ SG_ 3221225472 Aftrtrtmnt2DslPrtcltFltrStMnClbO "Calibration offset for the soot Mean for Aftertreatment 2 Diesel Particulate Filter soot sensor.";
CM_ SG_ 3221225472 Aftrtrtmnt1WrmUpDslOxdtnCtlystOt "This is the temperature measured at the outlet of the warm up oxidation catalytic converter in exhaust bank 1.";
CM_ SG_ 3221225472 Aftrtrtmnt1WrmUpDslOxdtnCtlystIn "This is the temperature measured at the intake of the warm up oxidation catalytic converter in exhaust bank 1.";
CM_ SG_ 3221225472 Aftrtrtmnt1ThrWyCtlytcCnvrtrDffP "Used to identify the applicable J1939-73 FMI detected in the Three Way Catalytic Converter differential pressure sensorExhaust differential pressure measured between the intake and exhaust of a Three Way Catalytic Converter in exhaust";
CM_ SG_ 3221225472 Aftrtrtmnt1ThrWyCtlytcCnvrtrOtlt "Used to identify the applicable J1939-73 FMI detected in the Three Way Catalytic Converter outlet gas temperatureTemperature of engine combustion byproducts leaving the Three Way Catalytic Converter in exhaust bank 1.";
CM_ SG_ 3221225472 Aftrtrtmnt1ThrWyCtlytcCnvrtrIntk "Used to identify the applicable J1939-73 FMI detected in the Three Way Catalytic Converter intake gas temperatureTemperature of engine combustion byproducts entering the Three Way Catalytic Converter in exhaust bank 1.";
CM_ SG_ 3221225472 Aftrtrtmnt1SCRCtlystRgntTnk1HtrP "Used to identify the applicable J1939-73 FMI detected in the SCR catalyst reagent tank 1 heater, by the manufacturer’s";
CM_ SG_ 3221225472 AftrtrtmntSCROprtrIndcmntSverity "The severity of operator inducement for anomolies with the SCR system, such as tampering, low DEF quality, and DEF";
CM_ SG_ 3221225472 Aftrtrtmnt1SCRCtlystRgntTnk1TmpP "Used to identify the applicable J1939-73 FMI detected in the SCR catalyst reagent tank 1 temperature, by the";
CM_ SG_ 3221225472 Aftrtrtmnt1DEFTnkLwLvelIndicator "The desired illumination of the driver's warning indicator for diesel exhaust fluid (DEF) tank low level.";
CM_ SG_ 3221225472 Aftrtrtmnt1SCRCtlystTnkLvlPrlmnr "Used to identify the applicable J1939-73 FMI that applies to the most significant failure of the catalyst tank level sensor.";
CM_ SG_ 3221225472 Aftrtrtmnt1SCRCatalystTankLevel2 "The measure of the reagent level in the catalyst tank.";
CM_ SG_ 3221225472 Aftrtratment1SCRCatalystTankTemp "Temperature of the reagent in the storage tank.";
CM_ SG_ 3221225472 Aftrtrtment1SCRCatalystTankLevel "A special catalyst uses a chemical reagent to reach legal requirement for NOX emissions. This parameter indicates the";
CM_ SG_ 3221225472 Aftrtrtmnt1SCRCtalystTankHeater "Percentage of heating applied to the aftertreatment 1 catalyst tank heater.";
CM_ SG_ 3221225472 Aftrtrtmnt1OtltGsNOxSnsrNH3Crrct "Correction of NH3 at the NOx-signal to correct (recalculate) sensor signal on the Engine ECU side.";
CM_ SG_ 3221225472 Aftrtrtmnt1OtltGsNOxSnsrNO2Crrct "Correction of NO2 at the NOx-signal to correct (recalculate) sensor signal on the Engine ECU side.";
CM_ SG_ 3221225472 Aftrtrtmnt1OtltGsNOxSnsrCrrctnOf "Correction of pressure NOx-signal to correct (recalculate) sensor signal on the Engine ECU side.Correction of pressure Lambda-signal to correct (recalculate) sensor signal on the Engine ECU side.";
CM_ SG_ 3221225472 Aftrtrtmnt1OtltGsNOxSnsrNwPrtDvt "New part deviation NOx_Offset to correct (recalculate) sensor signal on the Engine ECU side.New part deviation NOx_Gain to correct (recalculate) sensor signal on the Engine ECU side.";
CM_ SG_ 3221225472 Aftrtrtmnt1OtltGsNOxSnsrHtrRatio "Heater ratio to determine temperature at sensor tip.";
CM_ SG_ 3221225472 Aftrtrtmnt1IntkGsNOxSnsrNH3Crrct "Correction of NH3 at the NOx-signal to correct (recalculate) sensor signal on the Engine ECU side.";
CM_ SG_ 3221225472 Aftrtrtmnt1IntkGsNOxSnsrNO2Crrct "Correction of NO2 at the NOx-signal to correct (recalculate) sensor signal on the Engine ECU side.";
CM_ SG_ 3221225472 Aftrtrtmnt1IntkGsNOxSnsrCrrctnOf "Correction of pressure NOx-signal to correct (recalculate) sensor signal on the Engine ECU side.Correction of pressure Lambda-signal to correct (recalculate) sensor signal on the Engine ECU side.";
CM_ SG_ 3221225472 Aftrtrtmnt1IntkGsNOxSnsrNwPrtDvt "New part deviation NOx_Offset to correct (recalculate) sensor signal on the Engine ECU side.New part deviation NOx_Gain to correct (recalculate) sensor signal on the Engine ECU side.";
CM_ SG_ 3221225472 Aftrtrtmnt1IntkGsNOxSnsrHtrRatio "Heater ratio to determine temperature at sensor tip.";
CM_ SG_ 3221225472 Aftrtrtmnt1DslPrtcltFltrStStndrd "Calibration offset for the soot standard deviation for Aftertreatment 1 Diesel Particulate Filter soot sensor.";
CM_ SG_ 3221225472 Aftrtrtmnt1DslPrtcltFltrStMnClbO "Calibration offset for the soot Mean for Aftertreatment 1 Diesel Particulate Filter soot sensor.";
CM_ SG_ 3221225472 ArmrestSwitchMatrix2Switch2 "Second switch input matrix for the second module located in the armrest";
CM_ SG_ 3221225472 ArmrestSwitchMatrix2Switch1 "Switch input matrix for the second module located in the armrest";
CM_ SG_ 3221225472 ArmrestSwitchMatrixSwitch2 "Second switch input matrix for the module located in the armrest";
CM_ SG_ 3221225472 ArmrestSwitchMatrixSwitch1 "Switch input matrix for the module located in the armrest";
CM_ SG_ 3221225472 AngularRateMeasurementLatency "The estimated measurement latency of the measurement.";
CM_ SG_ 3221225472 YawRateExRangeFigureOfMerit "Figure of merit for yaw angle measurement.";
CM_ SG_ 3221225472 RollRateExRangeFigureOfMerit "Figure of merit for roll angle measurement.";
CM_ SG_ 3221225472 PitchRateExRangeFigureOfMerit "Figure of merit for pitch angle measurement.";
CM_ SG_ 3221225472 YawRateExRange "Yaw rate is the rate-of-change of the yaw angle over time.";
CM_ SG_ 3221225472 RollRateExRange "Roll rate is the rate-of-change of the roll angle over time.";
CM_ SG_ 3221225472 PitchRateExRange "Pitch rate is the rate-of-change of the pitch angle over time, where the pitch angle vector is in the direction of travel of the";
CM_ SG_ 3221225472 Aftrtrtmnt2NOxAdsrbrDSOxRgnrtnSt "Indicates whether the NOx adsorber deSOx regeneration in the second aftertreatment system is active or inactive";
CM_ SG_ 3221225472 Aftrtrtmnt2NOxAdsrbrDNOxRgnrtnSt "Indicates whether the NOx adsorber deNOx regeneration in the second aftertreatment system is active or inactive";
CM_ SG_ 3221225472 Aftrtrtmnt1NOxAdsrbrDSOxRgnrtnSt "Indicates whether the NOx adsorber deSOx regeneration in the first aftertreatment system is active or inactive";
CM_ SG_ 3221225472 Aftrtrtmnt1NOxAdsrbrDNOxRgnrtnSt "Indicates whether the NOx adsorber deNOx regeneration in the first aftertreatment system is active or inactive";
CM_ SG_ 3221225472 Aftrtrtmnt2SCRCtlystCnvrsnEffcnc "The SCR catalyst conversion efficiency percentage. Calculated as 100 times the catalyst intake NOx minus the catalyst";
CM_ SG_ 3221225472 Aftrtrtmnt2SCRCmmnddCtlystRgntCn "This parameter transmits the amount of reagent that the emissions control system has requested to be used, averaged";
CM_ SG_ 3221225472 Aftrtrtmnt2SCRAvrgCtlystRgntCnsm "Measured use of reagent by a Selective Catalytic Reduction system for exhaust emission control, averaged over the";
CM_ SG_ 3221225472 Aftrtrtmnt2SCRCtlystRgntTnk2HtrP "Used to identify the applicable J1939-73 FMI detected in the SCR catalyst reagent tank 2 heater, by the manufacturer’s";
CM_ SG_ 3221225472 Aftrtrtmnt2SCRCtlystRgntTnk2Hter "The SCR catalyst reagent tank 2 heater percentage for aftertreatment system 1 (exhaust bank 1). 0% is off. See SPN";
CM_ SG_ 3221225472 Aftrtrtmnt2SCRRgntTnk2TmpPrlmnry "Used to identify the applicable J1939-73 FMI detected in the SCR catalyst reagent tank 2 temperature, by the";
CM_ SG_ 3221225472 Aftrtrtmnt2SCRCtlystRgntTnk2LvlP "Used to identify the applicable J1939-73 FMI detected in the SCR catalyst reagent tank 2 level, by the manufacturer’s";
CM_ SG_ 3221225472 Aftrtrtmnt2SCRCtlystRgntTnk2Lvl2 "The SCR catalyst reagent tank 2 level height in mm for aftertreatment system 2 (exhaust bank 2). Tank 2 is used as a";
CM_ SG_ 3221225472 Aftrtrtmnt2SCRCtlystRgntTnk2Temp "The SCR catalyst reagent tank 2 temperature for aftertreatment system 2 (exhaust bank 2). Tank 2 is used as a quick";
CM_ SG_ 3221225472 Aftrtrtmnt2SCRCtlystRgntTnk2Lvel "The SCR catalyst reagent tank 2 level percentage for aftertreatment system 2 (exhaust bank 2). 0% is empty and 100%";
CM_ SG_ 3221225472 Aftrtrtmnt2SCRCtlystRgntTnk1HtrP "Used to identify the applicable J1939-73 FMI detected in the SCR catalyst reagent tank 1 heater, by the manufacturer’s";
CM_ SG_ 3221225472 Aftrtrtmnt2SCRCtalystTankHeater "Percentage of heating applied to the aftertreatment 2 catalyst tank heater.";
CM_ SG_ 3221225472 Aftrtrtmnt2SCRCtlystRgntTnk1TmpP "Used to identify the applicable J1939-73 FMI detected in the SCR catalyst reagent tank 1 temperature, by the";
CM_ SG_ 3221225472 Aftrtrtmnt2SCRCtlystTnkLvlPrlmnr "Used to identify the applicable J1939-73 FMI that applies to the most significant failure of the catalyst tank level sensor.";
CM_ SG_ 3221225472 Aftrtrtmnt2SCRCatalystTankLevel2 "The measure of the reagent level in the catalyst tank.";
CM_ SG_ 3221225472 Aftrtratment2SCRCatalystTankTemp "Temperature of the reagent in the storage tank.";
CM_ SG_ 3221225472 Aftrtrtment2SCRCatalystTankLevel "A special catalyst uses chemical substance to reach legal requirement for NOX emissions. This parameter indicates the";
CM_ SG_ 3221225472 Aftrtrtmnt2SCRCtlystRgntTnkDrnVl "Commanded percentage of maximum Aftertreatment 2 SCR Catalyst Reagent Tank Drain Valve opening. 100% means";
CM_ SG_ 3221225472 Aftrtrtmnt2SCRCtlystRgntPmpState "State of aftertreatment 2 SCR Catalyst Reagent dosing pump.";
CM_ SG_ 3221225472 Aftrtrtmnt2SCRCtlystRgntTnkFllVl "Commanded percentage of maximum Aftertreatment 2 SCR Catalyst Reagent Tank Fill Valve opening. 100% means the";
CM_ SG_ 3221225472 Aftrtrtmnt2SCRCtlystRgntRtrnVlve "Command to the valve which determines whether the reagent is delivered to the injector or is routed back to the reagent";
CM_ SG_ 3221225472 Aftrtrtmnt2SCRCtlystRgntPmpDrvPr "The percent (command) sent to the motor to control the speed of the reagent pump.";
CM_ SG_ 3221225472 Aftrtrtmnt2SCRCtlystRgntPmpMtrSp "Rotational speed of the motor driving a pump for reagent used in an aftertreatment system.";
CM_ SG_ 3221225472 Aftrtrtmnt2SCRCtalystReagentType "This parameter indicates what reagent is in the tank. A value of 0011 indicates uncontaminated Diesel Exhaust Fluid.";
CM_ SG_ 3221225472 Aftrtrtmnt2SCRCtlystRgntPrprtsPr "Used to identify the applicable J1939-73 FMI that applies to the most significant failure of the catalyst reagent properties";
CM_ SG_ 3221225472 Aftrtrtmnt2SCRCtlystRgntTmp2Prlm "Used to identify the applicable J1939-73 FMI that applies to the most significant failure of the catalyst temperature sensor.";
CM_ SG_ 3221225472 Aftrtrtmnt2SCRCtlystRgntCndctvty "A measure of the conductivity of the reagent or fluid at the sensor. The conductivity is an indication of the reagent's";
CM_ SG_ 3221225472 Aftrtrtmnt2SCRCtlystRgntCncntrtn "A measure of the concentration of urea in water. Zero percent means that the tank contains no urea. A 32.5% value";
CM_ SG_ 3221225472 Aftrtrtmnt2SCRCtlystReagentTemp2 "Temperature of the catalyst reagent at the device measuring reagent quality";
CM_ SG_ 3221225472 Aftrtrtmnt2SCRCtlystOtltGsTmpPrl "Used to identify the applicable J1939-73 FMI detected in the SCR catalyst outlet gas temperature sensor by the";
CM_ SG_ 3221225472 Aftrtrtmnt2SCRCtlystOtletGasTemp "Temperature of engine combustion byproducts leaving the SCR catalyst exhaust in exhaust bank 2.";
CM_ SG_ 3221225472 Aftrtrtmnt2SCRCtlystIntkGsTmpPrl "Used to identify the applicable J1939-73 FMI detected in the SCR catalyst intake gas temperature sensor by the";
CM_ SG_ 3221225472 Aftrtrtmnt2SCRCtlystIntkeGasTemp "Temperature of engine combustion byproducts entering the SCR catalyst in exhaust bank 2.";
CM_ SG_ 3221225472 Aftrtrtmnt2SCRCtlystExhstGsDffPr "Used to identify the applicable J1939-73 FMI detected in the SCR catalyst differential pressure sensor by theExhaust differential pressure measured between the intake and exhaust of a SCR catalyst in exhaust bank 2.";
CM_ SG_ 3221225472 Aftrtrtmnt2SCRCtlystTnk2HaterCmd "This is the command for the Aftertreatment 2 SCR Catalyst Tank 2 Heater. See SPN 4438 for the measured value of the";
CM_ SG_ 3221225472 Aftrtrtmnt2SCRCtlystTnkHeaterCmd "Command for the Aftertreatment 2 SCR Catalyst Tank Heater. A value of 0% means no heating applied, a value of 100%";
CM_ SG_ 3221225472 Aftrtrtmnt2SCRCtlystRgntLnHater4 "The SCR catalyst reagent line heater 4 request for aftertreatment system 2 (exhaust bank 2).";
CM_ SG_ 3221225472 Aftrtrtmnt2SCRCtlystRgntLnHater3 "The SCR catalyst reagent line heater 3 request for aftertreatment system 2 (exhaust bank 2).";
CM_ SG_ 3221225472 Aftrtrtmnt2SCRCtlystRgntLnHater2 "The SCR catalyst reagent line heater 2 request for aftertreatment system 2 (exhaust bank 2).";
CM_ SG_ 3221225472 Aftrtrtmnt2SCRCtlystRgntLnHater1 "The SCR catalyst reagent line heater 1 request for aftertreatment system 2 (exhaust bank 2).";
CM_ SG_ 3221225472 Aftrtrtmnt2SCRDoserHeatingModeRq "Used if multiple heater modes are available in the Doser.";
CM_ SG_ 3221225472 Aftrtrtmnt2SCRDsrFltSppressionRq "Used if external devices can warn of conditions that require suppression of potential faults in the doser due to";
CM_ SG_ 3221225472 Aftrtrtmnt2SCRRqstdRgntQnttyFrIn "Represents the command for the reducing agent quantity integrator in the dosing control unit";
CM_ SG_ 3221225472 Aftrtrtmnt2SCRSystmRquestedState "Requested state of SCR system for aftertreatment system 2 (exhaust bank 2).";
CM_ SG_ 3221225472 Aftrtrtmnt2SCRRqstdDsngRgntQntty "Actual requested dosing quantity of catalyst reagent";
CM_ SG_ 3221225472 Aftrtrtmnt2SCRCtlystRgntLnHtr4Pr "Used to identify the applicable J1939-73 FMI detected in the SCR catalyst reagent line heater 4, by the manufacturer’s";
CM_ SG_ 3221225472 Aftrtrtmnt2SCRCtlystRgntLnHtr4St "The SCR catalyst reagent line heater 4 state for aftertreatment system 2 (exhaust bank 2).";
CM_ SG_ 3221225472 Aftrtrtmnt2SCRCtlystRgntLnHtr3Pr "Used to identify the applicable J1939-73 FMI detected in the SCR catalyst reagent line heater 3, by the manufacturer’s";
CM_ SG_ 3221225472 Aftrtrtmnt2SCRCtlystRgntLnHtr3St "The SCR catalyst reagent line heater 3 state for aftertreatment system 2 (exhaust bank 2).";
CM_ SG_ 3221225472 Aftrtrtmnt2SCRCtlystRgntLnHtr2Pr "Used to identify the applicable J1939-73 FMI detected in the SCR catalyst reagent line heater 2, by the manufacturer’s";
CM_ SG_ 3221225472 Aftrtrtmnt2SCRCtlystRgntLnHtr2St "The SCR catalyst reagent line heater 2 state for aftertreatment system 2 (exhaust bank 2).";
CM_ SG_ 3221225472 Aftrtrtmnt2SCRCtlystRgntLnHtr1Pr "Used to identify the applicable J1939-73 FMI detected in the SCR catalyst reagent line heater 1, by the manufacturer’s";
CM_ SG_ 3221225472 Aftrtrtmnt2SCRCtlystRgntLnHtr1St "The SCR catalyst reagent line heater 1 state for aftertreatment system 2 (exhaust bank 2).";
CM_ SG_ 3221225472 Aftrtrtmnt2SCRFeedbackCtrlStatus "The SCR feedback control status (open/closed loop) for aftertreatment system 2 (exhaust bank 2).";
CM_ SG_ 3221225472 Aftrtrtmnt2SCRDsngVlvExhstTmpRdc "Protection request for the dosing valve of the SCR-system to prevent overheating";
CM_ SG_ 3221225472 Aftrtrtment2SCRDosingReagentTemp "The SCR dosing reagent temperature (measured closest to dosing valve) for aftertreatment system 2 (exhaust bank 2).";
CM_ SG_ 3221225472 Aftrtrtmnt2SCRDsngAirAssistValve "The position of the valve used to regulate the air supply of an air assist SCR dosing system for an engine. 0% represents";
CM_ SG_ 3221225472 Aftrtrtmnt2SCRDsngArAssstAbsPrss "The SCR dosing system air assist absolute pressure for aftertreatment system 2 (exhaust bank 2). The air assist system";
CM_ SG_ 3221225472 Aftrtrtmnt2SCRDsngRagentAbsPress "The SCR dosing reagent absolute pressure (measured closest to dosing valve) for aftertreatment system 2 (exhaust bank";
CM_ SG_ 3221225472 Aftrtrtmnt2SCRActlRgntQnttyOfInt "The SCR requested reagent integrator total quantity for aftertreatment system 2 (exhaust bank 2).";
CM_ SG_ 3221225472 Aftertreatment2SCRSystemState "Actual state of SCR system";
CM_ SG_ 3221225472 Aftrtrtmnt2SCRActlDsngRgntQntity "Actual reducing agent quantity of SCR system.";
CM_ SG_ 3221225472 Aftrtrtmnt2OtltNH3GsSnsrHterCtrl "Indicates the heater status in the warm-up process. Upon receiving a power-up command, the NH3 gas sensor ramps up";
CM_ SG_ 3221225472 Aftrtrtmnt2OtltNH3GsSnsrHtrPrlmn "Used to identify the applicable J1939-73 FMI detected in the heater of the outlet NH3 exhaust gas sensor by the";
CM_ SG_ 3221225472 Aftrtrtmnt2OtltNH3GsSensorAtTemp "Indicates that the heater element of the aftertreatment outlet NH3 gas sensor is within the manufacturer’s specified range";
CM_ SG_ 3221225472 Aftrtrtmnt2OtltNH3GsSnsrPwrInRng "Indicates that the power supplied to the aftertreatment outlet NH3 gas sensor is within the manufacturer’s specification in";
CM_ SG_ 3221225472 Aftrtrtmnt2OtletNH3ReadingStable "Indicates that the NH3 reading of the aftertreatment outlet NH3 sensor is stable as determined by the manufacturer’s";
CM_ SG_ 3221225472 Aftrtrtmnt2OtltNH3SnsrPrlmnryFMI "Used to identify the applicable J1939-73 FMI detected in the aftertreatment outlet NH3 sensor by the manufacturer’s";
CM_ SG_ 3221225472 Aftertreatment2OutletNH3 "The amount of NH3 in the exhaust exiting the aftertreatment system measured by a NH3 sensor at the aftertreatment";
CM_ SG_ 3221225472 Aftrtrtmnt2GsOxdtnCtlystDffPrssP "Used to identify the applicable J1939-73 FMI detected in the gas oxidation catalyst differential pressure sensor by the";
CM_ SG_ 3221225472 Aftrtrtmnt2GsOxdtnCtlystOtltGsTm "Used to identify the applicable J1939-73 FMI detected in the gas oxidation catalyst outlet gas temperature sensor by theTemperature of engine combustion byproducts leaving the gas oxidation catalyst in exhaust bank 2. This gas parameter";
CM_ SG_ 3221225472 Aftrtrtmnt2GsOxdtnCtlystIntkGsTm "Used to identify the applicable J1939-73 FMI detected in the gas oxidation catalyst intake gas temperature sensor by theTemperature of engine combustion byproducts entering the gas oxidation catalyst in exhaust bank 2. This gas parameter";
CM_ SG_ 3221225472 Aftrtrtmnt2GsOxdtnCtlystDffPress "Exhaust differential pressure measured between the intake and exhaust of the gas oxidation catalyst in exhaust bank 2.";
CM_ SG_ 3221225472 Aftrtrtmnt2DslOxdtnCtlystOtltGsT "Used to identify the applicable J1939-73 FMI detected in the diesel oxidation catalyst outlet gas temperature sensor byTemperature of engine combustion byproducts leaving the diesel oxidation catalyst exhaust in exhaust bank 2. This";
CM_ SG_ 3221225472 Aftrtrtmnt2DslOxdtnCtlystIntkGsT "Used to identify the applicable J1939-73 FMI detected in the diesel oxidation catalyst intake gas temperature sensor byTemperature of engine combustion byproducts entering the diesel oxidation catalyst in exhaust bank 2. This diesel";
CM_ SG_ 3221225472 Aftrtrtmnt2DslOxdtnCtlystDffPrss "Exhaust differential pressure measured between the intake and exhaust of a diesel oxidation catalyst in exhaust bank 2.Used to identify the applicable J1939-73 FMI detected in the diesel oxidation catalyst differential pressure sensor by the";
CM_ SG_ 3221225472 Aftrtrtmnt1SCRCtlystRgntTnk2HtrP "Used to identify the applicable J1939-73 FMI detected in the SCR catalyst reagent tank 2 heater, by the manufacturer’s";
CM_ SG_ 3221225472 Aftrtrtmnt1SCRCtlystRgntTnk2Hter "The SCR catalyst reagent tank 2 heater percentage for aftertreatment system 1 (exhaust bank 1). 0% is off. See SPN";
CM_ SG_ 3221225472 Aftrtrtmnt1SCRRgntTnk2TmpPrlmnry "Used to identify the applicable J1939-73 FMI detected in the SCR catalyst reagent tank 2 temperature, by the";
CM_ SG_ 3221225472 Aftrtrtmnt1SCRCtlystRgntTnk2LvlP "Used to identify the applicable J1939-73 FMI detected in the SCR catalyst reagent tank 2 level, by the manufacturer’s";
CM_ SG_ 3221225472 Aftrtrtmnt1SCRCtlystRgntTnk2Lvl2 "The SCR catalyst reagent tank 2 level height in mm for aftertreatment system 1 (exhaust bank 1). Tank 2 is used as a";
CM_ SG_ 3221225472 Aftrtrtmnt1SCRCtlystRgntTnk2Temp "The SCR catalyst reagent tank 2 temperature for aftertreatment system 1 (exhaust bank 1). Tank 2 is used as a quick";
CM_ SG_ 3221225472 Aftrtrtmnt1SCRCtlystRgntTnk2Lvel "The SCR catalyst reagent tank 2 level percentage for aftertreatment system 1 (exhaust bank 1). 0% is empty and 100%";
CM_ SG_ 3221225472 Aftrtrtmnt1SCRCtlystRgntTnkDrnVl "Commanded percentage of maximum Aftertreatment 1 SCR Catalyst Reagent Tank Drain Valve opening. 100% means";
CM_ SG_ 3221225472 Aftrtrtmnt1SCRCtlystRgntPmpState "State of aftertreatment 1 SCR Catalyst Reagent dosing pump.";
CM_ SG_ 3221225472 Aftrtrtmnt1SCRCtlystRgntTnkFllVl "Commanded percentage of maximum Aftertreatment 1 SCR Catalyst Reagent Tank Fill Valve opening. 100% means the";
CM_ SG_ 3221225472 Aftrtrtmnt1SCRCtlystRgntRtrnVlve "Command to the valve which determines whether the reagent is delivered to the injector or is routed back to the reagent";
CM_ SG_ 3221225472 Aftrtrtmnt1SCRCtlystRgntPmpDrvPr "The percent (command) sent to the motor to control the speed of the reagent pump.";
CM_ SG_ 3221225472 Aftrtrtmnt1SCRCtlystRgntPmpMtrSp "Rotational speed of the motor driving a pump for reagent used in an aftertreatment system.";
CM_ SG_ 3221225472 Aftrtrtmnt1SCRCtlystOtltGsTmpPrl "Used to identify the applicable J1939-73 FMI detected in the SCR catalyst outlet gas temperature sensor by the";
CM_ SG_ 3221225472 Aftrtrtmnt1SCRCtlystOtletGasTemp "Temperature of engine combustion byproducts leaving the SCR catalyst exhaust in exhaust bank 1.";
CM_ SG_ 3221225472 Aftrtrtmnt1SCRCtlystIntkGsTmpPrl "Used to identify the applicable J1939-73 FMI detected in the SCR catalyst intake gas temperature sensor by the";
CM_ SG_ 3221225472 Aftrtrtmnt1SCRCtlystIntkeGasTemp "Temperature of engine combustion byproducts entering the SCR catalyst in exhaust bank 1.";
CM_ SG_ 3221225472 Aftrtrtmnt1SCRCtlystExhstGsDffPr "Used to identify the applicable J1939-73 FMI detected in the SCR catalyst differential pressure sensor by theExhaust differential pressure measured between the intake and exhaust of a SCR catalyst in exhaust bank 1.";
CM_ SG_ 3221225472 Aftrtrtmnt1SCRCtlystTnk2HaterCmd "This is the command for the Aftertreatment 1 SCR Catalyst Tank 2 Heater. See SPN 4372 for the measured value of the";
CM_ SG_ 3221225472 Aftrtrtmnt1SCRCtlystTnkHeaterCmd "Command for the Aftertreatment 1 SCR Catalyst Tank Heater. A value of 0% means no heating applied, a value of 100%";
CM_ SG_ 3221225472 Aftrtrtmnt1SCRCtlystRgntLnHater4 "The SCR catalyst reagent line heater 4 request for aftertreatment system 1 (exhaust bank 1).";
CM_ SG_ 3221225472 Aftrtrtmnt1SCRCtlystRgntLnHater3 "The SCR catalyst reagent line heater 3 request for aftertreatment system 1 (exhaust bank 1).";
CM_ SG_ 3221225472 Aftrtrtmnt1SCRCtlystRgntLnHater2 "The SCR catalyst reagent line heater 2 request for aftertreatment system 1 (exhaust bank 1).";
CM_ SG_ 3221225472 Aftrtrtmnt1SCRCtlystRgntLnHater1 "The SCR catalyst reagent line heater 1 request for aftertreatment system 1 (exhaust bank 1).";
CM_ SG_ 3221225472 Aftrtrtmnt1SCRDoserHeatingModeRq "Used if multiple heater modes are available in the Doser.";
CM_ SG_ 3221225472 Aftrtrtmnt1SCRDsrFltSppressionRq "Used if external devices can warn of conditions that require suppression of potential faults in the doser due to";
CM_ SG_ 3221225472 Aftrtrtmnt1SCRRqstdRgntQnttyFrIn "Represents the command for the reducing agent quantity integrator in the dosing control unit";
CM_ SG_ 3221225472 Aftrtrtmnt1SCRSystmRquestedState "Requested state of SCR system for aftertreatment system 1 (exhaust bank 1).";
CM_ SG_ 3221225472 Aftrtrtmnt1SCRRqstdDsngRgntQntty "Actual requested dosing quantity of catalyst reagent";
CM_ SG_ 3221225472 Aftrtrtmnt1SCRCtlystRgntLnHtr4Pr "Used to identify the applicable J1939-73 FMI detected in the SCR catalyst reagent line heater 4, by the manufacturer’s";
CM_ SG_ 3221225472 Aftrtrtmnt1SCRCtlystRgntLnHtr4St "The SCR catalyst reagent line heater 4 state for aftertreatment system 1 (exhaust bank 1).";
CM_ SG_ 3221225472 Aftrtrtmnt1SCRCtlystRgntLnHtr3Pr "Used to identify the applicable J1939-73 FMI detected in the SCR catalyst reagent line heater 3, by the manufacturer’s";
CM_ SG_ 3221225472 Aftrtrtmnt1SCRCtlystRgntLnHtr3St "The SCR catalyst reagent line heater 3 state for aftertreatment system 1 (exhaust bank 1).";
CM_ SG_ 3221225472 Aftrtrtmnt1SCRCtlystRgntLnHtr2Pr "Used to identify the applicable J1939-73 FMI detected in the SCR catalyst reagent line heater 2, by the manufacturer’s";
CM_ SG_ 3221225472 Aftrtrtmnt1SCRCtlystRgntLnHtr2St "The SCR catalyst reagent line heater 2 state for aftertreatment system 1 (exhaust bank 1).";
CM_ SG_ 3221225472 Aftrtrtmnt1SCRCtlystRgntLnHtr1Pr "Used to identify the applicable J1939-73 FMI detected in the SCR catalyst reagent line heater 1, by the manufacturer’s";
CM_ SG_ 3221225472 Aftrtrtmnt1SCRCtlystRgntLnHtr1St "The SCR catalyst reagent line heater 1 state for aftertreatment system 1 (exhaust bank 1).";
CM_ SG_ 3221225472 Aftrtrtmnt1SCRFeedbackCtrlStatus "The SCR feedback control status (open/closed loop) for aftertreatment system 1 (exhaust bank 1).";
CM_ SG_ 3221225472 Aftrtrtmnt1SCRDsngVlvExhstTmpRdc "Protection request for the dosing valve of the SCR-system to prevent overheating";
CM_ SG_ 3221225472 Aftrtrtment1SCRDosingReagentTemp "The SCR dosing reagent temperature (measured closest to dosing valve) for aftertreatment system 1 (exhaust bank 1).";
CM_ SG_ 3221225472 Aftrtrtmnt1SCRDsngAirAssistValve "The position of the valve used to regulate the air supply of an air assist SCR dosing system for an engine. 0% represents";
CM_ SG_ 3221225472 Aftrtrtmnt1SCRDsngArAssstAbsPrss "The SCR dosing system air assist absolute pressure for aftertreatment system 1 (exhaust bank 1). The air assist system";
CM_ SG_ 3221225472 Aftrtrtmnt1SCRDsngRagentAbsPress "The SCR dosing reagent absolute pressure (measured closest to dosing valve) for aftertreatment system 1 (exhaust bank";
CM_ SG_ 3221225472 Aftrtrtmnt1SCRActlRgntQnttyOfInt "The SCR requested reagent integrator total quantity for aftertreatment system 1 (exhaust bank 1).";
CM_ SG_ 3221225472 Aftertreatment1SCRSystemState "Actual state of SCR system";
CM_ SG_ 3221225472 Aftrtrtmnt1SCRActlDsngRgntQntity "Actual reducing agent quantity of SCR-system";
CM_ SG_ 3221225472 Aftrtrtmnt1OtltNH3GsSnsrHterCtrl "Indicates the heater status in the warm-up process. Upon receiving a power-up command, the NH3 gas sensor ramps up";
CM_ SG_ 3221225472 Aftrtrtmnt1OtltNH3GsSnsrHtrPrlmn "Used to identify the applicable J1939-73 FMI detected in the heater of the outlet NH3 exhaust gas sensor by the";
CM_ SG_ 3221225472 Aftrtrtmnt1OtltNH3GsSensorAtTemp "Indicates that the heater element of the aftertreatment outlet NH3 gas sensor is within the manufacturer’s specified range";
CM_ SG_ 3221225472 Aftrtrtmnt1OtltNH3GsSnsrPwrInRng "Indicates that the power supplied to the aftertreatment outlet NH3 gas sensor is within the manufacturer’s specification in";
CM_ SG_ 3221225472 Aftrtrtmnt1OtletNH3ReadingStable "Indicates that the NH3 reading of the aftertreatment outlet NH3 sensor is stable as determined by the manufacturer’s";
CM_ SG_ 3221225472 Aftrtrtmnt1OtltNH3SnsrPrlmnryFMI "Used to identify the applicable J1939-73 FMI detected in the aftertreatment outlet NH3 sensor by the manufacturer’s";
CM_ SG_ 3221225472 Aftertreatment1OutletNH3 "The amount of NH3 in the exhaust exiting the aftertreatment system measured by a NH3 sensor at the aftertreatment";
CM_ SG_ 3221225472 Aftrtrtmnt1GsOxdtnCtlystDffPrssP "Used to identify the applicable J1939-73 FMI detected in the gas oxidation catalyst differential pressure sensor by the";
CM_ SG_ 3221225472 Aftrtrtmnt1GsOxdtnCtlystOtltGsTm "Used to identify the applicable J1939-73 FMI detected in the gas oxidation catalyst outlet gas temperature sensor by theTemperature of engine combustion byproducts leaving the gas oxidation catalyst in exhaust bank 1. This gas parameter";
CM_ SG_ 3221225472 Aftrtrtmnt1GsOxdtnCtlystIntkGsTm "Used to identify the applicable J1939-73 FMI detected in the gas oxidation catalyst intake gas temperature sensor by theTemperature of engine combustion byproducts entering the gas oxidation catalyst in exhaust bank 1. This gas parameter";
CM_ SG_ 3221225472 Aftrtrtmnt1GsOxdtnCtlystDffPress "Exhaust differential pressure measured between the intake and exhaust of the gas oxidation catalyst in exhaust bank 1.";
BA_DEF_ SG_  "SigType" ENUM  "Default","Range","RangeSigned","ASCII","Discrete","Control","ReferencePGN","DTC","StringDelimiter","StringLength","StringLengthControl";
BA_DEF_ SG_  "GenSigStartValue" INT 0 10000;
BA_DEF_ SG_  "GenSigSendType" ENUM  "Cyclic","OnWrite","reserved","OnChange","reserved","reserved","reserved","NoSigSendType";
BA_DEF_ SG_  "GenSigILSupport" ENUM  "Yes","No";
BA_DEF_ SG_  "GenSigEVName" STRING ;
BA_DEF_ SG_  "SPN" INT 0 524287;
BA_DEF_ SG_  "SAEDocument" STRING ;
BA_DEF_ BO_  "GenMsgILSupport" ENUM  "Yes","No";
BA_DEF_ BO_  "GenMsgRequestable" INT 0 1;
BA_DEF_ BO_  "GenMsgSendType" ENUM  "cyclic","reserved","cyclicIfActive","reserved","reserved","reserved","reserved","reserved","noMsgSendType";
BA_DEF_ BO_  "VFrameFormat" ENUM  "StandardCAN","ExtendedCAN","reserved","J1939PG";
BA_DEF_ BO_  "SingleFrame" INT 0 1;
BA_DEF_ BO_  "GenMsgCycleTime" INT 0 3600000;
BA_DEF_ BO_  "SAE_Document" STRING ;
BA_DEF_ SG_  "SystemSignalLongSymbol" STRING ;
BA_DEF_DEF_  "SigType" "Default";
BA_DEF_DEF_  "GenSigStartValue" 0;
BA_DEF_DEF_  "GenSigSendType" "NoSigSendType";
BA_DEF_DEF_  "GenSigILSupport" "Yes";
BA_DEF_DEF_  "GenSigEVName" "Env@Nodename_@Signame";
BA_DEF_DEF_  "SPN" 0;
BA_DEF_DEF_  "SAEDocument" "";
BA_DEF_DEF_  "GenMsgILSupport" "Yes";
BA_DEF_DEF_  "GenMsgRequestable" 1;
BA_DEF_DEF_  "GenMsgSendType" "noMsgSendType";
BA_DEF_DEF_  "VFrameFormat" "J1939PG";
BA_DEF_DEF_  "SingleFrame" 1;
BA_DEF_DEF_  "GenMsgCycleTime" 0;
BA_DEF_DEF_  "SAE_Document" "";
BA_DEF_DEF_  "SystemSignalLongSymbol" "";
BA_ "SAEDocument" SG_ 3221225472 Joystick9YAxisPos "J1939-71";
BA_ "SPN" SG_ 3221225472 Joystick9YAxisPos 4683;
BA_ "SAEDocument" SG_ 3221225472 Jystck9YAxsLvrFrwrdPstvPosStatus "J1939-71";
BA_ "SPN" SG_ 3221225472 Jystck9YAxsLvrFrwrdPstvPosStatus 4682;
BA_ "SigType" SG_ 3221225472 Jystck9YAxsLvrFrwrdPstvPosStatus 4;
BA_ "SAEDocument" SG_ 3221225472 Jystck9YAxsLvrBckNgtivePosStatus "J1939-71";
BA_ "SPN" SG_ 3221225472 Jystck9YAxsLvrBckNgtivePosStatus 4681;
BA_ "SigType" SG_ 3221225472 Jystck9YAxsLvrBckNgtivePosStatus 4;
BA_ "SAEDocument" SG_ 3221225472 Joystick9YAxisNeutralPosStatus "J1939-71";
BA_ "SPN" SG_ 3221225472 Joystick9YAxisNeutralPosStatus 4680;
BA_ "SigType" SG_ 3221225472 Joystick9YAxisNeutralPosStatus 4;
BA_ "SAEDocument" SG_ 3221225472 Joystick9XAxisPos "J1939-71";
BA_ "SPN" SG_ 3221225472 Joystick9XAxisPos 4679;
BA_ "SAEDocument" SG_ 3221225472 Jystck9XAxsLvrRghtPstvePosStatus "J1939-71";
BA_ "SPN" SG_ 3221225472 Jystck9XAxsLvrRghtPstvePosStatus 4678;
BA_ "SigType" SG_ 3221225472 Jystck9XAxsLvrRghtPstvePosStatus 4;
BA_ "SAEDocument" SG_ 3221225472 Jystck9XAxsLvrLftNgtivePosStatus "J1939-71";
BA_ "SPN" SG_ 3221225472 Jystck9XAxsLvrLftNgtivePosStatus 4677;
BA_ "SigType" SG_ 3221225472 Jystck9XAxsLvrLftNgtivePosStatus 4;
BA_ "SAEDocument" SG_ 3221225472 Joystick9XAxisNeutralPosStatus "J1939-71";
BA_ "SPN" SG_ 3221225472 Joystick9XAxisNeutralPosStatus 4676;
BA_ "SigType" SG_ 3221225472 Joystick9XAxisNeutralPosStatus 4;
BA_ "SAEDocument" SG_ 3221225472 Joystick8Button9PressedStatus "J1939-71";
BA_ "SPN" SG_ 3221225472 Joystick8Button9PressedStatus 4660;
BA_ "SigType" SG_ 3221225472 Joystick8Button9PressedStatus 4;
BA_ "SAEDocument" SG_ 3221225472 Joystick8Button10PressedStatus "J1939-71";
BA_ "SPN" SG_ 3221225472 Joystick8Button10PressedStatus 4659;
BA_ "SigType" SG_ 3221225472 Joystick8Button10PressedStatus 4;
BA_ "SAEDocument" SG_ 3221225472 Joystick8Button11PressedStatus "J1939-71";
BA_ "SPN" SG_ 3221225472 Joystick8Button11PressedStatus 4658;
BA_ "SigType" SG_ 3221225472 Joystick8Button11PressedStatus 4;
BA_ "SAEDocument" SG_ 3221225472 Joystick8Button12PressedStatus "J1939-71";
BA_ "SPN" SG_ 3221225472 Joystick8Button12PressedStatus 4657;
BA_ "SigType" SG_ 3221225472 Joystick8Button12PressedStatus 4;
BA_ "SAEDocument" SG_ 3221225472 Joystick8Button5PressedStatus "J1939-71";
BA_ "SPN" SG_ 3221225472 Joystick8Button5PressedStatus 4656;
BA_ "SigType" SG_ 3221225472 Joystick8Button5PressedStatus 4;
BA_ "SAEDocument" SG_ 3221225472 Joystick8Button6PressedStatus "J1939-71";
BA_ "SPN" SG_ 3221225472 Joystick8Button6PressedStatus 4655;
BA_ "SigType" SG_ 3221225472 Joystick8Button6PressedStatus 4;
BA_ "SAEDocument" SG_ 3221225472 Joystick8Button7PressedStatus "J1939-71";
BA_ "SPN" SG_ 3221225472 Joystick8Button7PressedStatus 4654;
BA_ "SigType" SG_ 3221225472 Joystick8Button7PressedStatus 4;
BA_ "SAEDocument" SG_ 3221225472 Joystick8Button8PressedStatus "J1939-71";
BA_ "SPN" SG_ 3221225472 Joystick8Button8PressedStatus 4653;
BA_ "SigType" SG_ 3221225472 Joystick8Button8PressedStatus 4;
BA_ "SAEDocument" SG_ 3221225472 Joystick8Button1PressedStatus "J1939-71";
BA_ "SPN" SG_ 3221225472 Joystick8Button1PressedStatus 4652;
BA_ "SigType" SG_ 3221225472 Joystick8Button1PressedStatus 4;
BA_ "SAEDocument" SG_ 3221225472 Joystick8Button2PressedStatus "J1939-71";
BA_ "SPN" SG_ 3221225472 Joystick8Button2PressedStatus 4651;
BA_ "SigType" SG_ 3221225472 Joystick8Button2PressedStatus 4;
BA_ "SAEDocument" SG_ 3221225472 Joystick8Button3PressedStatus "J1939-71";
BA_ "SPN" SG_ 3221225472 Joystick8Button3PressedStatus 4650;
BA_ "SigType" SG_ 3221225472 Joystick8Button3PressedStatus 4;
BA_ "SAEDocument" SG_ 3221225472 Joystick8Button4PressedStatus "J1939-71";
BA_ "SPN" SG_ 3221225472 Joystick8Button4PressedStatus 4649;
BA_ "SigType" SG_ 3221225472 Joystick8Button4PressedStatus 4;
BA_ "SAEDocument" SG_ 3221225472 Joystick8XAxisDetentPosStatus "J1939-71";
BA_ "SPN" SG_ 3221225472 Joystick8XAxisDetentPosStatus 4648;
BA_ "SigType" SG_ 3221225472 Joystick8XAxisDetentPosStatus 4;
BA_ "SAEDocument" SG_ 3221225472 Joystick8YAxisDetentPosStatus "J1939-71";
BA_ "SPN" SG_ 3221225472 Joystick8YAxisDetentPosStatus 4647;
BA_ "SigType" SG_ 3221225472 Joystick8YAxisDetentPosStatus 4;
BA_ "SAEDocument" SG_ 3221225472 Joystick8YAxisPos "J1939-71";
BA_ "SPN" SG_ 3221225472 Joystick8YAxisPos 4646;
BA_ "SAEDocument" SG_ 3221225472 Jystck8YAxsLvrFrwrdPstvPosStatus "J1939-71";
BA_ "SPN" SG_ 3221225472 Jystck8YAxsLvrFrwrdPstvPosStatus 4645;
BA_ "SigType" SG_ 3221225472 Jystck8YAxsLvrFrwrdPstvPosStatus 4;
BA_ "SAEDocument" SG_ 3221225472 Jystck8YAxsLvrBckNgtivePosStatus "J1939-71";
BA_ "SPN" SG_ 3221225472 Jystck8YAxsLvrBckNgtivePosStatus 4644;
BA_ "SigType" SG_ 3221225472 Jystck8YAxsLvrBckNgtivePosStatus 4;
BA_ "SAEDocument" SG_ 3221225472 Joystick8YAxisNeutralPosStatus "J1939-71";
BA_ "SPN" SG_ 3221225472 Joystick8YAxisNeutralPosStatus 4643;
BA_ "SigType" SG_ 3221225472 Joystick8YAxisNeutralPosStatus 4;
BA_ "SAEDocument" SG_ 3221225472 Joystick8XAxisPos "J1939-71";
BA_ "SPN" SG_ 3221225472 Joystick8XAxisPos 4642;
BA_ "SAEDocument" SG_ 3221225472 Jystck8XAxsLvrRghtPstvePosStatus "J1939-71";
BA_ "SPN" SG_ 3221225472 Jystck8XAxsLvrRghtPstvePosStatus 4641;
BA_ "SigType" SG_ 3221225472 Jystck8XAxsLvrRghtPstvePosStatus 4;
BA_ "SAEDocument" SG_ 3221225472 Jystck8XAxsLvrLftNgtivePosStatus "J1939-71";
BA_ "SPN" SG_ 3221225472 Jystck8XAxsLvrLftNgtivePosStatus 4640;
BA_ "SigType" SG_ 3221225472 Jystck8XAxsLvrLftNgtivePosStatus 4;
BA_ "SAEDocument" SG_ 3221225472 Joystick8XAxisNeutralPosStatus "J1939-71";
BA_ "SPN" SG_ 3221225472 Joystick8XAxisNeutralPosStatus 4639;
BA_ "SigType" SG_ 3221225472 Joystick8XAxisNeutralPosStatus 4;
BA_ "SAEDocument" SG_ 3221225472 Joystick7Button9PressedStatus "J1939-71";
BA_ "SPN" SG_ 3221225472 Joystick7Button9PressedStatus 4623;
BA_ "SigType" SG_ 3221225472 Joystick7Button9PressedStatus 4;
BA_ "SAEDocument" SG_ 3221225472 Joystick7Button10PressedStatus "J1939-71";
BA_ "SPN" SG_ 3221225472 Joystick7Button10PressedStatus 4622;
BA_ "SigType" SG_ 3221225472 Joystick7Button10PressedStatus 4;
BA_ "SAEDocument" SG_ 3221225472 Joystick7Button11PressedStatus "J1939-71";
BA_ "SPN" SG_ 3221225472 Joystick7Button11PressedStatus 4621;
BA_ "SigType" SG_ 3221225472 Joystick7Button11PressedStatus 4;
BA_ "SAEDocument" SG_ 3221225472 Joystick7Button12PressedStatus "J1939-71";
BA_ "SPN" SG_ 3221225472 Joystick7Button12PressedStatus 4620;
BA_ "SigType" SG_ 3221225472 Joystick7Button12PressedStatus 4;
BA_ "SAEDocument" SG_ 3221225472 Joystick7Button5PressedStatus "J1939-71";
BA_ "SPN" SG_ 3221225472 Joystick7Button5PressedStatus 4619;
BA_ "SigType" SG_ 3221225472 Joystick7Button5PressedStatus 4;
BA_ "SAEDocument" SG_ 3221225472 Joystick7Button6PressedStatus "J1939-71";
BA_ "SPN" SG_ 3221225472 Joystick7Button6PressedStatus 4618;
BA_ "SigType" SG_ 3221225472 Joystick7Button6PressedStatus 4;
BA_ "SAEDocument" SG_ 3221225472 Joystick7Button7PressedStatus "J1939-71";
BA_ "SPN" SG_ 3221225472 Joystick7Button7PressedStatus 4617;
BA_ "SigType" SG_ 3221225472 Joystick7Button7PressedStatus 4;
BA_ "SAEDocument" SG_ 3221225472 Joystick7Button8PressedStatus "J1939-71";
BA_ "SPN" SG_ 3221225472 Joystick7Button8PressedStatus 4616;
BA_ "SigType" SG_ 3221225472 Joystick7Button8PressedStatus 4;
BA_ "SAEDocument" SG_ 3221225472 Joystick7Button1PressedStatus "J1939-71";
BA_ "SPN" SG_ 3221225472 Joystick7Button1PressedStatus 4615;
BA_ "SigType" SG_ 3221225472 Joystick7Button1PressedStatus 4;
BA_ "SAEDocument" SG_ 3221225472 Joystick7Button2PressedStatus "J1939-71";
BA_ "SPN" SG_ 3221225472 Joystick7Button2PressedStatus 4614;
BA_ "SigType" SG_ 3221225472 Joystick7Button2PressedStatus 4;
BA_ "SAEDocument" SG_ 3221225472 Joystick7Button3PressedStatus "J1939-71";
BA_ "SPN" SG_ 3221225472 Joystick7Button3PressedStatus 4613;
BA_ "SigType" SG_ 3221225472 Joystick7Button3PressedStatus 4;
BA_ "SAEDocument" SG_ 3221225472 Joystick7Button4PressedStatus "J1939-71";
BA_ "SPN" SG_ 3221225472 Joystick7Button4PressedStatus 4612;
BA_ "SigType" SG_ 3221225472 Joystick7Button4PressedStatus 4;
BA_ "SAEDocument" SG_ 3221225472 Joystick7XAxisDetentPosStatus "J1939-71";
BA_ "SPN" SG_ 3221225472 Joystick7XAxisDetentPosStatus 4611;
BA_ "SigType" SG_ 3221225472 Joystick7XAxisDetentPosStatus 4;
BA_ "SAEDocument" SG_ 3221225472 Joystick7YAxisDetentPosStatus "J1939-71";
BA_ "SPN" SG_ 3221225472 Joystick7YAxisDetentPosStatus 4610;
BA_ "SigType" SG_ 3221225472 Joystick7YAxisDetentPosStatus 4;
BA_ "SAEDocument" SG_ 3221225472 Joystick7YAxisPos "J1939-71";
BA_ "SPN" SG_ 3221225472 Joystick7YAxisPos 4609;
BA_ "SAEDocument" SG_ 3221225472 Jystck7YAxsLvrFrwrdPstvPosStatus "J1939-71";
BA_ "SPN" SG_ 3221225472 Jystck7YAxsLvrFrwrdPstvPosStatus 4608;
BA_ "SigType" SG_ 3221225472 Jystck7YAxsLvrFrwrdPstvPosStatus 4;
BA_ "SAEDocument" SG_ 3221225472 Jystck7YAxsLvrBckNgtivePosStatus "J1939-71";
BA_ "SPN" SG_ 3221225472 Jystck7YAxsLvrBckNgtivePosStatus 4607;
BA_ "SigType" SG_ 3221225472 Jystck7YAxsLvrBckNgtivePosStatus 4;
BA_ "SAEDocument" SG_ 3221225472 Joystick7YAxisNeutralPosStatus "J1939-71";
BA_ "SPN" SG_ 3221225472 Joystick7YAxisNeutralPosStatus 4606;
BA_ "SigType" SG_ 3221225472 Joystick7YAxisNeutralPosStatus 4;
BA_ "SAEDocument" SG_ 3221225472 Joystick7XAxisPos "J1939-71";
BA_ "SPN" SG_ 3221225472 Joystick7XAxisPos 4605;
BA_ "SAEDocument" SG_ 3221225472 Jystck7XAxsLvrRghtPstvePosStatus "J1939-71";
BA_ "SPN" SG_ 3221225472 Jystck7XAxsLvrRghtPstvePosStatus 4604;
BA_ "SigType" SG_ 3221225472 Jystck7XAxsLvrRghtPstvePosStatus 4;
BA_ "SAEDocument" SG_ 3221225472 Jystck7XAxsLvrLftNgtivePosStatus "J1939-71";
BA_ "SPN" SG_ 3221225472 Jystck7XAxsLvrLftNgtivePosStatus 4603;
BA_ "SigType" SG_ 3221225472 Jystck7XAxsLvrLftNgtivePosStatus 4;
BA_ "SAEDocument" SG_ 3221225472 Joystick7XAxisNeutralPosStatus "J1939-71";
BA_ "SPN" SG_ 3221225472 Joystick7XAxisNeutralPosStatus 4602;
BA_ "SigType" SG_ 3221225472 Joystick7XAxisNeutralPosStatus 4;
BA_ "SAEDocument" SG_ 3221225472 Joystick6Button9PressedStatus "J1939-71";
BA_ "SPN" SG_ 3221225472 Joystick6Button9PressedStatus 4586;
BA_ "SigType" SG_ 3221225472 Joystick6Button9PressedStatus 4;
BA_ "SAEDocument" SG_ 3221225472 Joystick6Button10PressedStatus "J1939-71";
BA_ "SPN" SG_ 3221225472 Joystick6Button10PressedStatus 4585;
BA_ "SigType" SG_ 3221225472 Joystick6Button10PressedStatus 4;
BA_ "SAEDocument" SG_ 3221225472 Joystick6Button11PressedStatus "J1939-71";
BA_ "SPN" SG_ 3221225472 Joystick6Button11PressedStatus 4584;
BA_ "SigType" SG_ 3221225472 Joystick6Button11PressedStatus 4;
BA_ "SAEDocument" SG_ 3221225472 Joystick6Button12PressedStatus "J1939-71";
BA_ "SPN" SG_ 3221225472 Joystick6Button12PressedStatus 4583;
BA_ "SigType" SG_ 3221225472 Joystick6Button12PressedStatus 4;
BA_ "SAEDocument" SG_ 3221225472 Joystick6Button5PressedStatus "J1939-71";
BA_ "SPN" SG_ 3221225472 Joystick6Button5PressedStatus 4582;
BA_ "SigType" SG_ 3221225472 Joystick6Button5PressedStatus 4;
BA_ "SAEDocument" SG_ 3221225472 Joystick6Button6PressedStatus "J1939-71";
BA_ "SPN" SG_ 3221225472 Joystick6Button6PressedStatus 4581;
BA_ "SigType" SG_ 3221225472 Joystick6Button6PressedStatus 4;
BA_ "SAEDocument" SG_ 3221225472 Joystick6Button7PressedStatus "J1939-71";
BA_ "SPN" SG_ 3221225472 Joystick6Button7PressedStatus 4580;
BA_ "SigType" SG_ 3221225472 Joystick6Button7PressedStatus 4;
BA_ "SAEDocument" SG_ 3221225472 Joystick6Button8PressedStatus "J1939-71";
BA_ "SPN" SG_ 3221225472 Joystick6Button8PressedStatus 4579;
BA_ "SigType" SG_ 3221225472 Joystick6Button8PressedStatus 4;
BA_ "SAEDocument" SG_ 3221225472 Joystick6Button1PressedStatus "J1939-71";
BA_ "SPN" SG_ 3221225472 Joystick6Button1PressedStatus 4578;
BA_ "SigType" SG_ 3221225472 Joystick6Button1PressedStatus 4;
BA_ "SAEDocument" SG_ 3221225472 Joystick6Button2PressedStatus "J1939-71";
BA_ "SPN" SG_ 3221225472 Joystick6Button2PressedStatus 4577;
BA_ "SigType" SG_ 3221225472 Joystick6Button2PressedStatus 4;
BA_ "SAEDocument" SG_ 3221225472 Joystick6Button3PressedStatus "J1939-71";
BA_ "SPN" SG_ 3221225472 Joystick6Button3PressedStatus 4576;
BA_ "SigType" SG_ 3221225472 Joystick6Button3PressedStatus 4;
BA_ "SAEDocument" SG_ 3221225472 Joystick6Button4PressedStatus "J1939-71";
BA_ "SPN" SG_ 3221225472 Joystick6Button4PressedStatus 4575;
BA_ "SigType" SG_ 3221225472 Joystick6Button4PressedStatus 4;
BA_ "SAEDocument" SG_ 3221225472 Joystick6XAxisDetentPosStatus "J1939-71";
BA_ "SPN" SG_ 3221225472 Joystick6XAxisDetentPosStatus 4574;
BA_ "SigType" SG_ 3221225472 Joystick6XAxisDetentPosStatus 4;
BA_ "SAEDocument" SG_ 3221225472 Joystick6YAxisDetentPosStatus "J1939-71";
BA_ "SPN" SG_ 3221225472 Joystick6YAxisDetentPosStatus 4573;
BA_ "SigType" SG_ 3221225472 Joystick6YAxisDetentPosStatus 4;
BA_ "SAEDocument" SG_ 3221225472 Joystick6YAxisPos "J1939-71";
BA_ "SPN" SG_ 3221225472 Joystick6YAxisPos 4572;
BA_ "SAEDocument" SG_ 3221225472 Jystck6YAxsLvrFrwrdPstvPosStatus "J1939-71";
BA_ "SPN" SG_ 3221225472 Jystck6YAxsLvrFrwrdPstvPosStatus 4571;
BA_ "SigType" SG_ 3221225472 Jystck6YAxsLvrFrwrdPstvPosStatus 4;
BA_ "SAEDocument" SG_ 3221225472 Jystck6YAxsLvrBckNgtivePosStatus "J1939-71";
BA_ "SPN" SG_ 3221225472 Jystck6YAxsLvrBckNgtivePosStatus 4570;
BA_ "SigType" SG_ 3221225472 Jystck6YAxsLvrBckNgtivePosStatus 4;
BA_ "SAEDocument" SG_ 3221225472 Joystick6YAxisNeutralPosStatus "J1939-71";
BA_ "SPN" SG_ 3221225472 Joystick6YAxisNeutralPosStatus 4569;
BA_ "SigType" SG_ 3221225472 Joystick6YAxisNeutralPosStatus 4;
BA_ "SAEDocument" SG_ 3221225472 Joystick6XAxisPos "J1939-71";
BA_ "SPN" SG_ 3221225472 Joystick6XAxisPos 4568;
BA_ "SAEDocument" SG_ 3221225472 Jystck6XAxsLvrRghtPstvePosStatus "J1939-71";
BA_ "SPN" SG_ 3221225472 Jystck6XAxsLvrRghtPstvePosStatus 4567;
BA_ "SigType" SG_ 3221225472 Jystck6XAxsLvrRghtPstvePosStatus 4;
BA_ "SAEDocument" SG_ 3221225472 Jystck6XAxsLvrLftNgtivePosStatus "J1939-71";
BA_ "SPN" SG_ 3221225472 Jystck6XAxsLvrLftNgtivePosStatus 4566;
BA_ "SigType" SG_ 3221225472 Jystck6XAxsLvrLftNgtivePosStatus 4;
BA_ "SAEDocument" SG_ 3221225472 Joystick6XAxisNeutralPosStatus "J1939-71";
BA_ "SPN" SG_ 3221225472 Joystick6XAxisNeutralPosStatus 4565;
BA_ "SigType" SG_ 3221225472 Joystick6XAxisNeutralPosStatus 4;
BA_ "SAEDocument" SG_ 3221225472 Joystick5Button9PressedStatus "J1939-71";
BA_ "SPN" SG_ 3221225472 Joystick5Button9PressedStatus 4549;
BA_ "SigType" SG_ 3221225472 Joystick5Button9PressedStatus 4;
BA_ "SAEDocument" SG_ 3221225472 Joystick5Button10PressedStatus "J1939-71";
BA_ "SPN" SG_ 3221225472 Joystick5Button10PressedStatus 4548;
BA_ "SigType" SG_ 3221225472 Joystick5Button10PressedStatus 4;
BA_ "SAEDocument" SG_ 3221225472 Joystick5Button11PressedStatus "J1939-71";
BA_ "SPN" SG_ 3221225472 Joystick5Button11PressedStatus 4547;
BA_ "SigType" SG_ 3221225472 Joystick5Button11PressedStatus 4;
BA_ "SAEDocument" SG_ 3221225472 Joystick5Button12PressedStatus "J1939-71";
BA_ "SPN" SG_ 3221225472 Joystick5Button12PressedStatus 4546;
BA_ "SigType" SG_ 3221225472 Joystick5Button12PressedStatus 4;
BA_ "SAEDocument" SG_ 3221225472 Joystick5Button5PressedStatus "J1939-71";
BA_ "SPN" SG_ 3221225472 Joystick5Button5PressedStatus 4545;
BA_ "SigType" SG_ 3221225472 Joystick5Button5PressedStatus 4;
BA_ "SAEDocument" SG_ 3221225472 Joystick5Button6PressedStatus "J1939-71";
BA_ "SPN" SG_ 3221225472 Joystick5Button6PressedStatus 4544;
BA_ "SigType" SG_ 3221225472 Joystick5Button6PressedStatus 4;
BA_ "SAEDocument" SG_ 3221225472 Joystick5Button7PressedStatus "J1939-71";
BA_ "SPN" SG_ 3221225472 Joystick5Button7PressedStatus 4543;
BA_ "SigType" SG_ 3221225472 Joystick5Button7PressedStatus 4;
BA_ "SAEDocument" SG_ 3221225472 Joystick5Button8PressedStatus "J1939-71";
BA_ "SPN" SG_ 3221225472 Joystick5Button8PressedStatus 4542;
BA_ "SigType" SG_ 3221225472 Joystick5Button8PressedStatus 4;
BA_ "SAEDocument" SG_ 3221225472 Joystick5Button1PressedStatus "J1939-71";
BA_ "SPN" SG_ 3221225472 Joystick5Button1PressedStatus 4541;
BA_ "SigType" SG_ 3221225472 Joystick5Button1PressedStatus 4;
BA_ "SAEDocument" SG_ 3221225472 Joystick5Button2PressedStatus "J1939-71";
BA_ "SPN" SG_ 3221225472 Joystick5Button2PressedStatus 4540;
BA_ "SigType" SG_ 3221225472 Joystick5Button2PressedStatus 4;
BA_ "SAEDocument" SG_ 3221225472 Joystick5Button3PressedStatus "J1939-71";
BA_ "SPN" SG_ 3221225472 Joystick5Button3PressedStatus 4539;
BA_ "SigType" SG_ 3221225472 Joystick5Button3PressedStatus 4;
BA_ "SAEDocument" SG_ 3221225472 Joystick5Button4PressedStatus "J1939-71";
BA_ "SPN" SG_ 3221225472 Joystick5Button4PressedStatus 4538;
BA_ "SigType" SG_ 3221225472 Joystick5Button4PressedStatus 4;
BA_ "SAEDocument" SG_ 3221225472 Joystick5XAxisDetentPosStatus "J1939-71";
BA_ "SPN" SG_ 3221225472 Joystick5XAxisDetentPosStatus 4537;
BA_ "SigType" SG_ 3221225472 Joystick5XAxisDetentPosStatus 4;
BA_ "SAEDocument" SG_ 3221225472 Joystick5YAxisDetentPosStatus "J1939-71";
BA_ "SPN" SG_ 3221225472 Joystick5YAxisDetentPosStatus 4536;
BA_ "SigType" SG_ 3221225472 Joystick5YAxisDetentPosStatus 4;
BA_ "SAEDocument" SG_ 3221225472 Joystick5YAxisPos "J1939-71";
BA_ "SPN" SG_ 3221225472 Joystick5YAxisPos 4535;
BA_ "SAEDocument" SG_ 3221225472 Jystck5YAxsLvrFrwrdPstvPosStatus "J1939-71";
BA_ "SPN" SG_ 3221225472 Jystck5YAxsLvrFrwrdPstvPosStatus 4534;
BA_ "SigType" SG_ 3221225472 Jystck5YAxsLvrFrwrdPstvPosStatus 4;
BA_ "SAEDocument" SG_ 3221225472 Jystck5YAxsLvrBckNgtivePosStatus "J1939-71";
BA_ "SPN" SG_ 3221225472 Jystck5YAxsLvrBckNgtivePosStatus 4533;
BA_ "SigType" SG_ 3221225472 Jystck5YAxsLvrBckNgtivePosStatus 4;
BA_ "SAEDocument" SG_ 3221225472 Joystick5YAxisNeutralPosStatus "J1939-71";
BA_ "SPN" SG_ 3221225472 Joystick5YAxisNeutralPosStatus 4532;
BA_ "SigType" SG_ 3221225472 Joystick5YAxisNeutralPosStatus 4;
BA_ "SAEDocument" SG_ 3221225472 Joystick5XAxisPos "J1939-71";
BA_ "SPN" SG_ 3221225472 Joystick5XAxisPos 4531;
BA_ "SAEDocument" SG_ 3221225472 Jystck5XAxsLvrRghtPstvePosStatus "J1939-71";
BA_ "SPN" SG_ 3221225472 Jystck5XAxsLvrRghtPstvePosStatus 4530;
BA_ "SigType" SG_ 3221225472 Jystck5XAxsLvrRghtPstvePosStatus 4;
BA_ "SAEDocument" SG_ 3221225472 Jystck5XAxsLvrLftNgtivePosStatus "J1939-71";
BA_ "SPN" SG_ 3221225472 Jystck5XAxsLvrLftNgtivePosStatus 4529;
BA_ "SigType" SG_ 3221225472 Jystck5XAxsLvrLftNgtivePosStatus 4;
BA_ "SAEDocument" SG_ 3221225472 Joystick5XAxisNeutralPosStatus "J1939-71";
BA_ "SPN" SG_ 3221225472 Joystick5XAxisNeutralPosStatus 4528;
BA_ "SigType" SG_ 3221225472 Joystick5XAxisNeutralPosStatus 4;
BA_ "SAEDocument" SG_ 3221225472 Joystick4Button9PressedStatus "J1939-71";
BA_ "SPN" SG_ 3221225472 Joystick4Button9PressedStatus 4512;
BA_ "SigType" SG_ 3221225472 Joystick4Button9PressedStatus 4;
BA_ "SAEDocument" SG_ 3221225472 Joystick4Button10PressedStatus "J1939-71";
BA_ "SPN" SG_ 3221225472 Joystick4Button10PressedStatus 4511;
BA_ "SigType" SG_ 3221225472 Joystick4Button10PressedStatus 4;
BA_ "SAEDocument" SG_ 3221225472 Joystick4Button11PressedStatus "J1939-71";
BA_ "SPN" SG_ 3221225472 Joystick4Button11PressedStatus 4510;
BA_ "SigType" SG_ 3221225472 Joystick4Button11PressedStatus 4;
BA_ "SAEDocument" SG_ 3221225472 Joystick4Button12PressedStatus "J1939-71";
BA_ "SPN" SG_ 3221225472 Joystick4Button12PressedStatus 4509;
BA_ "SigType" SG_ 3221225472 Joystick4Button12PressedStatus 4;
BA_ "SAEDocument" SG_ 3221225472 Joystick4Button5PressedStatus "J1939-71";
BA_ "SPN" SG_ 3221225472 Joystick4Button5PressedStatus 4508;
BA_ "SigType" SG_ 3221225472 Joystick4Button5PressedStatus 4;
BA_ "SAEDocument" SG_ 3221225472 Joystick4Button6PressedStatus "J1939-71";
BA_ "SPN" SG_ 3221225472 Joystick4Button6PressedStatus 4507;
BA_ "SigType" SG_ 3221225472 Joystick4Button6PressedStatus 4;
BA_ "SAEDocument" SG_ 3221225472 Joystick4Button7PressedStatus "J1939-71";
BA_ "SPN" SG_ 3221225472 Joystick4Button7PressedStatus 4506;
BA_ "SigType" SG_ 3221225472 Joystick4Button7PressedStatus 4;
BA_ "SAEDocument" SG_ 3221225472 Joystick4Button8PressedStatus "J1939-71";
BA_ "SPN" SG_ 3221225472 Joystick4Button8PressedStatus 4505;
BA_ "SigType" SG_ 3221225472 Joystick4Button8PressedStatus 4;
BA_ "SAEDocument" SG_ 3221225472 Joystick4Button1PressedStatus "J1939-71";
BA_ "SPN" SG_ 3221225472 Joystick4Button1PressedStatus 4504;
BA_ "SigType" SG_ 3221225472 Joystick4Button1PressedStatus 4;
BA_ "SAEDocument" SG_ 3221225472 Joystick4Button2PressedStatus "J1939-71";
BA_ "SPN" SG_ 3221225472 Joystick4Button2PressedStatus 4503;
BA_ "SigType" SG_ 3221225472 Joystick4Button2PressedStatus 4;
BA_ "SAEDocument" SG_ 3221225472 Joystick4Button3PressedStatus "J1939-71";
BA_ "SPN" SG_ 3221225472 Joystick4Button3PressedStatus 4502;
BA_ "SigType" SG_ 3221225472 Joystick4Button3PressedStatus 4;
BA_ "SAEDocument" SG_ 3221225472 Joystick4Button4PressedStatus "J1939-71";
BA_ "SPN" SG_ 3221225472 Joystick4Button4PressedStatus 4501;
BA_ "SigType" SG_ 3221225472 Joystick4Button4PressedStatus 4;
BA_ "SAEDocument" SG_ 3221225472 Joystick4XAxisDetentPosStatus "J1939-71";
BA_ "SPN" SG_ 3221225472 Joystick4XAxisDetentPosStatus 4500;
BA_ "SigType" SG_ 3221225472 Joystick4XAxisDetentPosStatus 4;
BA_ "SAEDocument" SG_ 3221225472 Joystick4YAxisDetentPosStatus "J1939-71";
BA_ "SPN" SG_ 3221225472 Joystick4YAxisDetentPosStatus 4499;
BA_ "SigType" SG_ 3221225472 Joystick4YAxisDetentPosStatus 4;
BA_ "SAEDocument" SG_ 3221225472 Joystick4YAxisPos "J1939-71";
BA_ "SPN" SG_ 3221225472 Joystick4YAxisPos 4498;
BA_ "SAEDocument" SG_ 3221225472 Jystck4YAxsLvrFrwrdPstvPosStatus "J1939-71";
BA_ "SPN" SG_ 3221225472 Jystck4YAxsLvrFrwrdPstvPosStatus 4497;
BA_ "SigType" SG_ 3221225472 Jystck4YAxsLvrFrwrdPstvPosStatus 4;
BA_ "SAEDocument" SG_ 3221225472 Jystck4YAxsLvrBckNgtivePosStatus "J1939-71";
BA_ "SPN" SG_ 3221225472 Jystck4YAxsLvrBckNgtivePosStatus 4496;
BA_ "SigType" SG_ 3221225472 Jystck4YAxsLvrBckNgtivePosStatus 4;
BA_ "SAEDocument" SG_ 3221225472 Joystick4YAxisNeutralPosStatus "J1939-71";
BA_ "SPN" SG_ 3221225472 Joystick4YAxisNeutralPosStatus 4495;
BA_ "SigType" SG_ 3221225472 Joystick4YAxisNeutralPosStatus 4;
BA_ "SAEDocument" SG_ 3221225472 Joystick4XAxisPos "J1939-71";
BA_ "SPN" SG_ 3221225472 Joystick4XAxisPos 4494;
BA_ "SAEDocument" SG_ 3221225472 Jystck4XAxsLvrRghtPstvePosStatus "J1939-71";
BA_ "SPN" SG_ 3221225472 Jystck4XAxsLvrRghtPstvePosStatus 4493;
BA_ "SigType" SG_ 3221225472 Jystck4XAxsLvrRghtPstvePosStatus 4;
BA_ "SAEDocument" SG_ 3221225472 Jystck4XAxsLvrLftNgtivePosStatus "J1939-71";
BA_ "SPN" SG_ 3221225472 Jystck4XAxsLvrLftNgtivePosStatus 4492;
BA_ "SigType" SG_ 3221225472 Jystck4XAxsLvrLftNgtivePosStatus 4;
BA_ "SAEDocument" SG_ 3221225472 Joystick4XAxisNeutralPosStatus "J1939-71";
BA_ "SPN" SG_ 3221225472 Joystick4XAxisNeutralPosStatus 4491;
BA_ "SigType" SG_ 3221225472 Joystick4XAxisNeutralPosStatus 4;
BA_ "SAEDocument" SG_ 3221225472 Joystick10Button9PressedStatus "J1939-71";
BA_ "SPN" SG_ 3221225472 Joystick10Button9PressedStatus 4734;
BA_ "SigType" SG_ 3221225472 Joystick10Button9PressedStatus 4;
BA_ "SAEDocument" SG_ 3221225472 Joystick10Button10PressedStatus "J1939-71";
BA_ "SPN" SG_ 3221225472 Joystick10Button10PressedStatus 4733;
BA_ "SigType" SG_ 3221225472 Joystick10Button10PressedStatus 4;
BA_ "SAEDocument" SG_ 3221225472 Joystick10Button11PressedStatus "J1939-71";
BA_ "SPN" SG_ 3221225472 Joystick10Button11PressedStatus 4732;
BA_ "SigType" SG_ 3221225472 Joystick10Button11PressedStatus 4;
BA_ "SAEDocument" SG_ 3221225472 Joystick10Button12PressedStatus "J1939-71";
BA_ "SPN" SG_ 3221225472 Joystick10Button12PressedStatus 4731;
BA_ "SigType" SG_ 3221225472 Joystick10Button12PressedStatus 4;
BA_ "SAEDocument" SG_ 3221225472 Joystick10Button5PressedStatus "J1939-71";
BA_ "SPN" SG_ 3221225472 Joystick10Button5PressedStatus 4730;
BA_ "SigType" SG_ 3221225472 Joystick10Button5PressedStatus 4;
BA_ "SAEDocument" SG_ 3221225472 Joystick10Button6PressedStatus "J1939-71";
BA_ "SPN" SG_ 3221225472 Joystick10Button6PressedStatus 4729;
BA_ "SigType" SG_ 3221225472 Joystick10Button6PressedStatus 4;
BA_ "SAEDocument" SG_ 3221225472 Joystick10Button7PressedStatus "J1939-71";
BA_ "SPN" SG_ 3221225472 Joystick10Button7PressedStatus 4728;
BA_ "SigType" SG_ 3221225472 Joystick10Button7PressedStatus 4;
BA_ "SAEDocument" SG_ 3221225472 Joystick10Button8PressedStatus "J1939-71";
BA_ "SPN" SG_ 3221225472 Joystick10Button8PressedStatus 4727;
BA_ "SigType" SG_ 3221225472 Joystick10Button8PressedStatus 4;
BA_ "SAEDocument" SG_ 3221225472 Joystick10Button1PressedStatus "J1939-71";
BA_ "SPN" SG_ 3221225472 Joystick10Button1PressedStatus 4726;
BA_ "SigType" SG_ 3221225472 Joystick10Button1PressedStatus 4;
BA_ "SAEDocument" SG_ 3221225472 Joystick10Button2PressedStatus "J1939-71";
BA_ "SPN" SG_ 3221225472 Joystick10Button2PressedStatus 4725;
BA_ "SigType" SG_ 3221225472 Joystick10Button2PressedStatus 4;
BA_ "SAEDocument" SG_ 3221225472 Joystick10Button3PressedStatus "J1939-71";
BA_ "SPN" SG_ 3221225472 Joystick10Button3PressedStatus 4724;
BA_ "SigType" SG_ 3221225472 Joystick10Button3PressedStatus 4;
BA_ "SAEDocument" SG_ 3221225472 Joystick10Button4PressedStatus "J1939-71";
BA_ "SPN" SG_ 3221225472 Joystick10Button4PressedStatus 4723;
BA_ "SigType" SG_ 3221225472 Joystick10Button4PressedStatus 4;
BA_ "SAEDocument" SG_ 3221225472 Joystick10XAxisDetentPosStatus "J1939-71";
BA_ "SPN" SG_ 3221225472 Joystick10XAxisDetentPosStatus 4722;
BA_ "SigType" SG_ 3221225472 Joystick10XAxisDetentPosStatus 4;
BA_ "SAEDocument" SG_ 3221225472 Joystick10YAxisDetentPosStatus "J1939-71";
BA_ "SPN" SG_ 3221225472 Joystick10YAxisDetentPosStatus 4721;
BA_ "SigType" SG_ 3221225472 Joystick10YAxisDetentPosStatus 4;
BA_ "SAEDocument" SG_ 3221225472 Joystick10YAxisPos "J1939-71";
BA_ "SPN" SG_ 3221225472 Joystick10YAxisPos 4720;
BA_ "SAEDocument" SG_ 3221225472 Jystck10YAxsLvrFrwrdPstvPsStatus "J1939-71";
BA_ "SPN" SG_ 3221225472 Jystck10YAxsLvrFrwrdPstvPsStatus 4719;
BA_ "SigType" SG_ 3221225472 Jystck10YAxsLvrFrwrdPstvPsStatus 4;
BA_ "SAEDocument" SG_ 3221225472 Jystck10YAxsLvrBckNgtvePosStatus "J1939-71";
BA_ "SPN" SG_ 3221225472 Jystck10YAxsLvrBckNgtvePosStatus 4718;
BA_ "SigType" SG_ 3221225472 Jystck10YAxsLvrBckNgtvePosStatus 4;
BA_ "SAEDocument" SG_ 3221225472 Joystick10YAxisNeutralPosStatus "J1939-71";
BA_ "SPN" SG_ 3221225472 Joystick10YAxisNeutralPosStatus 4717;
BA_ "SigType" SG_ 3221225472 Joystick10YAxisNeutralPosStatus 4;
BA_ "SAEDocument" SG_ 3221225472 Joystick10XAxisPos "J1939-71";
BA_ "SPN" SG_ 3221225472 Joystick10XAxisPos 4716;
BA_ "SAEDocument" SG_ 3221225472 Jystck10XAxsLvrRghtPstvPosStatus "J1939-71";
BA_ "SPN" SG_ 3221225472 Jystck10XAxsLvrRghtPstvPosStatus 4715;
BA_ "SigType" SG_ 3221225472 Jystck10XAxsLvrRghtPstvPosStatus 4;
BA_ "SAEDocument" SG_ 3221225472 Jystck10XAxsLvrLftNgtvePosStatus "J1939-71";
BA_ "SPN" SG_ 3221225472 Jystck10XAxsLvrLftNgtvePosStatus 4714;
BA_ "SigType" SG_ 3221225472 Jystck10XAxsLvrLftNgtvePosStatus 4;
BA_ "SAEDocument" SG_ 3221225472 Joystick10XAxisNeutralPosStatus "J1939-71";
BA_ "SPN" SG_ 3221225472 Joystick10XAxisNeutralPosStatus 4713;
BA_ "SigType" SG_ 3221225472 Joystick10XAxisNeutralPosStatus 4;
BA_ "SAEDocument" SG_ 3221225472 PssngrArbgDctivationSwitchStatus "J1939-71";
BA_ "SPN" SG_ 3221225472 PssngrArbgDctivationSwitchStatus 4962;
BA_ "SigType" SG_ 3221225472 PssngrArbgDctivationSwitchStatus 5;
BA_ "SAEDocument" SG_ 3221225472 Beltlock10Status "J1939-71";
BA_ "SPN" SG_ 3221225472 Beltlock10Status 4961;
BA_ "SigType" SG_ 3221225472 Beltlock10Status 5;
BA_ "SAEDocument" SG_ 3221225472 Beltlock9Status "J1939-71";
BA_ "SPN" SG_ 3221225472 Beltlock9Status 4960;
BA_ "SigType" SG_ 3221225472 Beltlock9Status 5;
BA_ "SAEDocument" SG_ 3221225472 Beltlock8Status "J1939-71";
BA_ "SPN" SG_ 3221225472 Beltlock8Status 4959;
BA_ "SigType" SG_ 3221225472 Beltlock8Status 5;
BA_ "SAEDocument" SG_ 3221225472 Beltlock7Status "J1939-71";
BA_ "SPN" SG_ 3221225472 Beltlock7Status 4958;
BA_ "SigType" SG_ 3221225472 Beltlock7Status 5;
BA_ "SAEDocument" SG_ 3221225472 Beltlock6Status "J1939-71";
BA_ "SPN" SG_ 3221225472 Beltlock6Status 4957;
BA_ "SigType" SG_ 3221225472 Beltlock6Status 5;
BA_ "SAEDocument" SG_ 3221225472 Beltlock5Status "J1939-71";
BA_ "SPN" SG_ 3221225472 Beltlock5Status 4956;
BA_ "SigType" SG_ 3221225472 Beltlock5Status 5;
BA_ "SAEDocument" SG_ 3221225472 Beltlock4Status "J1939-71";
BA_ "SPN" SG_ 3221225472 Beltlock4Status 4955;
BA_ "SigType" SG_ 3221225472 Beltlock4Status 5;
BA_ "SAEDocument" SG_ 3221225472 Beltlock3Status "J1939-71";
BA_ "SPN" SG_ 3221225472 Beltlock3Status 4954;
BA_ "SigType" SG_ 3221225472 Beltlock3Status 5;
BA_ "SAEDocument" SG_ 3221225472 PassengerBeltlockStatus "J1939-71";
BA_ "SPN" SG_ 3221225472 PassengerBeltlockStatus 4953;
BA_ "SigType" SG_ 3221225472 PassengerBeltlockStatus 5;
BA_ "SAEDocument" SG_ 3221225472 DriverBeltlockStatus "J1939-71";
BA_ "SPN" SG_ 3221225472 DriverBeltlockStatus 4952;
BA_ "SigType" SG_ 3221225472 DriverBeltlockStatus 5;
BA_ "SAEDocument" SG_ 3221225472 BatteryCharger2OutputCurrent "J1939-71";
BA_ "SPN" SG_ 3221225472 BatteryCharger2OutputCurrent 4997;
BA_ "SigType" SG_ 3221225472 BatteryCharger2OutputCurrent 1;
BA_ "SAEDocument" SG_ 3221225472 BatteryCharger2OutputVoltage "J1939-71";
BA_ "SPN" SG_ 3221225472 BatteryCharger2OutputVoltage 4996;
BA_ "SigType" SG_ 3221225472 BatteryCharger2OutputVoltage 1;
BA_ "SAEDocument" SG_ 3221225472 BatteryCharger2PowerLineState "J1939-71";
BA_ "SPN" SG_ 3221225472 BatteryCharger2PowerLineState 4995;
BA_ "SigType" SG_ 3221225472 BatteryCharger2PowerLineState 4;
BA_ "SAEDocument" SG_ 3221225472 BatteryCharger2State "J1939-71";
BA_ "SPN" SG_ 3221225472 BatteryCharger2State 4994;
BA_ "SAEDocument" SG_ 3221225472 BatteryCharger1OutputCurrent "J1939-71";
BA_ "SPN" SG_ 3221225472 BatteryCharger1OutputCurrent 4993;
BA_ "SigType" SG_ 3221225472 BatteryCharger1OutputCurrent 1;
BA_ "SAEDocument" SG_ 3221225472 BatteryCharger1OutputVoltage "J1939-71";
BA_ "SPN" SG_ 3221225472 BatteryCharger1OutputVoltage 4992;
BA_ "SigType" SG_ 3221225472 BatteryCharger1OutputVoltage 1;
BA_ "SAEDocument" SG_ 3221225472 BatteryCharger1PowerLineState "J1939-71";
BA_ "SPN" SG_ 3221225472 BatteryCharger1PowerLineState 4991;
BA_ "SigType" SG_ 3221225472 BatteryCharger1PowerLineState 4;
BA_ "SAEDocument" SG_ 3221225472 BatteryCharger1State "J1939-71";
BA_ "SPN" SG_ 3221225472 BatteryCharger1State 4990;
BA_ "SAEDocument" SG_ 3221225472 Aftrtrtmnt2ThrWyCtlystDffGasTemp "J1939-71";
BA_ "SPN" SG_ 3221225472 Aftrtrtmnt2ThrWyCtlystDffGasTemp 4780;
BA_ "SigType" SG_ 3221225472 Aftrtrtmnt2ThrWyCtlystDffGasTemp 1;
BA_ "SAEDocument" SG_ 3221225472 Aftrtrtmnt1ThrWyCtlystDffGasTemp "J1939-71";
BA_ "SPN" SG_ 3221225472 Aftrtrtmnt1ThrWyCtlystDffGasTemp 4779;
BA_ "SigType" SG_ 3221225472 Aftrtrtmnt1ThrWyCtlystDffGasTemp 1;
BA_ "SAEDocument" SG_ 3221225472 Aftrtrtmnt2GsOxdtnCtlystDffGsTmp "J1939-71";
BA_ "SPN" SG_ 3221225472 Aftrtrtmnt2GsOxdtnCtlystDffGsTmp 4778;
BA_ "SigType" SG_ 3221225472 Aftrtrtmnt2GsOxdtnCtlystDffGsTmp 1;
BA_ "SAEDocument" SG_ 3221225472 Aftrtrtmnt1GsOxdtnCtlystDffGsTmp "J1939-71";
BA_ "SPN" SG_ 3221225472 Aftrtrtmnt1GsOxdtnCtlystDffGsTmp 4777;
BA_ "SigType" SG_ 3221225472 Aftrtrtmnt1GsOxdtnCtlystDffGsTmp 1;
BA_ "SAEDocument" SG_ 3221225472 Aftrtrtmnt2WrmUpDslOxdtnCtlystOt "J1939-71";
BA_ "SPN" SG_ 3221225472 Aftrtrtmnt2WrmUpDslOxdtnCtlystOt 5316;
BA_ "SigType" SG_ 3221225472 Aftrtrtmnt2WrmUpDslOxdtnCtlystOt 1;
BA_ "SAEDocument" SG_ 3221225472 Aftrtrtmnt2WrmUpDslOxdtnCtlystIn "J1939-71";
BA_ "SPN" SG_ 3221225472 Aftrtrtmnt2WrmUpDslOxdtnCtlystIn 5315;
BA_ "SigType" SG_ 3221225472 Aftrtrtmnt2WrmUpDslOxdtnCtlystIn 1;
BA_ "SAEDocument" SG_ 3221225472 Aftrtrtmnt2ThrWyCtlytcCnvrtrDffP "J1939-71";
BA_ "SPN" SG_ 3221225472 Aftrtrtmnt2ThrWyCtlytcCnvrtrDffP 4297;
BA_ "SigType" SG_ 3221225472 Aftrtrtmnt2ThrWyCtlytcCnvrtrDffP 1;
BA_ "SAEDocument" SG_ 3221225472 Aftrtrtmnt2ThrWyCtlytcCnvrtrOtlt "J1939-71";
BA_ "SPN" SG_ 3221225472 Aftrtrtmnt2ThrWyCtlytcCnvrtrOtlt 4296;
BA_ "SigType" SG_ 3221225472 Aftrtrtmnt2ThrWyCtlytcCnvrtrOtlt 1;
BA_ "SAEDocument" SG_ 3221225472 Aftrtrtmnt2ThrWyCtlytcCnvrtrIntk "J1939-71";
BA_ "SPN" SG_ 3221225472 Aftrtrtmnt2ThrWyCtlytcCnvrtrIntk 4295;
BA_ "SigType" SG_ 3221225472 Aftrtrtmnt2ThrWyCtlytcCnvrtrIntk 1;
BA_ "SAEDocument" SG_ 3221225472 Aftrtrtmnt2OtltGsNOxSnsrNH3Crrct "J1939-71";
BA_ "SPN" SG_ 3221225472 Aftrtrtmnt2OtltGsNOxSnsrNH3Crrct 5051;
BA_ "SigType" SG_ 3221225472 Aftrtrtmnt2OtltGsNOxSnsrNH3Crrct 1;
BA_ "SAEDocument" SG_ 3221225472 Aftrtrtmnt2OtltGsNOxSnsrNO2Crrct "J1939-71";
BA_ "SPN" SG_ 3221225472 Aftrtrtmnt2OtltGsNOxSnsrNO2Crrct 5050;
BA_ "SigType" SG_ 3221225472 Aftrtrtmnt2OtltGsNOxSnsrNO2Crrct 1;
BA_ "SAEDocument" SG_ 3221225472 Aftrtrtmnt2OtltGsNOxSnsrCrrctnOf "J1939-71";
BA_ "SPN" SG_ 3221225472 Aftrtrtmnt2OtltGsNOxSnsrCrrctnOf 5048;
BA_ "SigType" SG_ 3221225472 Aftrtrtmnt2OtltGsNOxSnsrCrrctnOf 1;
BA_ "SAEDocument" SG_ 3221225472 Aftrtrtmnt2OtltGsNOxSnsrNwPrtDvt "J1939-71";
BA_ "SPN" SG_ 3221225472 Aftrtrtmnt2OtltGsNOxSnsrNwPrtDvt 5046;
BA_ "SigType" SG_ 3221225472 Aftrtrtmnt2OtltGsNOxSnsrNwPrtDvt 1;
BA_ "SAEDocument" SG_ 3221225472 Aftrtrtmnt2OtltGsNOxSnsrHtrRatio "J1939-71";
BA_ "SPN" SG_ 3221225472 Aftrtrtmnt2OtltGsNOxSnsrHtrRatio 5045;
BA_ "SigType" SG_ 3221225472 Aftrtrtmnt2OtltGsNOxSnsrHtrRatio 1;
BA_ "SAEDocument" SG_ 3221225472 Aftrtrtmnt2IntkGsNOxSnsrNH3Crrct "J1939-71";
BA_ "SPN" SG_ 3221225472 Aftrtrtmnt2IntkGsNOxSnsrNH3Crrct 5044;
BA_ "SigType" SG_ 3221225472 Aftrtrtmnt2IntkGsNOxSnsrNH3Crrct 1;
BA_ "SAEDocument" SG_ 3221225472 Aftrtrtmnt2IntkGsNOxSnsrNO2Crrct "J1939-71";
BA_ "SPN" SG_ 3221225472 Aftrtrtmnt2IntkGsNOxSnsrNO2Crrct 5043;
BA_ "SigType" SG_ 3221225472 Aftrtrtmnt2IntkGsNOxSnsrNO2Crrct 1;
BA_ "SAEDocument" SG_ 3221225472 Aftrtrtmnt2IntkGsNOxSnsrCrrctnOf "J1939-71";
BA_ "SPN" SG_ 3221225472 Aftrtrtmnt2IntkGsNOxSnsrCrrctnOf 5041;
BA_ "SigType" SG_ 3221225472 Aftrtrtmnt2IntkGsNOxSnsrCrrctnOf 1;
BA_ "SAEDocument" SG_ 3221225472 Aftrtrtmnt2IntkGsNOxSnsrNwPrtDvt "J1939-71";
BA_ "SPN" SG_ 3221225472 Aftrtrtmnt2IntkGsNOxSnsrNwPrtDvt 5039;
BA_ "SigType" SG_ 3221225472 Aftrtrtmnt2IntkGsNOxSnsrNwPrtDvt 1;
BA_ "SAEDocument" SG_ 3221225472 Aftrtrtmnt2IntkGsNOxSnsrHtrRatio "J1939-71";
BA_ "SPN" SG_ 3221225472 Aftrtrtmnt2IntkGsNOxSnsrHtrRatio 5038;
BA_ "SigType" SG_ 3221225472 Aftrtrtmnt2IntkGsNOxSnsrHtrRatio 1;
BA_ "SAEDocument" SG_ 3221225472 Aftertreatment2FuelPress2Ctrl "J1939-71";
BA_ "SPN" SG_ 3221225472 Aftertreatment2FuelPress2Ctrl 5428;
BA_ "SAEDocument" SG_ 3221225472 Aftrtrtmnt2FlFlwDverterValveCtrl "J1939-71";
BA_ "SPN" SG_ 3221225472 Aftrtrtmnt2FlFlwDverterValveCtrl 5427;
BA_ "SigType" SG_ 3221225472 Aftrtrtmnt2FlFlwDverterValveCtrl 5;
BA_ "SAEDocument" SG_ 3221225472 Aftertreatment2FuelPumpRelayCtrl "J1939-71";
BA_ "SPN" SG_ 3221225472 Aftertreatment2FuelPumpRelayCtrl 5426;
BA_ "SigType" SG_ 3221225472 Aftertreatment2FuelPumpRelayCtrl 5;
BA_ "SAEDocument" SG_ 3221225472 Aftertreatment2FuelPress2 "J1939-71";
BA_ "SPN" SG_ 3221225472 Aftertreatment2FuelPress2 4303;
BA_ "SigType" SG_ 3221225472 Aftertreatment2FuelPress2 1;
BA_ "SAEDocument" SG_ 3221225472 Aftrtrtmnt2DslPrtcltFltrStStndrd "J1939-71";
BA_ "SPN" SG_ 3221225472 Aftrtrtmnt2DslPrtcltFltrStStndrd 5498;
BA_ "SAEDocument" SG_ 3221225472 Aftrtrtmnt2DslPrtcltFltrStMnClbO "J1939-71";
BA_ "SPN" SG_ 3221225472 Aftrtrtmnt2DslPrtcltFltrStMnClbO 5497;
BA_ "SAEDocument" SG_ 3221225472 Aftrtrtmnt1WrmUpDslOxdtnCtlystOt "J1939-71";
BA_ "SPN" SG_ 3221225472 Aftrtrtmnt1WrmUpDslOxdtnCtlystOt 4810;
BA_ "SigType" SG_ 3221225472 Aftrtrtmnt1WrmUpDslOxdtnCtlystOt 1;
BA_ "SAEDocument" SG_ 3221225472 Aftrtrtmnt1WrmUpDslOxdtnCtlystIn "J1939-71";
BA_ "SPN" SG_ 3221225472 Aftrtrtmnt1WrmUpDslOxdtnCtlystIn 4809;
BA_ "SigType" SG_ 3221225472 Aftrtrtmnt1WrmUpDslOxdtnCtlystIn 1;
BA_ "SAEDocument" SG_ 3221225472 Aftrtrtmnt1ThrWyCtlytcCnvrtrDffP "J1939-71";
BA_ "SPN" SG_ 3221225472 Aftrtrtmnt1ThrWyCtlytcCnvrtrDffP 4291;
BA_ "SigType" SG_ 3221225472 Aftrtrtmnt1ThrWyCtlytcCnvrtrDffP 1;
BA_ "SAEDocument" SG_ 3221225472 Aftrtrtmnt1ThrWyCtlytcCnvrtrOtlt "J1939-71";
BA_ "SPN" SG_ 3221225472 Aftrtrtmnt1ThrWyCtlytcCnvrtrOtlt 4290;
BA_ "SigType" SG_ 3221225472 Aftrtrtmnt1ThrWyCtlytcCnvrtrOtlt 1;
BA_ "SAEDocument" SG_ 3221225472 Aftrtrtmnt1ThrWyCtlytcCnvrtrIntk "J1939-71";
BA_ "SPN" SG_ 3221225472 Aftrtrtmnt1ThrWyCtlytcCnvrtrIntk 4289;
BA_ "SigType" SG_ 3221225472 Aftrtrtmnt1ThrWyCtlytcCnvrtrIntk 1;
BA_ "SAEDocument" SG_ 3221225472 Aftrtrtmnt1SCRCtlystRgntTnk1HtrP "J1939-71";
BA_ "SPN" SG_ 3221225472 Aftrtrtmnt1SCRCtlystRgntTnk1HtrP 4366;
BA_ "SAEDocument" SG_ 3221225472 AftrtrtmntSCROprtrIndcmntSverity "J1939-71";
BA_ "SPN" SG_ 3221225472 AftrtrtmntSCROprtrIndcmntSverity 5246;
BA_ "SAEDocument" SG_ 3221225472 Aftrtrtmnt1SCRCtlystRgntTnk1TmpP "J1939-71";
BA_ "SPN" SG_ 3221225472 Aftrtrtmnt1SCRCtlystRgntTnk1TmpP 4365;
BA_ "SAEDocument" SG_ 3221225472 Aftrtrtmnt1DEFTnkLwLvelIndicator "J1939-71";
BA_ "SPN" SG_ 3221225472 Aftrtrtmnt1DEFTnkLwLvelIndicator 5245;
BA_ "SAEDocument" SG_ 3221225472 Aftrtrtmnt1SCRCtlystTnkLvlPrlmnr "J1939-71";
BA_ "SPN" SG_ 3221225472 Aftrtrtmnt1SCRCtlystTnkLvlPrlmnr 3532;
BA_ "SAEDocument" SG_ 3221225472 Aftrtrtmnt1SCRCatalystTankLevel2 "J1939-71";
BA_ "SPN" SG_ 3221225472 Aftrtrtmnt1SCRCatalystTankLevel2 3517;
BA_ "SigType" SG_ 3221225472 Aftrtrtmnt1SCRCatalystTankLevel2 1;
BA_ "SAEDocument" SG_ 3221225472 Aftrtratment1SCRCatalystTankTemp "J1939-71";
BA_ "SPN" SG_ 3221225472 Aftrtratment1SCRCatalystTankTemp 3031;
BA_ "SigType" SG_ 3221225472 Aftrtratment1SCRCatalystTankTemp 1;
BA_ "SAEDocument" SG_ 3221225472 Aftrtrtment1SCRCatalystTankLevel "J1939-71";
BA_ "SPN" SG_ 3221225472 Aftrtrtment1SCRCatalystTankLevel 1761;
BA_ "SigType" SG_ 3221225472 Aftrtrtment1SCRCatalystTankLevel 1;
BA_ "SAEDocument" SG_ 3221225472 Aftrtrtmnt1SCRCtalystTankHeater "J1939-71";
BA_ "SPN" SG_ 3221225472 Aftrtrtmnt1SCRCtalystTankHeater 3363;
BA_ "SigType" SG_ 3221225472 Aftrtrtmnt1SCRCtalystTankHeater 1;
BA_ "SAEDocument" SG_ 3221225472 Aftrtrtmnt1OtltGsNOxSnsrNH3Crrct "J1939-71";
BA_ "SPN" SG_ 3221225472 Aftrtrtmnt1OtltGsNOxSnsrNH3Crrct 5037;
BA_ "SigType" SG_ 3221225472 Aftrtrtmnt1OtltGsNOxSnsrNH3Crrct 1;
BA_ "SAEDocument" SG_ 3221225472 Aftrtrtmnt1OtltGsNOxSnsrNO2Crrct "J1939-71";
BA_ "SPN" SG_ 3221225472 Aftrtrtmnt1OtltGsNOxSnsrNO2Crrct 5036;
BA_ "SigType" SG_ 3221225472 Aftrtrtmnt1OtltGsNOxSnsrNO2Crrct 1;
BA_ "SAEDocument" SG_ 3221225472 Aftrtrtmnt1OtltGsNOxSnsrCrrctnOf "J1939-71";
BA_ "SPN" SG_ 3221225472 Aftrtrtmnt1OtltGsNOxSnsrCrrctnOf 5034;
BA_ "SigType" SG_ 3221225472 Aftrtrtmnt1OtltGsNOxSnsrCrrctnOf 1;
BA_ "SAEDocument" SG_ 3221225472 Aftrtrtmnt1OtltGsNOxSnsrNwPrtDvt "J1939-71";
BA_ "SPN" SG_ 3221225472 Aftrtrtmnt1OtltGsNOxSnsrNwPrtDvt 5032;
BA_ "SigType" SG_ 3221225472 Aftrtrtmnt1OtltGsNOxSnsrNwPrtDvt 1;
BA_ "SAEDocument" SG_ 3221225472 Aftrtrtmnt1OtltGsNOxSnsrHtrRatio "J1939-71";
BA_ "SPN" SG_ 3221225472 Aftrtrtmnt1OtltGsNOxSnsrHtrRatio 5031;
BA_ "SigType" SG_ 3221225472 Aftrtrtmnt1OtltGsNOxSnsrHtrRatio 1;
BA_ "SAEDocument" SG_ 3221225472 Aftrtrtmnt1IntkGsNOxSnsrNH3Crrct "J1939-71";
BA_ "SPN" SG_ 3221225472 Aftrtrtmnt1IntkGsNOxSnsrNH3Crrct 5030;
BA_ "SigType" SG_ 3221225472 Aftrtrtmnt1IntkGsNOxSnsrNH3Crrct 1;
BA_ "SAEDocument" SG_ 3221225472 Aftrtrtmnt1IntkGsNOxSnsrNO2Crrct "J1939-71";
BA_ "SPN" SG_ 3221225472 Aftrtrtmnt1IntkGsNOxSnsrNO2Crrct 5029;
BA_ "SigType" SG_ 3221225472 Aftrtrtmnt1IntkGsNOxSnsrNO2Crrct 1;
BA_ "SAEDocument" SG_ 3221225472 Aftrtrtmnt1IntkGsNOxSnsrCrrctnOf "J1939-71";
BA_ "SPN" SG_ 3221225472 Aftrtrtmnt1IntkGsNOxSnsrCrrctnOf 5027;
BA_ "SigType" SG_ 3221225472 Aftrtrtmnt1IntkGsNOxSnsrCrrctnOf 1;
BA_ "SAEDocument" SG_ 3221225472 Aftrtrtmnt1IntkGsNOxSnsrNwPrtDvt "J1939-71";
BA_ "SPN" SG_ 3221225472 Aftrtrtmnt1IntkGsNOxSnsrNwPrtDvt 5025;
BA_ "SigType" SG_ 3221225472 Aftrtrtmnt1IntkGsNOxSnsrNwPrtDvt 1;
BA_ "SAEDocument" SG_ 3221225472 Aftrtrtmnt1IntkGsNOxSnsrHtrRatio "J1939-71";
BA_ "SPN" SG_ 3221225472 Aftrtrtmnt1IntkGsNOxSnsrHtrRatio 5024;
BA_ "SigType" SG_ 3221225472 Aftrtrtmnt1IntkGsNOxSnsrHtrRatio 1;
BA_ "SAEDocument" SG_ 3221225472 Aftrtrtmnt1DslPrtcltFltrStStndrd "J1939-71";
BA_ "SPN" SG_ 3221225472 Aftrtrtmnt1DslPrtcltFltrStStndrd 5496;
BA_ "SAEDocument" SG_ 3221225472 Aftrtrtmnt1DslPrtcltFltrStMnClbO "J1939-71";
BA_ "SPN" SG_ 3221225472 Aftrtrtmnt1DslPrtcltFltrStMnClbO 5495;
BA_ "SAEDocument" SG_ 3221225472 ArmrestSwitchMatrix2Switch2 "J1939-71";
BA_ "SPN" SG_ 3221225472 ArmrestSwitchMatrix2Switch2 5494;
BA_ "SigType" SG_ 3221225472 ArmrestSwitchMatrix2Switch2 5;
BA_ "SAEDocument" SG_ 3221225472 ArmrestSwitchMatrix2Switch1 "J1939-71";
BA_ "SPN" SG_ 3221225472 ArmrestSwitchMatrix2Switch1 5493;
BA_ "SigType" SG_ 3221225472 ArmrestSwitchMatrix2Switch1 5;
BA_ "SAEDocument" SG_ 3221225472 ArmrestSwitchMatrixSwitch2 "J1939-71";
BA_ "SPN" SG_ 3221225472 ArmrestSwitchMatrixSwitch2 5492;
BA_ "SigType" SG_ 3221225472 ArmrestSwitchMatrixSwitch2 5;
BA_ "SAEDocument" SG_ 3221225472 ArmrestSwitchMatrixSwitch1 "J1939-71";
BA_ "SPN" SG_ 3221225472 ArmrestSwitchMatrixSwitch1 1503;
BA_ "SigType" SG_ 3221225472 ArmrestSwitchMatrixSwitch1 5;
BA_ "SAEDocument" SG_ 3221225472 AngularRateMeasurementLatency "J1939-71";
BA_ "SPN" SG_ 3221225472 AngularRateMeasurementLatency 4989;
BA_ "SigType" SG_ 3221225472 AngularRateMeasurementLatency 1;
BA_ "SAEDocument" SG_ 3221225472 YawRateExRangeFigureOfMerit "J1939-71";
BA_ "SPN" SG_ 3221225472 YawRateExRangeFigureOfMerit 4988;
BA_ "SigType" SG_ 3221225472 YawRateExRangeFigureOfMerit 5;
BA_ "SAEDocument" SG_ 3221225472 RollRateExRangeFigureOfMerit "J1939-71";
BA_ "SPN" SG_ 3221225472 RollRateExRangeFigureOfMerit 4987;
BA_ "SigType" SG_ 3221225472 RollRateExRangeFigureOfMerit 5;
BA_ "SAEDocument" SG_ 3221225472 PitchRateExRangeFigureOfMerit "J1939-71";
BA_ "SPN" SG_ 3221225472 PitchRateExRangeFigureOfMerit 4986;
BA_ "SigType" SG_ 3221225472 PitchRateExRangeFigureOfMerit 5;
BA_ "SAEDocument" SG_ 3221225472 YawRateExRange "J1939-71";
BA_ "SPN" SG_ 3221225472 YawRateExRange 4985;
BA_ "SigType" SG_ 3221225472 YawRateExRange 1;
BA_ "SAEDocument" SG_ 3221225472 RollRateExRange "J1939-71";
BA_ "SPN" SG_ 3221225472 RollRateExRange 4984;
BA_ "SigType" SG_ 3221225472 RollRateExRange 1;
BA_ "SAEDocument" SG_ 3221225472 PitchRateExRange "J1939-71";
BA_ "SPN" SG_ 3221225472 PitchRateExRange 4983;
BA_ "SigType" SG_ 3221225472 PitchRateExRange 1;
BA_ "SAEDocument" SG_ 3221225472 Aftrtrtmnt2NOxAdsrbrDSOxRgnrtnSt "J1939-71";
BA_ "SPN" SG_ 3221225472 Aftrtrtmnt2NOxAdsrbrDSOxRgnrtnSt 5462;
BA_ "SigType" SG_ 3221225472 Aftrtrtmnt2NOxAdsrbrDSOxRgnrtnSt 5;
BA_ "SAEDocument" SG_ 3221225472 Aftrtrtmnt2NOxAdsrbrDNOxRgnrtnSt "J1939-71";
BA_ "SPN" SG_ 3221225472 Aftrtrtmnt2NOxAdsrbrDNOxRgnrtnSt 5460;
BA_ "SigType" SG_ 3221225472 Aftrtrtmnt2NOxAdsrbrDNOxRgnrtnSt 5;
BA_ "SAEDocument" SG_ 3221225472 Aftrtrtmnt1NOxAdsrbrDSOxRgnrtnSt "J1939-71";
BA_ "SPN" SG_ 3221225472 Aftrtrtmnt1NOxAdsrbrDSOxRgnrtnSt 5461;
BA_ "SigType" SG_ 3221225472 Aftrtrtmnt1NOxAdsrbrDSOxRgnrtnSt 5;
BA_ "SAEDocument" SG_ 3221225472 Aftrtrtmnt1NOxAdsrbrDNOxRgnrtnSt "J1939-71";
BA_ "SPN" SG_ 3221225472 Aftrtrtmnt1NOxAdsrbrDNOxRgnrtnSt 5459;
BA_ "SigType" SG_ 3221225472 Aftrtrtmnt1NOxAdsrbrDNOxRgnrtnSt 5;
BA_ "SAEDocument" SG_ 3221225472 Aftrtrtmnt2SCRCtlystCnvrsnEffcnc "J1939-71";
BA_ "SPN" SG_ 3221225472 Aftrtrtmnt2SCRCtlystCnvrsnEffcnc 4419;
BA_ "SigType" SG_ 3221225472 Aftrtrtmnt2SCRCtlystCnvrsnEffcnc 1;
BA_ "SAEDocument" SG_ 3221225472 Aftrtrtmnt2SCRCmmnddCtlystRgntCn "J1939-71";
BA_ "SPN" SG_ 3221225472 Aftrtrtmnt2SCRCmmnddCtlystRgntCn 4418;
BA_ "SAEDocument" SG_ 3221225472 Aftrtrtmnt2SCRAvrgCtlystRgntCnsm "J1939-71";
BA_ "SPN" SG_ 3221225472 Aftrtrtmnt2SCRAvrgCtlystRgntCnsm 4417;
BA_ "SigType" SG_ 3221225472 Aftrtrtmnt2SCRAvrgCtlystRgntCnsm 1;
BA_ "SAEDocument" SG_ 3221225472 Aftrtrtmnt2SCRCtlystRgntTnk2HtrP "J1939-71";
BA_ "SPN" SG_ 3221225472 Aftrtrtmnt2SCRCtlystRgntTnk2HtrP 4439;
BA_ "SAEDocument" SG_ 3221225472 Aftrtrtmnt2SCRCtlystRgntTnk2Hter "J1939-71";
BA_ "SPN" SG_ 3221225472 Aftrtrtmnt2SCRCtlystRgntTnk2Hter 4438;
BA_ "SAEDocument" SG_ 3221225472 Aftrtrtmnt2SCRRgntTnk2TmpPrlmnry "J1939-71";
BA_ "SPN" SG_ 3221225472 Aftrtrtmnt2SCRRgntTnk2TmpPrlmnry 4437;
BA_ "SAEDocument" SG_ 3221225472 Aftrtrtmnt2SCRCtlystRgntTnk2LvlP "J1939-71";
BA_ "SPN" SG_ 3221225472 Aftrtrtmnt2SCRCtlystRgntTnk2LvlP 4436;
BA_ "SAEDocument" SG_ 3221225472 Aftrtrtmnt2SCRCtlystRgntTnk2Lvl2 "J1939-71";
BA_ "SPN" SG_ 3221225472 Aftrtrtmnt2SCRCtlystRgntTnk2Lvl2 4435;
BA_ "SAEDocument" SG_ 3221225472 Aftrtrtmnt2SCRCtlystRgntTnk2Temp "J1939-71";
BA_ "SPN" SG_ 3221225472 Aftrtrtmnt2SCRCtlystRgntTnk2Temp 4434;
BA_ "SigType" SG_ 3221225472 Aftrtrtmnt2SCRCtlystRgntTnk2Temp 1;
BA_ "SAEDocument" SG_ 3221225472 Aftrtrtmnt2SCRCtlystRgntTnk2Lvel "J1939-71";
BA_ "SPN" SG_ 3221225472 Aftrtrtmnt2SCRCtlystRgntTnk2Lvel 4433;
BA_ "SigType" SG_ 3221225472 Aftrtrtmnt2SCRCtlystRgntTnk2Lvel 1;
BA_ "SAEDocument" SG_ 3221225472 Aftrtrtmnt2SCRCtlystRgntTnk1HtrP "J1939-71";
BA_ "SPN" SG_ 3221225472 Aftrtrtmnt2SCRCtlystRgntTnk1HtrP 4432;
BA_ "SAEDocument" SG_ 3221225472 Aftrtrtmnt2SCRCtalystTankHeater "J1939-71";
BA_ "SPN" SG_ 3221225472 Aftrtrtmnt2SCRCtalystTankHeater 4431;
BA_ "SigType" SG_ 3221225472 Aftrtrtmnt2SCRCtalystTankHeater 1;
BA_ "SAEDocument" SG_ 3221225472 Aftrtrtmnt2SCRCtlystRgntTnk1TmpP "J1939-71";
BA_ "SPN" SG_ 3221225472 Aftrtrtmnt2SCRCtlystRgntTnk1TmpP 4430;
BA_ "SAEDocument" SG_ 3221225472 Aftrtrtmnt2SCRCtlystTnkLvlPrlmnr "J1939-71";
BA_ "SPN" SG_ 3221225472 Aftrtrtmnt2SCRCtlystTnkLvlPrlmnr 4429;
BA_ "SAEDocument" SG_ 3221225472 Aftrtrtmnt2SCRCatalystTankLevel2 "J1939-71";
BA_ "SPN" SG_ 3221225472 Aftrtrtmnt2SCRCatalystTankLevel2 4428;
BA_ "SigType" SG_ 3221225472 Aftrtrtmnt2SCRCatalystTankLevel2 1;
BA_ "SAEDocument" SG_ 3221225472 Aftrtratment2SCRCatalystTankTemp "J1939-71";
BA_ "SPN" SG_ 3221225472 Aftrtratment2SCRCatalystTankTemp 4427;
BA_ "SigType" SG_ 3221225472 Aftrtratment2SCRCatalystTankTemp 1;
BA_ "SAEDocument" SG_ 3221225472 Aftrtrtment2SCRCatalystTankLevel "J1939-71";
BA_ "SPN" SG_ 3221225472 Aftrtrtment2SCRCatalystTankLevel 4426;
BA_ "SigType" SG_ 3221225472 Aftrtrtment2SCRCatalystTankLevel 1;
BA_ "SAEDocument" SG_ 3221225472 Aftrtrtmnt2SCRCtlystRgntTnkDrnVl "J1939-71";
BA_ "SPN" SG_ 3221225472 Aftrtrtmnt2SCRCtlystRgntTnkDrnVl 5439;
BA_ "SAEDocument" SG_ 3221225472 Aftrtrtmnt2SCRCtlystRgntPmpState "J1939-71";
BA_ "SPN" SG_ 3221225472 Aftrtrtmnt2SCRCtlystRgntPmpState 5438;
BA_ "SigType" SG_ 3221225472 Aftrtrtmnt2SCRCtlystRgntPmpState 5;
BA_ "SAEDocument" SG_ 3221225472 Aftrtrtmnt2SCRCtlystRgntTnkFllVl "J1939-71";
BA_ "SPN" SG_ 3221225472 Aftrtrtmnt2SCRCtlystRgntTnkFllVl 5437;
BA_ "SAEDocument" SG_ 3221225472 Aftrtrtmnt2SCRCtlystRgntRtrnVlve "J1939-71";
BA_ "SPN" SG_ 3221225472 Aftrtrtmnt2SCRCtlystRgntRtrnVlve 4442;
BA_ "SAEDocument" SG_ 3221225472 Aftrtrtmnt2SCRCtlystRgntPmpDrvPr "J1939-71";
BA_ "SPN" SG_ 3221225472 Aftrtrtmnt2SCRCtlystRgntPmpDrvPr 4441;
BA_ "SAEDocument" SG_ 3221225472 Aftrtrtmnt2SCRCtlystRgntPmpMtrSp "J1939-71";
BA_ "SPN" SG_ 3221225472 Aftrtrtmnt2SCRCtlystRgntPmpMtrSp 4440;
BA_ "SigType" SG_ 3221225472 Aftrtrtmnt2SCRCtlystRgntPmpMtrSp 1;
BA_ "SAEDocument" SG_ 3221225472 Aftrtrtmnt2SCRCtalystReagentType "J1939-71";
BA_ "SPN" SG_ 3221225472 Aftrtrtmnt2SCRCtalystReagentType 4425;
BA_ "SAEDocument" SG_ 3221225472 Aftrtrtmnt2SCRCtlystRgntPrprtsPr "J1939-71";
BA_ "SPN" SG_ 3221225472 Aftrtrtmnt2SCRCtlystRgntPrprtsPr 4424;
BA_ "SAEDocument" SG_ 3221225472 Aftrtrtmnt2SCRCtlystRgntTmp2Prlm "J1939-71";
BA_ "SPN" SG_ 3221225472 Aftrtrtmnt2SCRCtlystRgntTmp2Prlm 4423;
BA_ "SAEDocument" SG_ 3221225472 Aftrtrtmnt2SCRCtlystRgntCndctvty "J1939-71";
BA_ "SPN" SG_ 3221225472 Aftrtrtmnt2SCRCtlystRgntCndctvty 4422;
BA_ "SigType" SG_ 3221225472 Aftrtrtmnt2SCRCtlystRgntCndctvty 1;
BA_ "SAEDocument" SG_ 3221225472 Aftrtrtmnt2SCRCtlystRgntCncntrtn "J1939-71";
BA_ "SPN" SG_ 3221225472 Aftrtrtmnt2SCRCtlystRgntCncntrtn 4421;
BA_ "SigType" SG_ 3221225472 Aftrtrtmnt2SCRCtlystRgntCncntrtn 1;
BA_ "SAEDocument" SG_ 3221225472 Aftrtrtmnt2SCRCtlystReagentTemp2 "J1939-71";
BA_ "SPN" SG_ 3221225472 Aftrtrtmnt2SCRCtlystReagentTemp2 4420;
BA_ "SigType" SG_ 3221225472 Aftrtrtmnt2SCRCtlystReagentTemp2 1;
BA_ "SAEDocument" SG_ 3221225472 Aftrtrtmnt2SCRCtlystOtltGsTmpPrl "J1939-71";
BA_ "SPN" SG_ 3221225472 Aftrtrtmnt2SCRCtlystOtltGsTmpPrl 4416;
BA_ "SAEDocument" SG_ 3221225472 Aftrtrtmnt2SCRCtlystOtletGasTemp "J1939-71";
BA_ "SPN" SG_ 3221225472 Aftrtrtmnt2SCRCtlystOtletGasTemp 4415;
BA_ "SigType" SG_ 3221225472 Aftrtrtmnt2SCRCtlystOtletGasTemp 1;
BA_ "SAEDocument" SG_ 3221225472 Aftrtrtmnt2SCRCtlystIntkGsTmpPrl "J1939-71";
BA_ "SPN" SG_ 3221225472 Aftrtrtmnt2SCRCtlystIntkGsTmpPrl 4414;
BA_ "SAEDocument" SG_ 3221225472 Aftrtrtmnt2SCRCtlystIntkeGasTemp "J1939-71";
BA_ "SPN" SG_ 3221225472 Aftrtrtmnt2SCRCtlystIntkeGasTemp 4413;
BA_ "SigType" SG_ 3221225472 Aftrtrtmnt2SCRCtlystIntkeGasTemp 1;
BA_ "SAEDocument" SG_ 3221225472 Aftrtrtmnt2SCRCtlystExhstGsDffPr "J1939-71";
BA_ "SPN" SG_ 3221225472 Aftrtrtmnt2SCRCtlystExhstGsDffPr 4411;
BA_ "SigType" SG_ 3221225472 Aftrtrtmnt2SCRCtlystExhstGsDffPr 1;
BA_ "SAEDocument" SG_ 3221225472 Aftrtrtmnt2SCRCtlystTnk2HaterCmd "J1939-71";
BA_ "SPN" SG_ 3221225472 Aftrtrtmnt2SCRCtlystTnk2HaterCmd 5415;
BA_ "SAEDocument" SG_ 3221225472 Aftrtrtmnt2SCRCtlystTnkHeaterCmd "J1939-71";
BA_ "SPN" SG_ 3221225472 Aftrtrtmnt2SCRCtlystTnkHeaterCmd 5138;
BA_ "SAEDocument" SG_ 3221225472 Aftrtrtmnt2SCRCtlystRgntLnHater4 "J1939-71";
BA_ "SPN" SG_ 3221225472 Aftrtrtmnt2SCRCtlystRgntLnHater4 4410;
BA_ "SigType" SG_ 3221225472 Aftrtrtmnt2SCRCtlystRgntLnHater4 5;
BA_ "SAEDocument" SG_ 3221225472 Aftrtrtmnt2SCRCtlystRgntLnHater3 "J1939-71";
BA_ "SPN" SG_ 3221225472 Aftrtrtmnt2SCRCtlystRgntLnHater3 4409;
BA_ "SigType" SG_ 3221225472 Aftrtrtmnt2SCRCtlystRgntLnHater3 5;
BA_ "SAEDocument" SG_ 3221225472 Aftrtrtmnt2SCRCtlystRgntLnHater2 "J1939-71";
BA_ "SPN" SG_ 3221225472 Aftrtrtmnt2SCRCtlystRgntLnHater2 4408;
BA_ "SigType" SG_ 3221225472 Aftrtrtmnt2SCRCtlystRgntLnHater2 5;
BA_ "SAEDocument" SG_ 3221225472 Aftrtrtmnt2SCRCtlystRgntLnHater1 "J1939-71";
BA_ "SPN" SG_ 3221225472 Aftrtrtmnt2SCRCtlystRgntLnHater1 4407;
BA_ "SigType" SG_ 3221225472 Aftrtrtmnt2SCRCtlystRgntLnHater1 5;
BA_ "SAEDocument" SG_ 3221225472 Aftrtrtmnt2SCRDoserHeatingModeRq "J1939-71";
BA_ "SPN" SG_ 3221225472 Aftrtrtmnt2SCRDoserHeatingModeRq 4406;
BA_ "SAEDocument" SG_ 3221225472 Aftrtrtmnt2SCRDsrFltSppressionRq "J1939-71";
BA_ "SPN" SG_ 3221225472 Aftrtrtmnt2SCRDsrFltSppressionRq 4405;
BA_ "SigType" SG_ 3221225472 Aftrtrtmnt2SCRDsrFltSppressionRq 5;
BA_ "SAEDocument" SG_ 3221225472 Aftrtrtmnt2SCRRqstdRgntQnttyFrIn "J1939-71";
BA_ "SPN" SG_ 3221225472 Aftrtrtmnt2SCRRqstdRgntQnttyFrIn 4403;
BA_ "SigType" SG_ 3221225472 Aftrtrtmnt2SCRRqstdRgntQnttyFrIn 1;
BA_ "SAEDocument" SG_ 3221225472 Aftrtrtmnt2SCRSystmRquestedState "J1939-71";
BA_ "SPN" SG_ 3221225472 Aftrtrtmnt2SCRSystmRquestedState 4402;
BA_ "SAEDocument" SG_ 3221225472 Aftrtrtmnt2SCRRqstdDsngRgntQntty "J1939-71";
BA_ "SPN" SG_ 3221225472 Aftrtrtmnt2SCRRqstdDsngRgntQntty 4401;
BA_ "SigType" SG_ 3221225472 Aftrtrtmnt2SCRRqstdDsngRgntQntty 1;
BA_ "SAEDocument" SG_ 3221225472 Aftrtrtmnt2SCRCtlystRgntLnHtr4Pr "J1939-71";
BA_ "SPN" SG_ 3221225472 Aftrtrtmnt2SCRCtlystRgntLnHtr4Pr 4400;
BA_ "SAEDocument" SG_ 3221225472 Aftrtrtmnt2SCRCtlystRgntLnHtr4St "J1939-71";
BA_ "SPN" SG_ 3221225472 Aftrtrtmnt2SCRCtlystRgntLnHtr4St 4399;
BA_ "SigType" SG_ 3221225472 Aftrtrtmnt2SCRCtlystRgntLnHtr4St 5;
BA_ "SAEDocument" SG_ 3221225472 Aftrtrtmnt2SCRCtlystRgntLnHtr3Pr "J1939-71";
BA_ "SPN" SG_ 3221225472 Aftrtrtmnt2SCRCtlystRgntLnHtr3Pr 4398;
BA_ "SAEDocument" SG_ 3221225472 Aftrtrtmnt2SCRCtlystRgntLnHtr3St "J1939-71";
BA_ "SPN" SG_ 3221225472 Aftrtrtmnt2SCRCtlystRgntLnHtr3St 4397;
BA_ "SigType" SG_ 3221225472 Aftrtrtmnt2SCRCtlystRgntLnHtr3St 5;
BA_ "SAEDocument" SG_ 3221225472 Aftrtrtmnt2SCRCtlystRgntLnHtr2Pr "J1939-71";
BA_ "SPN" SG_ 3221225472 Aftrtrtmnt2SCRCtlystRgntLnHtr2Pr 4396;
BA_ "SAEDocument" SG_ 3221225472 Aftrtrtmnt2SCRCtlystRgntLnHtr2St "J1939-71";
BA_ "SPN" SG_ 3221225472 Aftrtrtmnt2SCRCtlystRgntLnHtr2St 4395;
BA_ "SigType" SG_ 3221225472 Aftrtrtmnt2SCRCtlystRgntLnHtr2St 5;
BA_ "SAEDocument" SG_ 3221225472 Aftrtrtmnt2SCRCtlystRgntLnHtr1Pr "J1939-71";
BA_ "SPN" SG_ 3221225472 Aftrtrtmnt2SCRCtlystRgntLnHtr1Pr 4394;
BA_ "SAEDocument" SG_ 3221225472 Aftrtrtmnt2SCRCtlystRgntLnHtr1St "J1939-71";
BA_ "SPN" SG_ 3221225472 Aftrtrtmnt2SCRCtlystRgntLnHtr1St 4393;
BA_ "SigType" SG_ 3221225472 Aftrtrtmnt2SCRCtlystRgntLnHtr1St 5;
BA_ "SAEDocument" SG_ 3221225472 Aftrtrtmnt2SCRFeedbackCtrlStatus "J1939-71";
BA_ "SPN" SG_ 3221225472 Aftrtrtmnt2SCRFeedbackCtrlStatus 4392;
BA_ "SAEDocument" SG_ 3221225472 Aftrtrtmnt2SCRDsngVlvExhstTmpRdc "J1939-71";
BA_ "SPN" SG_ 3221225472 Aftrtrtmnt2SCRDsngVlvExhstTmpRdc 4391;
BA_ "SAEDocument" SG_ 3221225472 Aftrtrtment2SCRDosingReagentTemp "J1939-71";
BA_ "SPN" SG_ 3221225472 Aftrtrtment2SCRDosingReagentTemp 4390;
BA_ "SigType" SG_ 3221225472 Aftrtrtment2SCRDosingReagentTemp 1;
BA_ "SAEDocument" SG_ 3221225472 Aftrtrtmnt2SCRDsngAirAssistValve "J1939-71";
BA_ "SPN" SG_ 3221225472 Aftrtrtmnt2SCRDsngAirAssistValve 4389;
BA_ "SAEDocument" SG_ 3221225472 Aftrtrtmnt2SCRDsngArAssstAbsPrss "J1939-71";
BA_ "SPN" SG_ 3221225472 Aftrtrtmnt2SCRDsngArAssstAbsPrss 4388;
BA_ "SigType" SG_ 3221225472 Aftrtrtmnt2SCRDsngArAssstAbsPrss 1;
BA_ "SAEDocument" SG_ 3221225472 Aftrtrtmnt2SCRDsngRagentAbsPress "J1939-71";
BA_ "SPN" SG_ 3221225472 Aftrtrtmnt2SCRDsngRagentAbsPress 4387;
BA_ "SigType" SG_ 3221225472 Aftrtrtmnt2SCRDsngRagentAbsPress 1;
BA_ "SAEDocument" SG_ 3221225472 Aftrtrtmnt2SCRActlRgntQnttyOfInt "J1939-71";
BA_ "SPN" SG_ 3221225472 Aftrtrtmnt2SCRActlRgntQnttyOfInt 4386;
BA_ "SigType" SG_ 3221225472 Aftrtrtmnt2SCRActlRgntQnttyOfInt 1;
BA_ "SAEDocument" SG_ 3221225472 Aftertreatment2SCRSystemState "J1939-71";
BA_ "SPN" SG_ 3221225472 Aftertreatment2SCRSystemState 4385;
BA_ "SAEDocument" SG_ 3221225472 Aftrtrtmnt2SCRActlDsngRgntQntity "J1939-71";
BA_ "SPN" SG_ 3221225472 Aftrtrtmnt2SCRActlDsngRgntQntity 4384;
BA_ "SigType" SG_ 3221225472 Aftrtrtmnt2SCRActlDsngRgntQntity 1;
BA_ "SAEDocument" SG_ 3221225472 Aftrtrtmnt2OtltNH3GsSnsrHterCtrl "J1939-71";
BA_ "SPN" SG_ 3221225472 Aftrtrtmnt2OtltNH3GsSnsrHterCtrl 4449;
BA_ "SigType" SG_ 3221225472 Aftrtrtmnt2OtltNH3GsSnsrHterCtrl 5;
BA_ "SAEDocument" SG_ 3221225472 Aftrtrtmnt2OtltNH3GsSnsrHtrPrlmn "J1939-71";
BA_ "SPN" SG_ 3221225472 Aftrtrtmnt2OtltNH3GsSnsrHtrPrlmn 4448;
BA_ "SAEDocument" SG_ 3221225472 Aftrtrtmnt2OtltNH3GsSensorAtTemp "J1939-71";
BA_ "SPN" SG_ 3221225472 Aftrtrtmnt2OtltNH3GsSensorAtTemp 4447;
BA_ "SigType" SG_ 3221225472 Aftrtrtmnt2OtltNH3GsSensorAtTemp 5;
BA_ "SAEDocument" SG_ 3221225472 Aftrtrtmnt2OtltNH3GsSnsrPwrInRng "J1939-71";
BA_ "SPN" SG_ 3221225472 Aftrtrtmnt2OtltNH3GsSnsrPwrInRng 4446;
BA_ "SigType" SG_ 3221225472 Aftrtrtmnt2OtltNH3GsSnsrPwrInRng 5;
BA_ "SAEDocument" SG_ 3221225472 Aftrtrtmnt2OtletNH3ReadingStable "J1939-71";
BA_ "SPN" SG_ 3221225472 Aftrtrtmnt2OtletNH3ReadingStable 4445;
BA_ "SigType" SG_ 3221225472 Aftrtrtmnt2OtletNH3ReadingStable 5;
BA_ "SAEDocument" SG_ 3221225472 Aftrtrtmnt2OtltNH3SnsrPrlmnryFMI "J1939-71";
BA_ "SPN" SG_ 3221225472 Aftrtrtmnt2OtltNH3SnsrPrlmnryFMI 4444;
BA_ "SAEDocument" SG_ 3221225472 Aftertreatment2OutletNH3 "J1939-71";
BA_ "SPN" SG_ 3221225472 Aftertreatment2OutletNH3 4443;
BA_ "SigType" SG_ 3221225472 Aftertreatment2OutletNH3 1;
BA_ "SAEDocument" SG_ 3221225472 Aftrtrtmnt2GsOxdtnCtlystDffPrssP "J1939-71";
BA_ "SPN" SG_ 3221225472 Aftrtrtmnt2GsOxdtnCtlystDffPrssP 4764;
BA_ "SAEDocument" SG_ 3221225472 Aftrtrtmnt2GsOxdtnCtlystOtltGsTm "J1939-71";
BA_ "SPN" SG_ 3221225472 Aftrtrtmnt2GsOxdtnCtlystOtltGsTm 4760;
BA_ "SigType" SG_ 3221225472 Aftrtrtmnt2GsOxdtnCtlystOtltGsTm 1;
BA_ "SAEDocument" SG_ 3221225472 Aftrtrtmnt2GsOxdtnCtlystIntkGsTm "J1939-71";
BA_ "SPN" SG_ 3221225472 Aftrtrtmnt2GsOxdtnCtlystIntkGsTm 4759;
BA_ "SigType" SG_ 3221225472 Aftrtrtmnt2GsOxdtnCtlystIntkGsTm 1;
BA_ "SAEDocument" SG_ 3221225472 Aftrtrtmnt2GsOxdtnCtlystDffPress "J1939-71";
BA_ "SPN" SG_ 3221225472 Aftrtrtmnt2GsOxdtnCtlystDffPress 4761;
BA_ "SigType" SG_ 3221225472 Aftrtrtmnt2GsOxdtnCtlystDffPress 1;
BA_ "SAEDocument" SG_ 3221225472 Aftrtrtmnt2DslOxdtnCtlystOtltGsT "J1939-71";
BA_ "SPN" SG_ 3221225472 Aftrtrtmnt2DslOxdtnCtlystOtltGsT 4772;
BA_ "SigType" SG_ 3221225472 Aftrtrtmnt2DslOxdtnCtlystOtltGsT 1;
BA_ "SAEDocument" SG_ 3221225472 Aftrtrtmnt2DslOxdtnCtlystIntkGsT "J1939-71";
BA_ "SPN" SG_ 3221225472 Aftrtrtmnt2DslOxdtnCtlystIntkGsT 4771;
BA_ "SigType" SG_ 3221225472 Aftrtrtmnt2DslOxdtnCtlystIntkGsT 1;
BA_ "SAEDocument" SG_ 3221225472 Aftrtrtmnt2DslOxdtnCtlystDffPrss "J1939-71";
BA_ "SPN" SG_ 3221225472 Aftrtrtmnt2DslOxdtnCtlystDffPrss 4776;
BA_ "SAEDocument" SG_ 3221225472 Aftrtrtmnt1SCRCtlystRgntTnk2HtrP "J1939-71";
BA_ "SPN" SG_ 3221225472 Aftrtrtmnt1SCRCtlystRgntTnk2HtrP 4373;
BA_ "SAEDocument" SG_ 3221225472 Aftrtrtmnt1SCRCtlystRgntTnk2Hter "J1939-71";
BA_ "SPN" SG_ 3221225472 Aftrtrtmnt1SCRCtlystRgntTnk2Hter 4372;
BA_ "SigType" SG_ 3221225472 Aftrtrtmnt1SCRCtlystRgntTnk2Hter 1;
BA_ "SAEDocument" SG_ 3221225472 Aftrtrtmnt1SCRRgntTnk2TmpPrlmnry "J1939-71";
BA_ "SPN" SG_ 3221225472 Aftrtrtmnt1SCRRgntTnk2TmpPrlmnry 4371;
BA_ "SAEDocument" SG_ 3221225472 Aftrtrtmnt1SCRCtlystRgntTnk2LvlP "J1939-71";
BA_ "SPN" SG_ 3221225472 Aftrtrtmnt1SCRCtlystRgntTnk2LvlP 4370;
BA_ "SAEDocument" SG_ 3221225472 Aftrtrtmnt1SCRCtlystRgntTnk2Lvl2 "J1939-71";
BA_ "SPN" SG_ 3221225472 Aftrtrtmnt1SCRCtlystRgntTnk2Lvl2 4369;
BA_ "SAEDocument" SG_ 3221225472 Aftrtrtmnt1SCRCtlystRgntTnk2Temp "J1939-71";
BA_ "SPN" SG_ 3221225472 Aftrtrtmnt1SCRCtlystRgntTnk2Temp 4368;
BA_ "SigType" SG_ 3221225472 Aftrtrtmnt1SCRCtlystRgntTnk2Temp 1;
BA_ "SAEDocument" SG_ 3221225472 Aftrtrtmnt1SCRCtlystRgntTnk2Lvel "J1939-71";
BA_ "SPN" SG_ 3221225472 Aftrtrtmnt1SCRCtlystRgntTnk2Lvel 4367;
BA_ "SigType" SG_ 3221225472 Aftrtrtmnt1SCRCtlystRgntTnk2Lvel 1;
BA_ "SAEDocument" SG_ 3221225472 Aftrtrtmnt1SCRCtlystRgntTnkDrnVl "J1939-71";
BA_ "SPN" SG_ 3221225472 Aftrtrtmnt1SCRCtlystRgntTnkDrnVl 5436;
BA_ "SAEDocument" SG_ 3221225472 Aftrtrtmnt1SCRCtlystRgntPmpState "J1939-71";
BA_ "SPN" SG_ 3221225472 Aftrtrtmnt1SCRCtlystRgntPmpState 5435;
BA_ "SigType" SG_ 3221225472 Aftrtrtmnt1SCRCtlystRgntPmpState 5;
BA_ "SAEDocument" SG_ 3221225472 Aftrtrtmnt1SCRCtlystRgntTnkFllVl "J1939-71";
BA_ "SPN" SG_ 3221225472 Aftrtrtmnt1SCRCtlystRgntTnkFllVl 5434;
BA_ "SAEDocument" SG_ 3221225472 Aftrtrtmnt1SCRCtlystRgntRtrnVlve "J1939-71";
BA_ "SPN" SG_ 3221225472 Aftrtrtmnt1SCRCtlystRgntRtrnVlve 4376;
BA_ "SAEDocument" SG_ 3221225472 Aftrtrtmnt1SCRCtlystRgntPmpDrvPr "J1939-71";
BA_ "SPN" SG_ 3221225472 Aftrtrtmnt1SCRCtlystRgntPmpDrvPr 4375;
BA_ "SAEDocument" SG_ 3221225472 Aftrtrtmnt1SCRCtlystRgntPmpMtrSp "J1939-71";
BA_ "SPN" SG_ 3221225472 Aftrtrtmnt1SCRCtlystRgntPmpMtrSp 4374;
BA_ "SigType" SG_ 3221225472 Aftrtrtmnt1SCRCtlystRgntPmpMtrSp 1;
BA_ "SAEDocument" SG_ 3221225472 Aftrtrtmnt1SCRCtlystOtltGsTmpPrl "J1939-71";
BA_ "SPN" SG_ 3221225472 Aftrtrtmnt1SCRCtlystOtltGsTmpPrl 4362;
BA_ "SAEDocument" SG_ 3221225472 Aftrtrtmnt1SCRCtlystOtletGasTemp "J1939-71";
BA_ "SPN" SG_ 3221225472 Aftrtrtmnt1SCRCtlystOtletGasTemp 4363;
BA_ "SigType" SG_ 3221225472 Aftrtrtmnt1SCRCtlystOtletGasTemp 1;
BA_ "SAEDocument" SG_ 3221225472 Aftrtrtmnt1SCRCtlystIntkGsTmpPrl "J1939-71";
BA_ "SPN" SG_ 3221225472 Aftrtrtmnt1SCRCtlystIntkGsTmpPrl 4361;
BA_ "SAEDocument" SG_ 3221225472 Aftrtrtmnt1SCRCtlystIntkeGasTemp "J1939-71";
BA_ "SPN" SG_ 3221225472 Aftrtrtmnt1SCRCtlystIntkeGasTemp 4360;
BA_ "SigType" SG_ 3221225472 Aftrtrtmnt1SCRCtlystIntkeGasTemp 1;
BA_ "SAEDocument" SG_ 3221225472 Aftrtrtmnt1SCRCtlystExhstGsDffPr "J1939-71";
BA_ "SPN" SG_ 3221225472 Aftrtrtmnt1SCRCtlystExhstGsDffPr 4358;
BA_ "SigType" SG_ 3221225472 Aftrtrtmnt1SCRCtlystExhstGsDffPr 1;
BA_ "SAEDocument" SG_ 3221225472 Aftrtrtmnt1SCRCtlystTnk2HaterCmd "J1939-71";
BA_ "SPN" SG_ 3221225472 Aftrtrtmnt1SCRCtlystTnk2HaterCmd 5414;
BA_ "SAEDocument" SG_ 3221225472 Aftrtrtmnt1SCRCtlystTnkHeaterCmd "J1939-71";
BA_ "SPN" SG_ 3221225472 Aftrtrtmnt1SCRCtlystTnkHeaterCmd 5137;
BA_ "SAEDocument" SG_ 3221225472 Aftrtrtmnt1SCRCtlystRgntLnHater4 "J1939-71";
BA_ "SPN" SG_ 3221225472 Aftrtrtmnt1SCRCtlystRgntLnHater4 4357;
BA_ "SigType" SG_ 3221225472 Aftrtrtmnt1SCRCtlystRgntLnHater4 5;
BA_ "SAEDocument" SG_ 3221225472 Aftrtrtmnt1SCRCtlystRgntLnHater3 "J1939-71";
BA_ "SPN" SG_ 3221225472 Aftrtrtmnt1SCRCtlystRgntLnHater3 4356;
BA_ "SigType" SG_ 3221225472 Aftrtrtmnt1SCRCtlystRgntLnHater3 5;
BA_ "SAEDocument" SG_ 3221225472 Aftrtrtmnt1SCRCtlystRgntLnHater2 "J1939-71";
BA_ "SPN" SG_ 3221225472 Aftrtrtmnt1SCRCtlystRgntLnHater2 4355;
BA_ "SigType" SG_ 3221225472 Aftrtrtmnt1SCRCtlystRgntLnHater2 5;
BA_ "SAEDocument" SG_ 3221225472 Aftrtrtmnt1SCRCtlystRgntLnHater1 "J1939-71";
BA_ "SPN" SG_ 3221225472 Aftrtrtmnt1SCRCtlystRgntLnHater1 4354;
BA_ "SigType" SG_ 3221225472 Aftrtrtmnt1SCRCtlystRgntLnHater1 5;
BA_ "SAEDocument" SG_ 3221225472 Aftrtrtmnt1SCRDoserHeatingModeRq "J1939-71";
BA_ "SPN" SG_ 3221225472 Aftrtrtmnt1SCRDoserHeatingModeRq 4353;
BA_ "SAEDocument" SG_ 3221225472 Aftrtrtmnt1SCRDsrFltSppressionRq "J1939-71";
BA_ "SPN" SG_ 3221225472 Aftrtrtmnt1SCRDsrFltSppressionRq 4352;
BA_ "SigType" SG_ 3221225472 Aftrtrtmnt1SCRDsrFltSppressionRq 5;
BA_ "SAEDocument" SG_ 3221225472 Aftrtrtmnt1SCRRqstdRgntQnttyFrIn "J1939-71";
BA_ "SPN" SG_ 3221225472 Aftrtrtmnt1SCRRqstdRgntQnttyFrIn 4350;
BA_ "SigType" SG_ 3221225472 Aftrtrtmnt1SCRRqstdRgntQnttyFrIn 1;
BA_ "SAEDocument" SG_ 3221225472 Aftrtrtmnt1SCRSystmRquestedState "J1939-71";
BA_ "SPN" SG_ 3221225472 Aftrtrtmnt1SCRSystmRquestedState 4349;
BA_ "SAEDocument" SG_ 3221225472 Aftrtrtmnt1SCRRqstdDsngRgntQntty "J1939-71";
BA_ "SPN" SG_ 3221225472 Aftrtrtmnt1SCRRqstdDsngRgntQntty 4348;
BA_ "SigType" SG_ 3221225472 Aftrtrtmnt1SCRRqstdDsngRgntQntty 1;
BA_ "SAEDocument" SG_ 3221225472 Aftrtrtmnt1SCRCtlystRgntLnHtr4Pr "J1939-71";
BA_ "SPN" SG_ 3221225472 Aftrtrtmnt1SCRCtlystRgntLnHtr4Pr 4347;
BA_ "SAEDocument" SG_ 3221225472 Aftrtrtmnt1SCRCtlystRgntLnHtr4St "J1939-71";
BA_ "SPN" SG_ 3221225472 Aftrtrtmnt1SCRCtlystRgntLnHtr4St 4346;
BA_ "SigType" SG_ 3221225472 Aftrtrtmnt1SCRCtlystRgntLnHtr4St 5;
BA_ "SAEDocument" SG_ 3221225472 Aftrtrtmnt1SCRCtlystRgntLnHtr3Pr "J1939-71";
BA_ "SPN" SG_ 3221225472 Aftrtrtmnt1SCRCtlystRgntLnHtr3Pr 4345;
BA_ "SAEDocument" SG_ 3221225472 Aftrtrtmnt1SCRCtlystRgntLnHtr3St "J1939-71";
BA_ "SPN" SG_ 3221225472 Aftrtrtmnt1SCRCtlystRgntLnHtr3St 4344;
BA_ "SigType" SG_ 3221225472 Aftrtrtmnt1SCRCtlystRgntLnHtr3St 5;
BA_ "SAEDocument" SG_ 3221225472 Aftrtrtmnt1SCRCtlystRgntLnHtr2Pr "J1939-71";
BA_ "SPN" SG_ 3221225472 Aftrtrtmnt1SCRCtlystRgntLnHtr2Pr 4343;
BA_ "SAEDocument" SG_ 3221225472 Aftrtrtmnt1SCRCtlystRgntLnHtr2St "J1939-71";
BA_ "SPN" SG_ 3221225472 Aftrtrtmnt1SCRCtlystRgntLnHtr2St 4342;
BA_ "SigType" SG_ 3221225472 Aftrtrtmnt1SCRCtlystRgntLnHtr2St 5;
BA_ "SAEDocument" SG_ 3221225472 Aftrtrtmnt1SCRCtlystRgntLnHtr1Pr "J1939-71";
BA_ "SPN" SG_ 3221225472 Aftrtrtmnt1SCRCtlystRgntLnHtr1Pr 4341;
BA_ "SAEDocument" SG_ 3221225472 Aftrtrtmnt1SCRCtlystRgntLnHtr1St "J1939-71";
BA_ "SPN" SG_ 3221225472 Aftrtrtmnt1SCRCtlystRgntLnHtr1St 4340;
BA_ "SigType" SG_ 3221225472 Aftrtrtmnt1SCRCtlystRgntLnHtr1St 5;
BA_ "SAEDocument" SG_ 3221225472 Aftrtrtmnt1SCRFeedbackCtrlStatus "J1939-71";
BA_ "SPN" SG_ 3221225472 Aftrtrtmnt1SCRFeedbackCtrlStatus 4339;
BA_ "SAEDocument" SG_ 3221225472 Aftrtrtmnt1SCRDsngVlvExhstTmpRdc "J1939-71";
BA_ "SPN" SG_ 3221225472 Aftrtrtmnt1SCRDsngVlvExhstTmpRdc 4338;
BA_ "SAEDocument" SG_ 3221225472 Aftrtrtment1SCRDosingReagentTemp "J1939-71";
BA_ "SPN" SG_ 3221225472 Aftrtrtment1SCRDosingReagentTemp 4337;
BA_ "SigType" SG_ 3221225472 Aftrtrtment1SCRDosingReagentTemp 1;
BA_ "SAEDocument" SG_ 3221225472 Aftrtrtmnt1SCRDsngAirAssistValve "J1939-71";
BA_ "SPN" SG_ 3221225472 Aftrtrtmnt1SCRDsngAirAssistValve 4336;
BA_ "SAEDocument" SG_ 3221225472 Aftrtrtmnt1SCRDsngArAssstAbsPrss "J1939-71";
BA_ "SPN" SG_ 3221225472 Aftrtrtmnt1SCRDsngArAssstAbsPrss 4335;
BA_ "SigType" SG_ 3221225472 Aftrtrtmnt1SCRDsngArAssstAbsPrss 1;
BA_ "SAEDocument" SG_ 3221225472 Aftrtrtmnt1SCRDsngRagentAbsPress "J1939-71";
BA_ "SPN" SG_ 3221225472 Aftrtrtmnt1SCRDsngRagentAbsPress 4334;
BA_ "SigType" SG_ 3221225472 Aftrtrtmnt1SCRDsngRagentAbsPress 1;
BA_ "SAEDocument" SG_ 3221225472 Aftrtrtmnt1SCRActlRgntQnttyOfInt "J1939-71";
BA_ "SPN" SG_ 3221225472 Aftrtrtmnt1SCRActlRgntQnttyOfInt 4333;
BA_ "SigType" SG_ 3221225472 Aftrtrtmnt1SCRActlRgntQnttyOfInt 1;
BA_ "SAEDocument" SG_ 3221225472 Aftertreatment1SCRSystemState "J1939-71";
BA_ "SPN" SG_ 3221225472 Aftertreatment1SCRSystemState 4332;
BA_ "SAEDocument" SG_ 3221225472 Aftrtrtmnt1SCRActlDsngRgntQntity "J1939-71";
BA_ "SPN" SG_ 3221225472 Aftrtrtmnt1SCRActlDsngRgntQntity 4331;
BA_ "SigType" SG_ 3221225472 Aftrtrtmnt1SCRActlDsngRgntQntity 1;
BA_ "SAEDocument" SG_ 3221225472 Aftrtrtmnt1OtltNH3GsSnsrHterCtrl "J1939-71";
BA_ "SPN" SG_ 3221225472 Aftrtrtmnt1OtltNH3GsSnsrHterCtrl 4383;
BA_ "SigType" SG_ 3221225472 Aftrtrtmnt1OtltNH3GsSnsrHterCtrl 5;
BA_ "SAEDocument" SG_ 3221225472 Aftrtrtmnt1OtltNH3GsSnsrHtrPrlmn "J1939-71";
BA_ "SPN" SG_ 3221225472 Aftrtrtmnt1OtltNH3GsSnsrHtrPrlmn 4382;
BA_ "SAEDocument" SG_ 3221225472 Aftrtrtmnt1OtltNH3GsSensorAtTemp "J1939-71";
BA_ "SPN" SG_ 3221225472 Aftrtrtmnt1OtltNH3GsSensorAtTemp 4381;
BA_ "SigType" SG_ 3221225472 Aftrtrtmnt1OtltNH3GsSensorAtTemp 5;
BA_ "SAEDocument" SG_ 3221225472 Aftrtrtmnt1OtltNH3GsSnsrPwrInRng "J1939-71";
BA_ "SPN" SG_ 3221225472 Aftrtrtmnt1OtltNH3GsSnsrPwrInRng 4380;
BA_ "SigType" SG_ 3221225472 Aftrtrtmnt1OtltNH3GsSnsrPwrInRng 5;
BA_ "SAEDocument" SG_ 3221225472 Aftrtrtmnt1OtletNH3ReadingStable "J1939-71";
BA_ "SPN" SG_ 3221225472 Aftrtrtmnt1OtletNH3ReadingStable 4379;
BA_ "SigType" SG_ 3221225472 Aftrtrtmnt1OtletNH3ReadingStable 5;
BA_ "SAEDocument" SG_ 3221225472 Aftrtrtmnt1OtltNH3SnsrPrlmnryFMI "J1939-71";
BA_ "SPN" SG_ 3221225472 Aftrtrtmnt1OtltNH3SnsrPrlmnryFMI 4378;
BA_ "SAEDocument" SG_ 3221225472 Aftertreatment1OutletNH3 "J1939-71";
BA_ "SPN" SG_ 3221225472 Aftertreatment1OutletNH3 4377;
BA_ "SigType" SG_ 3221225472 Aftertreatment1OutletNH3 1;
BA_ "SAEDocument" SG_ 3221225472 Aftrtrtmnt1GsOxdtnCtlystDffPrssP "J1939-71";
BA_ "SPN" SG_ 3221225472 Aftrtrtmnt1GsOxdtnCtlystDffPrssP 4758;
BA_ "SAEDocument" SG_ 3221225472 Aftrtrtmnt1GsOxdtnCtlystOtltGsTm "J1939-71";
BA_ "SPN" SG_ 3221225472 Aftrtrtmnt1GsOxdtnCtlystOtltGsTm 4754;
BA_ "SigType" SG_ 3221225472 Aftrtrtmnt1GsOxdtnCtlystOtltGsTm 1;
BA_ "SAEDocument" SG_ 3221225472 Aftrtrtmnt1GsOxdtnCtlystIntkGsTm "J1939-71";
BA_ "SPN" SG_ 3221225472 Aftrtrtmnt1GsOxdtnCtlystIntkGsTm 4753;
BA_ "SigType" SG_ 3221225472 Aftrtrtmnt1GsOxdtnCtlystIntkGsTm 1;
BA_ "SAEDocument" SG_ 3221225472 Aftrtrtmnt1GsOxdtnCtlystDffPress "J1939-71";
BA_ "SPN" SG_ 3221225472 Aftrtrtmnt1GsOxdtnCtlystDffPress 4755;
BA_ "SigType" SG_ 3221225472 Aftrtrtmnt1GsOxdtnCtlystDffPress 1;
VAL_ 3221225472 Jystck9YAxsLvrFrwrdPstvPosStatus 3 "Not Available" 2 "Error Indicator" 1 "On positive side of Neutral" 0 "Not on Positive side of Neutral" ;
VAL_ 3221225472 Jystck9YAxsLvrBckNgtivePosStatus 3 "Not Available" 2 "Error Indicator" 1 "On negative side of Neutral" 0 "Not on negative side of Neutral" ;
VAL_ 3221225472 Joystick9YAxisNeutralPosStatus 3 "Not Available" 2 "Error Indicator" 1 "In Neutral Position" 0 "Not in Neutral Position" ;
VAL_ 3221225472 Jystck9XAxsLvrRghtPstvePosStatus 3 "Not Available" 2 "Error Indicator" 1 "On positive side of Neutral" 0 "Not on Positive side of Neutral" ;
VAL_ 3221225472 Jystck9XAxsLvrLftNgtivePosStatus 3 "Not Available" 2 "Error Indicator" 1 "On negative side of Neutral" 0 "Not on negative side of Neutral" ;
VAL_ 3221225472 Joystick9XAxisNeutralPosStatus 3 "Not Available" 2 "Error Indicator" 1 "In Neutral Position" 0 "Not in Neutral Position" ;
VAL_ 3221225472 Joystick8Button9PressedStatus 3 "Not Available" 2 "Error Indicator" 1 "Button pressed" 0 "Button not pressed" ;
VAL_ 3221225472 Joystick8Button10PressedStatus 3 "Not Available" 2 "Error Indicator" 1 "Button pressed" 0 "Button not pressed" ;
VAL_ 3221225472 Joystick8Button11PressedStatus 3 "Not Available" 2 "Error Indicator" 1 "Button pressed" 0 "Button not pressed" ;
VAL_ 3221225472 Joystick8Button12PressedStatus 3 "Not Available" 2 "Error Indicator" 1 "Button pressed" 0 "Button not pressed" ;
VAL_ 3221225472 Joystick8Button5PressedStatus 3 "Not Available" 2 "Error Indicator" 1 "Button pressed" 0 "Button not pressed" ;
VAL_ 3221225472 Joystick8Button6PressedStatus 3 "Not Available" 2 "Error Indicator" 1 "Button pressed" 0 "Button not pressed" ;
VAL_ 3221225472 Joystick8Button7PressedStatus 3 "Not Available" 2 "Error Indicator" 1 "Button pressed" 0 "Button not pressed" ;
VAL_ 3221225472 Joystick8Button8PressedStatus 3 "Not Available" 2 "Error Indicator" 1 "Button pressed" 0 "Button not pressed" ;
VAL_ 3221225472 Joystick8Button1PressedStatus 3 "Not Available" 2 "Error Indicator" 1 "Button pressed" 0 "Button not pressed" ;
VAL_ 3221225472 Joystick8Button2PressedStatus 3 "Not Available" 2 "Error Indicator" 1 "Button pressed" 0 "Button not pressed" ;
VAL_ 3221225472 Joystick8Button3PressedStatus 3 "Not Available" 2 "Error Indicator" 1 "Button pressed" 0 "Button not pressed" ;
VAL_ 3221225472 Joystick8Button4PressedStatus 3 "Not Available" 2 "Error Indicator" 1 "Button pressed" 0 "Button not pressed" ;
VAL_ 3221225472 Joystick8XAxisDetentPosStatus 3 "Not Available" 2 "Error Indicator" 1 "In the Detent Position" 0 "Not in the Detent Position" ;
VAL_ 3221225472 Joystick8YAxisDetentPosStatus 3 "Not Available" 2 "Error Indicator" 1 "In the Detent Position" 0 "Not in the Detent Position" ;
VAL_ 3221225472 Jystck8YAxsLvrFrwrdPstvPosStatus 3 "Not Available" 2 "Error Indicator" 1 "On positive side of Neutral" 0 "Not on Positive side of Neutral" ;
VAL_ 3221225472 Jystck8YAxsLvrBckNgtivePosStatus 3 "Not Available" 2 "Error Indicator" 1 "On negative side of Neutral" 0 "Not on negative side of Neutral" ;
VAL_ 3221225472 Joystick8YAxisNeutralPosStatus 3 "Not Available" 2 "Error Indicator" 1 "In Neutral Position" 0 "Not in Neutral Position" ;
VAL_ 3221225472 Jystck8XAxsLvrRghtPstvePosStatus 3 "Not Available" 2 "Error Indicator" 1 "On positive side of Neutral" 0 "Not on Positive side of Neutral" ;
VAL_ 3221225472 Jystck8XAxsLvrLftNgtivePosStatus 3 "Not Available" 2 "Error Indicator" 1 "On negative side of Neutral" 0 "Not on negative side of Neutral" ;
VAL_ 3221225472 Joystick8XAxisNeutralPosStatus 3 "Not Available" 2 "Error Indicator" 1 "In Neutral Position" 0 "Not in Neutral Position" ;
VAL_ 3221225472 Joystick7Button9PressedStatus 3 "Not Available" 2 "Error Indicator" 1 "Button pressed" 0 "Button not pressed" ;
VAL_ 3221225472 Joystick7Button10PressedStatus 3 "Not Available" 2 "Error Indicator" 1 "Button pressed" 0 "Button not pressed" ;
VAL_ 3221225472 Joystick7Button11PressedStatus 3 "Not Available" 2 "Error Indicator" 1 "Button pressed" 0 "Button not pressed" ;
VAL_ 3221225472 Joystick7Button12PressedStatus 3 "Not Available" 2 "Error Indicator" 1 "Button pressed" 0 "Button not pressed" ;
VAL_ 3221225472 Joystick7Button5PressedStatus 3 "Not Available" 2 "Error Indicator" 1 "Button pressed" 0 "Button not pressed" ;
VAL_ 3221225472 Joystick7Button6PressedStatus 3 "Not Available" 2 "Error Indicator" 1 "Button pressed" 0 "Button not pressed" ;
VAL_ 3221225472 Joystick7Button7PressedStatus 3 "Not Available" 2 "Error Indicator" 1 "Button pressed" 0 "Button not pressed" ;
VAL_ 3221225472 Joystick7Button8PressedStatus 3 "Not Available" 2 "Error Indicator" 1 "Button pressed" 0 "Button not pressed" ;
VAL_ 3221225472 Joystick7Button1PressedStatus 3 "Not Available" 2 "Error Indicator" 1 "Button pressed" 0 "Button not pressed" ;
VAL_ 3221225472 Joystick7Button2PressedStatus 3 "Not Available" 2 "Error Indicator" 1 "Button pressed" 0 "Button not pressed" ;
VAL_ 3221225472 Joystick7Button3PressedStatus 3 "Not Available" 2 "Error Indicator" 1 "Button pressed" 0 "Button not pressed" ;
VAL_ 3221225472 Joystick7Button4PressedStatus 3 "Not Available" 2 "Error Indicator" 1 "Button pressed" 0 "Button not pressed" ;
VAL_ 3221225472 Joystick7XAxisDetentPosStatus 3 "Not Available" 2 "Error Indicator" 1 "In the Detent Position" 0 "Not in the Detent Position" ;
VAL_ 3221225472 Joystick7YAxisDetentPosStatus 3 "Not Available" 2 "Error Indicator" 1 "In the Detent Position" 0 "Not in the Detent Position" ;
VAL_ 3221225472 Jystck7YAxsLvrFrwrdPstvPosStatus 3 "Not Available" 2 "Error Indicator" 1 "On positive side of Neutral" 0 "Not on Positive side of Neutral" ;
VAL_ 3221225472 Jystck7YAxsLvrBckNgtivePosStatus 3 "Not Available" 2 "Error Indicator" 1 "On negative side of Neutral" 0 "Not on negative side of Neutral" ;
VAL_ 3221225472 Joystick7YAxisNeutralPosStatus 3 "Not Available" 2 "Error Indicator" 1 "In Neutral Position" 0 "Not in Neutral Position" ;
VAL_ 3221225472 Jystck7XAxsLvrRghtPstvePosStatus 3 "Not Available" 2 "Error Indicator" 1 "On positive side of Neutral" 0 "Not on Positive side of Neutral" ;
VAL_ 3221225472 Jystck7XAxsLvrLftNgtivePosStatus 3 "Not Available" 2 "Error Indicator" 1 "On negative side of Neutral" 0 "Not on negative side of Neutral" ;
VAL_ 3221225472 Joystick7XAxisNeutralPosStatus 3 "Not Available" 2 "Error Indicator" 1 "In Neutral Position" 0 "Not in Neutral Position" ;
VAL_ 3221225472 Joystick6Button9PressedStatus 3 "Not Available" 2 "Error Indicator" 1 "Button pressed" 0 "Button not pressed" ;
VAL_ 3221225472 Joystick6Button10PressedStatus 3 "Not Available" 2 "Error Indicator" 1 "Button pressed" 0 "Button not pressed" ;
VAL_ 3221225472 Joystick6Button11PressedStatus 3 "Not Available" 2 "Error Indicator" 1 "Button pressed" 0 "Button not pressed" ;
VAL_ 3221225472 Joystick6Button12PressedStatus 3 "Not Available" 2 "Error Indicator" 1 "Button pressed" 0 "Button not pressed" ;
VAL_ 3221225472 Joystick6Button5PressedStatus 3 "Not Available" 2 "Error Indicator" 1 "Button pressed" 0 "Button not pressed" ;
VAL_ 3221225472 Joystick6Button6PressedStatus 3 "Not Available" 2 "Error Indicator" 1 "Button pressed" 0 "Button not pressed" ;
VAL_ 3221225472 Joystick6Button7PressedStatus 3 "Not Available" 2 "Error Indicator" 1 "Button pressed" 0 "Button not pressed" ;
VAL_ 3221225472 Joystick6Button8PressedStatus 3 "Not Available" 2 "Error Indicator" 1 "Button pressed" 0 "Button not pressed" ;
VAL_ 3221225472 Joystick6Button1PressedStatus 3 "Not Available" 2 "Error Indicator" 1 "Button pressed" 0 "Button not pressed" ;
VAL_ 3221225472 Joystick6Button2PressedStatus 3 "Not Available" 2 "Error Indicator" 1 "Button pressed" 0 "Button not pressed" ;
VAL_ 3221225472 Joystick6Button3PressedStatus 3 "Not Available" 2 "Error Indicator" 1 "Button pressed" 0 "Button not pressed" ;
VAL_ 3221225472 Joystick6Button4PressedStatus 3 "Not Available" 2 "Error Indicator" 1 "Button pressed" 0 "Button not pressed" ;
VAL_ 3221225472 Joystick6XAxisDetentPosStatus 3 "Not Available" 2 "Error Indicator" 1 "In the Detent Position" 0 "Not in the Detent Position" ;
VAL_ 3221225472 Joystick6YAxisDetentPosStatus 3 "Not Available" 2 "Error Indicator" 1 "In the Detent Position" 0 "Not in the Detent Position" ;
VAL_ 3221225472 Jystck6YAxsLvrFrwrdPstvPosStatus 3 "Not Available" 2 "Error Indicator" 1 "On positive side of Neutral" 0 "Not on Positive side of Neutral" ;
VAL_ 3221225472 Jystck6YAxsLvrBckNgtivePosStatus 3 "Not Available" 2 "Error Indicator" 1 "On negative side of Neutral" 0 "Not on negative side of Neutral" ;
VAL_ 3221225472 Joystick6YAxisNeutralPosStatus 3 "Not Available" 2 "Error Indicator" 1 "In Neutral Position" 0 "Not in Neutral Position" ;
VAL_ 3221225472 Jystck6XAxsLvrRghtPstvePosStatus 3 "Not Available" 2 "Error Indicator" 1 "On positive side of Neutral" 0 "Not on Positive side of Neutral" ;
VAL_ 3221225472 Jystck6XAxsLvrLftNgtivePosStatus 3 "Not Available" 2 "Error Indicator" 1 "On negative side of Neutral" 0 "Not on negative side of Neutral" ;
VAL_ 3221225472 Joystick6XAxisNeutralPosStatus 3 "Not Available" 2 "Error Indicator" 1 "In Neutral Position" 0 "Not in Neutral Position" ;
VAL_ 3221225472 Joystick5Button9PressedStatus 3 "Not Available" 2 "Error Indicator" 1 "Button pressed" 0 "Button not pressed" ;
VAL_ 3221225472 Joystick5Button10PressedStatus 3 "Not Available" 2 "Error Indicator" 1 "Button pressed" 0 "Button not pressed" ;
VAL_ 3221225472 Joystick5Button11PressedStatus 3 "Not Available" 2 "Error Indicator" 1 "Button pressed" 0 "Button not pressed" ;
VAL_ 3221225472 Joystick5Button12PressedStatus 3 "Not Available" 2 "Error Indicator" 1 "Button pressed" 0 "Button not pressed" ;
VAL_ 3221225472 Joystick5Button5PressedStatus 3 "Not Available" 2 "Error Indicator" 1 "Button pressed" 0 "Button not pressed" ;
VAL_ 3221225472 Joystick5Button6PressedStatus 3 "Not Available" 2 "Error Indicator" 1 "Button pressed" 0 "Button not pressed" ;
VAL_ 3221225472 Joystick5Button7PressedStatus 3 "Not Available" 2 "Error Indicator" 1 "Button pressed" 0 "Button not pressed" ;
VAL_ 3221225472 Joystick5Button8PressedStatus 3 "Not Available" 2 "Error Indicator" 1 "Button pressed" 0 "Button not pressed" ;
VAL_ 3221225472 Joystick5Button1PressedStatus 3 "Not Available" 2 "Error Indicator" 1 "Button pressed" 0 "Button not pressed" ;
VAL_ 3221225472 Joystick5Button2PressedStatus 3 "Not Available" 2 "Error Indicator" 1 "Button pressed" 0 "Button not pressed" ;
VAL_ 3221225472 Joystick5Button3PressedStatus 3 "Not Available" 2 "Error Indicator" 1 "Button pressed" 0 "Button not pressed" ;
VAL_ 3221225472 Joystick5Button4PressedStatus 3 "Not Available" 2 "Error Indicator" 1 "Button pressed" 0 "Button not pressed" ;
VAL_ 3221225472 Joystick5XAxisDetentPosStatus 3 "Not Available" 2 "Error Indicator" 1 "In the Detent Position" 0 "Not in the Detent Position" ;
VAL_ 3221225472 Joystick5YAxisDetentPosStatus 3 "Not Available" 2 "Error Indicator" 1 "In the Detent Position" 0 "Not in the Detent Position" ;
VAL_ 3221225472 Jystck5YAxsLvrFrwrdPstvPosStatus 3 "Not Available" 2 "Error Indicator" 1 "On positive side of Neutral" 0 "Not on Positive side of Neutral" ;
VAL_ 3221225472 Jystck5YAxsLvrBckNgtivePosStatus 3 "Not Available" 2 "Error Indicator" 1 "On negative side of Neutral" 0 "Not on negative side of Neutral" ;
VAL_ 3221225472 Joystick5YAxisNeutralPosStatus 3 "Not Available" 2 "Error Indicator" 1 "In Neutral Position" 0 "Not in Neutral Position" ;
VAL_ 3221225472 Jystck5XAxsLvrRghtPstvePosStatus 3 "Not Available" 2 "Error Indicator" 1 "On positive side of Neutral" 0 "Not on Positive side of Neutral" ;
VAL_ 3221225472 Jystck5XAxsLvrLftNgtivePosStatus 3 "Not Available" 2 "Error Indicator" 1 "On negative side of Neutral" 0 "Not on negative side of Neutral" ;
VAL_ 3221225472 Joystick5XAxisNeutralPosStatus 3 "Not Available" 2 "Error Indicator" 1 "In Neutral Position" 0 "Not in Neutral Position" ;
VAL_ 3221225472 Joystick4Button9PressedStatus 3 "Not Available" 2 "Error Indicator" 1 "Button pressed" 0 "Button not pressed" ;
VAL_ 3221225472 Joystick4Button10PressedStatus 3 "Not Available" 2 "Error Indicator" 1 "Button pressed" 0 "Button not pressed" ;
VAL_ 3221225472 Joystick4Button11PressedStatus 3 "Not Available" 2 "Error Indicator" 1 "Button pressed" 0 "Button not pressed" ;
VAL_ 3221225472 Joystick4Button12PressedStatus 3 "Not Available" 2 "Error Indicator" 1 "Button pressed" 0 "Button not pressed" ;
VAL_ 3221225472 Joystick4Button5PressedStatus 3 "Not Available" 2 "Error Indicator" 1 "Button pressed" 0 "Button not pressed" ;
VAL_ 3221225472 Joystick4Button6PressedStatus 3 "Not Available" 2 "Error Indicator" 1 "Button pressed" 0 "Button not pressed" ;
VAL_ 3221225472 Joystick4Button7PressedStatus 3 "Not Available" 2 "Error Indicator" 1 "Button pressed" 0 "Button not pressed" ;
VAL_ 3221225472 Joystick4Button8PressedStatus 3 "Not Available" 2 "Error Indicator" 1 "Button pressed" 0 "Button not pressed" ;
VAL_ 3221225472 Joystick4Button1PressedStatus 3 "Not Available" 2 "Error Indicator" 1 "Button pressed" 0 "Button not pressed" ;
VAL_ 3221225472 Joystick4Button2PressedStatus 3 "Not Available" 2 "Error Indicator" 1 "Button pressed" 0 "Button not pressed" ;
VAL_ 3221225472 Joystick4Button3PressedStatus 3 "Not Available" 2 "Error Indicator" 1 "Button pressed" 0 "Button not pressed" ;
VAL_ 3221225472 Joystick4Button4PressedStatus 3 "Not Available" 2 "Error Indicator" 1 "Button pressed" 0 "Button not pressed" ;
VAL_ 3221225472 Joystick4XAxisDetentPosStatus 3 "Not Available" 2 "Error Indicator" 1 "In the Detent Position" 0 "Not in the Detent Position" ;
VAL_ 3221225472 Joystick4YAxisDetentPosStatus 3 "Not Available" 2 "Error Indicator" 1 "In the Detent Position" 0 "Not in the Detent Position" ;
VAL_ 3221225472 Jystck4YAxsLvrFrwrdPstvPosStatus 3 "Not Available" 2 "Error Indicator" 1 "On positive side of Neutral" 0 "Not on Positive side of Neutral" ;
VAL_ 3221225472 Jystck4YAxsLvrBckNgtivePosStatus 3 "Not Available" 2 "Error Indicator" 1 "On negative side of Neutral" 0 "Not on negative side of Neutral" ;
VAL_ 3221225472 Joystick4YAxisNeutralPosStatus 3 "Not Available" 2 "Error Indicator" 1 "In Neutral Position" 0 "Not in Neutral Position" ;
VAL_ 3221225472 Jystck4XAxsLvrRghtPstvePosStatus 3 "Not Available" 2 "Error Indicator" 1 "On positive side of Neutral" 0 "Not on Positive side of Neutral" ;
VAL_ 3221225472 Jystck4XAxsLvrLftNgtivePosStatus 3 "Not Available" 2 "Error Indicator" 1 "On negative side of Neutral" 0 "Not on negative side of Neutral" ;
VAL_ 3221225472 Joystick4XAxisNeutralPosStatus 3 "Not Available" 2 "Error Indicator" 1 "In Neutral Position" 0 "Not in Neutral Position" ;
VAL_ 3221225472 Joystick10Button9PressedStatus 3 "Not Available" 2 "Error Indicator" 1 "Button pressed" 0 "Button not pressed" ;
VAL_ 3221225472 Joystick10Button10PressedStatus 3 "Not Available" 2 "Error Indicator" 1 "Button pressed" 0 "Button not pressed" ;
VAL_ 3221225472 Joystick10Button11PressedStatus 3 "Not Available" 2 "Error Indicator" 1 "Button pressed" 0 "Button not pressed" ;
VAL_ 3221225472 Joystick10Button12PressedStatus 3 "Not Available" 2 "Error Indicator" 1 "Button pressed" 0 "Button not pressed" ;
VAL_ 3221225472 Joystick10Button5PressedStatus 3 "Not Available" 2 "Error Indicator" 1 "Button pressed" 0 "Button not pressed" ;
VAL_ 3221225472 Joystick10Button6PressedStatus 3 "Not Available" 2 "Error Indicator" 1 "Button pressed" 0 "Button not pressed" ;
VAL_ 3221225472 Joystick10Button7PressedStatus 3 "Not Available" 2 "Error Indicator" 1 "Button pressed" 0 "Button not pressed" ;
VAL_ 3221225472 Joystick10Button8PressedStatus 3 "Not Available" 2 "Error Indicator" 1 "Button pressed" 0 "Button not pressed" ;
VAL_ 3221225472 Joystick10Button1PressedStatus 3 "Not Available" 2 "Error Indicator" 1 "Button pressed" 0 "Button not pressed" ;
VAL_ 3221225472 Joystick10Button2PressedStatus 3 "Not Available" 2 "Error Indicator" 1 "Button pressed" 0 "Button not pressed" ;
VAL_ 3221225472 Joystick10Button3PressedStatus 3 "Not Available" 2 "Error Indicator" 1 "Button pressed" 0 "Button not pressed" ;
VAL_ 3221225472 Joystick10Button4PressedStatus 3 "Not Available" 2 "Error Indicator" 1 "Button pressed" 0 "Button not pressed" ;
VAL_ 3221225472 Joystick10XAxisDetentPosStatus 3 "Not Available" 2 "Error Indicator" 1 "In the Detent Position" 0 "Not in the Detent Position" ;
VAL_ 3221225472 Joystick10YAxisDetentPosStatus 3 "Not Available" 2 "Error Indicator" 1 "In the Detent Position" 0 "Not in the Detent Position" ;
VAL_ 3221225472 Jystck10YAxsLvrFrwrdPstvPsStatus 3 "Not Available" 2 "Error Indicator" 1 "On positive side of Neutral" 0 "Not on Positive side of Neutral" ;
VAL_ 3221225472 Jystck10YAxsLvrBckNgtvePosStatus 3 "Not Available" 2 "Error Indicator" 1 "On negative side of Neutral" 0 "Not on negative side of Neutral" ;
VAL_ 3221225472 Joystick10YAxisNeutralPosStatus 3 "Not Available" 2 "Error Indicator" 1 "In Neutral Position" 0 "Not in Neutral Position" ;
VAL_ 3221225472 Jystck10XAxsLvrRghtPstvPosStatus 3 "Not Available" 2 "Error Indicator" 1 "On positive side of Neutral" 0 "Not on Positive side of Neutral" ;
VAL_ 3221225472 Jystck10XAxsLvrLftNgtvePosStatus 3 "Not Available" 2 "Error Indicator" 1 "On negative side of Neutral" 0 "Not on negative side of Neutral" ;
VAL_ 3221225472 Joystick10XAxisNeutralPosStatus 3 "Not Available" 2 "Error Indicator" 1 "In Neutral Position" 0 "Not in Neutral Position" ;
VAL_ 3221225472 PssngrArbgDctivationSwitchStatus 3 "not available" 2 "Error  State of deactivation switch cannot be determined" 1 "passenger airbag deactivated" 0 "passenger airbag activated" ;
VAL_ 3221225472 Beltlock10Status 3 "not available" 2 "Error  Beltlock state cannot be determined" 1 "locked" 0 "unlocked" ;
VAL_ 3221225472 Beltlock9Status 3 "not available" 2 "Error  Beltlock state cannot be determined" 1 "locked" 0 "unlocked" ;
VAL_ 3221225472 Beltlock8Status 3 "not available" 2 "Error  Beltlock state cannot be determined" 1 "locked" 0 "unlocked" ;
VAL_ 3221225472 Beltlock7Status 3 "not available" 2 "Error  Beltlock state cannot be determined" 1 "locked" 0 "unlocked" ;
VAL_ 3221225472 Beltlock6Status 3 "not available" 2 "Error  Beltlock state cannot be determined" 1 "locked" 0 "unlocked" ;
VAL_ 3221225472 Beltlock5Status 3 "not available" 2 "Error  Beltlock state cannot be determined" 1 "locked" 0 "unlocked" ;
VAL_ 3221225472 Beltlock4Status 3 "not available" 2 "Error  Beltlock state cannot be determined" 1 "locked" 0 "unlocked" ;
VAL_ 3221225472 Beltlock3Status 3 "not available" 2 "Error  Beltlock state cannot be determined" 1 "locked" 0 "unlocked" ;
VAL_ 3221225472 PassengerBeltlockStatus 3 "not available" 2 "Error  Beltlock state cannot be determined" 1 "locked" 0 "unlocked" ;
VAL_ 3221225472 DriverBeltlockStatus 3 "not available" 2 "Error  Beltlock state cannot be determined" 1 "locked" 0 "unlocked" ;
VAL_ 3221225472 Aftrtrtmnt2FlFlwDverterValveCtrl 3 "not available" 2 "reserved for SAE assignment" 1 "on" 0 "off" ;
VAL_ 3221225472 Aftertreatment2FuelPumpRelayCtrl 3 "not available" 2 "reserved for SAE assignment" 1 "on" 0 "off" ;
VAL_ 3221225472 AftrtrtmntSCROprtrIndcmntSverity 7 "Not Available / Not Supported" 6 "Reserved" 5 "Inducement Level 5" 4 "Inducement Level 4" 3 "Inducement Level 3" 2 "Inducement Level 2" 1 "Inducement Level 1" 0 "No Inducement Active" ;
VAL_ 3221225472 Aftrtrtmnt1DEFTnkLwLvelIndicator 5 "reserved for SAE assignment" 3 "reserved for SAE assignment" 2 "reserved for SAE assignment" 7 "not available" 4 "On  fast blink 1 HZ" 6 "reserved for SAE assignment" 1 "On  solid" 0 "Off" ;
VAL_ 3221225472 ArmrestSwitchMatrix2Switch2 0 "Off" ;
VAL_ 3221225472 ArmrestSwitchMatrix2Switch1 0 "Off" ;
VAL_ 3221225472 ArmrestSwitchMatrixSwitch2 0 "Off" ;
VAL_ 3221225472 ArmrestSwitchMatrixSwitch1 0 "Off" ;
VAL_ 3221225472 YawRateExRangeFigureOfMerit 3 "Not available" 2 "Error" 1 "Yaw rate degraded Data is suspect due to environmental conditions" 0 "Yaw rate fully functional Data is within sensor specification" ;
VAL_ 3221225472 RollRateExRangeFigureOfMerit 3 "Not available" 2 "Error" 1 "Roll rate degraded Data is suspect due to environmental conditions" 0 "Roll rate fully functional Data is within sensor specification" ;
VAL_ 3221225472 PitchRateExRangeFigureOfMerit 3 "Not available" 2 "Error" 1 "Pitch rate degraded Data is suspect due to environmental conditions" 0 "Pitch rate fully functional Data is within sensor specification" ;
VAL_ 3221225472 Aftrtrtmnt2NOxAdsrbrDSOxRgnrtnSt 3 "Not available" 2 "Error indicator" 1 "Active" 0 "Inactive" ;
VAL_ 3221225472 Aftrtrtmnt2NOxAdsrbrDNOxRgnrtnSt 3 "Not available" 2 "Error indicator" 1 "Active" 0 "Inactive" ;
VAL_ 3221225472 Aftrtrtmnt1NOxAdsrbrDSOxRgnrtnSt 3 "Not available" 2 "Error indicator" 1 "Active" 0 "Inactive" ;
VAL_ 3221225472 Aftrtrtmnt1NOxAdsrbrDNOxRgnrtnSt 3 "Not available" 2 "Error indicator" 1 "Active" 0 "Inactive" ;
VAL_ 3221225472 Aftrtrtmnt2SCRCtlystRgntPmpState 3 "not available" 2 "reserved for SAE assignment" 1 "pump error" 0 "pump operational" ;
VAL_ 3221225472 Aftrtrtmnt2SCRCtalystReagentType 15 "Not available" 14 "Error detected with urea reagent type detection" 13 "Not able to determine catalyst reagent type type unknown" 5 "to 1100  Reserved for SAE assignment" 3 "Catalyst reagent is proper mixture" 2 "Catalyst reagent is diesel" 1 "Catalyst reagent is urea concentration too low" 0 "Catalyst reagent is urea concentration too high" ;
VAL_ 3221225472 Aftrtrtmnt2SCRCtlystRgntLnHater4 3 "not available" 2 "reserved for future assignment by SAE" 1 "request for heater to be active" 0 "request for heater to be inactive" ;
VAL_ 3221225472 Aftrtrtmnt2SCRCtlystRgntLnHater3 3 "not available" 2 "reserved for future assignment by SAE" 1 "request for heater to be active" 0 "request for heater to be inactive" ;
VAL_ 3221225472 Aftrtrtmnt2SCRCtlystRgntLnHater2 3 "not available" 2 "reserved for future assignment by SAE" 1 "request for heater to be active" 0 "request for heater to be inactive" ;
VAL_ 3221225472 Aftrtrtmnt2SCRCtlystRgntLnHater1 3 "not available" 2 "reserved for future assignment by SAE" 1 "request for heater to be active" 0 "request for heater to be inactive" ;
VAL_ 3221225472 Aftrtrtmnt2SCRDoserHeatingModeRq 7 "Not available" 4 "110 Reserved" 3 "Heater on" 2 "Heater automatic mode" 1 "Heater economy mode" 0 "Heater off" ;
VAL_ 3221225472 Aftrtrtmnt2SCRDsrFltSppressionRq 3 "Not available" 2 "Reserved" 1 "Error suppression on" 0 "Error suppression off" ;
VAL_ 3221225472 Aftrtrtmnt2SCRSystmRquestedState 15 "Not available" 14 "Error" 10 "Service test mode dosing not allowed" 9 "Service test mode dosing allowed" 8 "Diagnosis afterrun" 7 "Shutoff wait for afterrun" 6 "Protect mode against cold defreeze" 5 "Protect mode against heat pressure buildup" 4 "Reserved for future assignment by SAE" 3 "System error pending" 2 "Normal dosing operation" 1 "Preparing dosing readiness wake up prepare to operate wait for start" 0 "Dormant sleep mode" ;
VAL_ 3221225472 Aftrtrtmnt2SCRCtlystRgntLnHtr4St 3 "not available" 2 "error" 1 "heater active" 0 "heater inactive" ;
VAL_ 3221225472 Aftrtrtmnt2SCRCtlystRgntLnHtr3St 3 "not available" 2 "error" 1 "heater active" 0 "heater inactive" ;
VAL_ 3221225472 Aftrtrtmnt2SCRCtlystRgntLnHtr2St 3 "not available" 2 "error" 1 "heater active" 0 "heater inactive" ;
VAL_ 3221225472 Aftrtrtmnt2SCRCtlystRgntLnHtr1St 3 "not available" 2 "error" 1 "heater active" 0 "heater inactive" ;
VAL_ 3221225472 Aftrtrtmnt2SCRFeedbackCtrlStatus 4 "reserved for future assignment by SAE" 3 "reserved for future assignment by SAE" 2 "reserved for future assignment by SAE" 7 "not available" 6 "error" 5 "reserved for future assignment by SAE" 1 "closed loop control active" 0 "open loop control active" ;
VAL_ 3221225472 Aftertreatment2SCRSystemState 15 "Not available" 14 "Error" 10 "Service test mode dosing not allowed" 9 "Service test mode dosing allowed" 8 "Diagnosis afterrun" 7 "Shutoff wait for afterrun" 6 "Protect mode against cold defreeze" 5 "Protect mode against heat pressure buildup" 4 "Reserved for future assignment by SAE" 3 "System error pending" 2 "Normal dosing operation" 1 "Preparing dosing readiness wake up prepare to operate wait for start" 0 "Dormant sleep mode" ;
VAL_ 3221225472 Aftrtrtmnt2OtltNH3GsSnsrHterCtrl 3 "Heater off or Not available" 2 "Preheat 1" 1 "Preheat 2" 0 "Automatic" ;
VAL_ 3221225472 Aftrtrtmnt1SCRCtlystRgntPmpState 3 "not available" 2 "reserved for SAE assignment" 1 "pump error" 0 "pump operational" ;
VAL_ 3221225472 Aftrtrtmnt1SCRCtlystRgntLnHater4 3 "not available" 2 "reserved for future assignment by SAE" 1 "request for heater to be active" 0 "request for heater to be inactive" ;
VAL_ 3221225472 Aftrtrtmnt1SCRCtlystRgntLnHater3 3 "not available" 2 "reserved for future assignment by SAE" 1 "request for heater to be active" 0 "request for heater to be inactive" ;
VAL_ 3221225472 Aftrtrtmnt1SCRCtlystRgntLnHater2 3 "not available" 2 "reserved for future assignment by SAE" 1 "request for heater to be active" 0 "request for heater to be inactive" ;
VAL_ 3221225472 Aftrtrtmnt1SCRCtlystRgntLnHater1 3 "not available" 2 "reserved for future assignment by SAE" 1 "request for heater to be active" 0 "request for heater to be inactive" ;
VAL_ 3221225472 Aftrtrtmnt1SCRDoserHeatingModeRq 7 "Not available" 4 "110 Reserved" 3 "Heater on" 2 "Heater automatic mode" 1 "Heater economy mode" 0 "Heater off" ;
VAL_ 3221225472 Aftrtrtmnt1SCRDsrFltSppressionRq 3 "Not available" 2 "Reserved" 1 "Error suppression on" 0 "Error suppression off" ;
VAL_ 3221225472 Aftrtrtmnt1SCRSystmRquestedState 15 "Not available" 14 "Error" 10 "Service test mode dosing not allowed" 9 "Service test mode dosing allowed" 8 "Diagnosis afterrun" 7 "Shutoff wait for afterrun" 6 "Protect mode against cold defreeze" 5 "Protect mode against heat pressure buildup" 4 "Reserved for future assignment by SAE" 3 "System error pending" 2 "Normal dosing operation" 1 "Preparing dosing readiness wake up prepare to operate wait for start" 0 "Dormant sleep mode" ;
VAL_ 3221225472 Aftrtrtmnt1SCRCtlystRgntLnHtr4St 3 "not available" 2 "error" 1 "heater active" 0 "heater inactive" ;
VAL_ 3221225472 Aftrtrtmnt1SCRCtlystRgntLnHtr3St 3 "not available" 2 "error" 1 "heater active" 0 "heater inactive" ;
VAL_ 3221225472 Aftrtrtmnt1SCRCtlystRgntLnHtr2St 3 "not available" 2 "error" 1 "heater active" 0 "heater inactive" ;
VAL_ 3221225472 Aftrtrtmnt1SCRCtlystRgntLnHtr1St 3 "not available" 2 "error" 1 "heater active" 0 "heater inactive" ;
VAL_ 3221225472 Aftrtrtmnt1SCRFeedbackCtrlStatus 7 "not available" 4 "reserved for future assignment by SAE" 3 "reserved for future assignment by SAE" 2 "reserved for future assignment by SAE" 6 "error" 5 "reserved for future assignment by SAE" 1 "closed loop control active" 0 "open loop control active" ;
VAL_ 3221225472 Aftertreatment1SCRSystemState 15 "Not available" 14 "Error" 10 "Service test mode dosing not allowed" 9 "Service test mode dosing allowed" 8 "Diagnosis afterrun" 7 "Shutoff wait for afterrun" 6 "Protect mode against cold defreeze" 5 "Protect mode against heat pressure buildup" 4 "Reserved for future assignment by SAE" 3 "System error pending" 2 "Normal dosing operation" 1 "Preparing dosing readiness wake up prepare to operate wait for start" 0 "Dormant sleep mode" ;
VAL_ 3221225472 Aftrtrtmnt1OtltNH3GsSnsrHterCtrl 3 "Heater off or not available" 2 "Preheat 1" 1 "Preheat 2" 0 "Automatic" ;
