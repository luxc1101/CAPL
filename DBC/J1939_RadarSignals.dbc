VERSION ""

NS_ :

BS_:

BU_: Turbocharger OnBoardDataLogger OffBoardDiagnosticTool2 OffBoardDiagnosticTool1 FileServer ParkingBrakeController SeatControl2 FanDriveController SteeringColumnUnit CommunicationUnitRadio CommunicationUnitSatellite CommunicationUnitCellular PropulsionBatteryCharger ChassisController2 ChassisController1 EngineValveControl AuxiliaryHeater2 AuxiliaryHeater1 ClutchUnit RampControl InformationSystem1 SuspensionSystemController2 OilSensor VehicleDynamicStability ExhaustEmissionController TransmissionDisplay2 TransmissionDisplay1 ClimateControl2 WaterPumpController RearAxleSteeringController LightingOperatorControl SeatController1 IgnitionController2 IgnitionController1 TirePressureController CabController2 CabController1 PneumaticSystemController SuspensionSystemController1 HydraulicPumpController EnduranceBrakingSystem RetarderExhaustEngine2 OnBoardDiagnosticUnit HeadwayController RetarderExhaustEngine1 CabDisplay1 ManagementComputer VirtualTerminal OffVehicleGateway PowerTakeOffFront HitchControl AuxiliaryValveControl BodyController TractorTrailerBridge1 StarterSystem ElectricalSystem VehicleSecurity VehicleNavigation AerodynamicControl ElectricalChargingSystem ClimateControl1 TripRecorder InstrumentCluster SuspensionDriveAxle2 SuspensionDriveAxle1 SuspensionSteerAxle SteeringController FuelSystem CruiseControl RetarderDriveline RetarderEngine BrakesDriveAxle2 BrakesDriveAxle1 BrakesSystemController BrakesSteerAxle AxleDrive2 AxleDrive1 AxleSteering PowerTakeOff ShiftConsoleSecondary ShiftConsolePrimary Transmission2 Transmission1 Engine2 Engine1

BO_ 3221225472 VECTOR__INDEPENDENT_SIG_MSG: 0 Vector__XXX
 SG_ EngFuelActuator2CtrlCmd : 0|16@1+ (1,0) [0|160.6375] "%" Vector__XXX
 SG_ EngFuelActuator1CtrlCmd : 0|16@1+ (1,0) [0|160.6375] "%" Vector__XXX
 SG_ EngThrottleActuator2CtrlCmd : 0|16@1+ (1,0) [0|160.6375] "%" Vector__XXX
 SG_ EngThrottleActuator1CtrlCmd : 0|16@1+ (1,0) [0|160.6375] "%" Vector__XXX
 SG_ EngCyl24KnockLevel : 0|8@1+ (1,0) [0|250] "%" Vector__XXX
 SG_ EngCyl23KnockLevel : 0|8@1+ (1,0) [0|250] "%" Vector__XXX
 SG_ EngCyl22KnockLevel : 0|8@1+ (1,0) [0|250] "%" Vector__XXX
 SG_ EngCyl21KnockLevel : 0|8@1+ (1,0) [0|250] "%" Vector__XXX
 SG_ EngCyl20KnockLevel : 0|8@1+ (1,0) [0|250] "%" Vector__XXX
 SG_ EngCyl19KnockLevel : 0|8@1+ (1,0) [0|250] "%" Vector__XXX
 SG_ EngCyl18KnockLevel : 0|8@1+ (1,0) [0|250] "%" Vector__XXX
 SG_ EngCyl17KnockLevel : 0|8@1+ (1,0) [0|250] "%" Vector__XXX
 SG_ EngCyl16KnockLevel : 0|8@1+ (1,0) [0|250] "%" Vector__XXX
 SG_ EngCyl15KnockLevel : 0|8@1+ (1,0) [0|250] "%" Vector__XXX
 SG_ EngCyl14KnockLevel : 0|8@1+ (1,0) [0|250] "%" Vector__XXX
 SG_ EngCyl13KnockLevel : 0|8@1+ (1,0) [0|250] "%" Vector__XXX
 SG_ EngCyl12KnockLevel : 0|8@1+ (1,0) [0|250] "%" Vector__XXX
 SG_ EngCyl11KnockLevel : 0|8@1+ (1,0) [0|250] "%" Vector__XXX
 SG_ EngCyl10KnockLevel : 0|8@1+ (1,0) [0|250] "%" Vector__XXX
 SG_ EngCyl9KnockLevel : 0|8@1+ (1,0) [0|250] "%" Vector__XXX
 SG_ EngCyl8KnockLevel : 0|8@1+ (1,0) [0|250] "%" Vector__XXX
 SG_ EngCyl7KnockLevel : 0|8@1+ (1,0) [0|250] "%" Vector__XXX
 SG_ EngCyl6KnockLevel : 0|8@1+ (1,0) [0|250] "%" Vector__XXX
 SG_ EngCyl5KnockLevel : 0|8@1+ (1,0) [0|250] "%" Vector__XXX
 SG_ EngCyl4KnockLevel : 0|8@1+ (1,0) [0|250] "%" Vector__XXX
 SG_ EngCyl3KnockLevel : 0|8@1+ (1,0) [0|250] "%" Vector__XXX
 SG_ EngCyl2KnockLevel : 0|8@1+ (1,0) [0|250] "%" Vector__XXX
 SG_ EngCyl1KnockLevel : 0|8@1+ (1,0) [0|250] "%" Vector__XXX
 SG_ EngCyl24CombustionStatus : 0|2@1+ (1,0) [0|3] "" Vector__XXX
 SG_ EngCyl23CombustionStatus : 0|2@1+ (1,0) [0|3] "" Vector__XXX
 SG_ EngCyl22CombustionStatus : 0|2@1+ (1,0) [0|3] "" Vector__XXX
 SG_ EngCyl21CombustionStatus : 0|2@1+ (1,0) [0|3] "" Vector__XXX
 SG_ EngCyl20CombustionStatus : 0|2@1+ (1,0) [0|3] "" Vector__XXX
 SG_ EngCyl19CombustionStatus : 0|2@1+ (1,0) [0|3] "" Vector__XXX
 SG_ EngCyl18CombustionStatus : 0|2@1+ (1,0) [0|3] "" Vector__XXX
 SG_ EngCyl17CombustionStatus : 0|2@1+ (1,0) [0|3] "" Vector__XXX
 SG_ EngCyl16CombustionStatus : 0|2@1+ (1,0) [0|3] "" Vector__XXX
 SG_ EngCyl15CombustionStatus : 0|2@1+ (1,0) [0|3] "" Vector__XXX
 SG_ EngCyl14CombustionStatus : 0|2@1+ (1,0) [0|3] "" Vector__XXX
 SG_ EngCyl13CombustionStatus : 0|2@1+ (1,0) [0|3] "" Vector__XXX
 SG_ EngCyl12CombustionStatus : 0|2@1+ (1,0) [0|3] "" Vector__XXX
 SG_ EngCyl11CombustionStatus : 0|2@1+ (1,0) [0|3] "" Vector__XXX
 SG_ EngCyl10CombustionStatus : 0|2@1+ (1,0) [0|3] "" Vector__XXX
 SG_ EngCyl9CombustionStatus : 0|2@1+ (1,0) [0|3] "" Vector__XXX
 SG_ EngCyl8CombustionStatus : 0|2@1+ (1,0) [0|3] "" Vector__XXX
 SG_ EngCyl7CombustionStatus : 0|2@1+ (1,0) [0|3] "" Vector__XXX
 SG_ EngCyl6CombustionStatus : 0|2@1+ (1,0) [0|3] "" Vector__XXX
 SG_ EngCyl5CombustionStatus : 0|2@1+ (1,0) [0|3] "" Vector__XXX
 SG_ EngCyl4CombustionStatus : 0|2@1+ (1,0) [0|3] "" Vector__XXX
 SG_ EngCyl3CombustionStatus : 0|2@1+ (1,0) [0|3] "" Vector__XXX
 SG_ EngCyl2CombustionStatus : 0|2@1+ (1,0) [0|3] "" Vector__XXX
 SG_ EngCyl1CombustionStatus : 0|2@1+ (1,0) [0|3] "" Vector__XXX
 SG_ RqGenOverallPowerFactorLagging : 0|2@1+ (1,0) [0|4] "" Vector__XXX
 SG_ RqGeneratorOverallPowerFactor : 0|16@1+ (6.103515625E-005,-1) [-1|2.921814] "" Vector__XXX
 SG_ RqGeneratorTotalACReactivePower : 0|32@1+ (1,-2000000000) [-2000000000|2000000000] "VA" Vector__XXX
 SG_ BladeRotationAngleFigureOfMerit : 0|2@1+ (1,0) [0|3] "" Vector__XXX
 SG_ RelativeBladeHeightFigureOfMerit : 0|2@1+ (1,0) [0|3] "" Vector__XXX
 SG_ RltvBldHghtAndBldRttnAnglMsrmntL : 0|8@1+ (0.5,0) [0|125] "ms" Vector__XXX
 SG_ BladeRotationAngle : 0|16@1+ (0.0078124659559567,-200) [-200|301.99] "deg" Vector__XXX
 SG_ RelativeBladeHeight : 0|16@1+ (0.1,-3200) [-3200|3225.5] "mm" Vector__XXX
 SG_ RetarderDemandValue : 0|8@1+ (1,-125) [-125|125] "%" Vector__XXX
 SG_ ParkBrakeDemandValue : 0|8@1+ (0.4,0) [0|100] "%" Vector__XXX
 SG_ ServiceBrakeDemandValue : 0|16@1+ (0.01953125,0) [0|1255] "kPa" Vector__XXX
 SG_ VehicleType : 0|2@1+ (1,0) [0|3] "" Vector__XXX
 SG_ BrakeLightSwitch : 0|2@1+ (1,0) [0|3] "" Vector__XXX
 SG_ ASREngineControlActive : 0|2@1+ (1,0) [0|3] "" Vector__XXX
 SG_ ASRBreakControlActive : 0|2@1+ (1,0) [0|3] "" Vector__XXX
 SG_ VehicleRetarderCtrlActive : 0|2@1+ (1,0) [0|3] "" Vector__XXX
 SG_ VehicleABSActive : 0|2@1+ (1,0) [0|1] "" Vector__XXX
 SG_ RoadCurvature : 0|16@1+ (1,-250) [-250|251.992] "1/km" Vector__XXX
 SG_ PneumaticControlLine : 0|2@1+ (1,0) [0|1] "" Vector__XXX
 SG_ ABSOffroadRequest : 0|2@1+ (1,0) [0|1] "" Vector__XXX
 SG_ TwoElCircuitsBrakeDemand : 0|2@1+ (1,0) [0|1] "" Vector__XXX
 SG_ VehicleRetarderCtrlActive : 0|2@1+ (1,0) [0|3] "" Vector__XXX
 SG_ WheelSpeedDiffMainAxle : 0|16@1+ (0.00390625,-125) [-125|125] "km/hr" Vector__XXX
 SG_ ActualRetarderPercTorque : 0|8@1+ (1,-125) [-125|125] "%" Vector__XXX
 SG_ Wheel_BasedVehicleSpeed : 0|16@1+ (0.00390625,0) [0|251] "km/hr" Vector__XXX
 SG_ SupplyLineBrakingRequest : 0|2@1+ (1,0) [0|1] "" Vector__XXX
 SG_ VDCActive : 0|2@1+ (1,0) [0|1] "" Vector__XXX
 SG_ AutomTowedVehBreakActive : 0|2@1+ (1,0) [0|1] "" Vector__XXX
 SG_ VehicleServiceBrakeActive : 0|2@1+ (1,0) [0|1] "" Vector__XXX
 SG_ VehicleRetarderCtrlActive : 0|2@1+ (1,0) [0|3] "" Vector__XXX
 SG_ VehicleABSActive : 0|2@1+ (1,0) [0|1] "" Vector__XXX
 SG_ ReferenceRetarderTorque : 0|16@1+ (1,0) [0|64255] "Nm" Vector__XXX
 SG_ AxleLoadSum : 0|16@1+ (2,0) [0|128510] "kg" Vector__XXX
 SG_ SupplyLineBrakingRequest : 0|2@1+ (1,0) [0|1] "" Vector__XXX
 SG_ LoadingRampApproachAssist : 0|2@1+ (1,0) [0|1] "" Vector__XXX
 SG_ SpringBrakeEngaged : 0|2@1+ (1,0) [0|1] "" Vector__XXX
 SG_ ElectrLoadPropFunc : 0|2@1+ (1,0) [0|1] "" Vector__XXX
 SG_ SpringBrakeInstalled : 0|2@1+ (1,0) [0|1] "" Vector__XXX
 SG_ VehicleType : 0|2@1+ (1,0) [0|3] "" Vector__XXX
 SG_ ElecSupplyOfNonBrakingSys : 0|2@1+ (1,0) [0|1] "" Vector__XXX
 SG_ AmberWarningSignalReq : 0|2@1+ (1,0) [0|1] "" Vector__XXX
 SG_ RedWarningSignalRequest : 0|2@1+ (1,0) [0|1] "" Vector__XXX
 SG_ VehicleElectrSupplySuff : 0|2@1+ (1,0) [0|1] "" Vector__XXX
 SG_ AutomTowedVehBreakActive : 0|2@1+ (1,0) [0|1] "" Vector__XXX
 SG_ VehicleServiceBrakeActive : 0|2@1+ (1,0) [0|1] "" Vector__XXX
 SG_ VehicleRetarderCtrlActive : 0|2@1+ (1,0) [0|3] "" Vector__XXX
 SG_ VehicleABSActive : 0|2@1+ (1,0) [0|1] "" Vector__XXX
 SG_ PneumaticSupplyPressure : 0|8@1+ (5,0) [0|1250] "kPa" Vector__XXX
 SG_ BrakeTemperature : 0|8@1+ (10,0) [0|2500] "°C" Vector__XXX
 SG_ BrakeLining : 0|8@1+ (0.4,0) [0|100] "%" Vector__XXX
 SG_ TyrePressure : 0|8@1+ (10,0) [0|2500] "kPa" Vector__XXX
 SG_ TyreWheelIdentTemp2 : 0|4@1+ (1,0) [0|15] "" Vector__XXX
 SG_ TyreWheelIdentTemp1 : 0|4@1+ (1,0) [0|15] "" Vector__XXX
 SG_ TyreWheelIdentPressure2 : 0|4@1+ (1,0) [0|15] "" Vector__XXX
 SG_ TyreWheelIdentPressure1 : 0|4@1+ (1,0) [0|15] "" Vector__XXX
 SG_ TyreWheelIdentLining2 : 0|4@1+ (1,0) [0|15] "" Vector__XXX
 SG_ TyreWheelIdentLining1 : 0|4@1+ (1,0) [0|15] "" Vector__XXX
 SG_ VehiclePneumSupplySuff : 0|2@1+ (1,0) [0|1] "" Vector__XXX
 SG_ BrakeTemperatureStatus : 0|2@1+ (1,0) [0|1] "" Vector__XXX
 SG_ BrakeLiningSufficient : 0|2@1+ (1,0) [0|1] "" Vector__XXX
 SG_ TyrePressureSufficient : 0|2@1+ (1,0) [0|1] "" Vector__XXX
 SG_ ODDRequest : 0|2@1+ (1,0) [0|3] "" Vector__XXX
 SG_ AntiTheftDeviceReq : 0|2@1+ (1,0) [0|3] "" Vector__XXX
 SG_ VehicleType : 0|2@1+ (1,0) [0|3] "" Vector__XXX
 SG_ MaxVehicleSpeedLimit : 0|8@1+ (1,0) [0|250] "km/h" Vector__XXX
 SG_ EngineSpeedUpperLimit : 0|16@1+ (0.125,0) [0|8031.875] "rpm" Vector__XXX
 SG_ EngineSpeedLowerLimit : 0|16@1+ (0.125,0) [0|8191.875] "rpm" Vector__XXX
 SG_ EngineTorqueMode : 0|4@1+ (1,0) [0|15] "" Vector__XXX
 SG_ VehicleSpeed : 0|16@1+ (0.00390625,0) [0|250.996] "km/hr" Vector__XXX
 SG_ PercentLoadAtCurrentSpeed : 0|8@1+ (1,0) [0|125] "%" Vector__XXX
 SG_ EngineSpeed : 0|16@1+ (0.125,0) [0|8031.88] "rpm" Vector__XXX
 SG_ ActualEngine_PercTorque : 0|8@1+ (1,-125) [-125|125] "%" Vector__XXX
 SG_ DriversDemandEngine_PercTorque : 0|8@1+ (1,-125) [-125|125] "%" Vector__XXX
 SG_ EngineRunning : 0|2@1+ (1,0) [0|1] "" Vector__XXX
 SG_ EngineControlAllowed : 0|2@1+ (1,0) [0|1] "" Vector__XXX
 SG_ ClutchIndptdPTOFeedback : 0|2@1+ (1,0) [0|1] "" Vector__XXX
 SG_ AccelPedalPosition : 0|8@1+ (0.4,0) [0|100] "%" Vector__XXX
 SG_ AccelPedalLowIdleSwitch : 0|2@1+ (1,0) [0|1] "" Vector__XXX
 SG_ StarterActive : 0|2@1+ (1,0) [0|1] "" Vector__XXX
 SG_ TorqueConvOilTemp : 0|16@1+ (0.03125,-273) [-273|1735] "°C" Vector__XXX
 SG_ TorqueConvtOilTempWarning : 0|3@1+ (1,0) [0|2] "" Vector__XXX
 SG_ PTOControlAllowed : 0|2@1+ (1,0) [0|1] "" Vector__XXX
 SG_ SecEngineMtdPTOFeedback : 0|2@1+ (1,0) [0|1] "" Vector__XXX
 SG_ FirstEngineMtdPTOFeedback : 0|2@1+ (1,0) [0|1] "" Vector__XXX
 SG_ SecClutchDptdPTOFeedback : 0|2@1+ (1,0) [0|1] "" Vector__XXX
 SG_ FirstClutchDpdtPTOFeedback : 0|2@1+ (1,0) [0|1] "" Vector__XXX
 SG_ CurrentGear : 0|8@1+ (1,-125) [-125|125] "" Vector__XXX
 SG_ PercentClutchSlip : 0|8@1+ (0.4,0) [0|100] "%" Vector__XXX
 SG_ ReferenceEngineTorque : 0|16@1+ (1,0) [0|64255] "Nm" Vector__XXX
 SG_ FuelLevelWarning : 0|2@1+ (1,0) [0|1] "" Vector__XXX
 SG_ EngineOilPressureWarning : 0|2@1+ (1,0) [0|1] "" Vector__XXX
 SG_ EngineCoolantTempWarning : 0|3@1+ (1,0) [0|2] "" Vector__XXX
 SG_ EngineOilPressure : 0|8@1+ (4,0) [0|1000] "kPa" Vector__XXX
 SG_ EngCoolantTemp : 0|8@1+ (1,-40) [-40|210] "deg C" Vector__XXX
 SG_ EngineOilTemperature : 0|16@1+ (0.03125,-273) [-273|1735] "°C" Vector__XXX
 SG_ AmbientAirTemperature : 0|16@1+ (0.03125,-273) [-273|1735] "°C" Vector__XXX
 SG_ VehicleType : 0|2@1+ (1,0) [0|3] "" Vector__XXX
 SG_ BodyPressure : 0|8@1+ (0.1,0) [0|25] "bar" Vector__XXX
 SG_ BodyFluidLevel : 0|16@1+ (2,0) [0|128510] "L" Vector__XXX
 SG_ ThermalBodyTemperature : 0|8@1+ (1,-125) [-125|125] "°C" Vector__XXX
 SG_ RearObstacleDistance : 0|8@1+ (2,0) [0|500] "cm" Vector__XXX
 SG_ AntiTheftDeviceStatus : 0|2@1+ (1,0) [0|1] "" Vector__XXX
 SG_ ODDStatus : 0|2@1+ (1,0) [0|1] "" Vector__XXX
 SG_ ReqEngineSpeedUpperLim : 0|16@1+ (0.125,0) [0|8031.875] "rpm" Vector__XXX
 SG_ ReqEngineSpeedLowerLim : 0|16@1+ (0.125,0) [0|8031.875] "rpm" Vector__XXX
 SG_ ReqEngineTorqueLimit : 0|8@1+ (1,-125) [-125|125] "%" Vector__XXX
 SG_ ReqEngineSpeedLimit : 0|8@1+ (1,0) [0|250] "km/hr" Vector__XXX
 SG_ ReqEngineSpeed : 0|16@1+ (0.125,0) [0|8031.875] "rpm" Vector__XXX
 SG_ SecEngineMtdPTOSwitch : 0|2@1+ (1,0) [0|1] "" Vector__XXX
 SG_ SecClutchDpdtPTOSwitch : 0|2@1+ (1,0) [0|1] "" Vector__XXX
 SG_ FirstClutchDpdtPTOSwitch : 0|2@1+ (1,0) [0|1] "" Vector__XXX
 SG_ OperatingPanelActive : 0|2@1+ (1,0) [0|1] "" Vector__XXX
 SG_ RefusePackerStepSwitch : 0|2@1+ (1,0) [0|1] "" Vector__XXX
 SG_ EngineStopSwitch : 0|2@1+ (1,0) [0|1] "" Vector__XXX
 SG_ EngineStartSwitch : 0|2@1+ (1,0) [0|3] "" Vector__XXX
 SG_ StarterLockoutSwitch : 0|2@1+ (1,0) [0|1] "" Vector__XXX
 SG_ RqstedPercentClutchSlip : 0|8@1+ (0.4,0) [0|100] "%" Vector__XXX
 SG_ FirstEngineMtdPTOSwitch : 0|2@1+ (1,0) [0|1] "" Vector__XXX
 SG_ ClutchIndpdtPTOSwitch : 0|2@1+ (1,0) [0|1] "" Vector__XXX
 SG_ TrailerLeftSideMarkerLight : 0|2@1+ (1,0) [0|3] "" Vector__XXX
 SG_ TrailerLeftReversingLight : 0|2@1+ (1,0) [0|3] "" Vector__XXX
 SG_ TrailerLeftRearWidIndLight : 0|2@1+ (1,0) [0|3] "" Vector__XXX
 SG_ TrailerLeftRearRegPltLight : 0|2@1+ (1,0) [0|3] "" Vector__XXX
 SG_ TrailerLeftRearLight : 0|2@1+ (1,0) [0|3] "" Vector__XXX
 SG_ TrailerLeftRearFogLight : 0|2@1+ (1,0) [0|3] "" Vector__XXX
 SG_ TrailerLeftDirIndLight : 0|2@1+ (1,0) [0|3] "" Vector__XXX
 SG_ TrailerLeftCrnMarkerLight : 0|2@1+ (1,0) [0|3] "" Vector__XXX
 SG_ TrailerInteriorLight : 0|2@1+ (1,0) [0|3] "" Vector__XXX
 SG_ TrailerWorkLamp : 0|2@1+ (1,0) [0|3] "" Vector__XXX
 SG_ TrailerRotatingIdentLight : 0|2@1+ (1,0) [0|3] "" Vector__XXX
 SG_ TrailerRightStopLight : 0|2@1+ (1,0) [0|3] "" Vector__XXX
 SG_ TrailerRightSideMrkLight : 0|2@1+ (1,0) [0|3] "" Vector__XXX
 SG_ TrailerRightReversingLight : 0|2@1+ (1,0) [0|3] "" Vector__XXX
 SG_ TrailRightRearWidIndLight : 0|2@1+ (1,0) [0|3] "" Vector__XXX
 SG_ TrailerRightRearRegPltLight : 0|2@1+ (1,0) [0|3] "" Vector__XXX
 SG_ TrailerRightRearLight : 0|2@1+ (1,0) [0|3] "" Vector__XXX
 SG_ TrailerRightRearFogLight : 0|2@1+ (1,0) [0|3] "" Vector__XXX
 SG_ TrailerRightDirIndLight : 0|2@1+ (1,0) [0|3] "" Vector__XXX
 SG_ TrailerRightCrnMarkerLight : 0|2@1+ (1,0) [0|3] "" Vector__XXX
 SG_ TrailerRearWarningLight : 0|2@1+ (1,0) [0|3] "" Vector__XXX
 SG_ TrailerLeftStopLight : 0|2@1+ (1,0) [0|3] "" Vector__XXX
 SG_ SN : 0|4@1+ (1,0) [0|15] "" Vector__XXX
 SG_ SeparationTime : 0|8@1+ (1,0) [0|255] "ms" Vector__XXX
 SG_ BlockSize : 0|8@1+ (1,0) [0|255] "" Vector__XXX
 SG_ FlowStatus : 0|4@1+ (1,0) [0|3] "" Vector__XXX
 SG_ FirstFrameDataLength : 0|12@0+ (1,0) [0|4095] "Byte" Vector__XXX
 SG_ SingleFrameDataLength : 0|4@1+ (1,0) [0|7] "Byte" Vector__XXX
 SG_ ProtocolCtrlInformation : 0|4@1+ (1,0) [0|3] "" Vector__XXX
 SG_ SN : 0|4@1+ (1,0) [0|15] "" Vector__XXX
 SG_ SeparationTime : 0|8@1+ (1,0) [0|255] "ms" Vector__XXX
 SG_ BlockSize : 0|8@1+ (1,0) [0|255] "" Vector__XXX
 SG_ FlowStatus : 0|4@1+ (1,0) [0|3] "" Vector__XXX
 SG_ FirstFrameDataLength : 0|12@0+ (1,0) [0|4095] "Byte" Vector__XXX
 SG_ SingleFrameDataLength : 0|4@1+ (1,0) [0|7] "Byte" Vector__XXX
 SG_ ProtocolCtrlInformation : 0|4@1+ (1,0) [0|3] "" Vector__XXX
 SG_ ControlByte : 0|8@1+ (1,0) [0|255] "" Vector__XXX
 SG_ FilterMode : 0|8@1+ (1,0) [0|255] "" Vector__XXX
 SG_ ToPort : 0|4@1+ (1,0) [0|15] "" Vector__XXX
 SG_ FromPort : 0|4@1+ (1,0) [0|15] "" Vector__XXX
 SG_ ParkingAndTrailerAirPress : 0|8@1+ (8,0) [0|2000] "kPa" Vector__XXX
 SG_ DrivenAxleLoad : 0|16@1+ (2,0) [0|128510] "kg" Vector__XXX
 SG_ AuxEquipSupplyPressure : 0|8@1+ (8,0) [0|2000] "kPa" Vector__XXX
 SG_ StopLevelChangeReq : 0|2@1+ (1,0) [0|3] "" Vector__XXX
 SG_ RampLevelStorageReq : 0|2@1+ (1,0) [0|3] "" Vector__XXX
 SG_ LevelControlReq : 0|2@1+ (1,0) [0|3] "" Vector__XXX
 SG_ RampLevelReq : 0|2@1+ (1,0) [0|3] "" Vector__XXX
 SG_ SteeringAxleLockingReq : 0|2@1+ (1,0) [0|3] "" Vector__XXX
 SG_ LiftAxle2PositionReq : 0|2@1+ (1,0) [0|3] "" Vector__XXX
 SG_ LiftAxle1PositionReq : 0|2@1+ (1,0) [0|3] "" Vector__XXX
 SG_ TractionHelpReq : 0|2@1+ (1,0) [0|3] "" Vector__XXX
 SG_ LevelChangeReqRearAxle : 0|2@1+ (1,0) [0|3] "" Vector__XXX
 SG_ LevelChangeReqFrontAxle : 0|2@1+ (1,0) [0|3] "" Vector__XXX
 SG_ RideHeightRequest : 0|2@1+ (1,0) [0|3] "" Vector__XXX
 SG_ LevelControl : 0|2@1+ (1,0) [0|1] "" Vector__XXX
 SG_ NominalVehBodyLevelRearAxle : 0|16@1+ (1,0) [0|64255] "mm" Vector__XXX
 SG_ NominalVehBodyLevelFrontAxle : 0|16@1+ (1,0) [0|64255] "mm" Vector__XXX
 SG_ RampLevel : 0|2@1+ (1,0) [0|1] "" Vector__XXX
 SG_ NormalLevel : 0|2@1+ (1,0) [0|3] "" Vector__XXX
 SG_ StopLevelChangeAcknowledge : 0|2@1+ (1,0) [0|1] "" Vector__XXX
 SG_ LevelChangeRearAxle : 0|2@1+ (1,0) [0|1] "" Vector__XXX
 SG_ LevelChangeFrontAxle : 0|2@1+ (1,0) [0|1] "" Vector__XXX
 SG_ RampLevelStorage : 0|2@1+ (1,0) [0|1] "" Vector__XXX
 SG_ SteeringAxleLocking : 0|2@1+ (1,0) [0|3] "" Vector__XXX
 SG_ LiftAxle2Pos : 0|2@1+ (1,0) [0|3] "" Vector__XXX
 SG_ LiftAxle1Pos : 0|2@1+ (1,0) [0|3] "" Vector__XXX
 SG_ RampLevelPosition : 0|2@1+ (1,0) [0|3] "" Vector__XXX
 SG_ TractionHelp : 0|2@1+ (1,0) [0|1] "" Vector__XXX
 SG_ LevelCtrlSysRideHeightLevel : 0|2@1+ (1,0) [0|1] "" Vector__XXX
 SG_ RelVehBodyLevelRearAxle : 0|16@1+ (1,0) [0|64255] "mm" Vector__XXX
 SG_ RelVehBodyLevelFrontAxle : 0|16@1+ (1,-32000) [-32000|32255] "mm" Vector__XXX
 SG_ TyrePressThresholdDetect : 0|3@1+ (1,0) [0|7] "" Vector__XXX
 SG_ TyreModulePowerSupply : 0|2@1+ (1,0) [0|1] "" Vector__XXX
 SG_ TyreTemperature : 0|16@1+ (0.03125,-273) [-273|1735] "°C" Vector__XXX
 SG_ AirLeakageDetection : 0|16@1+ (0.1,0) [0|6425.5] "Pa/s" Vector__XXX
 SG_ TyreWheelIdentification2 : 0|4@1+ (1,0) [0|15] "" Vector__XXX
 SG_ TyreWheelIdentification1 : 0|4@1+ (1,0) [0|15] "" Vector__XXX
 SG_ NMHCConvertingCatalystCompleted : 0|1@1+ (1,0) [0|1] "" Vector__XXX
 SG_ NMHCConvertingCatalystEnabled : 0|1@1+ (1,0) [0|1] "" Vector__XXX
 SG_ NOxConvertingCatalystAdsorberCom : 0|1@1+ (1,0) [0|1] "" Vector__XXX
 SG_ NOxConvertingCatalystAdsorberEna : 0|1@1+ (1,0) [0|1] "" Vector__XXX
 SG_ DieselParticulateFilterCompleted : 0|1@1+ (1,0) [0|1] "" Vector__XXX
 SG_ DieselParticulateFilterEnabled : 0|1@1+ (1,0) [0|1] "" Vector__XXX
 SG_ BoostPressureControlSystemComple : 0|1@1+ (1,0) [0|1] "" Vector__XXX
 SG_ BoostPressureControlSystemEnable : 0|1@1- (1,0) [0|0] "" Vector__XXX
 SG_ MisfireMonitoringComplete : 0|1@1+ (1,0) [0|1] "" Vector__XXX
 SG_ MisfireMonitoringEnabled : 0|1@1+ (1,0) [0|0] "" Vector__XXX
 SG_ FuelSystemMonitoringEnabled : 0|1@1+ (1,0) [0|1] "" Vector__XXX
 SG_ ComprehensiveComptMonComplete : 0|1@1+ (1,0) [0|1] "" Vector__XXX
 SG_ ComprehensiveCompMonEnabled : 0|1@1+ (1,0) [0|1] "" Vector__XXX
 SG_ SecondAirSystemMonComplete : 0|1@1+ (1,0) [0|1] "" Vector__XXX
 SG_ SecondAirSystemMonEnabled : 0|1@1+ (1,0) [0|1] "" Vector__XXX
 SG_ OxygenSensorMonComplete : 0|1@1+ (1,0) [0|1] "" Vector__XXX
 SG_ OxygenSensorMonEnabled : 0|1@1+ (1,0) [0|1] "" Vector__XXX
 SG_ OxygenSensorHeaterMonComplete : 0|1@1+ (1,0) [0|1] "" Vector__XXX
 SG_ OxygenSensorHeaterMonEnabled : 0|1@1+ (1,0) [0|1] "" Vector__XXX
 SG_ HeatedCatalystMonComplete : 0|1@1+ (1,0) [0|1] "" Vector__XXX
 SG_ HeatedCatalystMonEnabled : 0|1@1+ (1,0) [0|1] "" Vector__XXX
 SG_ EvaporativeSystemMonComplete : 0|1@1+ (1,0) [0|1] "" Vector__XXX
 SG_ EvaporativeSystemMonEnabled : 0|1@1+ (1,0) [0|1] "" Vector__XXX
 SG_ EGRSystemMonitoringComplete : 0|1@1+ (1,0) [0|1] "" Vector__XXX
 SG_ EGRSystemMonitoringEnabled : 0|1@1+ (1,0) [0|1] "" Vector__XXX
 SG_ ColdStartAidSystemMonComplete : 0|1@1+ (1,0) [0|1] "" Vector__XXX
 SG_ ColdStartAidSystemMonEnabled : 0|1@1+ (1,0) [0|1] "" Vector__XXX
 SG_ CatalystMonComplete : 0|1@1+ (1,0) [0|1] "" Vector__XXX
 SG_ CatalystMonEnabled : 0|1@1+ (1,0) [0|1] "" Vector__XXX
 SG_ ACSystemRefrigerantMonComplete : 0|1@1+ (1,0) [0|1] "" Vector__XXX
 SG_ ACSystemRefrigerantMonEnabled : 0|1@1+ (1,0) [0|1] "" Vector__XXX
 SG_ FuelSystemMonitoringComplete : 0|1@1+ (1,0) [0|1] "" Vector__XXX
 SG_ NumOfWarmUpsSinceDTCsCleared : 0|8@1+ (1,0) [0|250] "" Vector__XXX
 SG_ TimeSinceEngineStart : 0|16@1+ (1,0) [0|64255] "sec" Vector__XXX
 SG_ SecurityEntityLengthHigh : 0|4@1+ (1,0) [0|255] "Byte" Vector__XXX
 SG_ SecurityEntityType : 0|4@1+ (1,0) [0|15] "" Vector__XXX
 SG_ SecurityEntityLength : 0|8@1+ (1,0) [0|1785] "Byte" Vector__XXX
 SG_ XBRMessageChecksum : 0|4@1+ (1,0) [0|15] "" Vector__XXX
 SG_ XBRMessageCounter : 0|4@1+ (1,0) [0|15] "" Vector__XXX
 SG_ XBRUrgency : 0|8@1+ (1,0) [0|100] "%" Vector__XXX
 SG_ XBRCtrlMode : 0|2@1+ (1,0) [0|3] "" Vector__XXX
 SG_ XBRPriority : 0|2@1+ (1,0) [0|3] "" Vector__XXX
 SG_ XBREBIMode : 0|2@1+ (1,0) [0|3] "" Vector__XXX
 SG_ ExtlAccelerationDemand : 0|16@1+ (1,-15.687) [-15.687|15.687] "m/s²" Vector__XXX
 SG_ WaterInFuelIndicator : 0|2@1+ (1,0) [0|3] "" Vector__XXX
 SG_ AxleLocation : 0|8@1+ (1,0) [0|255] "" Vector__XXX
 SG_ CargoWeight_30 : 0|16@1+ (2,0) [0|128510] "kg" Vector__XXX
 SG_ CargoWeight_20 : 0|16@1+ (2,0) [0|128510] "kg" Vector__XXX
 SG_ CargoWeight_10 : 0|16@1+ (2,0) [0|128510] "kg" Vector__XXX
 SG_ CargoWeight_00 : 0|16@1+ (2,0) [0|128510] "kg" Vector__XXX
 SG_ TrailerWeight_30 : 0|16@1+ (2,0) [0|128510] "kg" Vector__XXX
 SG_ TrailerWeight_20 : 0|16@1+ (2,0) [0|128510] "kg" Vector__XXX
 SG_ TrailerWeight_10 : 0|16@1+ (2,0) [0|128510] "kg" Vector__XXX
 SG_ TrailerWeight_00 : 0|16@1+ (2,0) [0|128510] "kg" Vector__XXX
 SG_ AxleWeight_30 : 0|16@1+ (0.5,0) [0|32127.5] "kg" Vector__XXX
 SG_ AxleWeight_20 : 0|16@1+ (0.5,0) [0|32127.5] "kg" Vector__XXX
 SG_ AxleWeight_10 : 0|16@1+ (0.5,0) [0|32127.5] "kg" Vector__XXX
 SG_ AxleWeight_00 : 0|16@1+ (0.5,0) [0|32127.5] "kg" Vector__XXX
 SG_ NetBatteryCurrent : 0|16@1+ (0.05,-1600) [-1600|1612.75] "A" Vector__XXX
 SG_ AltCurrent : 0|16@1+ (0.05,-1600) [-1600|1612.75] "A" Vector__XXX
 SG_ ECUPowerOutputSupplyVoltage3 : 0|16@1+ (0.05,0) [0|3212.75] "V" Vector__XXX
 SG_ ECUPowerOutputSupplyVoltage2 : 0|16@1+ (0.05,0) [0|3212.75] "V" Vector__XXX
 SG_ ECUPowerOutputSupplyVoltage1 : 0|16@1+ (0.05,0) [0|3212.75] "V" Vector__XXX
 SG_ BatteryPotential_PowerInput2 : 0|16@1+ (0.05,0) [0|3212.75] "V" Vector__XXX
 SG_ Longitude : 0|32@1+ (9.9998264269999E-008,-210) [-210|211.1008122] "deg" Vector__XXX
 SG_ Latitude : 0|32@1+ (9.9998264269999E-008,-210) [-210|211.1008122] "deg" Vector__XXX
 SG_ VehicleIdentificationNumber : 0|8@1+ (1.02,0) [0|255] "per byte" Vector__XXX
 SG_ TotalPowerTakeoffHours : 0|32@1+ (0.05,0) [0|210554060.75] "hr" Vector__XXX
 SG_ TotalVehicleHours : 0|32@1+ (0.05,0) [0|210554060.75] "hr" Vector__XXX
 SG_ HydOilLevel : 0|8@1+ (0.4,0) [0|100] "%" Vector__XXX
 SG_ WinchOilPressSwitch : 0|2@1+ (1,0) [0|3] "" Vector__XXX
 SG_ HydOilFilterRestrictionSwitch : 0|2@1+ (1,0) [0|3] "" Vector__XXX
 SG_ HydTemp : 0|8@1+ (1,-40) [-40|210] "deg C" Vector__XXX
 SG_ Altitude : 0|16@1+ (0.125,-2500) [-2500|5531.875] "m" Vector__XXX
 SG_ Pitch : 0|16@1+ (0.0078124659559567,-200) [-200|301.99] "deg" Vector__XXX
 SG_ NavigationBasedVehicleSpeed : 0|16@1+ (0.0039062485409696,0) [0|250.996] "km/h" Vector__XXX
 SG_ CompassBearing : 0|16@1+ (0.0078124659559567,0) [0|501.99] "deg" Vector__XXX
 SG_ HighResolutionTripDistance : 0|32@1+ (0.0049999999821898,0) [0|21055406] "km" Vector__XXX
 SG_ HghRsolutionTotalVehicleDistance : 0|32@1+ (0.0049999999821898,0) [0|21055406] "km" Vector__XXX
 SG_ YCBrakeCtrlActive : 0|2@1+ (1,0) [0|3] "" Vector__XXX
 SG_ YCEngCtrlActive : 0|2@1+ (1,0) [0|3] "" Vector__XXX
 SG_ ROPBrakeCtrlActive : 0|2@1+ (1,0) [0|3] "" Vector__XXX
 SG_ ROPEngCtrlActive : 0|2@1+ (1,0) [0|3] "" Vector__XXX
 SG_ VDCBrakeLightRq : 0|2@1+ (1,0) [0|3] "" Vector__XXX
 SG_ VDCFullyOperational : 0|2@1+ (1,0) [0|3] "" Vector__XXX
 SG_ VDCInformationSignal : 0|2@1+ (1,0) [0|3] "" Vector__XXX
 SG_ TotalVehicleDistance : 0|32@1+ (0.12500000000594,0) [0|526385151.9] "km" Vector__XXX
 SG_ TripDistance : 0|32@1+ (0.12500000000594,0) [0|526385151.9] "km" Vector__XXX
 SG_ TripCruiseDistance : 0|32@1+ (0.12500000000594,0) [0|526385151.9] "km" Vector__XXX
 SG_ TripMaxVehicleSpeed : 0|16@1+ (0.0039062485409696,0) [0|250.996] "km/h" Vector__XXX
 SG_ TripAirCompressorOnTime : 0|32@1+ (0.05,0) [0|210554060.75] "hr" Vector__XXX
 SG_ TripIdleTime : 0|32@1+ (0.05,0) [0|210554060.75] "hr" Vector__XXX
 SG_ TripEngRunningTime : 0|32@1+ (0.05,0) [0|210554060.75] "hr" Vector__XXX
 SG_ TripCruiseTime : 0|32@1+ (0.05,0) [0|210554060.75] "hr" Vector__XXX
 SG_ TripPTOGovernorTime : 0|32@1+ (0.05,0) [0|210554060.75] "hr" Vector__XXX
 SG_ TripTimeInDerateByEng : 0|32@1+ (0.05,0) [0|210554060.75] "hr" Vector__XXX
 SG_ TripTimeInGearDown : 0|32@1+ (0.05,0) [0|210554060.75] "hr" Vector__XXX
 SG_ TripTimeInTopGear : 0|32@1+ (0.05,0) [0|210554060.75] "hr" Vector__XXX
 SG_ TripTimeInVSL : 0|32@1+ (0.05,0) [0|210554060.75] "hr" Vector__XXX
 SG_ TripSuddenDecelerations : 0|16@1+ (1,0) [0|64255] "counts" Vector__XXX
 SG_ TrpNumberOfIdleShutdownOverrides : 0|16@1+ (1,0) [0|64255] "counts" Vector__XXX
 SG_ TripNumberOfIdleShutdowns : 0|16@1+ (1,0) [0|64255] "counts" Vector__XXX
 SG_ TripNumberOfHotShutdowns : 0|16@1+ (1,0) [0|64255] "counts" Vector__XXX
 SG_ EngRequestedTorqueHighResolution : 0|4@1+ (1,0) [0|0.875] "%" Vector__XXX
 SG_ TSC1CtrlPurpose : 0|5@1+ (1,0) [0|31] "" Vector__XXX
 SG_ TSC1TransRate : 0|3@1+ (1,0) [0|7] "" Vector__XXX
 SG_ EngRequestedTorque_TorqueLimit : 0|8@1+ (1,-125) [-125|125] "%" Vector__XXX
 SG_ EngRequestedSpeed_SpeedLimit : 0|16@1+ (1,0) [0|8031.875] "rpm" Vector__XXX
 SG_ OverrideCtrlModePriority : 0|2@1+ (1,0) [0|3] "" Vector__XXX
 SG_ EngRequestedSpeedCtrlConditions : 0|2@1+ (1,0) [0|3] "" Vector__XXX
 SG_ EngOverrideCtrlMode : 0|2@1+ (1,0) [0|3] "" Vector__XXX
 SG_ TransitRunStatus : 0|2@1+ (1,0) [0|3] "" Vector__XXX
 SG_ VehicleUseStatus : 0|2@1+ (1,0) [0|3] "" Vector__XXX
 SG_ SilentAlarmStatus : 0|2@1+ (1,0) [0|3] "" Vector__XXX
 SG_ PatronCount : 0|8@1+ (1,0) [0|250] "" Vector__XXX
 SG_ TypeOfPassengerCount : 0|8@1+ (1.02,0) [0|255] "" Vector__XXX
 SG_ FareboxAlarmIdentifier : 0|7@1+ (1,0) [0|127] "" Vector__XXX
 SG_ FareboxEmergencyStatus : 0|2@1+ (1,0) [0|3] "" Vector__XXX
 SG_ TransferSold : 0|8@1+ (1.02,0) [0|255] "" Vector__XXX
 SG_ RouteNumber : 0|12@1+ (1,0) [0|4095] "" Vector__XXX
 SG_ TransferType : 0|5@1+ (1,0) [0|31] "" Vector__XXX
 SG_ TypeOfService : 0|3@1+ (1,0) [0|7] "" Vector__XXX
 SG_ InitialFareAgency : 0|5@1+ (1,0) [0|31] "" Vector__XXX
 SG_ PassCategory : 0|4@1+ (1,0) [0|15] "" Vector__XXX
 SG_ FareValidity : 0|4@1+ (1,0) [0|15] "" Vector__XXX
 SG_ PaymentDetails : 0|4@1+ (1,0) [0|15] "" Vector__XXX
 SG_ TypeOfFare : 0|4@1+ (1,0) [0|15] "" Vector__XXX
 SG_ PassengerType : 0|4@1+ (1,0) [0|15] "" Vector__XXX
 SG_ TransactionType : 0|4@1+ (1,0) [0|15] "" Vector__XXX
 SG_ DriversFareboxSecurityCode : 0|16@1+ (1.0199206287448,0) [0|65535] "counts" Vector__XXX
 SG_ AssignedBlock : 0|16@1+ (1.0199206287448,0) [0|65535] "counts" Vector__XXX
 SG_ AssignedRun : 0|16@1+ (1.0199206287448,0) [0|65535] "counts" Vector__XXX
 SG_ AssignedRoute : 0|16@1+ (1.0199206287448,0) [0|65535] "counts" Vector__XXX
 SG_ PatternNumber : 0|16@1+ (1.0199206287448,0) [0|65535] "counts" Vector__XXX
 SG_ TripNumber : 0|16@1+ (1.0199206287448,0) [0|65535] "counts" Vector__XXX
 SG_ FarePresets : 0|8@1+ (1.02,0) [0|255] "" Vector__XXX
 SG_ TripDirection : 0|4@1+ (1,0) [0|15] "" Vector__XXX
 SG_ TripStatus : 0|3@1+ (1,0) [0|0] "" Vector__XXX
 SG_ FareboxServiceStatus : 0|2@1+ (1,0) [0|3] "" Vector__XXX
 SG_ VehicleID : 0|16@1+ (1.0199206287448,0) [0|65535] "counts" Vector__XXX
 SG_ StrobeActivationCtrlStatus : 0|2@1+ (1,0) [0|3] "" Vector__XXX
 SG_ TransitDoorEnable : 0|2@1+ (1,0) [0|3] "" Vector__XXX
 SG_ PriorityOfRespSentByEmitter : 0|4@1+ (1,0) [0|15] "" Vector__XXX
 SG_ IntrsctnPrmptionRequest_Response : 0|2@1+ (1,0) [0|3] "" Vector__XXX
 SG_ TransitRouteIDUsage : 0|2@1+ (1,0) [0|3] "" Vector__XXX
 SG_ RangeCodeEnable : 0|2@1+ (1,0) [0|3] "" Vector__XXX
 SG_ NmbrOfBytsInThMlpstIdntification : 0|8@1+ (1,0) [0|250] "" Vector__XXX
 SG_ NmbrOfBytsInThTrnstAssgndBlckIdn : 0|8@1+ (1,0) [0|250] "" Vector__XXX
 SG_ NmbrOfBytsInThTrnstAssgndRnIdntt : 0|8@1+ (1,0) [0|250] "" Vector__XXX
 SG_ NmbrOfBytsInThTrnstAssgndRtIdntt : 0|8@1+ (1,0) [0|250] "" Vector__XXX
 SG_ Agency : 0|8@1+ (1.02,0) [0|255] "" Vector__XXX
 SG_ ReferenceTirePressSetting_33 : 0|8@1+ (8,0) [0|2000] "kPa" Vector__XXX
 SG_ ReferenceTirePressSetting_32 : 0|8@1+ (8,0) [0|2000] "kPa" Vector__XXX
 SG_ ReferenceTirePressSetting_31 : 0|8@1+ (8,0) [0|2000] "kPa" Vector__XXX
 SG_ ReferenceTirePressSetting_30 : 0|8@1+ (8,0) [0|2000] "kPa" Vector__XXX
 SG_ ReferenceTirePressSetting_23 : 0|8@1+ (8,0) [0|2000] "kPa" Vector__XXX
 SG_ ReferenceTirePressSetting_22 : 0|8@1+ (8,0) [0|2000] "kPa" Vector__XXX
 SG_ ReferenceTirePressSetting_21 : 0|8@1+ (8,0) [0|2000] "kPa" Vector__XXX
 SG_ ReferenceTirePressSetting_20 : 0|8@1+ (8,0) [0|2000] "kPa" Vector__XXX
 SG_ ReferenceTirePressSetting_13 : 0|8@1+ (8,0) [0|2000] "kPa" Vector__XXX
 SG_ ReferenceTirePressSetting_12 : 0|8@1+ (8,0) [0|2000] "kPa" Vector__XXX
 SG_ ReferenceTirePressSetting_11 : 0|8@1+ (8,0) [0|2000] "kPa" Vector__XXX
 SG_ ReferenceTirePressSetting_10 : 0|8@1+ (8,0) [0|2000] "kPa" Vector__XXX
 SG_ ReferenceTirePressSetting_01 : 0|8@1+ (8,0) [0|2000] "kPa" Vector__XXX
 SG_ ReferenceTirePressSetting_00 : 0|8@1+ (8,0) [0|2000] "kPa" Vector__XXX
 SG_ TireLocation : 0|8@1+ (1,0) [0|255] "" Vector__XXX
 SG_ ReferenceTirePress_33 : 0|8@1+ (8,0) [0|2000] "kPa" Vector__XXX
 SG_ ReferenceTirePress_32 : 0|8@1+ (8,0) [0|2000] "kPa" Vector__XXX
 SG_ ReferenceTirePress_31 : 0|8@1+ (8,0) [0|2000] "kPa" Vector__XXX
 SG_ ReferenceTirePress_30 : 0|8@1+ (8,0) [0|2000] "kPa" Vector__XXX
 SG_ ReferenceTirePress_23 : 0|8@1+ (8,0) [0|2000] "kPa" Vector__XXX
 SG_ ReferenceTirePress_22 : 0|8@1+ (8,0) [0|2000] "kPa" Vector__XXX
 SG_ ReferenceTirePress_21 : 0|8@1+ (8,0) [0|2000] "kPa" Vector__XXX
 SG_ ReferenceTirePress_20 : 0|8@1+ (8,0) [0|2000] "kPa" Vector__XXX
 SG_ ReferenceTirePress_13 : 0|8@1+ (8,0) [0|2000] "kPa" Vector__XXX
 SG_ ReferenceTirePress_12 : 0|8@1+ (8,0) [0|2000] "kPa" Vector__XXX
 SG_ ReferenceTirePress_11 : 0|8@1+ (8,0) [0|2000] "kPa" Vector__XXX
 SG_ ReferenceTirePress_10 : 0|8@1+ (8,0) [0|2000] "kPa" Vector__XXX
 SG_ ReferenceTirePress_01 : 0|8@1+ (8,0) [0|2000] "kPa" Vector__XXX
 SG_ ReferenceTirePress_00 : 0|8@1+ (8,0) [0|2000] "kPa" Vector__XXX
 SG_ TireLocation : 0|8@1+ (1,0) [0|255] "" Vector__XXX
 SG_ SteerChannelTirePress : 0|16@1+ (0.5,0) [0|32127.5] "kPa" Vector__XXX
 SG_ DriveChannelTirePress : 0|16@1+ (0.5,0) [0|32127.5] "kPa" Vector__XXX
 SG_ TrailerTagOrPushChannelTirePress : 0|16@1+ (0.5,0) [0|32127.5] "kPa" Vector__XXX
 SG_ SteerChannelTirePressTarget : 0|16@1+ (0.5,0) [0|32127.5] "kPa" Vector__XXX
 SG_ DriveChannelTirePressTarget : 0|16@1+ (0.5,0) [0|32127.5] "kPa" Vector__XXX
 SG_ TrlrTgOrPshChnnelTirePressTarget : 0|16@1+ (0.5,0) [0|32127.5] "kPa" Vector__XXX
 SG_ PCUTrilerTagOrPushSolenoidStatus : 0|2@1+ (1,0) [0|3] "" Vector__XXX
 SG_ PCUSupplySolenoidStatus : 0|2@1+ (1,0) [0|3] "" Vector__XXX
 SG_ PCUCtrlSolenoidStatus : 0|2@1+ (1,0) [0|3] "" Vector__XXX
 SG_ PCUDeflateSolenoidStatus : 0|2@1+ (1,0) [0|3] "" Vector__XXX
 SG_ TirePressSupplySwitchStatus : 0|2@1+ (1,0) [0|3] "" Vector__XXX
 SG_ PCUSteerSolenoidStatus : 0|2@1+ (1,0) [0|3] "" Vector__XXX
 SG_ PCUDriveSolenoidStatus : 0|2@1+ (1,0) [0|3] "" Vector__XXX
 SG_ DriveChannelMode : 0|4@1+ (1,0) [0|15] "" Vector__XXX
 SG_ Trailer_tagChannelMode : 0|4@1+ (1,0) [0|15] "" Vector__XXX
 SG_ SteerChannelMode : 0|4@1+ (1,0) [0|15] "" Vector__XXX
 SG_ TirePressCheckInterval : 0|8@1+ (1,0) [0|250] "mins" Vector__XXX
 SG_ TirePressThresholdDetection_13 : 0|3@1+ (1,0) [0|7] "" Vector__XXX
 SG_ TirePressThresholdDetection_12 : 0|3@1+ (1,0) [0|7] "" Vector__XXX
 SG_ TirePressThresholdDetection_11 : 0|3@1+ (1,0) [0|7] "" Vector__XXX
 SG_ TirePressThresholdDetection_10 : 0|3@1+ (1,0) [0|7] "" Vector__XXX
 SG_ TirePressThresholdDetection_01 : 0|3@1+ (1,0) [0|7] "" Vector__XXX
 SG_ TirePress_33 : 0|8@1+ (4,0) [0|1000] "kPa" Vector__XXX
 SG_ TirePress_32 : 0|8@1+ (4,0) [0|1000] "kPa" Vector__XXX
 SG_ TirePress_31 : 0|8@1+ (4,0) [0|1000] "kPa" Vector__XXX
 SG_ TirePress_30 : 0|8@1+ (4,0) [0|1000] "kPa" Vector__XXX
 SG_ TirePress_23 : 0|8@1+ (4,0) [0|1000] "kPa" Vector__XXX
 SG_ TirePress_22 : 0|8@1+ (4,0) [0|1000] "kPa" Vector__XXX
 SG_ TirePress_21 : 0|8@1+ (4,0) [0|1000] "kPa" Vector__XXX
 SG_ TirePress_20 : 0|8@1+ (4,0) [0|1000] "kPa" Vector__XXX
 SG_ TirePress_13 : 0|8@1+ (4,0) [0|1000] "kPa" Vector__XXX
 SG_ TirePress_12 : 0|8@1+ (4,0) [0|1000] "kPa" Vector__XXX
 SG_ TirePress_11 : 0|8@1+ (4,0) [0|1000] "kPa" Vector__XXX
 SG_ TirePress_10 : 0|8@1+ (4,0) [0|1000] "kPa" Vector__XXX
 SG_ TireAirLeakageRate_33 : 0|16@1+ (0.1,0) [0|6425.5] "Pa/s" Vector__XXX
 SG_ TireAirLeakageRate_32 : 0|16@1+ (0.1,0) [0|6425.5] "Pa/s" Vector__XXX
 SG_ TireAirLeakageRate_31 : 0|16@1+ (0.1,0) [0|6425.5] "Pa/s" Vector__XXX
 SG_ TireAirLeakageRate_30 : 0|16@1+ (0.1,0) [0|6425.5] "Pa/s" Vector__XXX
 SG_ TireAirLeakageRate_23 : 0|16@1+ (0.1,0) [0|6425.5] "Pa/s" Vector__XXX
 SG_ TireAirLeakageRate_22 : 0|16@1+ (0.1,0) [0|6425.5] "Pa/s" Vector__XXX
 SG_ TireAirLeakageRate_21 : 0|16@1+ (0.1,0) [0|6425.5] "Pa/s" Vector__XXX
 SG_ TireAirLeakageRate_20 : 0|16@1+ (0.1,0) [0|6425.5] "Pa/s" Vector__XXX
 SG_ TireAirLeakageRate_13 : 0|16@1+ (0.1,0) [0|6425.5] "Pa/s" Vector__XXX
 SG_ TireAirLeakageRate_12 : 0|16@1+ (0.1,0) [0|6425.5] "Pa/s" Vector__XXX
 SG_ TireAirLeakageRate_11 : 0|16@1+ (0.1,0) [0|6425.5] "Pa/s" Vector__XXX
 SG_ TireAirLeakageRate_10 : 0|16@1+ (0.1,0) [0|6425.5] "Pa/s" Vector__XXX
 SG_ TireAirLeakageRate_01 : 0|16@1+ (0.1,0) [0|6425.5] "Pa/s" Vector__XXX
 SG_ TireAirLeakageRate_00 : 0|16@1+ (0.1,0) [0|6425.5] "Pa/s" Vector__XXX
 SG_ CTIWheelSensorStatus_33 : 0|2@1+ (1,0) [0|3] "" Vector__XXX
 SG_ CTIWheelSensorStatus_32 : 0|2@1+ (1,0) [0|3] "" Vector__XXX
 SG_ CTIWheelSensorStatus_31 : 0|2@1+ (1,0) [0|3] "" Vector__XXX
 SG_ CTIWheelSensorStatus_30 : 0|2@1+ (1,0) [0|3] "" Vector__XXX
 SG_ CTIWheelSensorStatus_23 : 0|2@1+ (1,0) [0|3] "" Vector__XXX
 SG_ CTIWheelSensorStatus_22 : 0|2@1+ (1,0) [0|3] "" Vector__XXX
 SG_ CTIWheelSensorStatus_21 : 0|2@1+ (1,0) [0|3] "" Vector__XXX
 SG_ CTIWheelSensorStatus_20 : 0|2@1+ (1,0) [0|3] "" Vector__XXX
 SG_ CTIWheelSensorStatus_13 : 0|2@1+ (1,0) [0|3] "" Vector__XXX
 SG_ CTIWheelSensorStatus_12 : 0|2@1+ (1,0) [0|3] "" Vector__XXX
 SG_ CTIWheelSensorStatus_11 : 0|2@1+ (1,0) [0|3] "" Vector__XXX
 SG_ CTIWheelSensorStatus_10 : 0|2@1+ (1,0) [0|3] "" Vector__XXX
 SG_ CTIWheelSensorStatus_01 : 0|2@1+ (1,0) [0|3] "" Vector__XXX
 SG_ CTIWheelEndElectricalFault_33 : 0|2@1+ (1,0) [0|3] "" Vector__XXX
 SG_ CTIWheelEndElectricalFault_32 : 0|2@1+ (1,0) [0|3] "" Vector__XXX
 SG_ CTIWheelEndElectricalFault_31 : 0|2@1+ (1,0) [0|3] "" Vector__XXX
 SG_ CTIWheelEndElectricalFault_30 : 0|2@1+ (1,0) [0|3] "" Vector__XXX
 SG_ CTIWheelEndElectricalFault_23 : 0|2@1+ (1,0) [0|3] "" Vector__XXX
 SG_ CTIWheelEndElectricalFault_22 : 0|2@1+ (1,0) [0|3] "" Vector__XXX
 SG_ CTIWheelEndElectricalFault_21 : 0|2@1+ (1,0) [0|3] "" Vector__XXX
 SG_ CTIWheelEndElectricalFault_20 : 0|2@1+ (1,0) [0|3] "" Vector__XXX
 SG_ CTIWheelEndElectricalFault_13 : 0|2@1+ (1,0) [0|3] "" Vector__XXX
 SG_ TireLocation : 0|8@1+ (1,0) [0|255] "" Vector__XXX
 SG_ ReferenceRetarderTorque : 0|16@1+ (1,0) [0|64255] "Nm" Vector__XXX
 SG_ PercentClutchSlip : 0|8@1+ (0.4,0) [0|100] "%" Vector__XXX
 SG_ EngCoolantTemp : 0|16@1+ (0.03125,-273) [-273|1734.96875] "deg C" Vector__XXX
 SG_ EngCoolantTemp : 0|8@1+ (1,-40) [-40|210] "deg C" Vector__XXX
 SG_ MaxVehicleSpeedLimit : 0|8@1+ (1,0) [0|250] "km/h" Vector__XXX
 SG_ LiftAxle2Pos : 0|2@1+ (1,0) [0|3] "" Vector__XXX
 SG_ LiftAxle1Pos : 0|2@1+ (1,0) [0|3] "" Vector__XXX
 SG_ EngCoolantTemp : 0|8@1+ (1,-40) [-40|210] "deg C" Vector__XXX
 SG_ ControlByte : 0|8@1+ (1,0) [0|255] "" Vector__XXX
 SG_ RoadCurvature : 0|16@1+ (1,-250) [-250|251.992] "1/km" Vector__XXX
 SG_ ControlByte : 0|8@1+ (1,0) [0|255] "" Vector__XXX
 SG_ AltCurrent : 0|8@1+ (1,0) [0|250] "A" Vector__XXX
 SG_ NetBatteryCurrent : 0|8@1+ (1,-125) [-125|125] "A" Vector__XXX
 SG_ AxleLocation : 0|8@1+ (1.02,0) [0|255] "" Vector__XXX

CM_ SG_ 3221225472 EngFuelActuator2CtrlCmd "The control command to fuel actuator 2, normalized to percent, where 0% represents fully closed and 100% represents";
CM_ SG_ 3221225472 EngFuelActuator1CtrlCmd "The control command to fuel actuator 1, normalized to percent, where 0% represents fully closed and 100% represents";
CM_ SG_ 3221225472 EngThrottleActuator2CtrlCmd "The control command to throttle actuator 2, normalized to percent, where 0% represents fully closed and 100%";
CM_ SG_ 3221225472 EngThrottleActuator1CtrlCmd "The control command to throttle actuator 1, normalized to percent, where 0% represents fully closed and 100%";
CM_ SG_ 3221225472 EngCyl24KnockLevel "Used to indicate the level of knock for engine cylinder 24. The level of knock is reported using a relative scale where 0%";
CM_ SG_ 3221225472 EngCyl23KnockLevel "Used to indicate the level of knock for engine cylinder 23. The level of knock is reported using a relative scale where 0%";
CM_ SG_ 3221225472 EngCyl22KnockLevel "Used to indicate the level of knock for engine cylinder 22. The level of knock is reported using a relative scale where 0%";
CM_ SG_ 3221225472 EngCyl21KnockLevel "Used to indicate the level of knock for engine cylinder 21. The level of knock is reported using a relative scale where 0%";
CM_ SG_ 3221225472 EngCyl20KnockLevel "Used to indicate the level of knock for engine cylinder 20. The level of knock is reported using a relative scale where 0%";
CM_ SG_ 3221225472 EngCyl19KnockLevel "Used to indicate the level of knock for engine cylinder 19. The level of knock is reported using a relative scale where 0%";
CM_ SG_ 3221225472 EngCyl18KnockLevel "Used to indicate the level of knock for engine cylinder 18. The level of knock is reported using a relative scale where 0%";
CM_ SG_ 3221225472 EngCyl17KnockLevel "Used to indicate the level of knock for engine cylinder 17. The level of knock is reported using a relative scale where 0%";
CM_ SG_ 3221225472 EngCyl16KnockLevel "Used to indicate the level of knock for engine cylinder 16. The level of knock is reported using a relative scale where 0%";
CM_ SG_ 3221225472 EngCyl15KnockLevel "Used to indicate the level of knock for engine cylinder 15. The level of knock is reported using a relative scale where 0%";
CM_ SG_ 3221225472 EngCyl14KnockLevel "Used to indicate the level of knock for engine cylinder 14. The level of knock is reported using a relative scale where 0%";
CM_ SG_ 3221225472 EngCyl13KnockLevel "Used to indicate the level of knock for engine cylinder 13. The level of knock is reported using a relative scale where 0%";
CM_ SG_ 3221225472 EngCyl12KnockLevel "Used to indicate the level of knock for engine cylinder 12. The level of knock is reported using a relative scale where 0%";
CM_ SG_ 3221225472 EngCyl11KnockLevel "Used to indicate the level of knock for engine cylinder 11. The level of knock is reported using a relative scale where 0%";
CM_ SG_ 3221225472 EngCyl10KnockLevel "Used to indicate the level of knock for engine cylinder 10. The level of knock is reported using a relative scale where 0%";
CM_ SG_ 3221225472 EngCyl9KnockLevel "Used to indicate the level of knock for engine cylinder 9. The level of knock is reported using a relative scale where 0% is";
CM_ SG_ 3221225472 EngCyl8KnockLevel "Used to indicate the level of knock for engine cylinder 8. The level of knock is reported using a relative scale where 0% is";
CM_ SG_ 3221225472 EngCyl7KnockLevel "Used to indicate the level of knock for engine cylinder 7. The level of knock is reported using a relative scale where 0% is";
CM_ SG_ 3221225472 EngCyl6KnockLevel "Used to indicate the level of knock for engine cylinder 6. The level of knock is reported using a relative scale where 0% is";
CM_ SG_ 3221225472 EngCyl5KnockLevel "Used to indicate the level of knock for engine cylinder 5. The level of knock is reported using a relative scale where 0% is";
CM_ SG_ 3221225472 EngCyl4KnockLevel "Used to indicate the level of knock for engine cylinder 4. The level of knock is reported using a relative scale where 0% is";
CM_ SG_ 3221225472 EngCyl3KnockLevel "Used to indicate the level of knock for engine cylinder 3. The level of knock is reported using a relative scale where 0% is";
CM_ SG_ 3221225472 EngCyl2KnockLevel "Used to indicate the level of knock for engine cylinder 2. The level of knock is reported using a relative scale where 0% is";
CM_ SG_ 3221225472 EngCyl1KnockLevel "Used to indicate the level of knock for engine cylinder 1. The level of knock is reported using a relative scale where 0% is";
CM_ SG_ 3221225472 EngCyl24CombustionStatus "This parameter is used to indicate state of combustion in engine cylinder #24";
CM_ SG_ 3221225472 EngCyl23CombustionStatus "This parameter is used to indicate state of combustion in engine cylinder #23";
CM_ SG_ 3221225472 EngCyl22CombustionStatus "This parameter is used to indicate state of combustion in engine cylinder #22";
CM_ SG_ 3221225472 EngCyl21CombustionStatus "This parameter is used to indicate state of combustion in engine cylinder #21";
CM_ SG_ 3221225472 EngCyl20CombustionStatus "This parameter is used to indicate state of combustion in engine cylinder #20";
CM_ SG_ 3221225472 EngCyl19CombustionStatus "This parameter is used to indicate state of combustion in engine cylinder #19";
CM_ SG_ 3221225472 EngCyl18CombustionStatus "This parameter is used to indicate state of combustion in engine cylinder #18";
CM_ SG_ 3221225472 EngCyl17CombustionStatus "This parameter is used to indicate state of combustion in engine cylinder #17";
CM_ SG_ 3221225472 EngCyl16CombustionStatus "This parameter is used to indicate state of combustion in engine cylinder #16";
CM_ SG_ 3221225472 EngCyl15CombustionStatus "This parameter is used to indicate state of combustion in engine cylinder #15";
CM_ SG_ 3221225472 EngCyl14CombustionStatus "This parameter is used to indicate state of combustion in engine cylinder #14";
CM_ SG_ 3221225472 EngCyl13CombustionStatus "This parameter is used to indicate state of combustion in engine cylinder #13";
CM_ SG_ 3221225472 EngCyl12CombustionStatus "This parameter is used to indicate state of combustion in engine cylinder #12";
CM_ SG_ 3221225472 EngCyl11CombustionStatus "This parameter is used to indicate state of combustion in engine cylinder #11";
CM_ SG_ 3221225472 EngCyl10CombustionStatus "This parameter is used to indicate state of combustion in engine cylinder #10";
CM_ SG_ 3221225472 EngCyl9CombustionStatus "This parameter is used to indicate state of combustion in engine cylinder #9";
CM_ SG_ 3221225472 EngCyl8CombustionStatus "This parameter is used to indicate state of combustion in engine cylinder #8";
CM_ SG_ 3221225472 EngCyl7CombustionStatus "This parameter is used to indicate state of combustion in engine cylinder #7";
CM_ SG_ 3221225472 EngCyl6CombustionStatus "This parameter is used to indicate state of combustion in engine cylinder #6";
CM_ SG_ 3221225472 EngCyl5CombustionStatus "This parameter is used to indicate state of combustion in engine cylinder #5";
CM_ SG_ 3221225472 EngCyl4CombustionStatus "This parameter is used to indicate state of combustion in engine cylinder #4";
CM_ SG_ 3221225472 EngCyl3CombustionStatus "This parameter is used to indicate state of combustion in engine cylinder #3";
CM_ SG_ 3221225472 EngCyl2CombustionStatus "This parameter is used to indicate state of combustion in engine cylinder #2";
CM_ SG_ 3221225472 EngCyl1CombustionStatus "This parameter is used to indicate state of combustion in engine cylinder #1";
CM_ SG_ 3221225472 RqGenOverallPowerFactorLagging "The requested lead/lag status for the generator average AC power factor";
CM_ SG_ 3221225472 RqGeneratorOverallPowerFactor "The requested average power factor of the generator.";
CM_ SG_ 3221225472 RqGeneratorTotalACReactivePower "The total reactive power requested to be delivered by the generator";
CM_ SG_ 3221225472 BladeRotationAngleFigureOfMerit "Figure of merit for blade rotation measurement.";
CM_ SG_ 3221225472 RelativeBladeHeightFigureOfMerit "Figure of merit for blade height measurement.";
CM_ SG_ 3221225472 RltvBldHghtAndBldRttnAnglMsrmntL "The estimated measurement latency of the measurement.";
CM_ SG_ 3221225472 BladeRotationAngle "The blade rotation angle measurement around the yaw (z-axis).";
CM_ SG_ 3221225472 RelativeBladeHeight "The measured vertical distance from a fixed location on the machine blade to a ground-based reference (i.e. relative";
CM_ SG_ 3221225472 RetarderDemandValue "The demanded value of the retarder on the towed vehicle(s) as a percentage of the absolute peak torque of retarder.";
CM_ SG_ 3221225472 ParkBrakeDemandValue "The requested brake pressure value of the parking brake as a percentage of maximum.";
CM_ SG_ 3221225472 ServiceBrakeDemandValue "The requested brake pressure value of the service brake demanded by the driver.";
CM_ SG_ 3221225472 VehicleType "Information to identify a dolly axle within the road train.Information to identify a dolly axle within the road train.Information to identify a dolly axle within the road train.Information to identify a dolly axle within the road train.";
CM_ SG_ 3221225472 BrakeLightSwitch "Signal which indicates that the brake pedal is being pressed.";
CM_ SG_ 3221225472 ASREngineControlActive "Signal which indicates that ASR engine control is active/passive.";
CM_ SG_ 3221225472 ASRBreakControlActive "Signal which indicates that ASR brake control is active/passive.";
CM_ SG_ 3221225472 VehicleRetarderCtrlActive "This signal indicates the active/passive state in all cases when the installed retarder is applied by the driver’s demand or by other systems (brakes).This signal indicates the active/passive state in all cases when the installed retarder is applied by the driver’s demand or by other systems (brakes).This signal indicates the active/passive state in all cases when the installed retarder is applied by the driver’s demand or by other systems (brakes).This signal indicates the active/passive state in all cases when the installed retarder is applied by the driver’s demand or by other systems (brakes).";
CM_ SG_ 3221225472 VehicleABSActive "Signal indicating the ABS is active/passive.Signal indicating the ABS is active/passive.Signal indicating the ABS is active/passive.";
CM_ SG_ 3221225472 RoadCurvature "Estimated value of the current road curvature for use by the adaptive cruise control system. Positive values are used forEstimated value of the current road curvature for use by the adaptive cruise control system. Positive values are used for";
CM_ SG_ 3221225472 PneumaticControlLine "Signal which indicates that the towing vehicle has a pneumatic control line for the towed vehicle service braking system";
CM_ SG_ 3221225472 ABSOffroadRequest "Request to activate the ABS off-road function. The switch signal is independent of an actual ABS control situation.";
CM_ SG_ 3221225472 TwoElCircuitsBrakeDemand "Signal which indicates that the service brake demand value sent by the towing vehicle can be generated by one or two independent electrical braking circuit(s).";
CM_ SG_ 3221225472 WheelSpeedDiffMainAxle "Difference between the wheel speed at the right side and and the left side of the main axle.";
CM_ SG_ 3221225472 ActualRetarderPercTorque "Actual torque of the retarder as negative percentage of maximum.";
CM_ SG_ 3221225472 Wheel_BasedVehicleSpeed "Actual speed of the vehicle (positive value for forward and backward speed) calculated as the average of the wheel speeds of one axle influenced by slip and filtered by a frequency range of 5 Hz to 20 Hz.";
CM_ SG_ 3221225472 SupplyLineBrakingRequest "Signal indicating the trailer is requesting to be braked by the commercial vehicle by means of bleeding the pneumatic supply line.Signal indicating the trailer is requesting to be braked by the commercial vehicle by means of bleeding the pneumatic supply line.";
CM_ SG_ 3221225472 VDCActive "Signal which indicates that Vehicle Dynamic Control (VDC) is active/passive.";
CM_ SG_ 3221225472 AutomTowedVehBreakActive "Signal indicating the automatic towed vehicle braking is active/passive.Signal indicating the automatic towed vehicle braking is active/passive.";
CM_ SG_ 3221225472 VehicleServiceBrakeActive "Signal indicating the service brake of the towed vehicle is active/passive, by observing the brake pressure.Signal indicating the service brake of the towed vehicle is active/passive, by observing the brake pressure.";
CM_ SG_ 3221225472 ReferenceRetarderTorque "This parameter is the 100% reference value for all defined indicated retarder torque parameters. It is only defined onceThis parameter is the 100% reference value for all defined indicated retarder torque parameters. It is only defined once";
CM_ SG_ 3221225472 AxleLoadSum "Sum of the static vertical loads of the vehicle axles.";
CM_ SG_ 3221225472 LoadingRampApproachAssist "The parameter indicates whether the loading ramp approach assistance is activated.";
CM_ SG_ 3221225472 SpringBrakeEngaged "Signal indicating the vehicle spring brake is engaged.";
CM_ SG_ 3221225472 ElectrLoadPropFunc "Signal indicating the vehicle is equipped with an electrical load proportional function.";
CM_ SG_ 3221225472 SpringBrakeInstalled "Signal indicating the vehicle has one or more axle(s) fitted with spring brakes.";
CM_ SG_ 3221225472 ElecSupplyOfNonBrakingSys "Signal which indicates the status of the supply of non-braking systems.";
CM_ SG_ 3221225472 AmberWarningSignalReq "Request from the towed vehicle to the commercial vehicle to activate the amber warning signal on the commercial vehicle.";
CM_ SG_ 3221225472 RedWarningSignalRequest "Request from the towed vehicle to the commercial vehicle to activate the red warning signal on the commercial vehicle, which indicates certain specified failures within the braking equipment of the towed vehicles.";
CM_ SG_ 3221225472 VehicleElectrSupplySuff "Signal indicating the actual supply voltage is sufficient/insufficient for proper brake function (including over voltage).";
CM_ SG_ 3221225472 PneumaticSupplyPressure "Actual supply pressure of the reservoir of the braking system.";
CM_ SG_ 3221225472 BrakeTemperature "Actual brake temperature.";
CM_ SG_ 3221225472 BrakeLining "Actual relative value of brake lining of a specific brake.";
CM_ SG_ 3221225472 TyrePressure "Actual tyre pressure without corrections.";
CM_ SG_ 3221225472 TyreWheelIdentTemp2 "Second part of identification number of the tyre or wheel (the number of axles).";
CM_ SG_ 3221225472 TyreWheelIdentTemp1 "First part of identification number of the tyre or wheel (position on each axle).";
CM_ SG_ 3221225472 TyreWheelIdentPressure2 "Second part of identification number of the tyre or wheel (the number of axles).";
CM_ SG_ 3221225472 TyreWheelIdentPressure1 "First part of identification number of the tyre or wheel (position on each axle).";
CM_ SG_ 3221225472 TyreWheelIdentLining2 "Second part of identification number of the tyre or wheel (the number of axles).";
CM_ SG_ 3221225472 TyreWheelIdentLining1 "First part of identification number of the tyre or wheel (position on each axle).";
CM_ SG_ 3221225472 VehiclePneumSupplySuff "Signal indicating the actual supply pressure of the reservoir of the braking system is insufficient or sufficient.";
CM_ SG_ 3221225472 BrakeTemperatureStatus "Signal which indicates that the brake temperature is higher than a specific level.";
CM_ SG_ 3221225472 BrakeLiningSufficient "Signal which indicates that the brake lining is sufficient/insufficient.";
CM_ SG_ 3221225472 TyrePressureSufficient "Signal which indicates that the tyre pressure is insufficient";
CM_ SG_ 3221225472 ODDRequest "Command signal to switch on or off the obstacle detection device (ODD).";
CM_ SG_ 3221225472 AntiTheftDeviceReq "Command signal to activate the anti-theft device.";
CM_ SG_ 3221225472 MaxVehicleSpeedLimit "Maximum vehicle velocity allowed.Maximum vehicle velocity allowed.";
CM_ SG_ 3221225472 EngineSpeedUpperLimit "The engine speed which cannot be exceeded.";
CM_ SG_ 3221225472 EngineSpeedLowerLimit "The minimum engine speed which the engine is allowed to reach.";
CM_ SG_ 3221225472 EngineTorqueMode "State signal which indicates which engine torque mode is currently generating, limiting, or controlling the torque";
CM_ SG_ 3221225472 PercentLoadAtCurrentSpeed "The ratio of actual engine percent torque to maximum indicated torque available at the current engine speed, clipped to zero torque during engine braking.";
CM_ SG_ 3221225472 EngineSpeed "Actual engine speed which is calculated over a minimum crankshaft angle of 720 degrees divided by
the number of cylinders.";
CM_ SG_ 3221225472 ActualEngine_PercTorque "The calculated output torque of the engine.";
CM_ SG_ 3221225472 DriversDemandEngine_PercTorque "The torque output of the engine requested by the driver.";
CM_ SG_ 3221225472 EngineRunning "Signal which indicates whether the engine is running.";
CM_ SG_ 3221225472 EngineControlAllowed "Switch signal which indicates that engine control is allowed.";
CM_ SG_ 3221225472 ClutchIndptdPTOFeedback "Signal which indicates the current state of the clutch independent power take off.";
CM_ SG_ 3221225472 AccelPedalPosition "The ratio of actual accelerator pedal position to maximum pedal position.";
CM_ SG_ 3221225472 AccelPedalLowIdleSwitch "Switch signal which indicates whether the accelerator pedal low idle switch is opened or closed.";
CM_ SG_ 3221225472 StarterActive "Signal which indicates whether the starter is in use.";
CM_ SG_ 3221225472 TorqueConvOilTemp "Temperature of the torque converter lubricant.";
CM_ SG_ 3221225472 TorqueConvtOilTempWarning "Signal which indicates that the torque converter oil temperature has reached its warning level.";
CM_ SG_ 3221225472 PTOControlAllowed "Switch signal which indicates that PTO control is allowed.";
CM_ SG_ 3221225472 SecEngineMtdPTOFeedback "Signal which indicates the current state of the second engine mounted power take off.";
CM_ SG_ 3221225472 FirstEngineMtdPTOFeedback "Signal which indicates the current state of the first engine mounted power take off.";
CM_ SG_ 3221225472 SecClutchDptdPTOFeedback "Signal which indicates the current state of the second clutch dependent power take off.";
CM_ SG_ 3221225472 FirstClutchDpdtPTOFeedback "Signal which indicates the current state of the first clutch dependent power take off.";
CM_ SG_ 3221225472 CurrentGear "The gear currently engaged in the transmission or the last gear engaged while the transmission is in process of shifting to the new or selected gear.";
CM_ SG_ 3221225472 PercentClutchSlip "Parameter which represents the ratio of input shaft speed to current engine speed (in percent).Parameter which represents the ratio of input shaft speed to current engine speed (in percent).";
CM_ SG_ 3221225472 ReferenceEngineTorque "The 100 % reference value for all defined indicated engine torque parameters.";
CM_ SG_ 3221225472 FuelLevelWarning "This signal indicates the decrease of the fuel level to a certain minimum.";
CM_ SG_ 3221225472 EngineOilPressureWarning "Signal which indicates that the engine oil pressure has reached its warning level.";
CM_ SG_ 3221225472 EngineCoolantTempWarning "Signal which indicates that the engine coolant temperature has reached its warning level.";
CM_ SG_ 3221225472 EngineOilPressure "Gauge pressure of the oil in the engine lubrication system as provided by the oil pump.";
CM_ SG_ 3221225472 EngCoolantTemp "Temperature of liquid found in engine cooling system.Temperature of liquid found in engine cooling system. The higher resolution is required for control purposes.Temperature of liquid found in engine cooling system.Temperature of liquid found in engine cooling system.";
CM_ SG_ 3221225472 EngineOilTemperature "Temperature of the engine lubricant.";
CM_ SG_ 3221225472 AmbientAirTemperature "Temperature of air surrounding vehicle.";
CM_ SG_ 3221225472 BodyPressure "The actual pressure in a body on the towed vehicle.";
CM_ SG_ 3221225472 BodyFluidLevel "The actual fluid level in a body on the towed vehicle.";
CM_ SG_ 3221225472 ThermalBodyTemperature "The actual temperature in a thermal body on the towed vehicle.";
CM_ SG_ 3221225472 RearObstacleDistance "The actual distance between the back of the towed vehicle and any obstacle.";
CM_ SG_ 3221225472 AntiTheftDeviceStatus "Signal which indicates that the anti-theft device is switched on or off.";
CM_ SG_ 3221225472 ODDStatus "Signal which indicates that an obstacle detection device (ODD) is active/inactive.";
CM_ SG_ 3221225472 ReqEngineSpeedUpperLim "The requested engine speed which is not to be exceeded.";
CM_ SG_ 3221225472 ReqEngineSpeedLowerLim "The requested minimum engine speed which the engine is to allow.";
CM_ SG_ 3221225472 ReqEngineTorqueLimit "The requested engine torque that the engine is not allowed to exceed, indicated as a ratio of the reference engine torque.";
CM_ SG_ 3221225472 ReqEngineSpeedLimit "The requested vehicle speed which the vehicle is not allowed to exceed.";
CM_ SG_ 3221225472 ReqEngineSpeed "This is the engine speed which the engine is expected to operate at.";
CM_ SG_ 3221225472 SecEngineMtdPTOSwitch "Signal which indicates the state of the second engine mounted power take off switch.";
CM_ SG_ 3221225472 SecClutchDpdtPTOSwitch "Signal which indicates the state of the second clutch dependent power take off switch.";
CM_ SG_ 3221225472 FirstClutchDpdtPTOSwitch "Signal which indicates the state of the first clutch dependent power take off switch.";
CM_ SG_ 3221225472 OperatingPanelActive "Signal which indicates that the operating panel is active.";
CM_ SG_ 3221225472 RefusePackerStepSwitch "Signal which indicates the state of the refuse packer step switch.";
CM_ SG_ 3221225472 EngineStopSwitch "Signal which indicates the state of the engine stop switch.";
CM_ SG_ 3221225472 EngineStartSwitch "Signal which indicates the state of the engine start switch.";
CM_ SG_ 3221225472 StarterLockoutSwitch "Signal which indicates the state of the starter lockout switch.";
CM_ SG_ 3221225472 RqstedPercentClutchSlip "Command signal to influence the clutch.";
CM_ SG_ 3221225472 FirstEngineMtdPTOSwitch "Signal which indicates the state of the first engine mounted power take off switch.";
CM_ SG_ 3221225472 ClutchIndpdtPTOSwitch "Signal which indicates the state of the clutch independent power take off switch.";
CM_ SG_ 3221225472 TrailerLeftSideMarkerLight "This signal indicates the state of the trailer left-hand side marker light(s).";
CM_ SG_ 3221225472 TrailerLeftReversingLight "This signal indicates the state of the trailer left-hand reversing light(s).";
CM_ SG_ 3221225472 TrailerLeftRearWidIndLight "This signal indicates the state of the trailer left-hand rear width indicator light(s).";
CM_ SG_ 3221225472 TrailerLeftRearRegPltLight "This signal indicates the state of the trailer left-hand rear registration-plate light(s).";
CM_ SG_ 3221225472 TrailerLeftRearLight "This signal indicates the state of the trailer left-hand rear light(s).";
CM_ SG_ 3221225472 TrailerLeftRearFogLight "This signal indicates the state of the trailer left-hand rear fog light(s).";
CM_ SG_ 3221225472 TrailerLeftDirIndLight "This signal indicates the state of the trailer left-hand direction indicator light(s).";
CM_ SG_ 3221225472 TrailerLeftCrnMarkerLight "This signal indicates the state of the trailer left-hand corner marker light(s).";
CM_ SG_ 3221225472 TrailerInteriorLight "This signal indicates the state of the trailer interior light(s).";
CM_ SG_ 3221225472 TrailerWorkLamp "This signal indicates the state of the trailer work lamp(s).";
CM_ SG_ 3221225472 TrailerRotatingIdentLight "This signal indicates the state of the trailer rotating identification light(s).";
CM_ SG_ 3221225472 TrailerRightStopLight "This signal indicates the state of the trailer right-hand stop light(s).";
CM_ SG_ 3221225472 TrailerRightSideMrkLight "This signal indicates the state of the trailer right-hand side marker light(s).";
CM_ SG_ 3221225472 TrailerRightReversingLight "This signal indicates the state of the trailer right-hand reversing light(s).";
CM_ SG_ 3221225472 TrailRightRearWidIndLight "This signal indicates the state of the trailer right-hand rear width indicator light(s).";
CM_ SG_ 3221225472 TrailerRightRearRegPltLight "This signal indicates the state of the trailer right-hand rear registration-plate light(s).";
CM_ SG_ 3221225472 TrailerRightRearLight "This signal indicates the state of the trailer right-hand rear light(s).";
CM_ SG_ 3221225472 TrailerRightRearFogLight "This signal indicates the state of the trailer right-hand rear fog light(s).";
CM_ SG_ 3221225472 TrailerRightDirIndLight "This signal indicates the state of the trailer right-hand direction indicator light(s).";
CM_ SG_ 3221225472 TrailerRightCrnMarkerLight "This signal indicates the state of the trailer right-hand corner marker light(s).";
CM_ SG_ 3221225472 TrailerRearWarningLight "This signal indicates the state of the trailer rear warning light(s).";
CM_ SG_ 3221225472 TrailerLeftStopLight "This signal indicates the state of the trailer left-hand stop light(s).";
CM_ SG_ 3221225472 ProtocolCtrlInformation "Part of Network Protocol Control Information (N_PCI) of a ISO 15765 message.Part of Network Protocol Control Information (N_PCI) of a ISO 15765 message.";
CM_ SG_ 3221225472 FilterMode "Filter mode for Network PG";
CM_ SG_ 3221225472 ToPort "Destination port for network PG";
CM_ SG_ 3221225472 FromPort "Source port for Network PG";
CM_ SG_ 3221225472 ParkingAndTrailerAirPress "The pneumatic pressure in the circuit or reservoir for the parking brake and the trailer supply.";
CM_ SG_ 3221225472 DrivenAxleLoad "Actual static vertical load on driven axle of the commercial vehicle. In case of more than one driven axle the value of the axle with the highest vertical load is transmitted.";
CM_ SG_ 3221225472 AuxEquipSupplyPressure "The pneumatic pressure in the auxiliary circuit.";
CM_ SG_ 3221225472 StopLevelChangeReq "Command signal to stop immediately any change of the actual body height level.";
CM_ SG_ 3221225472 RampLevelStorageReq "Command signal to store the actual body height level as new programmed and memorised ramp levels 1 or 2 in the ECU";
CM_ SG_ 3221225472 LevelControlReq "Command signal to enable or disable the automatic level control.";
CM_ SG_ 3221225472 RampLevelReq "Command signal to control the body height to a level programmed and memorised in the ECU.";
CM_ SG_ 3221225472 SteeringAxleLockingReq "Command signal to lock the steering axle.";
CM_ SG_ 3221225472 LiftAxle2PositionReq "Command signal to control the lift axle position / tag axle load condition.";
CM_ SG_ 3221225472 LiftAxle1PositionReq "Command signal to control the lift axle position / tag axle load condition.";
CM_ SG_ 3221225472 TractionHelpReq "Command signal to control the lift axle position / tag axle load condition to transfer more load on the driven axle of the commercial vehicle.";
CM_ SG_ 3221225472 LevelChangeReqRearAxle "Command signal to control the body height [up (lifting)/down (lowering)] for the rear axle.";
CM_ SG_ 3221225472 LevelChangeReqFrontAxle "Command signal to control the body height [up (lifting)/down (lowering)] for the front axle.";
CM_ SG_ 3221225472 RideHeightRequest "Command signal to activate a normal ride body height. The normal levels 1 and 2 are trailer specific body heights.";
CM_ SG_ 3221225472 LevelControl "Signal which indicates that the automatic level control is enabled or disabled.";
CM_ SG_ 3221225472 NominalVehBodyLevelRearAxle "Actual nominal vehicle body height.";
CM_ SG_ 3221225472 NominalVehBodyLevelFrontAxle "Actual nominal vehicle body height.";
CM_ SG_ 3221225472 RampLevel "Signal which indicates the level of the body height as an anser to 'ramp level request'.";
CM_ SG_ 3221225472 NormalLevel "Signal which indicates the normal levels of the vehicle independently of a specific request.";
CM_ SG_ 3221225472 StopLevelChangeAcknowledge "Signal which indicates the stop of any level change due to a 'stop request'.";
CM_ SG_ 3221225472 LevelChangeRearAxle "Signal which indicates the level change of the body height at the rear axle due to any external requests.";
CM_ SG_ 3221225472 LevelChangeFrontAxle "Signal which indicates the level change of the body height at the front axle due to any external requests.";
CM_ SG_ 3221225472 RampLevelStorage "Signal which indicates the storage of a new ramp level in the ECU.";
CM_ SG_ 3221225472 SteeringAxleLocking "Signal which indicates the actual steering axle locking status.";
CM_ SG_ 3221225472 LiftAxle2Pos "Signal which indicates the position / load condition of lift axle / tag axle #2. Numbering of lift/tag axles starts at front axle.Signal which indicates the position / load condition of lift axle / tag axle #2. Numbering of lift/tag axles starts at front axle.";
CM_ SG_ 3221225472 LiftAxle1Pos "Signal which indicates the position / load condition of lift axle / tag axle #1. Numbering of lift/tag axles starts at front axle.Signal which indicates the position / load condition of lift axle / tag axle #1. Numbering of lift/tag axles starts at front axle.";
CM_ SG_ 3221225472 RampLevelPosition "Signal which indicates the ramp level positions of the vehicle independently of a specific request.";
CM_ SG_ 3221225472 TractionHelp "Signal which indicates that a load transfer is active.";
CM_ SG_ 3221225472 LevelCtrlSysRideHeightLevel "Signal which indicates the body height position of the vehicle as an answer to 'ride height request'.";
CM_ SG_ 3221225472 RelVehBodyLevelRearAxle "Actual relative vehicle body height.";
CM_ SG_ 3221225472 RelVehBodyLevelFrontAxle "Actual relative vehicle body height.";
CM_ SG_ 3221225472 TyrePressThresholdDetect "Signal indicating the pressure level of the tyre.";
CM_ SG_ 3221225472 TyreModulePowerSupply "Signal indicating the power supply of the tyre module is sufficient to achieve the specified performance of the module.";
CM_ SG_ 3221225472 TyreTemperature "The temperature measured by the tyre module.";
CM_ SG_ 3221225472 AirLeakageDetection "The pressure loss of a tyre.";
CM_ SG_ 3221225472 TyreWheelIdentification2 "First part of the identification number of the tyre or whee (number of axles).";
CM_ SG_ 3221225472 TyreWheelIdentification1 "First part of the identification number of the tyre or whee (position on each axle).";
CM_ SG_ 3221225472 XBRMessageChecksum "The XBR message checksum is used to verify the signal path from the demanding device to the brake controller on";
CM_ SG_ 3221225472 XBRMessageCounter "The XBR message counter is to verify the signal path from the demanding device to the brake controller on electronic";
CM_ SG_ 3221225472 XBRUrgency "The idea of the urgency value is to adjust the endurance brake integration behavior in the EBS system according to the";
CM_ SG_ 3221225472 XBRCtrlMode "The XBR Control Mode is used as an input to the brake system and defines how the external acceleration demand has to";
CM_ SG_ 3221225472 XBRPriority "The XBR Priority is used as an input to the brake system to manage the priority of overlapping external and internal";
CM_ SG_ 3221225472 XBREBIMode "The XBR EBI (Endurance Brake Integration) Mode is used as an input for the brake system to prescribe the use of";
CM_ SG_ 3221225472 ExtlAccelerationDemand "Parameter provided to the brake system from external sources. This is the acceleration which the brake system is";
CM_ SG_ 3221225472 WaterInFuelIndicator "Signal which indicates the presence of water in the fuel.";
CM_ SG_ 3221225472 AxleLocation "To identify to which of several similar devices (such as tires or fuel tanks) the information applies.To identify to which of several similar devices (such as tires or fuel tanks) the information applies.";
CM_ SG_ 3221225472 CargoWeight_30 "The mass of freight carried.";
CM_ SG_ 3221225472 CargoWeight_20 "The mass of freight carried.";
CM_ SG_ 3221225472 CargoWeight_10 "The mass of freight carried.";
CM_ SG_ 3221225472 CargoWeight_00 "The mass of freight carried.";
CM_ SG_ 3221225472 TrailerWeight_30 "Total mass of freight-carrying vehicle designed to be pulled by truck, including the weight of the contents.";
CM_ SG_ 3221225472 TrailerWeight_20 "Total mass of freight-carrying vehicle designed to be pulled by truck, including the weight of the contents.";
CM_ SG_ 3221225472 TrailerWeight_10 "Total mass of freight-carrying vehicle designed to be pulled by truck, including the weight of the contents.";
CM_ SG_ 3221225472 TrailerWeight_00 "Total mass of freight-carrying vehicle designed to be pulled by truck, including the weight of the contents.";
CM_ SG_ 3221225472 AxleWeight_30 "Total mass imposed by the tires on the road surface at the specified axle.";
CM_ SG_ 3221225472 AxleWeight_20 "Total mass imposed by the tires on the road surface at the specified axle.";
CM_ SG_ 3221225472 AxleWeight_10 "Total mass imposed by the tires on the road surface at the specified axle.";
CM_ SG_ 3221225472 AxleWeight_00 "Total mass imposed by the tires on the road surface at the specified axle.";
CM_ SG_ 3221225472 NetBatteryCurrent "Net flow of electrical current into/out-of the battery or batteries. This parameter is the high range and resolution of SPNNet flow of electrical current into/out of the battery or batteries.";
CM_ SG_ 3221225472 AltCurrent "This parameter indicates the amount of electrical current output from the alternator of the main vehicle. Alternator CurrentMeasure of electrical current flow from the alternator. Alternator Current (High Range/Resolution) parameter SPN 1795";
CM_ SG_ 3221225472 ECUPowerOutputSupplyVoltage3 "The third power output from an ECM.";
CM_ SG_ 3221225472 ECUPowerOutputSupplyVoltage2 "The second power output from an ECM.";
CM_ SG_ 3221225472 ECUPowerOutputSupplyVoltage1 "The first power output from an ECM";
CM_ SG_ 3221225472 BatteryPotential_PowerInput2 "This parameter measures the second source of battery potential as measured at the input of the ECM/actuator etc.";
CM_ SG_ 3221225472 Longitude "Longitude position of the vehicle.";
CM_ SG_ 3221225472 Latitude "Latitude position of the vehicle.";
CM_ SG_ 3221225472 VehicleIdentificationNumber "Vehicle Identification Number (VIN) as assigned by the vehicle manufacturer.";
CM_ SG_ 3221225472 TotalPowerTakeoffHours "Accumulated time of operation of power takeoff device.";
CM_ SG_ 3221225472 TotalVehicleHours "Accumulated time of operation of vehicle.";
CM_ SG_ 3221225472 HydOilLevel "This parameter indicates the level of the hydraulic fluid in tank as a ratio of current volume to total tank volume. This";
CM_ SG_ 3221225472 WinchOilPressSwitch "State of switch used to determine if Winch Oil Pressure is above desired minimum";
CM_ SG_ 3221225472 HydOilFilterRestrictionSwitch "This switch indicates whether hydraulic oil filter is clogged. This is not the transmission oil filter restriction switch, which is";
CM_ SG_ 3221225472 HydTemp "Temperature of hydraulic fluid.";
CM_ SG_ 3221225472 Altitude "Altitude of the vehicle referenced to sea level at standard atmospheric pressure and temperature.";
CM_ SG_ 3221225472 Pitch "Pitch of the vehicle as calculated by the navigation device(s).";
CM_ SG_ 3221225472 NavigationBasedVehicleSpeed "Speed of the vehicle as calculated from a device such as a Global Positioning System (GPS).";
CM_ SG_ 3221225472 CompassBearing "Present compass bearing of vehicle.";
CM_ SG_ 3221225472 HighResolutionTripDistance "Distance traveled during all or part of a journey.";
CM_ SG_ 3221225472 HghRsolutionTotalVehicleDistance "Accumulated distance traveled by the vehicle during its operation.";
CM_ SG_ 3221225472 YCBrakeCtrlActive "State signal which indicates that Yaw Control (YC) has activated brake control. Active means that YC actually controls";
CM_ SG_ 3221225472 YCEngCtrlActive "State Signal which indicates that the Yaw Control (YC) has commanded engine control to be active. Within the physical";
CM_ SG_ 3221225472 ROPBrakeCtrlActive "State signal which indicates that Roll over Prevention (ROP) has activated brake control. Active means that ROP actually";
CM_ SG_ 3221225472 ROPEngCtrlActive "State Signal which indicates that the Roll Over Prevention (ROP) has commanded engine control to be active. Within the";
CM_ SG_ 3221225472 VDCBrakeLightRq "Indicates whether VDC requests to turn the vehicle brake lights on";
CM_ SG_ 3221225472 VDCFullyOperational "Signal that indicates whether VDC is fully operational or whether its functionality is reduced by a permanent or temporary";
CM_ SG_ 3221225472 VDCInformationSignal "This parameter commands the VDC information signal, for example a dash lamp.";
CM_ SG_ 3221225472 TotalVehicleDistance "Accumulated distance traveled by vehicle during its operation.";
CM_ SG_ 3221225472 TripDistance "Distance traveled during all or part of a journey.";
CM_ SG_ 3221225472 TripCruiseDistance "Total distance that the engine has operated in the cruise hold state, excluding time in accelerator override, since the last";
CM_ SG_ 3221225472 TripMaxVehicleSpeed "Maximum vehicle speed achieved while the engine speed is greater than zero and the accelerator pedal position (APS) is";
CM_ SG_ 3221225472 TripAirCompressorOnTime "Total time that the air compressor is on and compressing air since the last trip reset.";
CM_ SG_ 3221225472 TripIdleTime "Total time accumulated while the engine speed is greater than zero, both the PTO and remote PTO governors are";
CM_ SG_ 3221225472 TripEngRunningTime "Total time accumulated while the engine speed is greater than zero since the last trip reset. Note that time with the";
CM_ SG_ 3221225472 TripCruiseTime "Total time accumulated while the engine is in the cruise hold state, excluding time in accelerator override, since the last";
CM_ SG_ 3221225472 TripPTOGovernorTime "Total time accumulated while the engine is in the PTO or remote PTO governor hold state since the last trip reset.";
CM_ SG_ 3221225472 TripTimeInDerateByEng "Total time accumulated when the engine final fueling has been derated due to an engine protection algorithm, since the";
CM_ SG_ 3221225472 TripTimeInGearDown "Total time accumulated when the vehicle has operated in one gear down from the top gear for a calibrated minimum time,";
CM_ SG_ 3221225472 TripTimeInTopGear "Total time accumulated when the vehicle has operated in top gear for a calibrated minimum time, since the last trip reset.";
CM_ SG_ 3221225472 TripTimeInVSL "Total time accumulated when the engine has operated on the vehicle speed limiter (VSL) while not in the cruise hold";
CM_ SG_ 3221225472 TripSuddenDecelerations "Total number of decelerations whenever the vehicle deceleration is more than XYZ km/h/sec (where XYZ is a calibratible";
CM_ SG_ 3221225472 TrpNumberOfIdleShutdownOverrides "Total number of times an operator disables idle shutdown to prevent an engine shutdown, since the last trip reset.";
CM_ SG_ 3221225472 TripNumberOfIdleShutdowns "Total number of times the engine has been shutdown due to idling too long (at normal idle or fast idle) since the last trip";
CM_ SG_ 3221225472 TripNumberOfHotShutdowns "Total number of hot shutdowns since the last trip reset. A hot shutdown is based on operation at high load or high engine";
CM_ SG_ 3221225472 EngRequestedTorqueHighResolution "This parameter displays an additional torque in percent of the reference engine torque.";
CM_ SG_ 3221225472 TSC1CtrlPurpose "State signal which indicates which control mode the sending device is using to generate the TSC1 command. Note that";
CM_ SG_ 3221225472 TSC1TransRate "This parameter indicates the transmission rate at which the sending device will transmit the TSC1 message. The engine";
CM_ SG_ 3221225472 EngRequestedTorque_TorqueLimit "Parameter provided to the engine or retarder in the torque/speed control message for controlling or limiting the output";
CM_ SG_ 3221225472 EngRequestedSpeed_SpeedLimit "Parameter provided to the engine from external sources in the torque/speed control message. This is the engine speed";
CM_ SG_ 3221225472 OverrideCtrlModePriority "This field is used as an input to the engine or retarder to determine the priority of the Override Control Mode received in";
CM_ SG_ 3221225472 EngRequestedSpeedCtrlConditions "This mode tells the engine control system the governor characteristics that are desired during speed control. The four";
CM_ SG_ 3221225472 EngOverrideCtrlMode "The override control mode defines which sort of command is used:";
CM_ SG_ 3221225472 TransitRunStatus "Status of the run switch for the vehicle.";
CM_ SG_ 3221225472 VehicleUseStatus "Used to indicate the proper or unauthorized use of the vehicle. The administrative control device or any device issuing the";
CM_ SG_ 3221225472 SilentAlarmStatus "Used to report silent alarm push button status.";
CM_ SG_ 3221225472 PatronCount "Count of the number of passengers on a transit vehicle. If the type of passenger count (SPN 3043) is 0, the patron count";
CM_ SG_ 3221225472 TypeOfPassengerCount "Used to notify transit link devices of the type of passenger counting system used in the vehicle. Some passenger";
CM_ SG_ 3221225472 FareboxAlarmIdentifier "Indicates the nature of the farebox alarm condition.";
CM_ SG_ 3221225472 FareboxEmergencyStatus "Indicates if a farebox emergency condition exists.";
CM_ SG_ 3221225472 TransferSold "Indicates that a transfer was sold or issued on this transaction including its type and/or restrictions. The final definitions of";
CM_ SG_ 3221225472 RouteNumber "The route number issuing the transfer.";
CM_ SG_ 3221225472 TransferType "The kind of transfer used";
CM_ SG_ 3221225472 TypeOfService "The type of service provided";
CM_ SG_ 3221225472 InitialFareAgency "Identifies where the initial fare is paid";
CM_ SG_ 3221225472 PassCategory "Agency defined value indicating the category of the passenger associated with this fare";
CM_ SG_ 3221225472 FareValidity "Agency defined value indicating validity of this fare";
CM_ SG_ 3221225472 PaymentDetails "Payment details.";
CM_ SG_ 3221225472 TypeOfFare "Type of Fare";
CM_ SG_ 3221225472 PassengerType "Enumerated value representing the type/class of passenger, as defined by the agency.";
CM_ SG_ 3221225472 TransactionType "Enumerated value representing the type of transaction completed";
CM_ SG_ 3221225472 DriversFareboxSecurityCode "Security code for the farebox, numerical only.";
CM_ SG_ 3221225472 AssignedBlock "The agency defined block number for this trip";
CM_ SG_ 3221225472 AssignedRun "The agency defined run number for this trip";
CM_ SG_ 3221225472 AssignedRoute "The identity number assigned to this route.";
CM_ SG_ 3221225472 PatternNumber "The agency defined pattern number for this trip";
CM_ SG_ 3221225472 TripNumber "The identity number assigned to this trip.";
CM_ SG_ 3221225472 FarePresets "Fare Presets";
CM_ SG_ 3221225472 TripDirection "The general direction of travel for this trip.";
CM_ SG_ 3221225472 TripStatus "Trip Status";
CM_ SG_ 3221225472 FareboxServiceStatus "Indicates if the farebox is in or out of service.";
CM_ SG_ 3221225472 VehicleID "Numerical designation of the vehicle. 65535 is used to represent the vehicle ID is not available.";
CM_ SG_ 3221225472 StrobeActivationCtrlStatus "Strobe activation control status";
CM_ SG_ 3221225472 TransitDoorEnable "Transit door enable";
CM_ SG_ 3221225472 PriorityOfRespSentByEmitter "Priority of response sent by emitter";
CM_ SG_ 3221225472 IntrsctnPrmptionRequest_Response "Status of the intersection signal preemption";
CM_ SG_ 3221225472 TransitRouteIDUsage "Transit route ID usage";
CM_ SG_ 3221225472 RangeCodeEnable "Range code enable";
CM_ SG_ 3221225472 NmbrOfBytsInThMlpstIdntification "Number of bytes in the Milepost Identification. This parameter identifies the length, in bytes, of the data in SPN 590";
CM_ SG_ 3221225472 NmbrOfBytsInThTrnstAssgndBlckIdn "Number of bytes in the Transit Assigned Block Identity. This parameter identifies the length, in bytes, of the data in SPN";
CM_ SG_ 3221225472 NmbrOfBytsInThTrnstAssgndRnIdntt "Number of bytes in the Transit Assigned Run Identity. This parameter identifies the length, in bytes, of the data in SPN";
CM_ SG_ 3221225472 NmbrOfBytsInThTrnstAssgndRtIdntt "Number of bytes in the Transit Assigned Route Identity. This parameter identifies the length, in bytes, of the data in SPN";
CM_ SG_ 3221225472 Agency "The identity of the agency involved in this transaction";
CM_ SG_ 3221225472 TireLocation "Identifies which tire is associated with the parametric data in this PGN.Identifies which tire is associated with the parametric data in this PGN.Identifies which tire is associated with the parametric data in this PGN.";
CM_ SG_ 3221225472 SteerChannelTirePress "The latest gage pressure reading of the steer group of tires, as opposed to the pressure in each tire.";
CM_ SG_ 3221225472 DriveChannelTirePress "The latest gage pressure reading of the drive group of tires, as opposed to the pressure in each tire.";
CM_ SG_ 3221225472 TrailerTagOrPushChannelTirePress "The latest gage pressure reading of the trailer, tag, or push group of tires, as opposed to the pressure in each tire.";
CM_ SG_ 3221225472 SteerChannelTirePressTarget "The tire pressure control system’s target gage pressure for the steer group of tires.";
CM_ SG_ 3221225472 DriveChannelTirePressTarget "The tire pressure control system’s target gage pressure for the drive group of tires.";
CM_ SG_ 3221225472 TrlrTgOrPshChnnelTirePressTarget "The tire pressure control system’s target gage pressure for the trailer, tag, or push group of tires.";
CM_ SG_ 3221225472 PCUTrilerTagOrPushSolenoidStatus "Current state of the trailer, tag, or push solenoid used to implement a tire pressure control system in its pneumatic control";
CM_ SG_ 3221225472 PCUSupplySolenoidStatus "Current state of the supply solenoid used to implement a tire pressure control system in its pneumatic control unit (PCU).";
CM_ SG_ 3221225472 PCUCtrlSolenoidStatus "Current state of the control solenoid used to implement a tire pressure control system in its pneumatic control unit (PCU).";
CM_ SG_ 3221225472 PCUDeflateSolenoidStatus "Current state of the deflate solenoid used to implement a tire pressure control system in its pneumatic control unit (PCU).";
CM_ SG_ 3221225472 TirePressSupplySwitchStatus "Current state of an open/closed type switch used to determine if adequate pressure exists for system implementation.";
CM_ SG_ 3221225472 PCUSteerSolenoidStatus "Current state of the steer solenoid used to implement a tire pressure control system in its pneumatic control unit (PCU).";
CM_ SG_ 3221225472 PCUDriveSolenoidStatus "Current state of the drive solenoid used to implement a tire pressure control system in its pneumatic control unit (PCU).";
CM_ SG_ 3221225472 DriveChannelMode "Indicates the functional mode of trailer/tag channel of the tire pressure control system.";
CM_ SG_ 3221225472 Trailer_tagChannelMode "Indicates the functional mode of trailer/tag channel of the tire pressure control system.";
CM_ SG_ 3221225472 SteerChannelMode "Indicates the functional mode of steer channel of the tire pressure control system.";
CM_ SG_ 3221225472 TirePressCheckInterval "The interval at which the system will check the tire pressures (e.g., 5, 10, 15 min.).";
CM_ SG_ 3221225472 TirePressThresholdDetection_13 "Signal indicating the pressure level of the tire.";
CM_ SG_ 3221225472 TirePressThresholdDetection_12 "Signal indicating the pressure level of the tire.";
CM_ SG_ 3221225472 TirePressThresholdDetection_11 "Signal indicating the pressure level of the tire.";
CM_ SG_ 3221225472 TirePressThresholdDetection_10 "Signal indicating the pressure level of the tire.";
CM_ SG_ 3221225472 TirePressThresholdDetection_01 "Signal indicating the pressure level of the tire.";
CM_ SG_ 3221225472 TirePress_33 "Pressure at which air is contained in cavity formed by tire and rim.";
CM_ SG_ 3221225472 TirePress_32 "Pressure at which air is contained in cavity formed by tire and rim.";
CM_ SG_ 3221225472 TirePress_31 "Pressure at which air is contained in cavity formed by tire and rim.";
CM_ SG_ 3221225472 TirePress_30 "Pressure at which air is contained in cavity formed by tire and rim.";
CM_ SG_ 3221225472 TirePress_23 "Pressure at which air is contained in cavity formed by tire and rim.";
CM_ SG_ 3221225472 TirePress_22 "Pressure at which air is contained in cavity formed by tire and rim.";
CM_ SG_ 3221225472 TirePress_21 "Pressure at which air is contained in cavity formed by tire and rim.";
CM_ SG_ 3221225472 TirePress_20 "Pressure at which air is contained in cavity formed by tire and rim.";
CM_ SG_ 3221225472 TirePress_13 "Pressure at which air is contained in cavity formed by tire and rim.";
CM_ SG_ 3221225472 TirePress_12 "Pressure at which air is contained in cavity formed by tire and rim.";
CM_ SG_ 3221225472 TirePress_11 "Pressure at which air is contained in cavity formed by tire and rim.";
CM_ SG_ 3221225472 TirePress_10 "Pressure at which air is contained in cavity formed by tire and rim.";
CM_ SG_ 3221225472 TireAirLeakageRate_33 "The pressure loss rate of a tire.";
CM_ SG_ 3221225472 TireAirLeakageRate_32 "The pressure loss rate of a tire.";
CM_ SG_ 3221225472 TireAirLeakageRate_31 "The pressure loss rate of a tire.";
CM_ SG_ 3221225472 TireAirLeakageRate_30 "The pressure loss rate of a tire.";
CM_ SG_ 3221225472 TireAirLeakageRate_23 "The pressure loss rate of a tire.";
CM_ SG_ 3221225472 TireAirLeakageRate_22 "The pressure loss rate of a tire.";
CM_ SG_ 3221225472 TireAirLeakageRate_21 "The pressure loss rate of a tire.";
CM_ SG_ 3221225472 TireAirLeakageRate_20 "The pressure loss rate of a tire.";
CM_ SG_ 3221225472 TireAirLeakageRate_13 "The pressure loss rate of a tire.";
CM_ SG_ 3221225472 TireAirLeakageRate_12 "The pressure loss rate of a tire.";
CM_ SG_ 3221225472 TireAirLeakageRate_11 "The pressure loss rate of a tire.";
CM_ SG_ 3221225472 TireAirLeakageRate_10 "The pressure loss rate of a tire.";
CM_ SG_ 3221225472 TireAirLeakageRate_01 "The pressure loss rate of a tire.";
CM_ SG_ 3221225472 TireAirLeakageRate_00 "The pressure loss rate of a tire.";
CM_ SG_ 3221225472 CTIWheelSensorStatus_33 "Indicates whether the wheel is being monitored by the CTI controller.";
CM_ SG_ 3221225472 CTIWheelSensorStatus_32 "Indicates whether the wheel is being monitored by the CTI controller.";
CM_ SG_ 3221225472 CTIWheelSensorStatus_31 "Indicates whether the wheel is being monitored by the CTI controller.";
CM_ SG_ 3221225472 CTIWheelSensorStatus_30 "Indicates whether the wheel is being monitored by the CTI controller.";
CM_ SG_ 3221225472 CTIWheelSensorStatus_23 "Indicates whether the wheel is being monitored by the CTI controller.";
CM_ SG_ 3221225472 CTIWheelSensorStatus_22 "Indicates whether the wheel is being monitored by the CTI controller.";
CM_ SG_ 3221225472 CTIWheelSensorStatus_21 "Indicates whether the wheel is being monitored by the CTI controller.";
CM_ SG_ 3221225472 CTIWheelSensorStatus_20 "Indicates whether the wheel is being monitored by the CTI controller.";
CM_ SG_ 3221225472 CTIWheelSensorStatus_13 "Indicates whether the wheel is being monitored by the CTI controller.";
CM_ SG_ 3221225472 CTIWheelSensorStatus_12 "Indicates whether the wheel is being monitored by the CTI controller.";
CM_ SG_ 3221225472 CTIWheelSensorStatus_11 "Indicates whether the wheel is being monitored by the CTI controller.";
CM_ SG_ 3221225472 CTIWheelSensorStatus_10 "Indicates whether the wheel is being monitored by the CTI controller.";
CM_ SG_ 3221225472 CTIWheelSensorStatus_01 "Indicates whether the wheel is being monitored by the CTI controller.";
CM_ SG_ 3221225472 CTIWheelEndElectricalFault_33 "Indicates the status of electrical fault on CTI wheel interface.";
CM_ SG_ 3221225472 CTIWheelEndElectricalFault_32 "Indicates the status of electrical fault on CTI wheel interface.";
CM_ SG_ 3221225472 CTIWheelEndElectricalFault_31 "Indicates the status of electrical fault on CTI wheel interface.";
CM_ SG_ 3221225472 CTIWheelEndElectricalFault_30 "Indicates the status of electrical fault on CTI wheel interface.";
CM_ SG_ 3221225472 CTIWheelEndElectricalFault_23 "Indicates the status of electrical fault on CTI wheel interface.";
CM_ SG_ 3221225472 CTIWheelEndElectricalFault_22 "Indicates the status of electrical fault on CTI wheel interface.";
CM_ SG_ 3221225472 CTIWheelEndElectricalFault_21 "Indicates the status of electrical fault on CTI wheel interface.";
CM_ SG_ 3221225472 CTIWheelEndElectricalFault_20 "Indicates the status of electrical fault on CTI wheel interface.";
CM_ SG_ 3221225472 CTIWheelEndElectricalFault_13 "Indicates the status of electrical fault on CTI wheel interface.";
BA_DEF_ SG_  "SigType" ENUM  "Default","Range","RangeSigned","ASCII","Discrete","Control","ReferencePGN","DTC","StringDelimiter","StringLength","StringLengthControl";
BA_DEF_ SG_  "GenSigStartValue" INT 0 10000;
BA_DEF_ SG_  "GenSigSendType" ENUM  "Cyclic","OnWrite","reserved","OnChange","reserved","reserved","reserved","NoSigSendType";
BA_DEF_ SG_  "GenSigILSupport" ENUM  "Yes","No";
BA_DEF_ SG_  "GenSigEVName" STRING ;
BA_DEF_ SG_  "SPN" INT 0 524287;
BA_DEF_ SG_  "SAEDocument" STRING ;
BA_DEF_ BO_  "GenMsgILSupport" ENUM  "Yes","No";
BA_DEF_ BO_  "GenMsgRequestable" INT 0 1;
BA_DEF_ BO_  "GenMsgSendType" ENUM  "cyclic","reserved","cyclicIfActive","reserved","reserved","reserved","reserved","reserved","noMsgSendType";
BA_DEF_ BO_  "VFrameFormat" ENUM  "StandardCAN","ExtendedCAN","reserved","J1939PG";
BA_DEF_ BO_  "SingleFrame" INT 0 1;
BA_DEF_ BO_  "GenMsgCycleTime" INT 0 3600000;
BA_DEF_ BO_  "SAE_Document" STRING ;
BA_DEF_ SG_  "SystemSignalLongSymbol" STRING ;
BA_DEF_DEF_  "SigType" "Default";
BA_DEF_DEF_  "GenSigStartValue" 0;
BA_DEF_DEF_  "GenSigSendType" "NoSigSendType";
BA_DEF_DEF_  "GenSigILSupport" "Yes";
BA_DEF_DEF_  "GenSigEVName" "Env@Nodename_@Signame";
BA_DEF_DEF_  "SPN" 0;
BA_DEF_DEF_  "SAEDocument" "";
BA_DEF_DEF_  "GenMsgILSupport" "Yes";
BA_DEF_DEF_  "GenMsgRequestable" 1;
BA_DEF_DEF_  "GenMsgSendType" "noMsgSendType";
BA_DEF_DEF_  "VFrameFormat" "J1939PG";
BA_DEF_DEF_  "SingleFrame" 1;
BA_DEF_DEF_  "GenMsgCycleTime" 0;
BA_DEF_DEF_  "SAE_Document" "";
BA_DEF_DEF_  "SystemSignalLongSymbol" "";
BA_ "SAEDocument" SG_ 3221225472 EngFuelActuator2CtrlCmd "J1939-71";
BA_ "SPN" SG_ 3221225472 EngFuelActuator2CtrlCmd 1244;
BA_ "SAEDocument" SG_ 3221225472 EngFuelActuator1CtrlCmd "J1939-71";
BA_ "SPN" SG_ 3221225472 EngFuelActuator1CtrlCmd 633;
BA_ "SAEDocument" SG_ 3221225472 EngThrottleActuator2CtrlCmd "J1939-71";
BA_ "SPN" SG_ 3221225472 EngThrottleActuator2CtrlCmd 3465;
BA_ "SAEDocument" SG_ 3221225472 EngThrottleActuator1CtrlCmd "J1939-71";
BA_ "SPN" SG_ 3221225472 EngThrottleActuator1CtrlCmd 3464;
BA_ "SAEDocument" SG_ 3221225472 EngCyl24KnockLevel "J1939-71";
BA_ "SPN" SG_ 3221225472 EngCyl24KnockLevel 1375;
BA_ "SAEDocument" SG_ 3221225472 EngCyl23KnockLevel "J1939-71";
BA_ "SPN" SG_ 3221225472 EngCyl23KnockLevel 1374;
BA_ "SAEDocument" SG_ 3221225472 EngCyl22KnockLevel "J1939-71";
BA_ "SPN" SG_ 3221225472 EngCyl22KnockLevel 1373;
BA_ "SAEDocument" SG_ 3221225472 EngCyl21KnockLevel "J1939-71";
BA_ "SPN" SG_ 3221225472 EngCyl21KnockLevel 1372;
BA_ "SAEDocument" SG_ 3221225472 EngCyl20KnockLevel "J1939-71";
BA_ "SPN" SG_ 3221225472 EngCyl20KnockLevel 1371;
BA_ "SAEDocument" SG_ 3221225472 EngCyl19KnockLevel "J1939-71";
BA_ "SPN" SG_ 3221225472 EngCyl19KnockLevel 1370;
BA_ "SAEDocument" SG_ 3221225472 EngCyl18KnockLevel "J1939-71";
BA_ "SPN" SG_ 3221225472 EngCyl18KnockLevel 1369;
BA_ "SAEDocument" SG_ 3221225472 EngCyl17KnockLevel "J1939-71";
BA_ "SPN" SG_ 3221225472 EngCyl17KnockLevel 1368;
BA_ "SAEDocument" SG_ 3221225472 EngCyl16KnockLevel "J1939-71";
BA_ "SPN" SG_ 3221225472 EngCyl16KnockLevel 1367;
BA_ "SAEDocument" SG_ 3221225472 EngCyl15KnockLevel "J1939-71";
BA_ "SPN" SG_ 3221225472 EngCyl15KnockLevel 1366;
BA_ "SAEDocument" SG_ 3221225472 EngCyl14KnockLevel "J1939-71";
BA_ "SPN" SG_ 3221225472 EngCyl14KnockLevel 1365;
BA_ "SAEDocument" SG_ 3221225472 EngCyl13KnockLevel "J1939-71";
BA_ "SPN" SG_ 3221225472 EngCyl13KnockLevel 1364;
BA_ "SAEDocument" SG_ 3221225472 EngCyl12KnockLevel "J1939-71";
BA_ "SPN" SG_ 3221225472 EngCyl12KnockLevel 1363;
BA_ "SAEDocument" SG_ 3221225472 EngCyl11KnockLevel "J1939-71";
BA_ "SPN" SG_ 3221225472 EngCyl11KnockLevel 1362;
BA_ "SAEDocument" SG_ 3221225472 EngCyl10KnockLevel "J1939-71";
BA_ "SPN" SG_ 3221225472 EngCyl10KnockLevel 1361;
BA_ "SAEDocument" SG_ 3221225472 EngCyl9KnockLevel "J1939-71";
BA_ "SPN" SG_ 3221225472 EngCyl9KnockLevel 1360;
BA_ "SAEDocument" SG_ 3221225472 EngCyl8KnockLevel "J1939-71";
BA_ "SPN" SG_ 3221225472 EngCyl8KnockLevel 1359;
BA_ "SAEDocument" SG_ 3221225472 EngCyl7KnockLevel "J1939-71";
BA_ "SPN" SG_ 3221225472 EngCyl7KnockLevel 1358;
BA_ "SAEDocument" SG_ 3221225472 EngCyl6KnockLevel "J1939-71";
BA_ "SPN" SG_ 3221225472 EngCyl6KnockLevel 1357;
BA_ "SAEDocument" SG_ 3221225472 EngCyl5KnockLevel "J1939-71";
BA_ "SPN" SG_ 3221225472 EngCyl5KnockLevel 1356;
BA_ "SAEDocument" SG_ 3221225472 EngCyl4KnockLevel "J1939-71";
BA_ "SPN" SG_ 3221225472 EngCyl4KnockLevel 1355;
BA_ "SAEDocument" SG_ 3221225472 EngCyl3KnockLevel "J1939-71";
BA_ "SPN" SG_ 3221225472 EngCyl3KnockLevel 1354;
BA_ "SAEDocument" SG_ 3221225472 EngCyl2KnockLevel "J1939-71";
BA_ "SPN" SG_ 3221225472 EngCyl2KnockLevel 1353;
BA_ "SAEDocument" SG_ 3221225472 EngCyl1KnockLevel "J1939-71";
BA_ "SPN" SG_ 3221225472 EngCyl1KnockLevel 1352;
BA_ "SAEDocument" SG_ 3221225472 EngCyl24CombustionStatus "J1939-71";
BA_ "SPN" SG_ 3221225472 EngCyl24CombustionStatus 3410;
BA_ "SigType" SG_ 3221225472 EngCyl24CombustionStatus 5;
BA_ "SAEDocument" SG_ 3221225472 EngCyl23CombustionStatus "J1939-71";
BA_ "SPN" SG_ 3221225472 EngCyl23CombustionStatus 3409;
BA_ "SigType" SG_ 3221225472 EngCyl23CombustionStatus 5;
BA_ "SAEDocument" SG_ 3221225472 EngCyl22CombustionStatus "J1939-71";
BA_ "SPN" SG_ 3221225472 EngCyl22CombustionStatus 3408;
BA_ "SigType" SG_ 3221225472 EngCyl22CombustionStatus 5;
BA_ "SAEDocument" SG_ 3221225472 EngCyl21CombustionStatus "J1939-71";
BA_ "SPN" SG_ 3221225472 EngCyl21CombustionStatus 3407;
BA_ "SigType" SG_ 3221225472 EngCyl21CombustionStatus 5;
BA_ "SAEDocument" SG_ 3221225472 EngCyl20CombustionStatus "J1939-71";
BA_ "SPN" SG_ 3221225472 EngCyl20CombustionStatus 3406;
BA_ "SigType" SG_ 3221225472 EngCyl20CombustionStatus 5;
BA_ "SAEDocument" SG_ 3221225472 EngCyl19CombustionStatus "J1939-71";
BA_ "SPN" SG_ 3221225472 EngCyl19CombustionStatus 3405;
BA_ "SigType" SG_ 3221225472 EngCyl19CombustionStatus 5;
BA_ "SAEDocument" SG_ 3221225472 EngCyl18CombustionStatus "J1939-71";
BA_ "SPN" SG_ 3221225472 EngCyl18CombustionStatus 3404;
BA_ "SigType" SG_ 3221225472 EngCyl18CombustionStatus 5;
BA_ "SAEDocument" SG_ 3221225472 EngCyl17CombustionStatus "J1939-71";
BA_ "SPN" SG_ 3221225472 EngCyl17CombustionStatus 3403;
BA_ "SigType" SG_ 3221225472 EngCyl17CombustionStatus 5;
BA_ "SAEDocument" SG_ 3221225472 EngCyl16CombustionStatus "J1939-71";
BA_ "SPN" SG_ 3221225472 EngCyl16CombustionStatus 3402;
BA_ "SigType" SG_ 3221225472 EngCyl16CombustionStatus 5;
BA_ "SAEDocument" SG_ 3221225472 EngCyl15CombustionStatus "J1939-71";
BA_ "SPN" SG_ 3221225472 EngCyl15CombustionStatus 3401;
BA_ "SigType" SG_ 3221225472 EngCyl15CombustionStatus 5;
BA_ "SAEDocument" SG_ 3221225472 EngCyl14CombustionStatus "J1939-71";
BA_ "SPN" SG_ 3221225472 EngCyl14CombustionStatus 3400;
BA_ "SigType" SG_ 3221225472 EngCyl14CombustionStatus 5;
BA_ "SAEDocument" SG_ 3221225472 EngCyl13CombustionStatus "J1939-71";
BA_ "SPN" SG_ 3221225472 EngCyl13CombustionStatus 3399;
BA_ "SigType" SG_ 3221225472 EngCyl13CombustionStatus 5;
BA_ "SAEDocument" SG_ 3221225472 EngCyl12CombustionStatus "J1939-71";
BA_ "SPN" SG_ 3221225472 EngCyl12CombustionStatus 3398;
BA_ "SigType" SG_ 3221225472 EngCyl12CombustionStatus 5;
BA_ "SAEDocument" SG_ 3221225472 EngCyl11CombustionStatus "J1939-71";
BA_ "SPN" SG_ 3221225472 EngCyl11CombustionStatus 3397;
BA_ "SigType" SG_ 3221225472 EngCyl11CombustionStatus 5;
BA_ "SAEDocument" SG_ 3221225472 EngCyl10CombustionStatus "J1939-71";
BA_ "SPN" SG_ 3221225472 EngCyl10CombustionStatus 3396;
BA_ "SigType" SG_ 3221225472 EngCyl10CombustionStatus 5;
BA_ "SAEDocument" SG_ 3221225472 EngCyl9CombustionStatus "J1939-71";
BA_ "SPN" SG_ 3221225472 EngCyl9CombustionStatus 3395;
BA_ "SigType" SG_ 3221225472 EngCyl9CombustionStatus 5;
BA_ "SAEDocument" SG_ 3221225472 EngCyl8CombustionStatus "J1939-71";
BA_ "SPN" SG_ 3221225472 EngCyl8CombustionStatus 3394;
BA_ "SigType" SG_ 3221225472 EngCyl8CombustionStatus 5;
BA_ "SAEDocument" SG_ 3221225472 EngCyl7CombustionStatus "J1939-71";
BA_ "SPN" SG_ 3221225472 EngCyl7CombustionStatus 3393;
BA_ "SigType" SG_ 3221225472 EngCyl7CombustionStatus 5;
BA_ "SAEDocument" SG_ 3221225472 EngCyl6CombustionStatus "J1939-71";
BA_ "SPN" SG_ 3221225472 EngCyl6CombustionStatus 3392;
BA_ "SigType" SG_ 3221225472 EngCyl6CombustionStatus 5;
BA_ "SAEDocument" SG_ 3221225472 EngCyl5CombustionStatus "J1939-71";
BA_ "SPN" SG_ 3221225472 EngCyl5CombustionStatus 3391;
BA_ "SigType" SG_ 3221225472 EngCyl5CombustionStatus 5;
BA_ "SAEDocument" SG_ 3221225472 EngCyl4CombustionStatus "J1939-71";
BA_ "SPN" SG_ 3221225472 EngCyl4CombustionStatus 3390;
BA_ "SigType" SG_ 3221225472 EngCyl4CombustionStatus 5;
BA_ "SAEDocument" SG_ 3221225472 EngCyl3CombustionStatus "J1939-71";
BA_ "SPN" SG_ 3221225472 EngCyl3CombustionStatus 3389;
BA_ "SigType" SG_ 3221225472 EngCyl3CombustionStatus 5;
BA_ "SAEDocument" SG_ 3221225472 EngCyl2CombustionStatus "J1939-71";
BA_ "SPN" SG_ 3221225472 EngCyl2CombustionStatus 3388;
BA_ "SigType" SG_ 3221225472 EngCyl2CombustionStatus 5;
BA_ "SAEDocument" SG_ 3221225472 EngCyl1CombustionStatus "J1939-71";
BA_ "SPN" SG_ 3221225472 EngCyl1CombustionStatus 3387;
BA_ "SigType" SG_ 3221225472 EngCyl1CombustionStatus 5;
BA_ "SAEDocument" SG_ 3221225472 RqGenOverallPowerFactorLagging "J1939-75";
BA_ "SPN" SG_ 3221225472 RqGenOverallPowerFactorLagging 3385;
BA_ "SigType" SG_ 3221225472 RqGenOverallPowerFactorLagging 4;
BA_ "SAEDocument" SG_ 3221225472 RqGeneratorOverallPowerFactor "J1939-75";
BA_ "SPN" SG_ 3221225472 RqGeneratorOverallPowerFactor 3384;
BA_ "SigType" SG_ 3221225472 RqGeneratorOverallPowerFactor 1;
BA_ "SAEDocument" SG_ 3221225472 RqGeneratorTotalACReactivePower "J1939-75";
BA_ "SPN" SG_ 3221225472 RqGeneratorTotalACReactivePower 3383;
BA_ "SigType" SG_ 3221225472 RqGeneratorTotalACReactivePower 1;
BA_ "SAEDocument" SG_ 3221225472 BladeRotationAngleFigureOfMerit "J1939-71";
BA_ "SPN" SG_ 3221225472 BladeRotationAngleFigureOfMerit 3332;
BA_ "SigType" SG_ 3221225472 BladeRotationAngleFigureOfMerit 5;
BA_ "SAEDocument" SG_ 3221225472 RelativeBladeHeightFigureOfMerit "J1939-71";
BA_ "SPN" SG_ 3221225472 RelativeBladeHeightFigureOfMerit 3367;
BA_ "SigType" SG_ 3221225472 RelativeBladeHeightFigureOfMerit 5;
BA_ "SAEDocument" SG_ 3221225472 RltvBldHghtAndBldRttnAnglMsrmntL "J1939-71";
BA_ "SPN" SG_ 3221225472 RltvBldHghtAndBldRttnAnglMsrmntL 3366;
BA_ "SigType" SG_ 3221225472 RltvBldHghtAndBldRttnAnglMsrmntL 1;
BA_ "SAEDocument" SG_ 3221225472 BladeRotationAngle "J1939-71";
BA_ "SPN" SG_ 3221225472 BladeRotationAngle 3331;
BA_ "SigType" SG_ 3221225472 BladeRotationAngle 1;
BA_ "SAEDocument" SG_ 3221225472 RelativeBladeHeight "J1939-71";
BA_ "SPN" SG_ 3221225472 RelativeBladeHeight 3365;
BA_ "SigType" SG_ 3221225472 RelativeBladeHeight 1;
BA_ "SAEDocument" SG_ 3221225472 RetarderDemandValue "ISO11992";
BA_ "SAEDocument" SG_ 3221225472 ParkBrakeDemandValue "ISO11992";
BA_ "SAEDocument" SG_ 3221225472 ServiceBrakeDemandValue "ISO11992";
BA_ "SAEDocument" SG_ 3221225472 VehicleType "ISO11992";
BA_ "SAEDocument" SG_ 3221225472 BrakeLightSwitch "ISO11992";
BA_ "SigType" SG_ 3221225472 BrakeLightSwitch 4;
BA_ "SAEDocument" SG_ 3221225472 ASREngineControlActive "ISO11992";
BA_ "SigType" SG_ 3221225472 ASREngineControlActive 4;
BA_ "SAEDocument" SG_ 3221225472 ASRBreakControlActive "ISO11992";
BA_ "SigType" SG_ 3221225472 ASRBreakControlActive 4;
BA_ "SAEDocument" SG_ 3221225472 VehicleRetarderCtrlActive "ISO11992";
BA_ "SigType" SG_ 3221225472 VehicleRetarderCtrlActive 4;
BA_ "SAEDocument" SG_ 3221225472 VehicleABSActive "ISO11992";
BA_ "SigType" SG_ 3221225472 VehicleABSActive 4;
BA_ "SAEDocument" SG_ 3221225472 RoadCurvature "J1939-71";
BA_ "SPN" SG_ 3221225472 RoadCurvature 1591;
BA_ "SAEDocument" SG_ 3221225472 PneumaticControlLine "ISO11992";
BA_ "SigType" SG_ 3221225472 PneumaticControlLine 4;
BA_ "SAEDocument" SG_ 3221225472 ABSOffroadRequest "ISO11992";
BA_ "SigType" SG_ 3221225472 ABSOffroadRequest 4;
BA_ "SAEDocument" SG_ 3221225472 TwoElCircuitsBrakeDemand "ISO11992";
BA_ "SigType" SG_ 3221225472 TwoElCircuitsBrakeDemand 4;
BA_ "SAEDocument" SG_ 3221225472 WheelSpeedDiffMainAxle "ISO11992";
BA_ "SAEDocument" SG_ 3221225472 ActualRetarderPercTorque "ISO11992";
BA_ "SigType" SG_ 3221225472 ActualRetarderPercTorque 1;
BA_ "SAEDocument" SG_ 3221225472 Wheel_BasedVehicleSpeed "ISO11992";
BA_ "SigType" SG_ 3221225472 Wheel_BasedVehicleSpeed 1;
BA_ "SAEDocument" SG_ 3221225472 SupplyLineBrakingRequest "ISO11992";
BA_ "SigType" SG_ 3221225472 SupplyLineBrakingRequest 4;
BA_ "SAEDocument" SG_ 3221225472 VDCActive "ISO11992";
BA_ "SigType" SG_ 3221225472 VDCActive 4;
BA_ "SAEDocument" SG_ 3221225472 AutomTowedVehBreakActive "ISO11992";
BA_ "SigType" SG_ 3221225472 AutomTowedVehBreakActive 4;
BA_ "SAEDocument" SG_ 3221225472 VehicleServiceBrakeActive "ISO11992";
BA_ "SigType" SG_ 3221225472 VehicleServiceBrakeActive 4;
BA_ "SAEDocument" SG_ 3221225472 ReferenceRetarderTorque "J1939-71";
BA_ "SPN" SG_ 3221225472 ReferenceRetarderTorque 556;
BA_ "SigType" SG_ 3221225472 ReferenceRetarderTorque 1;
BA_ "SAEDocument" SG_ 3221225472 AxleLoadSum "ISO11992";
BA_ "SAEDocument" SG_ 3221225472 LoadingRampApproachAssist "ISO11992";
BA_ "SigType" SG_ 3221225472 LoadingRampApproachAssist 4;
BA_ "SAEDocument" SG_ 3221225472 SpringBrakeEngaged "ISO11992";
BA_ "SigType" SG_ 3221225472 SpringBrakeEngaged 4;
BA_ "SAEDocument" SG_ 3221225472 ElectrLoadPropFunc "ISO11992";
BA_ "SigType" SG_ 3221225472 ElectrLoadPropFunc 4;
BA_ "SAEDocument" SG_ 3221225472 SpringBrakeInstalled "ISO11992";
BA_ "SigType" SG_ 3221225472 SpringBrakeInstalled 4;
BA_ "SAEDocument" SG_ 3221225472 ElecSupplyOfNonBrakingSys "ISO11992";
BA_ "SigType" SG_ 3221225472 ElecSupplyOfNonBrakingSys 4;
BA_ "SAEDocument" SG_ 3221225472 AmberWarningSignalReq "ISO11992";
BA_ "SigType" SG_ 3221225472 AmberWarningSignalReq 4;
BA_ "SAEDocument" SG_ 3221225472 RedWarningSignalRequest "ISO11992";
BA_ "SigType" SG_ 3221225472 RedWarningSignalRequest 4;
BA_ "SAEDocument" SG_ 3221225472 VehicleElectrSupplySuff "ISO11992";
BA_ "SigType" SG_ 3221225472 VehicleElectrSupplySuff 4;
BA_ "SAEDocument" SG_ 3221225472 PneumaticSupplyPressure "ISO11992";
BA_ "SAEDocument" SG_ 3221225472 BrakeTemperature "ISO11992";
BA_ "SAEDocument" SG_ 3221225472 BrakeLining "ISO11992";
BA_ "SAEDocument" SG_ 3221225472 TyrePressure "ISO11992";
BA_ "SAEDocument" SG_ 3221225472 TyreWheelIdentTemp2 "ISO11992";
BA_ "SAEDocument" SG_ 3221225472 TyreWheelIdentTemp1 "ISO11992";
BA_ "SAEDocument" SG_ 3221225472 TyreWheelIdentPressure2 "ISO11992";
BA_ "SAEDocument" SG_ 3221225472 TyreWheelIdentPressure1 "ISO11992";
BA_ "SAEDocument" SG_ 3221225472 TyreWheelIdentLining2 "ISO11992";
BA_ "SAEDocument" SG_ 3221225472 TyreWheelIdentLining1 "ISO11992";
BA_ "SAEDocument" SG_ 3221225472 VehiclePneumSupplySuff "ISO11992";
BA_ "SigType" SG_ 3221225472 VehiclePneumSupplySuff 4;
BA_ "SAEDocument" SG_ 3221225472 BrakeTemperatureStatus "ISO11992";
BA_ "SigType" SG_ 3221225472 BrakeTemperatureStatus 4;
BA_ "SAEDocument" SG_ 3221225472 BrakeLiningSufficient "ISO11992";
BA_ "SigType" SG_ 3221225472 BrakeLiningSufficient 4;
BA_ "SAEDocument" SG_ 3221225472 TyrePressureSufficient "ISO11992";
BA_ "SigType" SG_ 3221225472 TyrePressureSufficient 4;
BA_ "SAEDocument" SG_ 3221225472 ODDRequest "ISO11992";
BA_ "SigType" SG_ 3221225472 ODDRequest 4;
BA_ "SAEDocument" SG_ 3221225472 AntiTheftDeviceReq "ISO11992";
BA_ "SigType" SG_ 3221225472 AntiTheftDeviceReq 4;
BA_ "SAEDocument" SG_ 3221225472 MaxVehicleSpeedLimit "J1939-71";
BA_ "SPN" SG_ 3221225472 MaxVehicleSpeedLimit 74;
BA_ "SigType" SG_ 3221225472 MaxVehicleSpeedLimit 1;
BA_ "SAEDocument" SG_ 3221225472 EngineSpeedUpperLimit "ISO11992";
BA_ "SAEDocument" SG_ 3221225472 EngineSpeedLowerLimit "ISO11992";
BA_ "SAEDocument" SG_ 3221225472 EngineTorqueMode "ISO11992";
BA_ "SAEDocument" SG_ 3221225472 VehicleSpeed "ISO11992";
BA_ "SigType" SG_ 3221225472 VehicleSpeed 1;
BA_ "SAEDocument" SG_ 3221225472 PercentLoadAtCurrentSpeed "ISO11992";
BA_ "SigType" SG_ 3221225472 PercentLoadAtCurrentSpeed 1;
BA_ "SAEDocument" SG_ 3221225472 EngineSpeed "ISO11992";
BA_ "SigType" SG_ 3221225472 EngineSpeed 1;
BA_ "SAEDocument" SG_ 3221225472 ActualEngine_PercTorque "ISO11992";
BA_ "SigType" SG_ 3221225472 ActualEngine_PercTorque 1;
BA_ "SAEDocument" SG_ 3221225472 DriversDemandEngine_PercTorque "ISO11992";
BA_ "SigType" SG_ 3221225472 DriversDemandEngine_PercTorque 1;
BA_ "SAEDocument" SG_ 3221225472 EngineRunning "ISO11992";
BA_ "SigType" SG_ 3221225472 EngineRunning 4;
BA_ "SAEDocument" SG_ 3221225472 EngineControlAllowed "ISO11992";
BA_ "SigType" SG_ 3221225472 EngineControlAllowed 4;
BA_ "SAEDocument" SG_ 3221225472 ClutchIndptdPTOFeedback "ISO11992";
BA_ "SigType" SG_ 3221225472 ClutchIndptdPTOFeedback 4;
BA_ "SAEDocument" SG_ 3221225472 AccelPedalPosition "ISO11992";
BA_ "SigType" SG_ 3221225472 AccelPedalPosition 1;
BA_ "SAEDocument" SG_ 3221225472 AccelPedalLowIdleSwitch "ISO11992";
BA_ "SigType" SG_ 3221225472 AccelPedalLowIdleSwitch 4;
BA_ "SAEDocument" SG_ 3221225472 StarterActive "ISO11992";
BA_ "SigType" SG_ 3221225472 StarterActive 4;
BA_ "SAEDocument" SG_ 3221225472 TorqueConvOilTemp "ISO11992";
BA_ "SAEDocument" SG_ 3221225472 TorqueConvtOilTempWarning "ISO11992";
BA_ "SAEDocument" SG_ 3221225472 PTOControlAllowed "ISO11992";
BA_ "SigType" SG_ 3221225472 PTOControlAllowed 4;
BA_ "SAEDocument" SG_ 3221225472 SecEngineMtdPTOFeedback "ISO11992";
BA_ "SigType" SG_ 3221225472 SecEngineMtdPTOFeedback 4;
BA_ "SAEDocument" SG_ 3221225472 FirstEngineMtdPTOFeedback "ISO11992";
BA_ "SigType" SG_ 3221225472 FirstEngineMtdPTOFeedback 4;
BA_ "SAEDocument" SG_ 3221225472 SecClutchDptdPTOFeedback "ISO11992";
BA_ "SigType" SG_ 3221225472 SecClutchDptdPTOFeedback 4;
BA_ "SAEDocument" SG_ 3221225472 FirstClutchDpdtPTOFeedback "ISO11992";
BA_ "SigType" SG_ 3221225472 FirstClutchDpdtPTOFeedback 4;
BA_ "SAEDocument" SG_ 3221225472 CurrentGear "ISO11992";
BA_ "SigType" SG_ 3221225472 CurrentGear 1;
BA_ "SAEDocument" SG_ 3221225472 PercentClutchSlip "J1939-71";
BA_ "SPN" SG_ 3221225472 PercentClutchSlip 522;
BA_ "SigType" SG_ 3221225472 PercentClutchSlip 1;
BA_ "SAEDocument" SG_ 3221225472 ReferenceEngineTorque "ISO11992";
BA_ "SigType" SG_ 3221225472 ReferenceEngineTorque 1;
BA_ "SAEDocument" SG_ 3221225472 FuelLevelWarning "ISO11992";
BA_ "SigType" SG_ 3221225472 FuelLevelWarning 4;
BA_ "SAEDocument" SG_ 3221225472 EngineOilPressureWarning "ISO11992";
BA_ "SigType" SG_ 3221225472 EngineOilPressureWarning 4;
BA_ "SAEDocument" SG_ 3221225472 EngineCoolantTempWarning "ISO11992";
BA_ "SAEDocument" SG_ 3221225472 EngineOilPressure "ISO11992";
BA_ "SigType" SG_ 3221225472 EngineOilPressure 1;
BA_ "SAEDocument" SG_ 3221225472 EngCoolantTemp "J1939-71";
BA_ "SPN" SG_ 3221225472 EngCoolantTemp 110;
BA_ "SigType" SG_ 3221225472 EngCoolantTemp 1;
BA_ "SAEDocument" SG_ 3221225472 EngineOilTemperature "ISO11992";
BA_ "SigType" SG_ 3221225472 EngineOilTemperature 1;
BA_ "SAEDocument" SG_ 3221225472 AmbientAirTemperature "ISO11992";
BA_ "SigType" SG_ 3221225472 AmbientAirTemperature 1;
BA_ "SAEDocument" SG_ 3221225472 BodyPressure "ISO11992";
BA_ "SAEDocument" SG_ 3221225472 BodyFluidLevel "ISO11992";
BA_ "SAEDocument" SG_ 3221225472 ThermalBodyTemperature "ISO11992";
BA_ "SAEDocument" SG_ 3221225472 RearObstacleDistance "ISO11992";
BA_ "SAEDocument" SG_ 3221225472 AntiTheftDeviceStatus "ISO11992";
BA_ "SigType" SG_ 3221225472 AntiTheftDeviceStatus 4;
BA_ "SAEDocument" SG_ 3221225472 ODDStatus "ISO11992";
BA_ "SigType" SG_ 3221225472 ODDStatus 4;
BA_ "SAEDocument" SG_ 3221225472 ReqEngineSpeedUpperLim "ISO11992";
BA_ "SAEDocument" SG_ 3221225472 ReqEngineSpeedLowerLim "ISO11992";
BA_ "SAEDocument" SG_ 3221225472 ReqEngineTorqueLimit "ISO11992";
BA_ "SAEDocument" SG_ 3221225472 ReqEngineSpeedLimit "ISO11992";
BA_ "SAEDocument" SG_ 3221225472 ReqEngineSpeed "ISO11992";
BA_ "SAEDocument" SG_ 3221225472 SecEngineMtdPTOSwitch "ISO11992";
BA_ "SigType" SG_ 3221225472 SecEngineMtdPTOSwitch 4;
BA_ "SAEDocument" SG_ 3221225472 SecClutchDpdtPTOSwitch "ISO11992";
BA_ "SigType" SG_ 3221225472 SecClutchDpdtPTOSwitch 4;
BA_ "SAEDocument" SG_ 3221225472 FirstClutchDpdtPTOSwitch "ISO11992";
BA_ "SigType" SG_ 3221225472 FirstClutchDpdtPTOSwitch 4;
BA_ "SAEDocument" SG_ 3221225472 OperatingPanelActive "ISO11992";
BA_ "SigType" SG_ 3221225472 OperatingPanelActive 4;
BA_ "SAEDocument" SG_ 3221225472 RefusePackerStepSwitch "ISO11992";
BA_ "SigType" SG_ 3221225472 RefusePackerStepSwitch 4;
BA_ "SAEDocument" SG_ 3221225472 EngineStopSwitch "ISO11992";
BA_ "SigType" SG_ 3221225472 EngineStopSwitch 4;
BA_ "SAEDocument" SG_ 3221225472 EngineStartSwitch "ISO11992";
BA_ "SigType" SG_ 3221225472 EngineStartSwitch 4;
BA_ "SAEDocument" SG_ 3221225472 StarterLockoutSwitch "ISO11992";
BA_ "SigType" SG_ 3221225472 StarterLockoutSwitch 4;
BA_ "SAEDocument" SG_ 3221225472 RqstedPercentClutchSlip "ISO11992";
BA_ "SigType" SG_ 3221225472 RqstedPercentClutchSlip 1;
BA_ "SAEDocument" SG_ 3221225472 FirstEngineMtdPTOSwitch "ISO11992";
BA_ "SigType" SG_ 3221225472 FirstEngineMtdPTOSwitch 4;
BA_ "SAEDocument" SG_ 3221225472 ClutchIndpdtPTOSwitch "ISO11992";
BA_ "SigType" SG_ 3221225472 ClutchIndpdtPTOSwitch 4;
BA_ "SAEDocument" SG_ 3221225472 TrailerLeftSideMarkerLight "ISO11992";
BA_ "SigType" SG_ 3221225472 TrailerLeftSideMarkerLight 4;
BA_ "SAEDocument" SG_ 3221225472 TrailerLeftReversingLight "ISO11992";
BA_ "SigType" SG_ 3221225472 TrailerLeftReversingLight 4;
BA_ "SAEDocument" SG_ 3221225472 TrailerLeftRearWidIndLight "ISO11992";
BA_ "SigType" SG_ 3221225472 TrailerLeftRearWidIndLight 4;
BA_ "SAEDocument" SG_ 3221225472 TrailerLeftRearRegPltLight "ISO11992";
BA_ "SigType" SG_ 3221225472 TrailerLeftRearRegPltLight 4;
BA_ "SAEDocument" SG_ 3221225472 TrailerLeftRearLight "ISO11992";
BA_ "SigType" SG_ 3221225472 TrailerLeftRearLight 4;
BA_ "SAEDocument" SG_ 3221225472 TrailerLeftRearFogLight "ISO11992";
BA_ "SigType" SG_ 3221225472 TrailerLeftRearFogLight 4;
BA_ "SAEDocument" SG_ 3221225472 TrailerLeftDirIndLight "ISO11992";
BA_ "SigType" SG_ 3221225472 TrailerLeftDirIndLight 4;
BA_ "SAEDocument" SG_ 3221225472 TrailerLeftCrnMarkerLight "ISO11992";
BA_ "SigType" SG_ 3221225472 TrailerLeftCrnMarkerLight 4;
BA_ "SAEDocument" SG_ 3221225472 TrailerInteriorLight "ISO11992";
BA_ "SigType" SG_ 3221225472 TrailerInteriorLight 4;
BA_ "SAEDocument" SG_ 3221225472 TrailerWorkLamp "ISO11992";
BA_ "SigType" SG_ 3221225472 TrailerWorkLamp 4;
BA_ "SAEDocument" SG_ 3221225472 TrailerRotatingIdentLight "ISO11992";
BA_ "SigType" SG_ 3221225472 TrailerRotatingIdentLight 4;
BA_ "SAEDocument" SG_ 3221225472 TrailerRightStopLight "ISO11992";
BA_ "SigType" SG_ 3221225472 TrailerRightStopLight 4;
BA_ "SAEDocument" SG_ 3221225472 TrailerRightSideMrkLight "ISO11992";
BA_ "SigType" SG_ 3221225472 TrailerRightSideMrkLight 4;
BA_ "SAEDocument" SG_ 3221225472 TrailerRightReversingLight "ISO11992";
BA_ "SigType" SG_ 3221225472 TrailerRightReversingLight 4;
BA_ "SAEDocument" SG_ 3221225472 TrailRightRearWidIndLight "ISO11992";
BA_ "SigType" SG_ 3221225472 TrailRightRearWidIndLight 4;
BA_ "SAEDocument" SG_ 3221225472 TrailerRightRearRegPltLight "ISO11992";
BA_ "SigType" SG_ 3221225472 TrailerRightRearRegPltLight 4;
BA_ "SAEDocument" SG_ 3221225472 TrailerRightRearLight "ISO11992";
BA_ "SigType" SG_ 3221225472 TrailerRightRearLight 4;
BA_ "SAEDocument" SG_ 3221225472 TrailerRightRearFogLight "ISO11992";
BA_ "SigType" SG_ 3221225472 TrailerRightRearFogLight 4;
BA_ "SAEDocument" SG_ 3221225472 TrailerRightDirIndLight "ISO11992";
BA_ "SigType" SG_ 3221225472 TrailerRightDirIndLight 4;
BA_ "SAEDocument" SG_ 3221225472 TrailerRightCrnMarkerLight "ISO11992";
BA_ "SigType" SG_ 3221225472 TrailerRightCrnMarkerLight 4;
BA_ "SAEDocument" SG_ 3221225472 TrailerRearWarningLight "ISO11992";
BA_ "SigType" SG_ 3221225472 TrailerRearWarningLight 4;
BA_ "SAEDocument" SG_ 3221225472 TrailerLeftStopLight "ISO11992";
BA_ "SigType" SG_ 3221225472 TrailerLeftStopLight 4;
BA_ "SAEDocument" SG_ 3221225472 SN "ISO15765";
BA_ "SAEDocument" SG_ 3221225472 SeparationTime "ISO15765";
BA_ "SAEDocument" SG_ 3221225472 BlockSize "ISO15765";
BA_ "SAEDocument" SG_ 3221225472 FlowStatus "ISO15765";
BA_ "SAEDocument" SG_ 3221225472 FirstFrameDataLength "ISO15765";
BA_ "SAEDocument" SG_ 3221225472 SingleFrameDataLength "ISO15765";
BA_ "SAEDocument" SG_ 3221225472 ProtocolCtrlInformation "ISO15765";
BA_ "SPN" SG_ 3221225472 ControlByte 2541;
BA_ "SAEDocument" SG_ 3221225472 ControlByte "J1939-21";
BA_ "SigType" SG_ 3221225472 ControlByte 1;
BA_ "SAEDocument" SG_ 3221225472 FilterMode "J1939-71";
BA_ "SigType" SG_ 3221225472 FilterMode 1;
BA_ "SAEDocument" SG_ 3221225472 ToPort "J1939-71";
BA_ "SAEDocument" SG_ 3221225472 FromPort "J1939-71";
BA_ "SAEDocument" SG_ 3221225472 ParkingAndTrailerAirPress "ISO15765";
BA_ "SigType" SG_ 3221225472 ParkingAndTrailerAirPress 1;
BA_ "SAEDocument" SG_ 3221225472 DrivenAxleLoad "ISO15765";
BA_ "SAEDocument" SG_ 3221225472 AuxEquipSupplyPressure "ISO15765";
BA_ "SigType" SG_ 3221225472 AuxEquipSupplyPressure 1;
BA_ "SAEDocument" SG_ 3221225472 StopLevelChangeReq "ISO15765";
BA_ "SigType" SG_ 3221225472 StopLevelChangeReq 4;
BA_ "SAEDocument" SG_ 3221225472 RampLevelStorageReq "ISO15765";
BA_ "SigType" SG_ 3221225472 RampLevelStorageReq 4;
BA_ "SAEDocument" SG_ 3221225472 LevelControlReq "ISO15765";
BA_ "SigType" SG_ 3221225472 LevelControlReq 4;
BA_ "SAEDocument" SG_ 3221225472 RampLevelReq "ISO15765";
BA_ "SigType" SG_ 3221225472 RampLevelReq 4;
BA_ "SAEDocument" SG_ 3221225472 SteeringAxleLockingReq "ISO15765";
BA_ "SigType" SG_ 3221225472 SteeringAxleLockingReq 4;
BA_ "SAEDocument" SG_ 3221225472 LiftAxle2PositionReq "ISO15765";
BA_ "SigType" SG_ 3221225472 LiftAxle2PositionReq 4;
BA_ "SAEDocument" SG_ 3221225472 LiftAxle1PositionReq "ISO15765";
BA_ "SigType" SG_ 3221225472 LiftAxle1PositionReq 4;
BA_ "SAEDocument" SG_ 3221225472 TractionHelpReq "ISO15765";
BA_ "SigType" SG_ 3221225472 TractionHelpReq 4;
BA_ "SAEDocument" SG_ 3221225472 LevelChangeReqRearAxle "ISO15765";
BA_ "SigType" SG_ 3221225472 LevelChangeReqRearAxle 4;
BA_ "SAEDocument" SG_ 3221225472 LevelChangeReqFrontAxle "ISO15765";
BA_ "SigType" SG_ 3221225472 LevelChangeReqFrontAxle 4;
BA_ "SAEDocument" SG_ 3221225472 RideHeightRequest "ISO15765";
BA_ "SigType" SG_ 3221225472 RideHeightRequest 4;
BA_ "SAEDocument" SG_ 3221225472 LevelControl "ISO15765";
BA_ "SigType" SG_ 3221225472 LevelControl 4;
BA_ "SAEDocument" SG_ 3221225472 NominalVehBodyLevelRearAxle "ISO15765";
BA_ "SAEDocument" SG_ 3221225472 NominalVehBodyLevelFrontAxle "ISO15765";
BA_ "SAEDocument" SG_ 3221225472 RampLevel "ISO15765";
BA_ "SigType" SG_ 3221225472 RampLevel 4;
BA_ "SAEDocument" SG_ 3221225472 NormalLevel "ISO15765";
BA_ "SigType" SG_ 3221225472 NormalLevel 4;
BA_ "SAEDocument" SG_ 3221225472 StopLevelChangeAcknowledge "ISO15765";
BA_ "SigType" SG_ 3221225472 StopLevelChangeAcknowledge 4;
BA_ "SAEDocument" SG_ 3221225472 LevelChangeRearAxle "ISO15765";
BA_ "SigType" SG_ 3221225472 LevelChangeRearAxle 4;
BA_ "SAEDocument" SG_ 3221225472 LevelChangeFrontAxle "ISO15765";
BA_ "SigType" SG_ 3221225472 LevelChangeFrontAxle 4;
BA_ "SAEDocument" SG_ 3221225472 RampLevelStorage "ISO15765";
BA_ "SigType" SG_ 3221225472 RampLevelStorage 4;
BA_ "SAEDocument" SG_ 3221225472 SteeringAxleLocking "ISO15765";
BA_ "SigType" SG_ 3221225472 SteeringAxleLocking 4;
BA_ "SAEDocument" SG_ 3221225472 LiftAxle2Pos "J1939-71";
BA_ "SPN" SG_ 3221225472 LiftAxle2Pos 1822;
BA_ "SigType" SG_ 3221225472 LiftAxle2Pos 4;
BA_ "SAEDocument" SG_ 3221225472 LiftAxle1Pos "J1939-71";
BA_ "SPN" SG_ 3221225472 LiftAxle1Pos 1743;
BA_ "SigType" SG_ 3221225472 LiftAxle1Pos 4;
BA_ "SAEDocument" SG_ 3221225472 RampLevelPosition "ISO15765";
BA_ "SigType" SG_ 3221225472 RampLevelPosition 4;
BA_ "SAEDocument" SG_ 3221225472 TractionHelp "ISO15765";
BA_ "SigType" SG_ 3221225472 TractionHelp 4;
BA_ "SAEDocument" SG_ 3221225472 LevelCtrlSysRideHeightLevel "ISO15765";
BA_ "SigType" SG_ 3221225472 LevelCtrlSysRideHeightLevel 4;
BA_ "SAEDocument" SG_ 3221225472 RelVehBodyLevelRearAxle "ISO11992";
BA_ "SAEDocument" SG_ 3221225472 RelVehBodyLevelFrontAxle "ISO11992";
BA_ "SAEDocument" SG_ 3221225472 TyrePressThresholdDetect "ISO11992";
BA_ "SAEDocument" SG_ 3221225472 TyreModulePowerSupply "ISO11992";
BA_ "SigType" SG_ 3221225472 TyreModulePowerSupply 4;
BA_ "SAEDocument" SG_ 3221225472 TyreTemperature "ISO11992";
BA_ "SAEDocument" SG_ 3221225472 AirLeakageDetection "ISO11992";
BA_ "SAEDocument" SG_ 3221225472 TyreWheelIdentification2 "ISO11992";
BA_ "SAEDocument" SG_ 3221225472 TyreWheelIdentification1 "ISO11992";
BA_ "SystemSignalLongSymbol" SG_ 3221225472 NOxConvertingCatalystAdsorberCom "NOxConvertingCatalystAdsorberCompleted";
BA_ "SystemSignalLongSymbol" SG_ 3221225472 NOxConvertingCatalystAdsorberEna "NOxConvertingCatalystAdsorberEnabled";
BA_ "SystemSignalLongSymbol" SG_ 3221225472 BoostPressureControlSystemComple "BoostPressureControlSystemCompleted";
BA_ "SystemSignalLongSymbol" SG_ 3221225472 BoostPressureControlSystemEnable "BoostPressureControlSystemEnabled";
BA_ "SAEDocument" SG_ 3221225472 MisfireMonitoringComplete "J1939-73";
BA_ "SAEDocument" SG_ 3221225472 MisfireMonitoringEnabled "J1939-73";
BA_ "SAEDocument" SG_ 3221225472 FuelSystemMonitoringEnabled "J1939-73";
BA_ "SAEDocument" SG_ 3221225472 ComprehensiveComptMonComplete "J1939-73";
BA_ "SAEDocument" SG_ 3221225472 ComprehensiveCompMonEnabled "J1939-73";
BA_ "SAEDocument" SG_ 3221225472 SecondAirSystemMonComplete "J1939-73";
BA_ "SAEDocument" SG_ 3221225472 SecondAirSystemMonEnabled "J1939-73";
BA_ "SAEDocument" SG_ 3221225472 OxygenSensorMonComplete "J1939-73";
BA_ "SAEDocument" SG_ 3221225472 OxygenSensorMonEnabled "J1939-73";
BA_ "SAEDocument" SG_ 3221225472 OxygenSensorHeaterMonComplete "J1939-73";
BA_ "SAEDocument" SG_ 3221225472 OxygenSensorHeaterMonEnabled "J1939-73";
BA_ "SAEDocument" SG_ 3221225472 HeatedCatalystMonComplete "J1939-73";
BA_ "SAEDocument" SG_ 3221225472 HeatedCatalystMonEnabled "J1939-73";
BA_ "SAEDocument" SG_ 3221225472 EvaporativeSystemMonComplete "J1939-73";
BA_ "SAEDocument" SG_ 3221225472 EvaporativeSystemMonEnabled "J1939-73";
BA_ "SAEDocument" SG_ 3221225472 EGRSystemMonitoringComplete "J1939-73";
BA_ "SAEDocument" SG_ 3221225472 EGRSystemMonitoringEnabled "J1939-73";
BA_ "SAEDocument" SG_ 3221225472 ColdStartAidSystemMonComplete "J1939-73";
BA_ "SAEDocument" SG_ 3221225472 ColdStartAidSystemMonEnabled "J1939-73";
BA_ "SAEDocument" SG_ 3221225472 CatalystMonComplete "J1939-73";
BA_ "SAEDocument" SG_ 3221225472 CatalystMonEnabled "J1939-73";
BA_ "SAEDocument" SG_ 3221225472 ACSystemRefrigerantMonComplete "J1939-73";
BA_ "SAEDocument" SG_ 3221225472 ACSystemRefrigerantMonEnabled "J1939-73";
BA_ "SAEDocument" SG_ 3221225472 FuelSystemMonitoringComplete "J1939-73";
BA_ "SAEDocument" SG_ 3221225472 NumOfWarmUpsSinceDTCsCleared "J1939-73";
BA_ "SPN" SG_ 3221225472 NumOfWarmUpsSinceDTCsCleared 3302;
BA_ "SAEDocument" SG_ 3221225472 TimeSinceEngineStart "J1939-73";
BA_ "SPN" SG_ 3221225472 TimeSinceEngineStart 3301;
BA_ "SAEDocument" SG_ 3221225472 SecurityEntityLengthHigh "J1939-73";
BA_ "SAEDocument" SG_ 3221225472 SecurityEntityType "J1939-73";
BA_ "SPN" SG_ 3221225472 SecurityEntityType 1479;
BA_ "SAEDocument" SG_ 3221225472 SecurityEntityLength "J1939-73";
BA_ "SPN" SG_ 3221225472 SecurityEntityLength 1596;
BA_ "SAEDocument" SG_ 3221225472 XBRMessageChecksum "J1939-71";
BA_ "SPN" SG_ 3221225472 XBRMessageChecksum 3188;
BA_ "SAEDocument" SG_ 3221225472 XBRMessageCounter "J1939-71";
BA_ "SPN" SG_ 3221225472 XBRMessageCounter 3189;
BA_ "SAEDocument" SG_ 3221225472 XBRUrgency "J1939-71";
BA_ "SPN" SG_ 3221225472 XBRUrgency 4099;
BA_ "SAEDocument" SG_ 3221225472 XBRCtrlMode "J1939-71";
BA_ "SPN" SG_ 3221225472 XBRCtrlMode 2916;
BA_ "SigType" SG_ 3221225472 XBRCtrlMode 5;
BA_ "SAEDocument" SG_ 3221225472 XBRPriority "J1939-71";
BA_ "SPN" SG_ 3221225472 XBRPriority 2915;
BA_ "SigType" SG_ 3221225472 XBRPriority 5;
BA_ "SAEDocument" SG_ 3221225472 XBREBIMode "J1939-71";
BA_ "SPN" SG_ 3221225472 XBREBIMode 2914;
BA_ "SigType" SG_ 3221225472 XBREBIMode 5;
BA_ "SAEDocument" SG_ 3221225472 ExtlAccelerationDemand "J1939-71";
BA_ "SPN" SG_ 3221225472 ExtlAccelerationDemand 2920;
BA_ "SAEDocument" SG_ 3221225472 WaterInFuelIndicator "J1939-71";
BA_ "SPN" SG_ 3221225472 WaterInFuelIndicator 97;
BA_ "SigType" SG_ 3221225472 WaterInFuelIndicator 4;
BA_ "SAEDocument" SG_ 3221225472 AxleLocation "J1939-71";
BA_ "SPN" SG_ 3221225472 AxleLocation 2928;
BA_ "SigType" SG_ 3221225472 AxleLocation 1;
BA_ "SPN" SG_ 3221225472 CargoWeight_30 522230;
BA_ "SigType" SG_ 3221225472 CargoWeight_30 1;
BA_ "SPN" SG_ 3221225472 CargoWeight_20 522220;
BA_ "SigType" SG_ 3221225472 CargoWeight_20 1;
BA_ "SPN" SG_ 3221225472 CargoWeight_10 522210;
BA_ "SigType" SG_ 3221225472 CargoWeight_10 1;
BA_ "SPN" SG_ 3221225472 CargoWeight_00 522200;
BA_ "SigType" SG_ 3221225472 CargoWeight_00 1;
BA_ "SPN" SG_ 3221225472 TrailerWeight_30 522130;
BA_ "SigType" SG_ 3221225472 TrailerWeight_30 1;
BA_ "SPN" SG_ 3221225472 TrailerWeight_20 522120;
BA_ "SigType" SG_ 3221225472 TrailerWeight_20 1;
BA_ "SPN" SG_ 3221225472 TrailerWeight_10 522110;
BA_ "SigType" SG_ 3221225472 TrailerWeight_10 1;
BA_ "SPN" SG_ 3221225472 TrailerWeight_00 522100;
BA_ "SigType" SG_ 3221225472 TrailerWeight_00 1;
BA_ "SPN" SG_ 3221225472 AxleWeight_30 522030;
BA_ "SigType" SG_ 3221225472 AxleWeight_30 1;
BA_ "SPN" SG_ 3221225472 AxleWeight_20 522020;
BA_ "SigType" SG_ 3221225472 AxleWeight_20 1;
BA_ "SPN" SG_ 3221225472 AxleWeight_10 522010;
BA_ "SigType" SG_ 3221225472 AxleWeight_10 1;
BA_ "SPN" SG_ 3221225472 AxleWeight_00 522000;
BA_ "SigType" SG_ 3221225472 AxleWeight_00 1;
BA_ "SAEDocument" SG_ 3221225472 NetBatteryCurrent "J1939-71";
BA_ "SPN" SG_ 3221225472 NetBatteryCurrent 114;
BA_ "SigType" SG_ 3221225472 NetBatteryCurrent 1;
BA_ "SAEDocument" SG_ 3221225472 AltCurrent "J1939-71";
BA_ "SPN" SG_ 3221225472 AltCurrent 115;
BA_ "SigType" SG_ 3221225472 AltCurrent 1;
BA_ "SAEDocument" SG_ 3221225472 ECUPowerOutputSupplyVoltage3 "J1939-71";
BA_ "SPN" SG_ 3221225472 ECUPowerOutputSupplyVoltage3 3599;
BA_ "SigType" SG_ 3221225472 ECUPowerOutputSupplyVoltage3 1;
BA_ "SAEDocument" SG_ 3221225472 ECUPowerOutputSupplyVoltage2 "J1939-71";
BA_ "SPN" SG_ 3221225472 ECUPowerOutputSupplyVoltage2 3598;
BA_ "SigType" SG_ 3221225472 ECUPowerOutputSupplyVoltage2 1;
BA_ "SAEDocument" SG_ 3221225472 ECUPowerOutputSupplyVoltage1 "J1939-71";
BA_ "SPN" SG_ 3221225472 ECUPowerOutputSupplyVoltage1 3597;
BA_ "SigType" SG_ 3221225472 ECUPowerOutputSupplyVoltage1 1;
BA_ "SAEDocument" SG_ 3221225472 BatteryPotential_PowerInput2 "J1939-71";
BA_ "SPN" SG_ 3221225472 BatteryPotential_PowerInput2 444;
BA_ "SigType" SG_ 3221225472 BatteryPotential_PowerInput2 1;
BA_ "SAEDocument" SG_ 3221225472 Longitude "J1939-71";
BA_ "SPN" SG_ 3221225472 Longitude 585;
BA_ "SigType" SG_ 3221225472 Longitude 1;
BA_ "SAEDocument" SG_ 3221225472 Latitude "J1939-71";
BA_ "SPN" SG_ 3221225472 Latitude 584;
BA_ "SigType" SG_ 3221225472 Latitude 1;
BA_ "SAEDocument" SG_ 3221225472 VehicleIdentificationNumber "J1939-71";
BA_ "SPN" SG_ 3221225472 VehicleIdentificationNumber 237;
BA_ "SigType" SG_ 3221225472 VehicleIdentificationNumber 1;
BA_ "SAEDocument" SG_ 3221225472 TotalPowerTakeoffHours "J1939-71";
BA_ "SPN" SG_ 3221225472 TotalPowerTakeoffHours 248;
BA_ "SigType" SG_ 3221225472 TotalPowerTakeoffHours 1;
BA_ "SAEDocument" SG_ 3221225472 TotalVehicleHours "J1939-71";
BA_ "SPN" SG_ 3221225472 TotalVehicleHours 246;
BA_ "SigType" SG_ 3221225472 TotalVehicleHours 1;
BA_ "SAEDocument" SG_ 3221225472 HydOilLevel "J1939-71";
BA_ "SPN" SG_ 3221225472 HydOilLevel 2602;
BA_ "SigType" SG_ 3221225472 HydOilLevel 1;
BA_ "SAEDocument" SG_ 3221225472 WinchOilPressSwitch "J1939-71";
BA_ "SPN" SG_ 3221225472 WinchOilPressSwitch 1857;
BA_ "SigType" SG_ 3221225472 WinchOilPressSwitch 4;
BA_ "SAEDocument" SG_ 3221225472 HydOilFilterRestrictionSwitch "J1939-71";
BA_ "SPN" SG_ 3221225472 HydOilFilterRestrictionSwitch 1713;
BA_ "SigType" SG_ 3221225472 HydOilFilterRestrictionSwitch 4;
BA_ "SAEDocument" SG_ 3221225472 HydTemp "J1939-71";
BA_ "SPN" SG_ 3221225472 HydTemp 1638;
BA_ "SigType" SG_ 3221225472 HydTemp 1;
BA_ "SAEDocument" SG_ 3221225472 Altitude "J1939-71";
BA_ "SPN" SG_ 3221225472 Altitude 580;
BA_ "SigType" SG_ 3221225472 Altitude 1;
BA_ "SAEDocument" SG_ 3221225472 Pitch "J1939-71";
BA_ "SPN" SG_ 3221225472 Pitch 583;
BA_ "SigType" SG_ 3221225472 Pitch 1;
BA_ "SAEDocument" SG_ 3221225472 NavigationBasedVehicleSpeed "J1939-71";
BA_ "SPN" SG_ 3221225472 NavigationBasedVehicleSpeed 517;
BA_ "SigType" SG_ 3221225472 NavigationBasedVehicleSpeed 1;
BA_ "SAEDocument" SG_ 3221225472 CompassBearing "J1939-71";
BA_ "SPN" SG_ 3221225472 CompassBearing 165;
BA_ "SigType" SG_ 3221225472 CompassBearing 1;
BA_ "SAEDocument" SG_ 3221225472 HighResolutionTripDistance "J1939-71";
BA_ "SPN" SG_ 3221225472 HighResolutionTripDistance 918;
BA_ "SigType" SG_ 3221225472 HighResolutionTripDistance 1;
BA_ "SAEDocument" SG_ 3221225472 HghRsolutionTotalVehicleDistance "J1939-71";
BA_ "SPN" SG_ 3221225472 HghRsolutionTotalVehicleDistance 917;
BA_ "SigType" SG_ 3221225472 HghRsolutionTotalVehicleDistance 1;
BA_ "SAEDocument" SG_ 3221225472 YCBrakeCtrlActive "J1939-71";
BA_ "SPN" SG_ 3221225472 YCBrakeCtrlActive 1819;
BA_ "SigType" SG_ 3221225472 YCBrakeCtrlActive 5;
BA_ "SAEDocument" SG_ 3221225472 YCEngCtrlActive "J1939-71";
BA_ "SPN" SG_ 3221225472 YCEngCtrlActive 1817;
BA_ "SigType" SG_ 3221225472 YCEngCtrlActive 5;
BA_ "SAEDocument" SG_ 3221225472 ROPBrakeCtrlActive "J1939-71";
BA_ "SPN" SG_ 3221225472 ROPBrakeCtrlActive 1818;
BA_ "SigType" SG_ 3221225472 ROPBrakeCtrlActive 5;
BA_ "SAEDocument" SG_ 3221225472 ROPEngCtrlActive "J1939-71";
BA_ "SPN" SG_ 3221225472 ROPEngCtrlActive 1816;
BA_ "SigType" SG_ 3221225472 ROPEngCtrlActive 5;
BA_ "SAEDocument" SG_ 3221225472 VDCBrakeLightRq "J1939-71";
BA_ "SPN" SG_ 3221225472 VDCBrakeLightRq 1815;
BA_ "SigType" SG_ 3221225472 VDCBrakeLightRq 5;
BA_ "SAEDocument" SG_ 3221225472 VDCFullyOperational "J1939-71";
BA_ "SPN" SG_ 3221225472 VDCFullyOperational 1814;
BA_ "SigType" SG_ 3221225472 VDCFullyOperational 5;
BA_ "SAEDocument" SG_ 3221225472 VDCInformationSignal "J1939-71";
BA_ "SPN" SG_ 3221225472 VDCInformationSignal 1813;
BA_ "SigType" SG_ 3221225472 VDCInformationSignal 5;
BA_ "SAEDocument" SG_ 3221225472 TotalVehicleDistance "J1939-71";
BA_ "SPN" SG_ 3221225472 TotalVehicleDistance 245;
BA_ "SigType" SG_ 3221225472 TotalVehicleDistance 1;
BA_ "SAEDocument" SG_ 3221225472 TripDistance "J1939-71";
BA_ "SPN" SG_ 3221225472 TripDistance 244;
BA_ "SigType" SG_ 3221225472 TripDistance 1;
BA_ "SAEDocument" SG_ 3221225472 TripCruiseDistance "J1939-71";
BA_ "SPN" SG_ 3221225472 TripCruiseDistance 1019;
BA_ "SigType" SG_ 3221225472 TripCruiseDistance 1;
BA_ "SAEDocument" SG_ 3221225472 TripMaxVehicleSpeed "J1939-71";
BA_ "SPN" SG_ 3221225472 TripMaxVehicleSpeed 1018;
BA_ "SigType" SG_ 3221225472 TripMaxVehicleSpeed 1;
BA_ "SAEDocument" SG_ 3221225472 TripAirCompressorOnTime "J1939-71";
BA_ "SPN" SG_ 3221225472 TripAirCompressorOnTime 1038;
BA_ "SigType" SG_ 3221225472 TripAirCompressorOnTime 1;
BA_ "SAEDocument" SG_ 3221225472 TripIdleTime "J1939-71";
BA_ "SPN" SG_ 3221225472 TripIdleTime 1037;
BA_ "SigType" SG_ 3221225472 TripIdleTime 1;
BA_ "SAEDocument" SG_ 3221225472 TripEngRunningTime "J1939-71";
BA_ "SPN" SG_ 3221225472 TripEngRunningTime 1036;
BA_ "SigType" SG_ 3221225472 TripEngRunningTime 1;
BA_ "SAEDocument" SG_ 3221225472 TripCruiseTime "J1939-71";
BA_ "SPN" SG_ 3221225472 TripCruiseTime 1034;
BA_ "SigType" SG_ 3221225472 TripCruiseTime 1;
BA_ "SAEDocument" SG_ 3221225472 TripPTOGovernorTime "J1939-71";
BA_ "SPN" SG_ 3221225472 TripPTOGovernorTime 1035;
BA_ "SigType" SG_ 3221225472 TripPTOGovernorTime 1;
BA_ "SAEDocument" SG_ 3221225472 TripTimeInDerateByEng "J1939-71";
BA_ "SPN" SG_ 3221225472 TripTimeInDerateByEng 1027;
BA_ "SigType" SG_ 3221225472 TripTimeInDerateByEng 1;
BA_ "SAEDocument" SG_ 3221225472 TripTimeInGearDown "J1939-71";
BA_ "SPN" SG_ 3221225472 TripTimeInGearDown 1026;
BA_ "SigType" SG_ 3221225472 TripTimeInGearDown 1;
BA_ "SAEDocument" SG_ 3221225472 TripTimeInTopGear "J1939-71";
BA_ "SPN" SG_ 3221225472 TripTimeInTopGear 1025;
BA_ "SigType" SG_ 3221225472 TripTimeInTopGear 1;
BA_ "SAEDocument" SG_ 3221225472 TripTimeInVSL "J1939-71";
BA_ "SPN" SG_ 3221225472 TripTimeInVSL 1024;
BA_ "SigType" SG_ 3221225472 TripTimeInVSL 1;
BA_ "SAEDocument" SG_ 3221225472 TripSuddenDecelerations "J1939-71";
BA_ "SPN" SG_ 3221225472 TripSuddenDecelerations 1023;
BA_ "SigType" SG_ 3221225472 TripSuddenDecelerations 1;
BA_ "SAEDocument" SG_ 3221225472 TrpNumberOfIdleShutdownOverrides "J1939-71";
BA_ "SPN" SG_ 3221225472 TrpNumberOfIdleShutdownOverrides 1022;
BA_ "SigType" SG_ 3221225472 TrpNumberOfIdleShutdownOverrides 1;
BA_ "SAEDocument" SG_ 3221225472 TripNumberOfIdleShutdowns "J1939-71";
BA_ "SPN" SG_ 3221225472 TripNumberOfIdleShutdowns 1021;
BA_ "SigType" SG_ 3221225472 TripNumberOfIdleShutdowns 1;
BA_ "SAEDocument" SG_ 3221225472 TripNumberOfHotShutdowns "J1939-71";
BA_ "SPN" SG_ 3221225472 TripNumberOfHotShutdowns 1020;
BA_ "SigType" SG_ 3221225472 TripNumberOfHotShutdowns 1;
BA_ "SAEDocument" SG_ 3221225472 EngRequestedTorqueHighResolution "J1939-71";
BA_ "SPN" SG_ 3221225472 EngRequestedTorqueHighResolution 4191;
BA_ "SAEDocument" SG_ 3221225472 TSC1CtrlPurpose "J1939-71";
BA_ "SPN" SG_ 3221225472 TSC1CtrlPurpose 3350;
BA_ "SAEDocument" SG_ 3221225472 TSC1TransRate "J1939-71";
BA_ "SPN" SG_ 3221225472 TSC1TransRate 3349;
BA_ "SAEDocument" SG_ 3221225472 EngRequestedTorque_TorqueLimit "J1939-71";
BA_ "SPN" SG_ 3221225472 EngRequestedTorque_TorqueLimit 518;
BA_ "SAEDocument" SG_ 3221225472 EngRequestedSpeed_SpeedLimit "J1939-71";
BA_ "SPN" SG_ 3221225472 EngRequestedSpeed_SpeedLimit 898;
BA_ "SAEDocument" SG_ 3221225472 OverrideCtrlModePriority "J1939-71";
BA_ "SPN" SG_ 3221225472 OverrideCtrlModePriority 897;
BA_ "SigType" SG_ 3221225472 OverrideCtrlModePriority 5;
BA_ "SAEDocument" SG_ 3221225472 EngRequestedSpeedCtrlConditions "J1939-71";
BA_ "SPN" SG_ 3221225472 EngRequestedSpeedCtrlConditions 696;
BA_ "SigType" SG_ 3221225472 EngRequestedSpeedCtrlConditions 5;
BA_ "SAEDocument" SG_ 3221225472 EngOverrideCtrlMode "J1939-71";
BA_ "SPN" SG_ 3221225472 EngOverrideCtrlMode 695;
BA_ "SigType" SG_ 3221225472 EngOverrideCtrlMode 5;
BA_ "SAEDocument" SG_ 3221225472 TransitRunStatus "J1939-71";
BA_ "SPN" SG_ 3221225472 TransitRunStatus 3046;
BA_ "SigType" SG_ 3221225472 TransitRunStatus 5;
BA_ "SAEDocument" SG_ 3221225472 VehicleUseStatus "J1939-71";
BA_ "SPN" SG_ 3221225472 VehicleUseStatus 3045;
BA_ "SigType" SG_ 3221225472 VehicleUseStatus 5;
BA_ "SAEDocument" SG_ 3221225472 SilentAlarmStatus "J1939-71";
BA_ "SPN" SG_ 3221225472 SilentAlarmStatus 3044;
BA_ "SigType" SG_ 3221225472 SilentAlarmStatus 5;
BA_ "SAEDocument" SG_ 3221225472 PatronCount "J1939-71";
BA_ "SPN" SG_ 3221225472 PatronCount 3047;
BA_ "SigType" SG_ 3221225472 PatronCount 1;
BA_ "SAEDocument" SG_ 3221225472 TypeOfPassengerCount "J1939-71";
BA_ "SPN" SG_ 3221225472 TypeOfPassengerCount 3043;
BA_ "SigType" SG_ 3221225472 TypeOfPassengerCount 1;
BA_ "SAEDocument" SG_ 3221225472 FareboxAlarmIdentifier "J1939-71";
BA_ "SPN" SG_ 3221225472 FareboxAlarmIdentifier 3181;
BA_ "SAEDocument" SG_ 3221225472 FareboxEmergencyStatus "J1939-71";
BA_ "SPN" SG_ 3221225472 FareboxEmergencyStatus 3179;
BA_ "SigType" SG_ 3221225472 FareboxEmergencyStatus 4;
BA_ "SAEDocument" SG_ 3221225472 TransferSold "J1939-71";
BA_ "SPN" SG_ 3221225472 TransferSold 3168;
BA_ "SigType" SG_ 3221225472 TransferSold 1;
BA_ "SAEDocument" SG_ 3221225472 RouteNumber "J1939-71";
BA_ "SPN" SG_ 3221225472 RouteNumber 3169;
BA_ "SAEDocument" SG_ 3221225472 TransferType "J1939-71";
BA_ "SPN" SG_ 3221225472 TransferType 3173;
BA_ "SAEDocument" SG_ 3221225472 TypeOfService "J1939-71";
BA_ "SPN" SG_ 3221225472 TypeOfService 3172;
BA_ "SAEDocument" SG_ 3221225472 InitialFareAgency "J1939-71";
BA_ "SPN" SG_ 3221225472 InitialFareAgency 3167;
BA_ "SAEDocument" SG_ 3221225472 PassCategory "J1939-71";
BA_ "SPN" SG_ 3221225472 PassCategory 3166;
BA_ "SAEDocument" SG_ 3221225472 FareValidity "J1939-71";
BA_ "SPN" SG_ 3221225472 FareValidity 3165;
BA_ "SAEDocument" SG_ 3221225472 PaymentDetails "J1939-71";
BA_ "SPN" SG_ 3221225472 PaymentDetails 3177;
BA_ "SAEDocument" SG_ 3221225472 TypeOfFare "J1939-71";
BA_ "SPN" SG_ 3221225472 TypeOfFare 3176;
BA_ "SAEDocument" SG_ 3221225472 PassengerType "J1939-71";
BA_ "SPN" SG_ 3221225472 PassengerType 3171;
BA_ "SAEDocument" SG_ 3221225472 TransactionType "J1939-71";
BA_ "SPN" SG_ 3221225472 TransactionType 3170;
BA_ "SAEDocument" SG_ 3221225472 DriversFareboxSecurityCode "J1939-71";
BA_ "SPN" SG_ 3221225472 DriversFareboxSecurityCode 3164;
BA_ "SigType" SG_ 3221225472 DriversFareboxSecurityCode 1;
BA_ "SAEDocument" SG_ 3221225472 AssignedBlock "J1939-71";
BA_ "SPN" SG_ 3221225472 AssignedBlock 3163;
BA_ "SigType" SG_ 3221225472 AssignedBlock 1;
BA_ "SAEDocument" SG_ 3221225472 AssignedRun "J1939-71";
BA_ "SPN" SG_ 3221225472 AssignedRun 3162;
BA_ "SigType" SG_ 3221225472 AssignedRun 1;
BA_ "SAEDocument" SG_ 3221225472 AssignedRoute "J1939-71";
BA_ "SPN" SG_ 3221225472 AssignedRoute 3160;
BA_ "SigType" SG_ 3221225472 AssignedRoute 1;
BA_ "SAEDocument" SG_ 3221225472 PatternNumber "J1939-71";
BA_ "SPN" SG_ 3221225472 PatternNumber 3161;
BA_ "SigType" SG_ 3221225472 PatternNumber 1;
BA_ "SAEDocument" SG_ 3221225472 TripNumber "J1939-71";
BA_ "SPN" SG_ 3221225472 TripNumber 3159;
BA_ "SigType" SG_ 3221225472 TripNumber 1;
BA_ "SAEDocument" SG_ 3221225472 FarePresets "J1939-71";
BA_ "SPN" SG_ 3221225472 FarePresets 3175;
BA_ "SigType" SG_ 3221225472 FarePresets 1;
BA_ "SAEDocument" SG_ 3221225472 TripDirection "J1939-71";
BA_ "SPN" SG_ 3221225472 TripDirection 3174;
BA_ "SAEDocument" SG_ 3221225472 TripStatus "J1939-71";
BA_ "SPN" SG_ 3221225472 TripStatus 3180;
BA_ "SAEDocument" SG_ 3221225472 FareboxServiceStatus "J1939-71";
BA_ "SPN" SG_ 3221225472 FareboxServiceStatus 3178;
BA_ "SigType" SG_ 3221225472 FareboxServiceStatus 4;
BA_ "SAEDocument" SG_ 3221225472 VehicleID "J1939-71";
BA_ "SPN" SG_ 3221225472 VehicleID 3085;
BA_ "SigType" SG_ 3221225472 VehicleID 1;
BA_ "SAEDocument" SG_ 3221225472 StrobeActivationCtrlStatus "J1939-71";
BA_ "SPN" SG_ 3221225472 StrobeActivationCtrlStatus 3082;
BA_ "SigType" SG_ 3221225472 StrobeActivationCtrlStatus 4;
BA_ "SAEDocument" SG_ 3221225472 TransitDoorEnable "J1939-71";
BA_ "SPN" SG_ 3221225472 TransitDoorEnable 3083;
BA_ "SigType" SG_ 3221225472 TransitDoorEnable 4;
BA_ "SAEDocument" SG_ 3221225472 PriorityOfRespSentByEmitter "J1939-71";
BA_ "SPN" SG_ 3221225472 PriorityOfRespSentByEmitter 3084;
BA_ "SAEDocument" SG_ 3221225472 IntrsctnPrmptionRequest_Response "J1939-71";
BA_ "SPN" SG_ 3221225472 IntrsctnPrmptionRequest_Response 3079;
BA_ "SigType" SG_ 3221225472 IntrsctnPrmptionRequest_Response 4;
BA_ "SAEDocument" SG_ 3221225472 TransitRouteIDUsage "J1939-71";
BA_ "SPN" SG_ 3221225472 TransitRouteIDUsage 3080;
BA_ "SigType" SG_ 3221225472 TransitRouteIDUsage 4;
BA_ "SAEDocument" SG_ 3221225472 RangeCodeEnable "J1939-71";
BA_ "SPN" SG_ 3221225472 RangeCodeEnable 3081;
BA_ "SigType" SG_ 3221225472 RangeCodeEnable 4;
BA_ "SAEDocument" SG_ 3221225472 NmbrOfBytsInThMlpstIdntification "J1939-71";
BA_ "SPN" SG_ 3221225472 NmbrOfBytsInThMlpstIdntification 3070;
BA_ "SigType" SG_ 3221225472 NmbrOfBytsInThMlpstIdntification 1;
BA_ "SAEDocument" SG_ 3221225472 NmbrOfBytsInThTrnstAssgndBlckIdn "J1939-71";
BA_ "SPN" SG_ 3221225472 NmbrOfBytsInThTrnstAssgndBlckIdn 3073;
BA_ "SigType" SG_ 3221225472 NmbrOfBytsInThTrnstAssgndBlckIdn 1;
BA_ "SAEDocument" SG_ 3221225472 NmbrOfBytsInThTrnstAssgndRnIdntt "J1939-71";
BA_ "SPN" SG_ 3221225472 NmbrOfBytsInThTrnstAssgndRnIdntt 3072;
BA_ "SigType" SG_ 3221225472 NmbrOfBytsInThTrnstAssgndRnIdntt 1;
BA_ "SAEDocument" SG_ 3221225472 NmbrOfBytsInThTrnstAssgndRtIdntt "J1939-71";
BA_ "SPN" SG_ 3221225472 NmbrOfBytsInThTrnstAssgndRtIdntt 3071;
BA_ "SigType" SG_ 3221225472 NmbrOfBytsInThTrnstAssgndRtIdntt 1;
BA_ "SAEDocument" SG_ 3221225472 Agency "J1939-71";
BA_ "SPN" SG_ 3221225472 Agency 3078;
BA_ "SigType" SG_ 3221225472 Agency 1;
BA_ "SPN" SG_ 3221225472 ReferenceTirePressSetting_33 521833;
BA_ "SigType" SG_ 3221225472 ReferenceTirePressSetting_33 1;
BA_ "SPN" SG_ 3221225472 ReferenceTirePressSetting_32 521832;
BA_ "SigType" SG_ 3221225472 ReferenceTirePressSetting_32 1;
BA_ "SPN" SG_ 3221225472 ReferenceTirePressSetting_31 521831;
BA_ "SigType" SG_ 3221225472 ReferenceTirePressSetting_31 1;
BA_ "SPN" SG_ 3221225472 ReferenceTirePressSetting_30 521830;
BA_ "SigType" SG_ 3221225472 ReferenceTirePressSetting_30 1;
BA_ "SPN" SG_ 3221225472 ReferenceTirePressSetting_23 521823;
BA_ "SigType" SG_ 3221225472 ReferenceTirePressSetting_23 1;
BA_ "SPN" SG_ 3221225472 ReferenceTirePressSetting_22 521822;
BA_ "SigType" SG_ 3221225472 ReferenceTirePressSetting_22 1;
BA_ "SPN" SG_ 3221225472 ReferenceTirePressSetting_21 521821;
BA_ "SigType" SG_ 3221225472 ReferenceTirePressSetting_21 1;
BA_ "SPN" SG_ 3221225472 ReferenceTirePressSetting_20 521820;
BA_ "SigType" SG_ 3221225472 ReferenceTirePressSetting_20 1;
BA_ "SPN" SG_ 3221225472 ReferenceTirePressSetting_13 521813;
BA_ "SigType" SG_ 3221225472 ReferenceTirePressSetting_13 1;
BA_ "SPN" SG_ 3221225472 ReferenceTirePressSetting_12 521812;
BA_ "SigType" SG_ 3221225472 ReferenceTirePressSetting_12 1;
BA_ "SPN" SG_ 3221225472 ReferenceTirePressSetting_11 521811;
BA_ "SigType" SG_ 3221225472 ReferenceTirePressSetting_11 1;
BA_ "SPN" SG_ 3221225472 ReferenceTirePressSetting_10 521810;
BA_ "SigType" SG_ 3221225472 ReferenceTirePressSetting_10 1;
BA_ "SPN" SG_ 3221225472 ReferenceTirePressSetting_01 521801;
BA_ "SigType" SG_ 3221225472 ReferenceTirePressSetting_01 1;
BA_ "SPN" SG_ 3221225472 ReferenceTirePressSetting_00 521800;
BA_ "SigType" SG_ 3221225472 ReferenceTirePressSetting_00 1;
BA_ "SAEDocument" SG_ 3221225472 TireLocation "J1939-71";
BA_ "SPN" SG_ 3221225472 TireLocation 929;
BA_ "SigType" SG_ 3221225472 TireLocation 1;
BA_ "SPN" SG_ 3221225472 ReferenceTirePress_33 521933;
BA_ "SigType" SG_ 3221225472 ReferenceTirePress_33 1;
BA_ "SPN" SG_ 3221225472 ReferenceTirePress_32 521932;
BA_ "SigType" SG_ 3221225472 ReferenceTirePress_32 1;
BA_ "SPN" SG_ 3221225472 ReferenceTirePress_31 521931;
BA_ "SigType" SG_ 3221225472 ReferenceTirePress_31 1;
BA_ "SPN" SG_ 3221225472 ReferenceTirePress_30 521930;
BA_ "SigType" SG_ 3221225472 ReferenceTirePress_30 1;
BA_ "SPN" SG_ 3221225472 ReferenceTirePress_23 521923;
BA_ "SigType" SG_ 3221225472 ReferenceTirePress_23 1;
BA_ "SPN" SG_ 3221225472 ReferenceTirePress_22 521922;
BA_ "SigType" SG_ 3221225472 ReferenceTirePress_22 1;
BA_ "SPN" SG_ 3221225472 ReferenceTirePress_21 521921;
BA_ "SigType" SG_ 3221225472 ReferenceTirePress_21 1;
BA_ "SPN" SG_ 3221225472 ReferenceTirePress_20 521920;
BA_ "SigType" SG_ 3221225472 ReferenceTirePress_20 1;
BA_ "SPN" SG_ 3221225472 ReferenceTirePress_13 521913;
BA_ "SigType" SG_ 3221225472 ReferenceTirePress_13 1;
BA_ "SPN" SG_ 3221225472 ReferenceTirePress_12 521912;
BA_ "SigType" SG_ 3221225472 ReferenceTirePress_12 1;
BA_ "SPN" SG_ 3221225472 ReferenceTirePress_11 521911;
BA_ "SigType" SG_ 3221225472 ReferenceTirePress_11 1;
BA_ "SPN" SG_ 3221225472 ReferenceTirePress_10 521910;
BA_ "SigType" SG_ 3221225472 ReferenceTirePress_10 1;
BA_ "SPN" SG_ 3221225472 ReferenceTirePress_01 521901;
BA_ "SigType" SG_ 3221225472 ReferenceTirePress_01 1;
BA_ "SPN" SG_ 3221225472 ReferenceTirePress_00 521900;
BA_ "SigType" SG_ 3221225472 ReferenceTirePress_00 1;
BA_ "SAEDocument" SG_ 3221225472 SteerChannelTirePress "J1939-71";
BA_ "SPN" SG_ 3221225472 SteerChannelTirePress 146;
BA_ "SigType" SG_ 3221225472 SteerChannelTirePress 1;
BA_ "SAEDocument" SG_ 3221225472 DriveChannelTirePress "J1939-71";
BA_ "SPN" SG_ 3221225472 DriveChannelTirePress 145;
BA_ "SigType" SG_ 3221225472 DriveChannelTirePress 1;
BA_ "SAEDocument" SG_ 3221225472 TrailerTagOrPushChannelTirePress "J1939-71";
BA_ "SPN" SG_ 3221225472 TrailerTagOrPushChannelTirePress 144;
BA_ "SigType" SG_ 3221225472 TrailerTagOrPushChannelTirePress 1;
BA_ "SAEDocument" SG_ 3221225472 SteerChannelTirePressTarget "J1939-71";
BA_ "SPN" SG_ 3221225472 SteerChannelTirePressTarget 143;
BA_ "SigType" SG_ 3221225472 SteerChannelTirePressTarget 1;
BA_ "SAEDocument" SG_ 3221225472 DriveChannelTirePressTarget "J1939-71";
BA_ "SPN" SG_ 3221225472 DriveChannelTirePressTarget 142;
BA_ "SigType" SG_ 3221225472 DriveChannelTirePressTarget 1;
BA_ "SAEDocument" SG_ 3221225472 TrlrTgOrPshChnnelTirePressTarget "J1939-71";
BA_ "SPN" SG_ 3221225472 TrlrTgOrPshChnnelTirePressTarget 141;
BA_ "SigType" SG_ 3221225472 TrlrTgOrPshChnnelTirePressTarget 1;
BA_ "SAEDocument" SG_ 3221225472 PCUTrilerTagOrPushSolenoidStatus "J1939-71";
BA_ "SPN" SG_ 3221225472 PCUTrilerTagOrPushSolenoidStatus 1475;
BA_ "SigType" SG_ 3221225472 PCUTrilerTagOrPushSolenoidStatus 5;
BA_ "SAEDocument" SG_ 3221225472 PCUSupplySolenoidStatus "J1939-71";
BA_ "SPN" SG_ 3221225472 PCUSupplySolenoidStatus 1474;
BA_ "SigType" SG_ 3221225472 PCUSupplySolenoidStatus 5;
BA_ "SAEDocument" SG_ 3221225472 PCUCtrlSolenoidStatus "J1939-71";
BA_ "SPN" SG_ 3221225472 PCUCtrlSolenoidStatus 1473;
BA_ "SigType" SG_ 3221225472 PCUCtrlSolenoidStatus 5;
BA_ "SAEDocument" SG_ 3221225472 PCUDeflateSolenoidStatus "J1939-71";
BA_ "SPN" SG_ 3221225472 PCUDeflateSolenoidStatus 1472;
BA_ "SigType" SG_ 3221225472 PCUDeflateSolenoidStatus 5;
BA_ "SAEDocument" SG_ 3221225472 TirePressSupplySwitchStatus "J1939-71";
BA_ "SPN" SG_ 3221225472 TirePressSupplySwitchStatus 1471;
BA_ "SigType" SG_ 3221225472 TirePressSupplySwitchStatus 5;
BA_ "SAEDocument" SG_ 3221225472 PCUSteerSolenoidStatus "J1939-71";
BA_ "SPN" SG_ 3221225472 PCUSteerSolenoidStatus 1470;
BA_ "SigType" SG_ 3221225472 PCUSteerSolenoidStatus 5;
BA_ "SAEDocument" SG_ 3221225472 PCUDriveSolenoidStatus "J1939-71";
BA_ "SPN" SG_ 3221225472 PCUDriveSolenoidStatus 1469;
BA_ "SigType" SG_ 3221225472 PCUDriveSolenoidStatus 5;
BA_ "SAEDocument" SG_ 3221225472 DriveChannelMode "J1939-71";
BA_ "SPN" SG_ 3221225472 DriveChannelMode 1468;
BA_ "SAEDocument" SG_ 3221225472 Trailer_tagChannelMode "J1939-71";
BA_ "SPN" SG_ 3221225472 Trailer_tagChannelMode 1467;
BA_ "SAEDocument" SG_ 3221225472 SteerChannelMode "J1939-71";
BA_ "SPN" SG_ 3221225472 SteerChannelMode 1466;
BA_ "SAEDocument" SG_ 3221225472 TirePressCheckInterval "J1939-71";
BA_ "SPN" SG_ 3221225472 TirePressCheckInterval 39;
BA_ "SPN" SG_ 3221225472 TirePressThresholdDetection_13 521613;
BA_ "SPN" SG_ 3221225472 TirePressThresholdDetection_12 521612;
BA_ "SPN" SG_ 3221225472 TirePressThresholdDetection_11 521611;
BA_ "SPN" SG_ 3221225472 TirePressThresholdDetection_10 521610;
BA_ "SPN" SG_ 3221225472 TirePressThresholdDetection_01 521601;
BA_ "SPN" SG_ 3221225472 TirePress_33 521033;
BA_ "SigType" SG_ 3221225472 TirePress_33 1;
BA_ "SPN" SG_ 3221225472 TirePress_32 521032;
BA_ "SigType" SG_ 3221225472 TirePress_32 1;
BA_ "SPN" SG_ 3221225472 TirePress_31 521031;
BA_ "SigType" SG_ 3221225472 TirePress_31 1;
BA_ "SPN" SG_ 3221225472 TirePress_30 521030;
BA_ "SigType" SG_ 3221225472 TirePress_30 1;
BA_ "SPN" SG_ 3221225472 TirePress_23 521023;
BA_ "SigType" SG_ 3221225472 TirePress_23 1;
BA_ "SPN" SG_ 3221225472 TirePress_22 521022;
BA_ "SigType" SG_ 3221225472 TirePress_22 1;
BA_ "SPN" SG_ 3221225472 TirePress_21 521021;
BA_ "SigType" SG_ 3221225472 TirePress_21 1;
BA_ "SPN" SG_ 3221225472 TirePress_20 521020;
BA_ "SigType" SG_ 3221225472 TirePress_20 1;
BA_ "SPN" SG_ 3221225472 TirePress_13 521013;
BA_ "SigType" SG_ 3221225472 TirePress_13 1;
BA_ "SPN" SG_ 3221225472 TirePress_12 521012;
BA_ "SigType" SG_ 3221225472 TirePress_12 1;
BA_ "SPN" SG_ 3221225472 TirePress_11 521011;
BA_ "SigType" SG_ 3221225472 TirePress_11 1;
BA_ "SPN" SG_ 3221225472 TirePress_10 521010;
BA_ "SigType" SG_ 3221225472 TirePress_10 1;
BA_ "SPN" SG_ 3221225472 TireAirLeakageRate_33 521533;
BA_ "SigType" SG_ 3221225472 TireAirLeakageRate_33 1;
BA_ "SPN" SG_ 3221225472 TireAirLeakageRate_32 521532;
BA_ "SigType" SG_ 3221225472 TireAirLeakageRate_32 1;
BA_ "SPN" SG_ 3221225472 TireAirLeakageRate_31 521531;
BA_ "SigType" SG_ 3221225472 TireAirLeakageRate_31 1;
BA_ "SPN" SG_ 3221225472 TireAirLeakageRate_30 521530;
BA_ "SigType" SG_ 3221225472 TireAirLeakageRate_30 1;
BA_ "SPN" SG_ 3221225472 TireAirLeakageRate_23 521523;
BA_ "SigType" SG_ 3221225472 TireAirLeakageRate_23 1;
BA_ "SPN" SG_ 3221225472 TireAirLeakageRate_22 521522;
BA_ "SigType" SG_ 3221225472 TireAirLeakageRate_22 1;
BA_ "SPN" SG_ 3221225472 TireAirLeakageRate_21 521521;
BA_ "SigType" SG_ 3221225472 TireAirLeakageRate_21 1;
BA_ "SPN" SG_ 3221225472 TireAirLeakageRate_20 521520;
BA_ "SigType" SG_ 3221225472 TireAirLeakageRate_20 1;
BA_ "SPN" SG_ 3221225472 TireAirLeakageRate_13 521513;
BA_ "SigType" SG_ 3221225472 TireAirLeakageRate_13 1;
BA_ "SPN" SG_ 3221225472 TireAirLeakageRate_12 521512;
BA_ "SigType" SG_ 3221225472 TireAirLeakageRate_12 1;
BA_ "SPN" SG_ 3221225472 TireAirLeakageRate_11 521511;
BA_ "SigType" SG_ 3221225472 TireAirLeakageRate_11 1;
BA_ "SPN" SG_ 3221225472 TireAirLeakageRate_10 521510;
BA_ "SigType" SG_ 3221225472 TireAirLeakageRate_10 1;
BA_ "SPN" SG_ 3221225472 TireAirLeakageRate_01 521501;
BA_ "SigType" SG_ 3221225472 TireAirLeakageRate_01 1;
BA_ "SPN" SG_ 3221225472 TireAirLeakageRate_00 521500;
BA_ "SigType" SG_ 3221225472 TireAirLeakageRate_00 1;
BA_ "SPN" SG_ 3221225472 CTIWheelSensorStatus_33 521433;
BA_ "SigType" SG_ 3221225472 CTIWheelSensorStatus_33 4;
BA_ "SPN" SG_ 3221225472 CTIWheelSensorStatus_32 521432;
BA_ "SigType" SG_ 3221225472 CTIWheelSensorStatus_32 4;
BA_ "SPN" SG_ 3221225472 CTIWheelSensorStatus_31 521431;
BA_ "SigType" SG_ 3221225472 CTIWheelSensorStatus_31 4;
BA_ "SPN" SG_ 3221225472 CTIWheelSensorStatus_30 521430;
BA_ "SigType" SG_ 3221225472 CTIWheelSensorStatus_30 4;
BA_ "SPN" SG_ 3221225472 CTIWheelSensorStatus_23 521423;
BA_ "SigType" SG_ 3221225472 CTIWheelSensorStatus_23 4;
BA_ "SPN" SG_ 3221225472 CTIWheelSensorStatus_22 521422;
BA_ "SigType" SG_ 3221225472 CTIWheelSensorStatus_22 4;
BA_ "SPN" SG_ 3221225472 CTIWheelSensorStatus_21 521421;
BA_ "SigType" SG_ 3221225472 CTIWheelSensorStatus_21 4;
BA_ "SPN" SG_ 3221225472 CTIWheelSensorStatus_20 521420;
BA_ "SigType" SG_ 3221225472 CTIWheelSensorStatus_20 4;
BA_ "SPN" SG_ 3221225472 CTIWheelSensorStatus_13 521413;
BA_ "SigType" SG_ 3221225472 CTIWheelSensorStatus_13 4;
BA_ "SPN" SG_ 3221225472 CTIWheelSensorStatus_12 521412;
BA_ "SigType" SG_ 3221225472 CTIWheelSensorStatus_12 4;
BA_ "SPN" SG_ 3221225472 CTIWheelSensorStatus_11 521411;
BA_ "SigType" SG_ 3221225472 CTIWheelSensorStatus_11 4;
BA_ "SPN" SG_ 3221225472 CTIWheelSensorStatus_10 521410;
BA_ "SigType" SG_ 3221225472 CTIWheelSensorStatus_10 4;
BA_ "SPN" SG_ 3221225472 CTIWheelSensorStatus_01 521401;
BA_ "SigType" SG_ 3221225472 CTIWheelSensorStatus_01 4;
BA_ "SPN" SG_ 3221225472 CTIWheelEndElectricalFault_33 521233;
BA_ "SigType" SG_ 3221225472 CTIWheelEndElectricalFault_33 4;
BA_ "SPN" SG_ 3221225472 CTIWheelEndElectricalFault_32 521232;
BA_ "SigType" SG_ 3221225472 CTIWheelEndElectricalFault_32 4;
BA_ "SPN" SG_ 3221225472 CTIWheelEndElectricalFault_31 521231;
BA_ "SigType" SG_ 3221225472 CTIWheelEndElectricalFault_31 4;
BA_ "SPN" SG_ 3221225472 CTIWheelEndElectricalFault_30 521230;
BA_ "SigType" SG_ 3221225472 CTIWheelEndElectricalFault_30 4;
BA_ "SPN" SG_ 3221225472 CTIWheelEndElectricalFault_23 521223;
BA_ "SigType" SG_ 3221225472 CTIWheelEndElectricalFault_23 4;
BA_ "SPN" SG_ 3221225472 CTIWheelEndElectricalFault_22 521222;
BA_ "SigType" SG_ 3221225472 CTIWheelEndElectricalFault_22 4;
BA_ "SPN" SG_ 3221225472 CTIWheelEndElectricalFault_21 521221;
BA_ "SigType" SG_ 3221225472 CTIWheelEndElectricalFault_21 4;
BA_ "SPN" SG_ 3221225472 CTIWheelEndElectricalFault_20 521220;
BA_ "SigType" SG_ 3221225472 CTIWheelEndElectricalFault_20 4;
BA_ "SPN" SG_ 3221225472 CTIWheelEndElectricalFault_13 521213;
BA_ "SigType" SG_ 3221225472 CTIWheelEndElectricalFault_13 4;
VAL_ 3221225472 EngCyl24CombustionStatus 3 "Not available" 2 "Error" 1 "Combustion exists" 0 "No combustion" ;
VAL_ 3221225472 EngCyl23CombustionStatus 3 "Not available" 2 "Error" 1 "Combustion exists" 0 "No combustion" ;
VAL_ 3221225472 EngCyl22CombustionStatus 3 "Not available" 2 "Error" 1 "Combustion exists" 0 "No combustion" ;
VAL_ 3221225472 EngCyl21CombustionStatus 3 "Not available" 2 "Error" 1 "Combustion exists" 0 "No combustion" ;
VAL_ 3221225472 EngCyl20CombustionStatus 3 "Not available" 2 "Error" 1 "Combustion exists" 0 "No combustion" ;
VAL_ 3221225472 EngCyl19CombustionStatus 3 "Not available" 2 "Error" 1 "Combustion exists" 0 "No combustion" ;
VAL_ 3221225472 EngCyl18CombustionStatus 3 "Not available" 2 "Error" 1 "Combustion exists" 0 "No combustion" ;
VAL_ 3221225472 EngCyl17CombustionStatus 3 "Not available" 2 "Error" 1 "Combustion exists" 0 "No combustion" ;
VAL_ 3221225472 EngCyl16CombustionStatus 3 "Not available" 2 "Error" 1 "Combustion exists" 0 "No combustion" ;
VAL_ 3221225472 EngCyl15CombustionStatus 3 "Not available" 2 "Error" 1 "Combustion exists" 0 "No combustion" ;
VAL_ 3221225472 EngCyl14CombustionStatus 3 "Not available" 2 "Error" 1 "Combustion exists" 0 "No combustion" ;
VAL_ 3221225472 EngCyl13CombustionStatus 3 "Not available" 2 "Error" 1 "Combustion exists" 0 "No combustion" ;
VAL_ 3221225472 EngCyl12CombustionStatus 3 "Not available" 2 "Error" 1 "Combustion exists" 0 "No combustion" ;
VAL_ 3221225472 EngCyl11CombustionStatus 3 "Not available" 2 "Error" 1 "Combustion exists" 0 "No combustion" ;
VAL_ 3221225472 EngCyl10CombustionStatus 3 "Not available" 2 "Error" 1 "Combustion exists" 0 "No combustion" ;
VAL_ 3221225472 EngCyl9CombustionStatus 3 "Not available" 2 "Error" 1 "Combustion exists" 0 "No combustion" ;
VAL_ 3221225472 EngCyl8CombustionStatus 3 "Not available" 2 "Error" 1 "Combustion exists" 0 "No combustion" ;
VAL_ 3221225472 EngCyl7CombustionStatus 3 "Not available" 2 "Error" 1 "Combustion exists" 0 "No combustion" ;
VAL_ 3221225472 EngCyl6CombustionStatus 3 "Not available" 2 "Error" 1 "Combustion exists" 0 "No combustion" ;
VAL_ 3221225472 EngCyl5CombustionStatus 1 "Combustion exists" 0 "No combustion" 3 "Not available" 2 "Error" ;
VAL_ 3221225472 EngCyl4CombustionStatus 3 "Not available" 2 "Error" 1 "Combustion exists" 0 "No combustion" ;
VAL_ 3221225472 EngCyl3CombustionStatus 3 "Not available" 2 "Error" 1 "Combustion exists" 0 "No combustion" ;
VAL_ 3221225472 EngCyl2CombustionStatus 3 "Not available" 2 "Error" 1 "Combustion exists" 0 "No combustion" ;
VAL_ 3221225472 EngCyl1CombustionStatus 3 "Not available" 2 "Error" 1 "Combustion exists" 0 "No combustion" ;
VAL_ 3221225472 RqGenOverallPowerFactorLagging 3 "NotAvailable" 2 "Error" 1 "Lagging" 0 "Leading" ;
VAL_ 3221225472 BladeRotationAngleFigureOfMerit 3 "Blade Rotation Angle not available" 2 "Blade Rotation Angle failed Roll sensor failed to operate correctly" 1 "Blade Rotation Angle degraded Data is suspect due to environmental conditions" 0 "Blade Rotation Angle fully functional Data is within sensor specification" ;
VAL_ 3221225472 RelativeBladeHeightFigureOfMerit 3 "Relative Blade Height not available" 2 "Relative Blade Height failed" 1 "Relative Blade Height degraded Data is suspect due to environmental conditions" 0 "Relative Blade Height fully functional Data is within sensor specification" ;
VAL_ 3221225472 VehicleType 1 "Dolly axle" 0 "Towing or towed vehicle" ;
VAL_ 3221225472 BrakeLightSwitch 1 "Switch on" 0 "Switch off" ;
VAL_ 3221225472 ASREngineControlActive 3 "NotAvailable" 2 "Reserved" 1 "ASREngineControlActive" 0 "ASREngnCntrlPassiveButInstalled" ;
VAL_ 3221225472 ASRBreakControlActive 1 "Active" 0 "Passive, but installed" ;
VAL_ 3221225472 VehicleRetarderCtrlActive 1 "Active" 0 "Passive" ;
VAL_ 3221225472 VehicleABSActive 1 "Active" 0 "Passiv, but installed" ;
VAL_ 3221225472 PneumaticControlLine 1 "Towing veh with pn ctrl line" 0 "Towing veh without pn ctrl line" ;
VAL_ 3221225472 ABSOffroadRequest 1 "ABS off-road switch on" 0 "ABS off-road switch off" ;
VAL_ 3221225472 TwoElCircuitsBrakeDemand 1 "Two el. circuit brake available" 0 "One el. circuit brake available" ;
VAL_ 3221225472 SupplyLineBrakingRequest 1 "Supply line braking request" 0 "No supply line braking request" ;
VAL_ 3221225472 VDCActive 1 "Active" 0 "Passive, but installed" ;
VAL_ 3221225472 AutomTowedVehBreakActive 1 "Active" 0 "Passive" ;
VAL_ 3221225472 VehicleServiceBrakeActive 1 "Active" 0 "Passive" ;
VAL_ 3221225472 LoadingRampApproachAssist 1 "Assistance active" 0 "Assistance not active" ;
VAL_ 3221225472 SpringBrakeEngaged 1 "Vehicle spring brake is engaged" 0 "Vehicle spring brake is released" ;
VAL_ 3221225472 ElectrLoadPropFunc 1 "Vehicle with el. load proportion" 0 "Vehicle without el. load proport" ;
VAL_ 3221225472 SpringBrakeInstalled 1 "Vehicle with spring brakes" 0 "Vehicle without spring brakes" ;
VAL_ 3221225472 ElecSupplyOfNonBrakingSys 1 "Supply switched on" 0 "Supply switched off" ;
VAL_ 3221225472 AmberWarningSignalReq 1 "Towed vehicle failure indicated" 0 "No towed vehicle failure indicat" ;
VAL_ 3221225472 RedWarningSignalRequest 1 "Towed vehicle failure indicated" 0 "No towed vehicle failure indicat" ;
VAL_ 3221225472 VehicleElectrSupplySuff 1 "Vehicle el. supply sufficient" 0 "Vehicle el. supply insufficient" ;
VAL_ 3221225472 TyreWheelIdentTemp2 15 "Axle position 15" 14 "Axle position 14" 13 "Axle position 13" 12 "Axle position 12" 11 "Axle position 11" 10 "Axle position 10" 9 "Axle position 9" 8 "Axle position 8" 7 "Axle position 7" 6 "Axle position 6" 5 "Axle position 5" 4 "Axle position 4" 3 "Axle position 3" 2 "Axle position 2" 1 "Axle position 1" 0 "Axle position not identified" ;
VAL_ 3221225472 TyreWheelIdentTemp1 15 "Wheel position 15" 14 "Wheel position 14" 13 "Wheel position 13" 12 "Wheel position 12" 11 "Wheel position 11" 10 "Wheel position 10" 9 "Wheel position 9" 8 "Wheel position 8" 7 "Wheel position 7" 6 "Wheel position 6" 5 "Wheel position 5" 4 "Wheel position 4" 3 "Wheel position 3" 2 "Wheel position 2" 1 "Wheel position 1" 0 "Wheel position not identified" ;
VAL_ 3221225472 TyreWheelIdentPressure2 15 "Axle position 15" 14 "Axle position 14" 13 "Axle position 13" 12 "Axle position 12" 11 "Axle position 11" 10 "Axle position 10" 9 "Axle position 9" 8 "Axle position 8" 7 "Axle position 7" 6 "Axle position 6" 5 "Axle position 5" 4 "Axle position 4" 3 "Axle position 3" 2 "Axle position 2" 1 "Axle position 1" 0 "Axle position not identified" ;
VAL_ 3221225472 TyreWheelIdentPressure1 15 "Wheel position 15" 14 "Wheel position 14" 13 "Wheel position 13" 12 "Wheel position 12" 11 "Wheel position 11" 10 "Wheel position 10" 9 "Wheel position 9" 8 "Wheel position 8" 7 "Wheel position 7" 6 "Wheel position 6" 5 "Wheel position 5" 4 "Wheel position 4" 3 "Wheel position 3" 2 "Wheel position 2" 1 "Wheel position 1" 0 "Wheel position not identified" ;
VAL_ 3221225472 TyreWheelIdentLining2 15 "Axle position 15" 14 "Axle position 14" 13 "Axle position 13" 12 "Axle position 12" 11 "Axle position 11" 10 "Axle position 10" 9 "Axle position 9" 8 "Axle position 8" 7 "Axle position 7" 6 "Axle position 6" 5 "Axle position 5" 4 "Axle position 4" 3 "Axle position 3" 2 "Axle position 2" 1 "Axle position 1" 0 "Axle position not identified" ;
VAL_ 3221225472 TyreWheelIdentLining1 15 "Wheel position 15" 14 "Wheel position 14" 13 "Wheel position 13" 12 "Wheel position 12" 11 "Wheel position 11" 10 "Wheel position 10" 9 "Wheel position 9" 8 "Wheel position 8" 7 "Wheel position 7" 6 "Wheel position 6" 5 "Wheel position 5" 4 "Wheel position 4" 3 "Wheel position 3" 2 "Wheel position 2" 1 "Wheel position 1" 0 "Wheel position not identified" ;
VAL_ 3221225472 VehiclePneumSupplySuff 1 "Pneumatic supply sufficient" 0 "Pneumatic supply insufficient" ;
VAL_ 3221225472 BrakeTemperatureStatus 1 "Brake temperature normal" 0 "Brake temperature out of range" ;
VAL_ 3221225472 BrakeLiningSufficient 1 "Brake linings sufficient" 0 "Brake linings insufficient" ;
VAL_ 3221225472 TyrePressureSufficient 1 "Tyre pressure sufficient" 0 "Tyre pressure insufficient" ;
VAL_ 3221225472 ODDRequest 3 "Take no action" 1 "ODD on" 0 "ODD off" ;
VAL_ 3221225472 AntiTheftDeviceReq 3 "Take no action" 1 "Anti-theft device on" 0 "Anti-theft device off" ;
VAL_ 3221225472 EngineTorqueMode 15 "Not available" 11 "Remote accelerator" 10 "Braking system" 9 "High speed governor" 8 "Torque limiting" 7 "ABS control" 6 "Transmission control" 5 "ASR control" 4 "Road speed governor" 3 "PTO governor" 2 "Cruise control" 1 "Accelerator pedal/operator selec" 0 "Low idle governor/no request (de" ;
VAL_ 3221225472 EngineRunning 1 "Engine running" 0 "Engine not running" ;
VAL_ 3221225472 EngineControlAllowed 1 "Engine control allowed" 0 "Engine control not allowed" ;
VAL_ 3221225472 ClutchIndptdPTOFeedback 1 "Engaged" 0 "Not engaged" ;
VAL_ 3221225472 AccelPedalLowIdleSwitch 1 "In low idle condition" 0 "Not in low idle condition" ;
VAL_ 3221225472 StarterActive 1 "Starter active" 0 "Starter not active" ;
VAL_ 3221225472 TorqueConvtOilTempWarning 2 "Warning" 1 "Prewarning" 0 "No warning" ;
VAL_ 3221225472 PTOControlAllowed 1 "PTO control allowed" 0 "PTO control not allowed" ;
VAL_ 3221225472 SecEngineMtdPTOFeedback 1 "Limits activated" 0 "Limits not activated" ;
VAL_ 3221225472 FirstEngineMtdPTOFeedback 1 "Limits activated" 0 "Limits not activated" ;
VAL_ 3221225472 SecClutchDptdPTOFeedback 1 "Engaged" 0 "Not engaged" ;
VAL_ 3221225472 FirstClutchDpdtPTOFeedback 1 "Engaged" 0 "Not engaged" ;
VAL_ 3221225472 FuelLevelWarning 1 "Fuel level warning on" 0 "Fuel level warning off" ;
VAL_ 3221225472 EngineOilPressureWarning 1 "Warning" 0 "No warning" ;
VAL_ 3221225472 EngineCoolantTempWarning 2 "Warning" 1 "Prewarning" 0 "No warning" ;
VAL_ 3221225472 AntiTheftDeviceStatus 1 "Anti-theft device on" 0 "Anti-theft device off" ;
VAL_ 3221225472 ODDStatus 1 "ODD active" 0 "ODD inactive" ;
VAL_ 3221225472 SecEngineMtdPTOSwitch 1 "Switched on" 0 "Switched off" ;
VAL_ 3221225472 SecClutchDpdtPTOSwitch 1 "Switched on" 0 "Switched off" ;
VAL_ 3221225472 FirstClutchDpdtPTOSwitch 1 "Switched on" 0 "Switched off" ;
VAL_ 3221225472 OperatingPanelActive 1 "Operating panel active" 0 "Operating panel not active" ;
VAL_ 3221225472 RefusePackerStepSwitch 1 "Switched on" 0 "Switched off" ;
VAL_ 3221225472 EngineStopSwitch 1 "Switched on" 0 "Switched off" ;
VAL_ 3221225472 EngineStartSwitch 1 "Switched on" 0 "Switched off" ;
VAL_ 3221225472 StarterLockoutSwitch 1 "Switched on" 0 "Switched off" ;
VAL_ 3221225472 FirstEngineMtdPTOSwitch 1 "Switched on" 0 "Switched off" ;
VAL_ 3221225472 ClutchIndpdtPTOSwitch 1 "Switched on" 0 "Switched off" ;
VAL_ 3221225472 TrailerLeftSideMarkerLight 1 "Lamp(s) lit" 0 "Lamp(s) not lit" ;
VAL_ 3221225472 TrailerLeftReversingLight 1 "Lamp(s) lit" 0 "Lamp(s) not lit" ;
VAL_ 3221225472 TrailerLeftRearWidIndLight 1 "Lamp(s) lit" 0 "Lamp(s) not lit" ;
VAL_ 3221225472 TrailerLeftRearRegPltLight 1 "Lamp(s) lit" 0 "Lamp(s) not lit" ;
VAL_ 3221225472 TrailerLeftRearLight 1 "Lamp(s) lit" 0 "Lamp(s) not lit" ;
VAL_ 3221225472 TrailerLeftRearFogLight 1 "Lamp(s) lit" 0 "Lamp(s) not lit" ;
VAL_ 3221225472 TrailerLeftDirIndLight 1 "Lamp(s) lit" 0 "Lamp(s) not lit" ;
VAL_ 3221225472 TrailerLeftCrnMarkerLight 1 "Lamp(s) lit" 0 "Lamp(s) not lit" ;
VAL_ 3221225472 TrailerInteriorLight 1 "Lamp(s) lit" 0 "Lamp(s) not lit" ;
VAL_ 3221225472 TrailerWorkLamp 1 "Lamp(s) lit" 0 "Lamp(s) not lit" ;
VAL_ 3221225472 TrailerRotatingIdentLight 1 "Lamp(s) lit" 0 "Lamp(s) not lit" ;
VAL_ 3221225472 TrailerRightStopLight 1 "Lamp(s) lit" 0 "Lamp(s) not lit" ;
VAL_ 3221225472 TrailerRightSideMrkLight 1 "Lamp(s) lit" 0 "Lamp(s) not lit" ;
VAL_ 3221225472 TrailerRightReversingLight 1 "Lamp(s) lit" 0 "Lamp(s) not lit" ;
VAL_ 3221225472 TrailRightRearWidIndLight 1 "Lamp(s) lit" 0 "Lamp(s) not lit" ;
VAL_ 3221225472 TrailerRightRearRegPltLight 1 "Lamp(s) lit" 0 "Lamp(s) not lit" ;
VAL_ 3221225472 TrailerRightRearLight 1 "Lamp(s) lit" 0 "Lamp(s) not lit" ;
VAL_ 3221225472 TrailerRightRearFogLight 1 "Lamp(s) lit" 0 "Lamp(s) not lit" ;
VAL_ 3221225472 TrailerRightDirIndLight 1 "Lamp(s) lit" 0 "Lamp(s) not lit" ;
VAL_ 3221225472 TrailerRightCrnMarkerLight 1 "Lamp(s) lit" 0 "Lamp(s) not lit" ;
VAL_ 3221225472 TrailerRearWarningLight 1 "Lamp(s) lit" 0 "Lamp(s) not lit" ;
VAL_ 3221225472 TrailerLeftStopLight 1 "Lamp(s) lit" 0 "Lamp(s) not lit" ;
VAL_ 3221225472 FlowStatus 2 "Overflow" 1 "Wait " 0 "Continue To Send" ;
VAL_ 3221225472 ProtocolCtrlInformation 3 "Flow control " 2 "Consecutive frame" 1 "First frame" 0 "Single frame" ;
VAL_ 3221225472 ControlByte 3 "CannotRespond" 2 "AccessDenied" 1 "NACK" 0 "ACK" ;
VAL_ 3221225472 FilterMode 1 "PassSpecificPGNs" 0 "BlockSpecificPGNs" ;
VAL_ 3221225472 StopLevelChangeReq 3 "Take no action" 1 "Stop request" 0 "No stop request" ;
VAL_ 3221225472 RampLevelStorageReq 3 "Take no action" 1 "Store ramp level 2" 0 "Store ramp level 1" ;
VAL_ 3221225472 LevelControlReq 3 "Take no action" 1 "Enable level control" 0 "Disable level control" ;
VAL_ 3221225472 RampLevelReq 3 "Take no action" 1 "Ramp level 2" 0 "Ramp level 1" ;
VAL_ 3221225472 SteeringAxleLockingReq 3 "Take no action" 1 "Lock steering axle" 0 "Unlock steering axle" ;
VAL_ 3221225472 LiftAxle2PositionReq 3 "Take no action" 1 "Position up / tag axle unladen" 0 "Position down / tag axle laden" ;
VAL_ 3221225472 LiftAxle1PositionReq 3 "Don't care/take no action" 2 "Reserved" 1 "Position up / tag axle unladen" 0 "Position down / tag axle laden" ;
VAL_ 3221225472 TractionHelpReq 3 "Take no action" 1 "Traction help request" 0 "No traction help request" ;
VAL_ 3221225472 LevelChangeReqRearAxle 2 "Take no action" 1 "Vehicle body down (lowering)" 0 "Vehicle body up (lifting)" ;
VAL_ 3221225472 LevelChangeReqFrontAxle 2 "Take no action" 1 "Vehicle body down (lowering)" 0 "Vehicle body up (lifting)" ;
VAL_ 3221225472 RideHeightRequest 2 "Take no action" 1 "Normal level 2" 0 "Normal level 1" ;
VAL_ 3221225472 LevelControl 1 "Level control enabled" 0 "Level control disabled" ;
VAL_ 3221225472 RampLevel 1 "Body at requested ramp level" 0 "Body not at requested ramp level" ;
VAL_ 3221225472 NormalLevel 3 "Not available" 1 "Normal level 2" 0 "Normal level 1" ;
VAL_ 3221225472 StopLevelChangeAcknowledge 1 "Level change stopped" 0 "No stop request" ;
VAL_ 3221225472 LevelChangeRearAxle 1 "Body lifting/lowering active" 0 "Body lifting/lowering not active" ;
VAL_ 3221225472 LevelChangeFrontAxle 1 "Body lifting/lowering active" 0 "Body lifting/lowering not active" ;
VAL_ 3221225472 RampLevelStorage 1 "New ramp level stored" 0 "No new storage request" ;
VAL_ 3221225472 SteeringAxleLocking 1 "Steering axle locked" 0 "Steering axle unlocked" ;
VAL_ 3221225472 LiftAxle2Pos 3 "Not available" 2 "Error" 1 "Lift axle position up / tag axle unladen" 0 "Lift axle position down / tag axle laden" ;
VAL_ 3221225472 LiftAxle1Pos 3 "Not available" 2 "Error" 1 "Lift axle position up / tag axle unladen" 0 "Lift axle position down / tag axle laden" ;
VAL_ 3221225472 RampLevelPosition 3 "Not available" 1 "Ramp level 2" 0 "Ramp level 1" ;
VAL_ 3221225472 TractionHelp 1 "Traction help active" 0 "Traction help inactive" ;
VAL_ 3221225472 LevelCtrlSysRideHeightLevel 1 "Vehicle body at requested level" 0 "Vehicle body not at req. level" ;
VAL_ 3221225472 TyrePressThresholdDetect 7 "Not available" 6 "Error indicator" 5 "Not defined" 4 "Extreme under pressure" 3 "Under pressure" 2 "No warning pressure" 1 "Over pressure" 0 "Extreme over pressure" ;
VAL_ 3221225472 TyreModulePowerSupply 1 "Sufficient power supply" 0 "Insufficient power supply" ;
VAL_ 3221225472 TyreWheelIdentification2 15 "Axle position 15" 14 "Axle position 14" 13 "Axle position 13" 12 "Axle position 12" 11 "Axle position 11" 10 "Axle position 10" 9 "Axle position 9" 8 "Axle position 8" 7 "Axle position 7" 6 "Axle position 6" 5 "Axle position 5" 4 "Axle position 4" 3 "Axle position 3" 2 "Axle position 2" 1 "Axle position 1" 0 "Axle position not identified" ;
VAL_ 3221225472 TyreWheelIdentification1 15 "Wheel position 15" 14 "Wheel position 14" 13 "Wheel position 13" 12 "Wheel position 12" 11 "Wheel position 11" 10 "Wheel position 10" 9 "Wheel position 9" 8 "Wheel position 8" 7 "Wheel position 7" 6 "Wheel position 6" 5 "Wheel position 5" 4 "Wheel position 4" 3 "Wheel position 3" 2 "Wheel position 2" 1 "Wheel position 1" 0 "Wheel position not identified" ;
VAL_ 3221225472 MisfireMonitoringComplete 1 "EnabledForCycle" 0 "DisabledForRestOfCycle" ;
VAL_ 3221225472 MisfireMonitoringEnabled 1 "EnabledForCycle" 0 "DisabledForRestOfCycle" ;
VAL_ 3221225472 FuelSystemMonitoringEnabled 1 "NotCompleteCycle" 0 "CompleteCycleOrNotSupported" ;
VAL_ 3221225472 ComprehensiveComptMonComplete 1 "NotCompleteCycle" 0 "CompleteCycleOrNotSupported" ;
VAL_ 3221225472 ComprehensiveCompMonEnabled 1 "NotCompleteCycle" 0 "CompleteCycleOrNotSupported" ;
VAL_ 3221225472 SecondAirSystemMonComplete 1 "EnabledForCycle" 0 "DisabledForRestOfCycle" ;
VAL_ 3221225472 SecondAirSystemMonEnabled 1 "EnabledForCycle" 0 "DisabledForRestOfCycle" ;
VAL_ 3221225472 OxygenSensorMonComplete 1 "EnabledForCycle" 0 "DisabledForRestOfCycle" ;
VAL_ 3221225472 OxygenSensorMonEnabled 1 "NotCompleteCycle" 0 "CompleteCycleOrNotSupported" ;
VAL_ 3221225472 OxygenSensorHeaterMonComplete 1 "EnabledForCycle" 0 "DisabledForRestOfCycle" ;
VAL_ 3221225472 OxygenSensorHeaterMonEnabled 1 "NotCompleteCycle" 0 "CompleteCycleOrNotSupported" ;
VAL_ 3221225472 HeatedCatalystMonComplete 1 "EnabledForCycle" 0 "DisabledForRestOfCycle" ;
VAL_ 3221225472 HeatedCatalystMonEnabled 1 "EnabledForCycle" 0 "DisabledForRestOfCycle" ;
VAL_ 3221225472 EvaporativeSystemMonComplete 1 "NotCompleteCycle" 0 "CompleteCycleOrNotSupported" ;
VAL_ 3221225472 EvaporativeSystemMonEnabled 1 "NotCompleteCycle" 0 "CompleteCycleOrNotSupported" ;
VAL_ 3221225472 EGRSystemMonitoringComplete 1 "NotCompleteCycle" 0 "CompleteCycleOrNotSupported" ;
VAL_ 3221225472 EGRSystemMonitoringEnabled 1 "EnabledForCycle" 0 "DisabledForRestOfCycle" ;
VAL_ 3221225472 ColdStartAidSystemMonComplete 1 "EnabledForCycle" 0 "DisabledForRestOfCycle" ;
VAL_ 3221225472 ColdStartAidSystemMonEnabled 1 "EnabledForCycle" 0 "DisabledForRestOfCycle" ;
VAL_ 3221225472 CatalystMonComplete 1 "NotCompleteCycle" 0 "CompleteCycleOrNotSupported" ;
VAL_ 3221225472 CatalystMonEnabled 1 "NotCompleteCycle" 0 "CompleteCycleOrNotSupported" ;
VAL_ 3221225472 ACSystemRefrigerantMonComplete 1 "NotCompleteCycle" 0 "CompleteCycleOrNotSupported" ;
VAL_ 3221225472 ACSystemRefrigerantMonEnabled 1 "NotCompleteCycle" 0 "CompleteCycleOrNotSupported" ;
VAL_ 3221225472 FuelSystemMonitoringComplete 1 "NotCompleteCycle" 0 "CompleteCycleOrNotSupported" ;
VAL_ 3221225472 SecurityEntityType 3 "Data is Certificate" 2 "Data is Session Key" 1 "Data is Long Key" 0 "Data is Long Seed" ;
VAL_ 3221225472 XBRCtrlMode 3 "Not defined" 2 "Acceleration control with maximum mode  Execute the XBR acceleration demand if it is higher than the drivers" 1 "Acceleration control with addition mode  Add the XBR acceleration demand to the drivers acceleration demand" 0 "Override disabled  Disable any existing control commanded by the source of this command" ;
VAL_ 3221225472 XBRPriority 3 "Low priority  used in override disabled XBR Control Mode" 2 "Medium priority  used for ACCSystems This mode does not override brake protection measures of the brake" 1 "High priority  not defined" 0 "Highest priority  used for emergency situations eg for future Collision Avoidance System This mode overrides" ;
VAL_ 3221225472 XBREBIMode 3 "Not defined" 2 "Endurance Brake Integration allowed" 1 "Only Endurance Brakes allowed" 0 "No Endurance Brake Integration allowed" ;
VAL_ 3221225472 WaterInFuelIndicator 3 "Not available" 2 "Error" 1 "Yes" 0 "No" ;
VAL_ 3221225472 AxleLocation 48 "Axle3_Position0" 32 "Axle2_Position0" 16 "Axle1_Position0" 0 "Axle0_Position0" ;
VAL_ 3221225472 WinchOilPressSwitch 3 "Not Available" 2 "Error  Switch state cannot be determined" 1 "OK  Oil pressure is above minimum" 0 "NOT OK Oil pressure is too low" ;
VAL_ 3221225472 HydOilFilterRestrictionSwitch 3 "Not Available" 2 "Error" 1 "Restriction exists on oil filter" 0 "No restriction" ;
VAL_ 3221225472 YCBrakeCtrlActive 3 "Dont care/Take no action" 2 "Reserved" 1 "YC brake control active" 0 "YC brake control passive but installed" ;
VAL_ 3221225472 YCEngCtrlActive 3 "Dont care/Take no action" 2 "Reserved" 1 "YC engine control active" 0 "YC engine control passive but installed" ;
VAL_ 3221225472 ROPBrakeCtrlActive 3 "Dont care/Take no action" 2 "Reserved" 1 "ROP brake control active" 0 "ROP brake control passive but installed" ;
VAL_ 3221225472 ROPEngCtrlActive 3 "Dont care/Take no action" 2 "Reserved" 1 "ROP engine control active" 0 "ROP engine control passive but installed" ;
VAL_ 3221225472 VDCBrakeLightRq 3 "Dont care/Take no action" 2 "Reserved" 1 "Turn brake light on" 0 "Turn brake light not on" ;
VAL_ 3221225472 VDCFullyOperational 3 "Dont care/Take no action" 2 "Reserved" 1 "Fully operational" 0 "Not fully operational" ;
VAL_ 3221225472 VDCInformationSignal 3 "Dont care/Take no action" 2 "Reserved" 1 "On" 0 "Off" ;
VAL_ 3221225472 EngRequestedTorqueHighResolution 7 "0875" 1 "0125" 0 "0000" 8 "1111  not available" ;
VAL_ 3221225472 TSC1CtrlPurpose 31 "P32  Temporary Power Train Control Original use of TSC1 Command" 5 "11110  P6P31  Reserved for SAE Assignment" 4 "P5  Engine Protection" 3 "P4  Road Speed Governor" 2 "P3  PTO Governor" 1 "P2  Cruise Control" 0 "P1  Accelerator Pedal/Operator Selection" ;
VAL_ 3221225472 TSC1TransRate 7 "Use standard TSC1 transmission rates of 10 ms to engine" 6 "20 ms transmission rate" 5 "50 ms transmission rate" 4 "100 ms transmission rate" 3 "250 ms transmission rate" 2 "500 ms transmission rate" 1 "750 ms transmission rate" 0 "1000 ms transmission rate" ;
VAL_ 3221225472 OverrideCtrlModePriority 3 "Low priority" 2 "Medium priority" 1 "High priority" 0 "Highest priority" ;
VAL_ 3221225472 EngRequestedSpeedCtrlConditions 2 "Stability Optimized for driveline engaged and/or in lockup condition 1 eg vehicle driveline" 3 "Stability Optimized for driveline engaged and/or in lockup condition 2 eg PTO driveline" 1 "Stability Optimized for driveline disengaged and nonlockup conditions" 0 "Transient Optimized for driveline disengaged and nonlockup conditions" ;
VAL_ 3221225472 EngOverrideCtrlMode 3 "Speed/torque limit control  Limit speed and/or torque based on the included limit values The speed limit governor is" 2 "Torque control  Control torque to the included desired torque value" 1 "Speed control  Govern speed to the included desired speed value" 0 "Override disabled  Disable any existing control commanded by the source of this command" ;
VAL_ 3221225472 TransitRunStatus 3 "Not available" 2 "Error condition" 0 "Off" ;
VAL_ 3221225472 VehicleUseStatus 3 "Not available" 2 "Error condition" 1 "Unauthorized use" 0 "Normal use" ;
VAL_ 3221225472 SilentAlarmStatus 3 "Not available" 2 "Error condition" 1 "On" 0 "Off" ;
VAL_ 3221225472 FareboxAlarmIdentifier 25 "Maintenance access out of service" 24 "Maintenance access in service considered an alarm condition" 23 "Paper currency jam cleared" 22 "Paper currency jam" 21 "Pass/transfer jam cleared" 20 "Pass/transfer jam" 19 "Farebox reset to automatic mode" 18 "Farebox set in manual bypass" 17 "Coin dejam operated" 16 "Card/pass box full" 15 "Card/pass box less than 75 full" 14 "Card/pass box 75 full" 13 "Currency box full" 12 "Currency box less than 75 full" 11 "Currency box 75 full" 10 "Coinbox full" 9 "Coinbox 75 full" 8 "Insufficient fare accepted" 7 "Cashbox opened in service considered an alarm condition" 6 "Cashbox door timeout" 5 "Cashbox restored" 4 "Cashbox removed" 3 "Probe completed" 2 "Probe started" 1 "Voltage restored" 0 "Voltage dropout" ;
VAL_ 3221225472 FareboxEmergencyStatus 3 "Not available" 2 "Error Condition" 1 "Emergency condition" 0 "Nonemergency condition" ;
VAL_ 3221225472 TransferType 5 "Out" 4 "In" 3 "West" 2 "East" 1 "South" 0 "North" ;
VAL_ 3221225472 TypeOfService 1 "Express service" 0 "Local service" ;
VAL_ 3221225472 PaymentDetails 5 "Card" 4 "Pass" 3 "Ticket" 2 "Token" 1 "Cash" 0 "Not an upgrade" ;
VAL_ 3221225472 TypeOfFare 6 "Pass B" 5 "Pass A" 4 "Ticket B" 3 "Ticket A" 2 "Token B" 1 "Token A" 0 "Cash/No detail" ;
VAL_ 3221225472 TransactionType 7 "Free" 6 "Transfer" 5 "Permit" 4 "Card" 3 "Pass" 2 "Ticket" 1 "Token" 0 "Cash" ;
VAL_ 3221225472 FarePresets 16 "to 11111111  Reserved for assignment" 0 "to 00001111  Agency defined" ;
VAL_ 3221225472 TripDirection 5 "Out" 4 "In" 3 "West" 2 "East" 1 "South" 0 "North" ;
VAL_ 3221225472 TripStatus 4 "Undefined" 3 "Undefined" 0 "Undefined" 6 "Layover end" 5 "Layover start" 2 "Trip end" 1 "Trip start" 7 "Undefined" ;
VAL_ 3221225472 FareboxServiceStatus 3 "Not available" 2 "Error Condition" 1 "Farebox in service" 0 "Farebox out of service" ;
VAL_ 3221225472 StrobeActivationCtrlStatus 3 "Not available" 2 "Error condition" 1 "Activate strobe" 0 "Deactivate strobe" ;
VAL_ 3221225472 TransitDoorEnable 3 "Not available" 2 "Error condition" 1 "Transit door status will override strobe activation" 0 "Ignore transit door status" ;
VAL_ 3221225472 PriorityOfRespSentByEmitter 15 "Not available" 14 "Error condition" 12 "to 1101  Reserved" 11 "Priority set by hardware to high priority" 10 "Priority set by hardware to probe priority" 9 "Priority set by hardware to low priority" 4 "to 1000  Reserved" 3 "High priority" 2 "Probe priority" 1 "Low priority" 0 "Reserved" ;
VAL_ 3221225472 IntrsctnPrmptionRequest_Response 3 "Not available" 2 "Error condition" 1 "Message is a response from the emitter" 0 "Message is a request directed to the emitter" ;
VAL_ 3221225472 TransitRouteIDUsage 3 "Not available" 2 "Error condition" 1 "Transit route ID used for interleaved data if range code not enabled" 0 "Transit route ID not used for interleaved data" ;
VAL_ 3221225472 RangeCodeEnable 3 "Not available" 2 "Error condition" 1 "Range code used for interleaved data" 0 "Range code not used for interleaved data" ;
VAL_ 3221225472 TireLocation 51 "Axle3_Position3" 50 "Axle3_Position2" 49 "Axle3_Position1" 35 "Axle2_Position3" 34 "Axle2_Position2" 33 "Axle2_Position1" 19 "Axle1_Position3" 18 "Axle1_Position2" 17 "Axle1_Position1" 1 "Axle0_Position1" 48 "Axle3_Position0" 32 "Axle2_Position0" 16 "Axle1_Position0" 0 "Axle0_Position0" ;
VAL_ 3221225472 PCUTrilerTagOrPushSolenoidStatus 3 "Not available" 2 "Error" 1 "On" 0 "Off" ;
VAL_ 3221225472 PCUSupplySolenoidStatus 3 "Not available" 2 "Error" 1 "On" 0 "Off" ;
VAL_ 3221225472 PCUCtrlSolenoidStatus 3 "Not available" 2 "Error" 1 "On" 0 "Off" ;
VAL_ 3221225472 PCUDeflateSolenoidStatus 3 "Not available" 2 "Error" 1 "On" 0 "Off" ;
VAL_ 3221225472 TirePressSupplySwitchStatus 3 "Not available" 2 "Error" 1 "On" 0 "Off" ;
VAL_ 3221225472 PCUSteerSolenoidStatus 3 "Not available" 2 "Error" 1 "On" 0 "Off" ;
VAL_ 3221225472 PCUDriveSolenoidStatus 3 "Not available" 2 "Error" 1 "On" 0 "Off" ;
VAL_ 3221225472 DriveChannelMode 15 "Not available" 14 "Error Condition" 6 "Pressure Check" 5 "Deflate Wait  System will deflate when conditions allow" 4 "Inflate Wait  System will inflate when conditions allow" 3 "Confirm" 2 "Deflate" 1 "Inflate" 0 "Maintain" ;
VAL_ 3221225472 Trailer_tagChannelMode 15 "Not available" 14 "Error Condition" 6 "Pressure Check" 5 "Deflate Wait  System will deflate when conditions allow" 4 "Inflate Wait  System will inflate when conditions allow" 3 "Confirm" 2 "Deflate" 1 "Inflate" 0 "Maintain" ;
VAL_ 3221225472 SteerChannelMode 15 "Not available" 14 "Error Condition" 6 "Pressure Check" 5 "Deflate Wait  System will deflate when conditions allow" 4 "Inflate Wait  System will inflate when conditions allow" 3 "Confirm" 2 "Deflate" 1 "Inflate" 0 "Maintain" ;
VAL_ 3221225472 TirePressThresholdDetection_13 7 "NotAvailable" 6 "ErrorIndicator" 5 "NotDefined" 4 "ExtrmUndrPrssTrPrssrIsAtALvlWhr" 3 "UndrPrssTrPrssrIsLwrThnThPrssrD" 2 "NWrnngPrssTrPrssrIsWthnThThrshl" 1 "OvrPrssTrPrssrIsHghrThnThPrssrD" 0 "ExtrmOvrPrssTrPrssrIsAtALvlWhrT" ;
VAL_ 3221225472 TirePressThresholdDetection_12 7 "NotAvailable" 6 "ErrorIndicator" 5 "NotDefined" 4 "ExtrmUndrPrssTrPrssrIsAtALvlWhr" 3 "UndrPrssTrPrssrIsLwrThnThPrssrD" 2 "NWrnngPrssTrPrssrIsWthnThThrshl" 1 "OvrPrssTrPrssrIsHghrThnThPrssrD" 0 "ExtrmOvrPrssTrPrssrIsAtALvlWhrT" ;
VAL_ 3221225472 TirePressThresholdDetection_11 7 "NotAvailable" 6 "ErrorIndicator" 5 "NotDefined" 4 "ExtrmUndrPrssTrPrssrIsAtALvlWhr" 3 "UndrPrssTrPrssrIsLwrThnThPrssrD" 2 "NWrnngPrssTrPrssrIsWthnThThrshl" 1 "OvrPrssTrPrssrIsHghrThnThPrssrD" 0 "ExtrmOvrPrssTrPrssrIsAtALvlWhrT" ;
VAL_ 3221225472 TirePressThresholdDetection_10 7 "NotAvailable" 6 "ErrorIndicator" 5 "NotDefined" 4 "ExtrmUndrPrssTrPrssrIsAtALvlWhr" 3 "UndrPrssTrPrssrIsLwrThnThPrssrD" 2 "NWrnngPrssTrPrssrIsWthnThThrshl" 1 "OvrPrssTrPrssrIsHghrThnThPrssrD" 0 "ExtrmOvrPrssTrPrssrIsAtALvlWhrT" ;
VAL_ 3221225472 TirePressThresholdDetection_01 7 "NotAvailable" 6 "ErrorIndicator" 5 "NotDefined" 4 "ExtrmUndrPrssTrPrssrIsAtALvlWhr" 3 "UndrPrssTrPrssrIsLwrThnThPrssrD" 2 "NWrnngPrssTrPrssrIsWthnThThrshl" 1 "OvrPrssTrPrssrIsHghrThnThPrssrD" 0 "ExtrmOvrPrssTrPrssrIsAtALvlWhrT" ;
VAL_ 3221225472 CTIWheelSensorStatus_33 3 "NotSupported" 2 "NotDefined" 1 "On" 0 "Off_IsolatedFromCTIPressCtrl" ;
VAL_ 3221225472 CTIWheelSensorStatus_32 3 "NotSupported" 2 "NotDefined" 1 "On" 0 "Off_IsolatedFromCTIPressCtrl" ;
VAL_ 3221225472 CTIWheelSensorStatus_31 3 "NotSupported" 2 "NotDefined" 1 "On" 0 "Off_IsolatedFromCTIPressCtrl" ;
VAL_ 3221225472 CTIWheelSensorStatus_30 3 "NotSupported" 2 "NotDefined" 1 "On" 0 "Off_IsolatedFromCTIPressCtrl" ;
VAL_ 3221225472 CTIWheelSensorStatus_23 3 "NotSupported" 2 "NotDefined" 1 "On" 0 "Off_IsolatedFromCTIPressCtrl" ;
VAL_ 3221225472 CTIWheelSensorStatus_22 3 "NotSupported" 2 "NotDefined" 1 "On" 0 "Off_IsolatedFromCTIPressCtrl" ;
VAL_ 3221225472 CTIWheelSensorStatus_21 3 "NotSupported" 2 "NotDefined" 1 "On" 0 "Off_IsolatedFromCTIPressCtrl" ;
VAL_ 3221225472 CTIWheelSensorStatus_20 3 "NotSupported" 2 "NotDefined" 1 "On" 0 "Off_IsolatedFromCTIPressCtrl" ;
VAL_ 3221225472 CTIWheelSensorStatus_13 3 "NotSupported" 2 "NotDefined" 1 "On" 0 "Off_IsolatedFromCTIPressCtrl" ;
VAL_ 3221225472 CTIWheelSensorStatus_12 3 "NotSupported" 2 "NotDefined" 1 "On" 0 "Off_IsolatedFromCTIPressCtrl" ;
VAL_ 3221225472 CTIWheelSensorStatus_11 3 "NotSupported" 2 "NotDefined" 1 "On" 0 "Off_IsolatedFromCTIPressCtrl" ;
VAL_ 3221225472 CTIWheelSensorStatus_10 3 "NotSupported" 2 "NotDefined" 1 "On" 0 "Off_IsolatedFromCTIPressCtrl" ;
VAL_ 3221225472 CTIWheelSensorStatus_01 3 "NotSupported" 2 "NotDefined" 1 "On" 0 "Off_IsolatedFromCTIPressCtrl" ;
VAL_ 3221225472 CTIWheelEndElectricalFault_33 3 "NotSupported" 2 "Error" 1 "NotDefined" 0 "Ok" ;
VAL_ 3221225472 CTIWheelEndElectricalFault_32 3 "NotSupported" 2 "Error" 1 "NotDefined" 0 "Ok" ;
VAL_ 3221225472 CTIWheelEndElectricalFault_31 3 "NotSupported" 2 "Error" 1 "NotDefined" 0 "Ok" ;
VAL_ 3221225472 CTIWheelEndElectricalFault_30 3 "NotSupported" 2 "Error" 1 "NotDefined" 0 "Ok" ;
VAL_ 3221225472 CTIWheelEndElectricalFault_23 3 "NotSupported" 2 "Error" 1 "NotDefined" 0 "Ok" ;
VAL_ 3221225472 CTIWheelEndElectricalFault_22 3 "NotSupported" 2 "Error" 1 "NotDefined" 0 "Ok" ;
VAL_ 3221225472 CTIWheelEndElectricalFault_21 3 "NotSupported" 2 "Error" 1 "NotDefined" 0 "Ok" ;
VAL_ 3221225472 CTIWheelEndElectricalFault_20 3 "NotSupported" 2 "Error" 1 "NotDefined" 0 "Ok" ;
VAL_ 3221225472 CTIWheelEndElectricalFault_13 3 "NotSupported" 2 "Error" 1 "NotDefined" 0 "Ok" ;
