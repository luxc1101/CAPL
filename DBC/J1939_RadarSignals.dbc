VERSION ""

NS_ :

BS_:

BU_: Turbocharger OnBoardDataLogger OffBoardDiagnosticTool2 OffBoardDiagnosticTool1 FileServer ParkingBrakeController SeatControl2 FanDriveController SteeringColumnUnit CommunicationUnitRadio CommunicationUnitSatellite CommunicationUnitCellular PropulsionBatteryCharger ChassisController2 ChassisController1 EngineValveControl AuxiliaryHeater2 AuxiliaryHeater1 ClutchUnit RampControl InformationSystem1 SuspensionSystemController2 OilSensor VehicleDynamicStability ExhaustEmissionController TransmissionDisplay2 TransmissionDisplay1 ClimateControl2 WaterPumpController RearAxleSteeringController LightingOperatorControl SeatController1 IgnitionController2 IgnitionController1 TirePressureController CabController2 CabController1 PneumaticSystemController SuspensionSystemController1 HydraulicPumpController EnduranceBrakingSystem RetarderExhaustEngine2 OnBoardDiagnosticUnit HeadwayController RetarderExhaustEngine1 CabDisplay1 ManagementComputer VirtualTerminal OffVehicleGateway PowerTakeOffFront HitchControl AuxiliaryValveControl BodyController TractorTrailerBridge1 StarterSystem ElectricalSystem VehicleSecurity VehicleNavigation AerodynamicControl ElectricalChargingSystem ClimateControl1 TripRecorder InstrumentCluster SuspensionDriveAxle2 SuspensionDriveAxle1 SuspensionSteerAxle SteeringController FuelSystem CruiseControl RetarderDriveline RetarderEngine BrakesDriveAxle2 BrakesDriveAxle1 BrakesSystemController BrakesSteerAxle AxleDrive2 AxleDrive1 AxleSteering PowerTakeOff ShiftConsoleSecondary ShiftConsolePrimary Transmission2 Transmission1 Engine2 Engine1

BO_ 3221225472 VECTOR__INDEPENDENT_SIG_MSG: 0 Vector__XXX
 SG_ TransRangeLowActuator : 0|2@1+ (1,0) [0|3] "" Vector__XXX
 SG_ TransRangeHighActuator : 0|2@1+ (1,0) [0|3] "" Vector__XXX
 SG_ TransShiftFingerGearActuator2 : 0|2@1+ (1,0) [0|3] "" Vector__XXX
 SG_ TransShiftFingerRailActuator2 : 0|2@1+ (1,0) [0|3] "" Vector__XXX
 SG_ TransShiftFingerGearActuator1 : 0|2@1+ (1,0) [0|3] "" Vector__XXX
 SG_ TransShiftFingerRailActuator1 : 0|2@1+ (1,0) [0|3] "" Vector__XXX
 SG_ TrnsShftFngerCenterRailIndicator : 0|2@1+ (1,0) [0|3] "" Vector__XXX
 SG_ TrnsShftFngerEngagementIndicator : 0|2@1+ (1,0) [0|3] "" Vector__XXX
 SG_ TransShiftFingerNeutralIndicator : 0|2@1+ (1,0) [0|3] "" Vector__XXX
 SG_ TransShiftFingerRailPos : 0|8@1+ (0.4,0) [0|100] "%" Vector__XXX
 SG_ TransShiftFingerGearPos : 0|8@1+ (0.4,0) [0|100] "%" Vector__XXX
 SG_ SrcAddrssOfCntrllngDvcFrTrnsCtrl : 0|8@1+ (1,0) [0|255] "" Vector__XXX
 SG_ TransInputShaftSpeed : 0|16@1+ (0.125,0) [0|8031.875] "rpm" Vector__XXX
 SG_ MomentaryEngMaxPowerEnable : 0|2@1+ (1,0) [0|3] "" Vector__XXX
 SG_ ProgressiveShiftDisable : 0|2@1+ (1,0) [0|3] "" Vector__XXX
 SG_ EngMomentaryOverspeedEnable : 0|2@1+ (1,0) [0|3] "" Vector__XXX
 SG_ TransOutputShaftSpeed : 0|16@1+ (0.125,0) [0|8031.875] "rpm" Vector__XXX
 SG_ TrnsTrqCnvrtrLckpTrnstnInProcess : 0|2@1+ (1,0) [0|3] "" Vector__XXX
 SG_ TransShiftInProcess : 0|2@1+ (1,0) [0|3] "" Vector__XXX
 SG_ TrnsTorqueConverterLockupEngaged : 0|2@1+ (1,0) [0|3] "" Vector__XXX
 SG_ TransDrivelineEngaged : 0|2@1+ (1,0) [0|3] "" Vector__XXX
 SG_ EngChargeAirCooler1OutletTemp : 0|16@1+ (0.03125,-273) [-273|1734.96875] "deg C" Vector__XXX
 SG_ EngIntkVlvActuationSystemOilTemp : 0|16@1+ (0.03125,-273) [-273|1734.96875] "deg C" Vector__XXX
 SG_ EngIntakeManifold1AirTemp : 0|16@1+ (0.03125,-273) [-273|1734.96875] "deg C" Vector__XXX
 SG_ EngExhstGsRcirculation1DiffPress : 0|16@1+ (0.0078124659559567,-250) [-250|251.99] "kPa" Vector__XXX
 SG_ EngExhaustGasRecirculation1Temp : 0|16@1+ (0.03125,-273) [-273|1734.96875] "deg C" Vector__XXX
 SG_ EngECUTemp : 0|16@1+ (0.03125,-273) [-273|1734.96875] "deg C" Vector__XXX
 SG_ EngOilTemp2 : 0|16@1+ (0.03125,-273) [-273|1734.96875] "deg C" Vector__XXX
 SG_ EngFuelTemp1 : 0|8@1+ (1,-40) [-40|210] "deg C" Vector__XXX
 SG_ EngIntercoolerThermostatOpening : 0|8@1+ (0.4,0) [0|100] "%" Vector__XXX
 SG_ EngIntercoolerTemp : 0|8@1+ (1,-40) [-40|210] "deg C" Vector__XXX
 SG_ EngTurboOilTemp : 0|16@1+ (0.03125,-273) [-273|1734.96875] "deg C" Vector__XXX
 SG_ EngOilTemp1 : 0|16@1+ (0.03125,-273) [-273|1734.96875] "deg C" Vector__XXX
 SG_ EngExhaustGasTempLeftManifold : 0|16@1+ (0.03125,-273) [-273|1734.96875] "deg C" Vector__XXX
 SG_ EngExhaustGasTempRightManifold : 0|16@1+ (0.03125,-273) [-273|1734.96875] "deg C" Vector__XXX
 SG_ TransOutputRetarder : 0|2@1+ (1,0) [0|3] "" Vector__XXX
 SG_ EngExhaustGasPort20Temp : 0|16@1+ (0.03125,-273) [-273|1734.96875] "deg C" Vector__XXX
 SG_ EngExhaustGasPort19Temp : 0|16@1+ (0.03125,-273) [-273|1734.96875] "deg C" Vector__XXX
 SG_ EngExhaustGasPort18Temp : 0|16@1+ (0.03125,-273) [-273|1734.96875] "deg C" Vector__XXX
 SG_ EngExhaustGasPort17Temp : 0|16@1+ (0.03125,-273) [-273|1734.96875] "deg C" Vector__XXX
 SG_ EngExhaustGasPort16Temp : 0|16@1+ (0.03125,-273) [-273|1734.96875] "deg C" Vector__XXX
 SG_ EngExhaustGasPort15Temp : 0|16@1+ (0.03125,-273) [-273|1734.96875] "deg C" Vector__XXX
 SG_ EngExhaustGasPort14Temp : 0|16@1+ (0.03125,-273) [-273|1734.96875] "deg C" Vector__XXX
 SG_ EngExhaustGasPort13Temp : 0|16@1+ (0.03125,-273) [-273|1734.96875] "deg C" Vector__XXX
 SG_ EngExhaustGasPort12Temp : 0|16@1+ (0.03125,-273) [-273|1734.96875] "deg C" Vector__XXX
 SG_ EngExhaustGasPort11Temp : 0|16@1+ (0.03125,-273) [-273|1734.96875] "deg C" Vector__XXX
 SG_ EngExhaustGasPort10Temp : 0|16@1+ (0.03125,-273) [-273|1734.96875] "deg C" Vector__XXX
 SG_ EngExhaustGasPort9Temp : 0|16@1+ (0.03125,-273) [-273|1734.96875] "deg C" Vector__XXX
 SG_ EngExhaustGasPort8Temp : 0|16@1+ (0.03125,-273) [-273|1734.96875] "deg C" Vector__XXX
 SG_ EngExhaustGasPort7Temp : 0|16@1+ (0.03125,-273) [-273|1734.96875] "deg C" Vector__XXX
 SG_ EngExhaustGasPort6Temp : 0|16@1+ (0.03125,-273) [-273|1734.96875] "deg C" Vector__XXX
 SG_ EngExhaustGasPort5Temp : 0|16@1+ (0.03125,-273) [-273|1734.96875] "deg C" Vector__XXX
 SG_ EngExhaustGasPort4Temp : 0|16@1+ (0.03125,-273) [-273|1734.96875] "deg C" Vector__XXX
 SG_ EngExhaustGasPort3Temp : 0|16@1+ (0.03125,-273) [-273|1734.96875] "deg C" Vector__XXX
 SG_ EngExhaustGasPort2Temp : 0|16@1+ (0.03125,-273) [-273|1734.96875] "deg C" Vector__XXX
 SG_ EngExhaustGasPort1Temp : 0|16@1+ (0.03125,-273) [-273|1734.96875] "deg C" Vector__XXX
 SG_ PayloadPercentage : 0|8@1+ (1,0) [0|250] "%" Vector__XXX
 SG_ DataMemoryUsage : 0|8@1+ (0.4,0) [0|100] "%" Vector__XXX
 SG_ KeepAliveBatteryConsumption : 0|16@1+ (1,0) [0|64255] "mAhr" Vector__XXX
 SG_ TravelVelocityCtrlPos : 0|8@1+ (1,-125) [-125|125] "%" Vector__XXX
 SG_ EngExhstGsOxygnSnsrClsdLpOprtion : 0|2@1+ (1,0) [0|3] "" Vector__XXX
 SG_ EngExhstGsOxygnSnsrFlngCrrection : 0|8@1+ (1,-125) [-125|125] "%" Vector__XXX
 SG_ EngActualExhaustOxygen : 0|16@1+ (0.0025,0) [0|160.6375] "%" Vector__XXX
 SG_ EngDesiredExhaustOxygen : 0|16@1+ (0.0025,0) [0|160.6375] "%" Vector__XXX
 SG_ EngDesiredRatedExhaustOxygen : 0|16@1+ (0.0025,0) [0|160.6375] "%" Vector__XXX
 SG_ Jystick3GripXAxisDetentPosStatus : 0|2@1+ (1,0) [0|3] "" Vector__XXX
 SG_ Jystick3GripYAxisDetentPosStatus : 0|2@1+ (1,0) [0|3] "" Vector__XXX
 SG_ Jystick3ThetaAxisDetentPosStatus : 0|2@1+ (1,0) [0|3] "" Vector__XXX
 SG_ Joystick3ThetaAxisPos : 0|10@1+ (1,0) [0|102] "%" Vector__XXX
 SG_ Jystck3ThtAxsClckwsPstvPosStatus : 0|2@1+ (1,0) [0|3] "" Vector__XXX
 SG_ Jystck3ThetaAxisNeutralPosStatus : 0|2@1+ (1,0) [0|3] "" Vector__XXX
 SG_ Joystick3GripYAxisPos : 0|10@1+ (1,0) [0|102] "%" Vector__XXX
 SG_ Jystck3GrpYAxsLvrFrwrdPstvPsStts : 0|2@1+ (1,0) [0|3] "" Vector__XXX
 SG_ Jystck3GrpYAxsLvrBckNgtvPsStatus : 0|2@1+ (1,0) [0|3] "" Vector__XXX
 SG_ Jystck3GripYAxisNeutralPosStatus : 0|2@1+ (1,0) [0|3] "" Vector__XXX
 SG_ Joystick3GripXAxisPos : 0|10@1+ (1,0) [0|102] "%" Vector__XXX
 SG_ Jystck3GrpXAxsLvrRghtPstvPsSttus : 0|2@1+ (1,0) [0|3] "" Vector__XXX
 SG_ Jystck3GrpXAxsLvrLftNgtvPsStatus : 0|2@1+ (1,0) [0|3] "" Vector__XXX
 SG_ Jystck3GripXAxisNeutralPosStatus : 0|2@1+ (1,0) [0|3] "" Vector__XXX
 SG_ Jystck3ThtAxsCntrClckwsNgtvPsStt : 0|2@1+ (1,0) [0|3] "" Vector__XXX
 SG_ Jystick2GripXAxisDetentPosStatus : 0|2@1+ (1,0) [0|3] "" Vector__XXX
 SG_ Jystick2GripYAxisDetentPosStatus : 0|2@1+ (1,0) [0|3] "" Vector__XXX
 SG_ Jystick2ThetaAxisDetentPosStatus : 0|2@1+ (1,0) [0|3] "" Vector__XXX
 SG_ Joystick2ThetaAxisPos : 0|10@1+ (1,0) [0|102] "%" Vector__XXX
 SG_ Jystck2ThtAxsClckwsPstvPosStatus : 0|2@1+ (1,0) [0|3] "" Vector__XXX
 SG_ Jystck2ThetaAxisNeutralPosStatus : 0|2@1+ (1,0) [0|3] "" Vector__XXX
 SG_ Joystick2GripYAxisPos : 0|10@1+ (1,0) [0|102] "%" Vector__XXX
 SG_ Jystck2GrpYAxsLvrFrwrdPstvPsStts : 0|2@1+ (1,0) [0|3] "" Vector__XXX
 SG_ Jystck2GrpYAxsLvrBckNgtvPsStatus : 0|2@1+ (1,0) [0|3] "" Vector__XXX
 SG_ Jystck2GripYAxisNeutralPosStatus : 0|2@1+ (1,0) [0|3] "" Vector__XXX
 SG_ Joystick2GripXAxisPos : 0|10@1+ (1,0) [0|102] "%" Vector__XXX
 SG_ Jystck2GrpXAxsLvrRghtPstvPsSttus : 0|2@1+ (1,0) [0|3] "" Vector__XXX
 SG_ Jystck2GrpXAxsLvrLftNgtvPsStatus : 0|2@1+ (1,0) [0|3] "" Vector__XXX
 SG_ Jystck2GripXAxisNeutralPosStatus : 0|2@1+ (1,0) [0|3] "" Vector__XXX
 SG_ Jystck2ThtAxsCntrClckwsNgtvPsStt : 0|2@1+ (1,0) [0|3] "" Vector__XXX
 SG_ Jystick1GripXAxisDetentPosStatus : 0|2@1+ (1,0) [0|3] "" Vector__XXX
 SG_ Jystick1GripYAxisDetentPosStatus : 0|2@1+ (1,0) [0|3] "" Vector__XXX
 SG_ Jystick1ThetaAxisDetentPosStatus : 0|2@1+ (1,0) [0|3] "" Vector__XXX
 SG_ Joystick1ThetaAxisPos : 0|10@1+ (1,0) [0|102] "%" Vector__XXX
 SG_ Jystck1ThtAxsClckwsPstvPosStatus : 0|2@1+ (1,0) [0|3] "" Vector__XXX
 SG_ Jystck1ThetaAxisNeutralPosStatus : 0|2@1+ (1,0) [0|3] "" Vector__XXX
 SG_ Joystick1GripYAxisPos : 0|10@1+ (1,0) [0|102] "%" Vector__XXX
 SG_ Jystck1GrpYAxsLvrFrwrdPstvPsStts : 0|2@1+ (1,0) [0|3] "" Vector__XXX
 SG_ Jystck1GrpYAxsLvrBckNgtvPsStatus : 0|2@1+ (1,0) [0|3] "" Vector__XXX
 SG_ Jystck1GripYAxisNeutralPosStatus : 0|2@1+ (1,0) [0|3] "" Vector__XXX
 SG_ Joystick1GripXAxisPos : 0|10@1+ (1,0) [0|102] "%" Vector__XXX
 SG_ Jystck1GrpXAxsLvrRghtPstvPsSttus : 0|2@1+ (1,0) [0|3] "" Vector__XXX
 SG_ Jystck1GrpXAxsLvrLftNgtvPsStatus : 0|2@1+ (1,0) [0|3] "" Vector__XXX
 SG_ Jystck1GripXAxisNeutralPosStatus : 0|2@1+ (1,0) [0|3] "" Vector__XXX
 SG_ Jystck1ThtAxsCntrClckwsNgtvPsStt : 0|2@1+ (1,0) [0|3] "" Vector__XXX
 SG_ EngFuelRackPos : 0|8@1+ (0.4,0) [0|100] "%" Vector__XXX
 SG_ EngGasMassFlowRate1 : 0|16@1+ (0.05,0) [0|3212.75] "kg/h" Vector__XXX
 SG_ InstantaneousEstBrakePower : 0|16@1+ (0.5,0) [0|32127.5] "kW" Vector__XXX
 SG_ EngExhaustGasPress : 0|16@1+ (0.0078124659559567,-250) [-250|251.99] "kPa" Vector__XXX
 SG_ EngPrefilterOilPress : 0|8@1+ (4,0) [0|1000] "kPa" Vector__XXX
 SG_ TotalECURunTime : 0|32@1+ (0.05,0) [0|210554060.75] "hr" Vector__XXX
 SG_ TotalECUDistance : 0|32@1+ (0.12500000000594,0) [0|526385151.9] "km" Vector__XXX
 SG_ EngExhstGsRcrcltion2MassFlowRate : 0|16@1+ (0.05,0) [0|3212.75] "kg/h" Vector__XXX
 SG_ EngIntakeAirMassFlowRate : 0|16@1+ (0.05,0) [0|3212.75] "kg/h" Vector__XXX
 SG_ EngExhstGsRcrcltion1MassFlowRate : 0|16@1+ (0.05,0) [0|3212.75] "kg/h" Vector__XXX
 SG_ FuelPumpPrimerStatus : 0|2@1+ (1,0) [0|3] "" Vector__XXX
 SG_ EngVentilationStatus : 0|3@1+ (1,0) [0|7] "" Vector__XXX
 SG_ EngCoolantPreheatedState : 0|2@1+ (1,0) [0|3] "" Vector__XXX
 SG_ EngOilPreHeatedState : 0|2@1+ (1,0) [0|3] "" Vector__XXX
 SG_ EngOilPrimingState : 0|2@1+ (1,0) [0|3] "" Vector__XXX
 SG_ EngOilPrimingPumpSwitch : 0|2@1+ (1,0) [0|3] "" Vector__XXX
 SG_ EngOilFilterOutletPress : 0|8@1+ (4,0) [0|1000] "kPa" Vector__XXX
 SG_ EngWasteOilReservoirLevel : 0|8@1+ (0.4,0) [0|100] "%" Vector__XXX
 SG_ EngFuelFilterDiffPress : 0|8@1+ (2,0) [0|500] "kPa" Vector__XXX
 SG_ EngFuelSupplyPumpIntakePress : 0|8@1+ (2,0) [0|500] "kPa" Vector__XXX
 SG_ EngOilLevelRemoteReservoir : 0|8@1+ (0.4,0) [0|100] "%" Vector__XXX
 SG_ EngExhstGsRcrclation1OutletPress : 0|8@1+ (2,0) [0|500] "kPa" Vector__XXX
 SG_ EngExhstVlvActtionSystemOilPress : 0|16@1+ (0.0039063107929344,0) [0|251] "MPa" Vector__XXX
 SG_ EngExhstGsRcrclation1IntakePress : 0|8@1+ (2,0) [0|500] "kPa" Vector__XXX
 SG_ EngIntkVlvActationSystemOilPress : 0|16@1+ (0.0039063107929344,0) [0|251] "MPa" Vector__XXX
 SG_ EngInjectorMeteringRail2Press : 0|16@1+ (0.0039063107929344,0) [0|251] "MPa" Vector__XXX
 SG_ EngInjectorTimingRail1Press : 0|16@1+ (0.0039063107929344,0) [0|251] "MPa" Vector__XXX
 SG_ EngInjectorMeteringRail1Press : 0|16@1+ (0.0039063107929344,0) [0|251] "MPa" Vector__XXX
 SG_ EngInjectionCtrlPress : 0|16@1+ (0.0039063107929344,0) [0|251] "MPa" Vector__XXX
 SG_ EngCoolantLevel : 0|8@1+ (0.4,0) [0|100] "%" Vector__XXX
 SG_ EngCoolantPress : 0|8@1+ (2,0) [0|500] "kPa" Vector__XXX
 SG_ EngCrankcasePress : 0|16@1+ (0.0078124659559567,-250) [-250|251.99] "kPa" Vector__XXX
 SG_ EngOilPress : 0|8@1+ (4,0) [0|1000] "kPa" Vector__XXX
 SG_ EngOilLevel : 0|8@1+ (0.4,0) [0|100] "%" Vector__XXX
 SG_ EngExCrankcaseBlowbyPress : 0|8@1+ (0.05,0) [0|12.5] "kPa" Vector__XXX
 SG_ EngFuelDeliveryPress : 0|8@1+ (4,0) [0|1000] "kPa" Vector__XXX
 SG_ SafetyWireStatus : 0|2@1+ (1,0) [0|3] "" Vector__XXX
 SG_ ElectricalLoad : 0|16@1+ (0.5,0) [0|32127.5] "kW" Vector__XXX
 SG_ EngVriableGeometryTurbo1CtrlMode : 0|2@1+ (1,0) [0|3] "" Vector__XXX
 SG_ EngTrb1ClclatedTurbineIntakeTemp : 0|16@1+ (1,-273) [-273|1734.96875] "deg C" Vector__XXX
 SG_ EngExhstGsRcirculation1ValveCtrl : 0|16@1+ (1,0) [0|160.6375] "%" Vector__XXX
 SG_ EngVrblGeometryTurbo1ActuatorPos : 0|8@1+ (0.4,0) [0|100] "%" Vector__XXX
 SG_ EngVrblGmtryTrbArCtrlShtoffValve : 0|2@1+ (1,0) [0|3] "" Vector__XXX
 SG_ EngTrb1ClclatedTurbineOutletTemp : 0|16@1+ (1,-273) [-273|1734.96875] "deg C" Vector__XXX
 SG_ CrnkAttmptCntOnPrsntStartAttempt : 0|8@1+ (1,0) [0|250] "" Vector__XXX
 SG_ EngIntakeManifoldPressCtrlMode : 0|2@1+ (1,0) [0|3] "" Vector__XXX
 SG_ EngRotationDirection : 0|2@1+ (1,0) [0|3] "" Vector__XXX
 SG_ EngRatedSpeed : 0|16@1+ (0.125,0) [0|8031.875] "rpm" Vector__XXX
 SG_ EngRatedPower : 0|16@1+ (0.5,0) [0|32127.5] "kW" Vector__XXX
 SG_ Aftertreatment2ExhaustDewPoint : 0|2@1+ (1,0) [0|3] "" Vector__XXX
 SG_ Aftertreatment2IntakeDewPoint : 0|2@1+ (1,0) [0|3] "" Vector__XXX
 SG_ Aftertreatment1ExhaustDewPoint : 0|2@1+ (1,0) [0|3] "" Vector__XXX
 SG_ Aftertreatment1IntakeDewPoint : 0|2@1+ (1,0) [0|3] "" Vector__XXX
 SG_ Aftrtreatment1ExhaustGasMassFlow : 0|16@1+ (0.2,0) [0|12851] "kg/h per bit" Vector__XXX
 SG_ EstEngPrsiticLossesPercentTorque : 0|8@1+ (1,-125) [-125|125] "%" Vector__XXX
 SG_ EngnsDsrdOprtngSpdAsymmtryAdjstm : 0|8@1+ (1,0) [0|250] "" Vector__XXX
 SG_ EnginesDesiredOperatingSpeed : 0|16@1+ (1,0) [0|8031.875] "rpm" Vector__XXX
 SG_ NominalFrictionPercentTorque : 0|8@1+ (1,-125) [-125|125] "%" Vector__XXX
 SG_ SrcAddrssOfCntrllngDvcForEngCtrl : 0|8@1+ (1,0) [0|255] "" Vector__XXX
 SG_ ActlEngPrcntTorqueHighResolution : 0|4@1+ (1,0) [0|0.875] "%" Vector__XXX
 SG_ EngDemandPercentTorque : 0|8@1+ (1,-125) [-125|125] "%" Vector__XXX
 SG_ EngStarterMode : 0|4@1+ (1,0) [0|15] "" Vector__XXX
 SG_ EngSpeed : 0|16@1+ (0.125,0) [0|8031.875] "rpm" Vector__XXX
 SG_ ActualEngPercentTorque : 0|8@1+ (1,-125) [-125|125] "%" Vector__XXX
 SG_ DriversDemandEngPercentTorque : 0|8@1+ (1,-125) [-125|125] "%" Vector__XXX
 SG_ EngTorqueMode : 0|4@1+ (1,0) [0|15] "" Vector__XXX
 SG_ ECUType : 0|8@1+ (1.02,0) [0|255] "per byte" Vector__XXX
 SG_ ECULocation : 0|8@1+ (1.02,0) [0|255] "per byte" Vector__XXX
 SG_ ECUSerialNumber : 0|8@1+ (1.02,0) [0|255] "per byte" Vector__XXX
 SG_ ECUPartNumber : 0|8@1+ (1.02,0) [0|255] "per byte" Vector__XXX
 SG_ EngMinContinuousTorque : 0|8@1+ (1,-125) [-125|125] "%" Vector__XXX
 SG_ EngMaxContinuousTorque : 0|8@1+ (1,-125) [-125|125] "%" Vector__XXX
 SG_ EngMinContinuousRPM : 0|8@1+ (1,0) [0|8000] "rpm" Vector__XXX
 SG_ EngMaxContinuousRPM : 0|8@1+ (1,0) [0|8000] "rpm" Vector__XXX
 SG_ EngHghLmtThrshldFrMnCntnsTrqFrmE : 0|8@1+ (1,-125) [-125|125] "%" Vector__XXX
 SG_ EngLwLmtThrshldFrMxTorqueFromEng : 0|8@1+ (1,-125) [-125|125] "%" Vector__XXX
 SG_ EngHghLmtThrshldFrMnCntnusEngRPM : 0|8@1+ (1,0) [0|8000] "rpm" Vector__XXX
 SG_ EngLwLmtThrsholdForMaxRPMFromEng : 0|8@1+ (1,0) [0|8000] "rpm" Vector__XXX
 SG_ SupportTSC1CtrlPurposeGroup4 : 0|8@1+ (1,0) [0|255] "" Vector__XXX
 SG_ SupportTSC1CtrlPurposeGroup3 : 0|8@1+ (1,0) [0|255] "" Vector__XXX
 SG_ SupportTSC1CtrlPurposeGroup2 : 0|8@1+ (1,0) [0|255] "" Vector__XXX
 SG_ SupportTSC1CtrlPurposeGroup1 : 0|8@1+ (1,0) [0|255] "" Vector__XXX
 SG_ SupportVariableRateTSC1Message : 0|8@1+ (1,0) [0|255] "" Vector__XXX
 SG_ EngDefaultTorqueLimit : 0|16@1+ (1,0) [0|64255] "Nm" Vector__XXX
 SG_ EngMomentOfInertia : 0|16@1+ (1,0) [0|257.02] "kg-m^2" Vector__XXX
 SG_ EngExRngRqstdSpdCtrlRngUpprLimit : 0|16@1+ (0.125,0) [0|8031.875] "rpm" Vector__XXX
 SG_ EngRqstdTrqueCtrlRangeUpperLimit : 0|8@1+ (1,-125) [-125|125] "%" Vector__XXX
 SG_ EngRqstdTrqueCtrlRangeLowerLimit : 0|8@1+ (1,-125) [-125|125] "%" Vector__XXX
 SG_ EngRqstdSpeedCtrlRangeUpperLimit : 0|8@1+ (10,0) [0|2500] "rpm" Vector__XXX
 SG_ EngRqstdSpeedCtrlRangeLowerLimit : 0|8@1+ (10,0) [0|2500] "rpm" Vector__XXX
 SG_ EngMaxMomentaryOverrideTimeLimit : 0|8@1+ (0.1,0) [0|25] "s" Vector__XXX
 SG_ EngMxMmentaryOverrideSpeedPoint7 : 0|16@1+ (0.125,0) [0|8031.875] "rpm" Vector__XXX
 SG_ EngReferenceTorque : 0|16@1+ (1,0) [0|64255] "Nm" Vector__XXX
 SG_ EngGain : 0|16@1+ (0.00078126215858688,0) [0|50.2] "%/rpm" Vector__XXX
 SG_ EngSpeedAtHighIdlePoint6 : 0|16@1+ (0.125,0) [0|8031.875] "rpm" Vector__XXX
 SG_ EngPercentTorqueAtPoint5 : 0|8@1+ (1,-125) [-125|125] "%" Vector__XXX
 SG_ EngSpeedAtPoint5 : 0|16@1+ (0.125,0) [0|8031.875] "rpm" Vector__XXX
 SG_ EngPercentTorqueAtPoint4 : 0|8@1+ (1,-125) [-125|125] "%" Vector__XXX
 SG_ EngSpeedAtPoint4 : 0|16@1+ (0.125,0) [0|8031.875] "rpm" Vector__XXX
 SG_ EngPercentTorqueAtPoint3 : 0|8@1+ (1,-125) [-125|125] "%" Vector__XXX
 SG_ EngSpeedAtPoint3 : 0|16@1+ (0.125,0) [0|8031.875] "rpm" Vector__XXX
 SG_ EngPercentTorqueAtPoint2 : 0|8@1+ (1,-125) [-125|125] "%" Vector__XXX
 SG_ EngSpeedAtPoint2 : 0|16@1+ (0.125,0) [0|8031.875] "rpm" Vector__XXX
 SG_ EngPercentTorqueAtIdlePoint1 : 0|8@1+ (1,-125) [-125|125] "%" Vector__XXX
 SG_ EngSpeedAtIdlePoint1 : 0|16@1+ (0.125,0) [0|8031.875] "rpm" Vector__XXX
 SG_ PrkngBrakeActuatorFullyActivated : 0|2@1+ (1,0) [0|3] "" Vector__XXX
 SG_ XBRAccelerationLimit : 0|8@1+ (1,-12.5) [-12.5|12.5] "m/s²" Vector__XXX
 SG_ XBRActiveCtrlMode : 0|4@1+ (1,0) [0|15] "" Vector__XXX
 SG_ XBRSystemState : 0|2@1+ (1,0) [0|3] "" Vector__XXX
 SG_ FoundationBrakeUse : 0|2@1+ (1,0) [0|3] "" Vector__XXX
 SG_ HillHolderMode : 0|3@1+ (1,0) [0|7] "" Vector__XXX
 SG_ HaltBrakeMode : 0|3@1+ (1,0) [0|7] "" Vector__XXX
 SG_ BrakeTempWarning : 0|2@1+ (1,0) [0|3] "" Vector__XXX
 SG_ BrkLnngRmningRearAxle3RightWheel : 0|8@1+ (0.4,0) [0|100] "%" Vector__XXX
 SG_ BrkLnngRminingRearAxle3LeftWheel : 0|8@1+ (0.4,0) [0|100] "%" Vector__XXX
 SG_ BrkLnngRmningRearAxle2RightWheel : 0|8@1+ (0.4,0) [0|100] "%" Vector__XXX
 SG_ BrkLnngRminingRearAxle2LeftWheel : 0|8@1+ (0.4,0) [0|100] "%" Vector__XXX
 SG_ BrkLnngRmningRearAxle1RightWheel : 0|8@1+ (0.4,0) [0|100] "%" Vector__XXX
 SG_ BrkLnngRminingRearAxle1LeftWheel : 0|8@1+ (0.4,0) [0|100] "%" Vector__XXX
 SG_ BrkLnngRmningFrontAxleRightWheel : 0|8@1+ (0.4,0) [0|100] "%" Vector__XXX
 SG_ BrkLnngRminingFrontAxleLeftWheel : 0|8@1+ (0.4,0) [0|100] "%" Vector__XXX
 SG_ BrkAppPrssHghRngRrAxl3RightWheel : 0|8@1+ (5,0) [0|1250] "kPa" Vector__XXX
 SG_ BrkAppPrssHghRngRrAxle3LeftWheel : 0|8@1+ (5,0) [0|1250] "kPa" Vector__XXX
 SG_ BrkAppPrssHghRngRrAxl2RightWheel : 0|8@1+ (5,0) [0|1250] "kPa" Vector__XXX
 SG_ BrkAppPrssHghRngRrAxle2LeftWheel : 0|8@1+ (5,0) [0|1250] "kPa" Vector__XXX
 SG_ BrkAppPrssHghRngRrAxle1LeftWheel : 0|8@1+ (5,0) [0|1250] "kPa" Vector__XXX
 SG_ BrkAppPrssHghRngFrntAxlRghtWheel : 0|8@1+ (5,0) [0|1250] "kPa" Vector__XXX
 SG_ BrkAppPrssHghRngFrntAxlLeftWheel : 0|8@1+ (5,0) [0|1250] "kPa" Vector__XXX
 SG_ BrkAppPrssHghRngRrAxl1RightWheel : 0|8@1+ (5,0) [0|1250] "kPa" Vector__XXX
 SG_ RearAxleGroupEngagementStatus : 0|2@1+ (1,0) [0|3] "" Vector__XXX
 SG_ FrontAxleGroupEngagementStatus : 0|2@1+ (1,0) [0|3] "" Vector__XXX
 SG_ DiffLockStateCentralRear : 0|2@1+ (1,0) [0|3] "" Vector__XXX
 SG_ DiffLockStateCentralFront : 0|2@1+ (1,0) [0|3] "" Vector__XXX
 SG_ DiffLockStateCentral : 0|2@1+ (1,0) [0|3] "" Vector__XXX
 SG_ DiffLockStateRearAxle2 : 0|2@1+ (1,0) [0|3] "" Vector__XXX
 SG_ DiffLockStateRearAxle1 : 0|2@1+ (1,0) [0|3] "" Vector__XXX
 SG_ DiffLockStateFrontAxle2 : 0|2@1+ (1,0) [0|3] "" Vector__XXX
 SG_ DiffLockStateFrontAxle1 : 0|2@1+ (1,0) [0|3] "" Vector__XXX
 SG_ Location : 0|8@1+ (1.02,0) [0|255] "" Vector__XXX
 SG_ SeaWaterPumpOutletPress : 0|8@1+ (2,0) [0|500] "kPa" Vector__XXX
 SG_ EngAuxCoolantTemp : 0|8@1+ (1,-40) [-40|210] "deg C" Vector__XXX
 SG_ EngAuxCoolantPress : 0|8@1+ (4,0) [0|1000] "kPa" Vector__XXX
 SG_ Driver2Identification : 0|8@1+ (1.02,0) [0|255] "per byte" Vector__XXX
 SG_ Driver1Identification : 0|8@1+ (1.02,0) [0|255] "per byte" Vector__XXX
 SG_ FuelLevel2 : 0|8@1+ (0.4,0) [0|100] "%" Vector__XXX
 SG_ CargoAmbientTemp : 0|16@1+ (0.03125,-273) [-273|1734.96875] "deg C" Vector__XXX
 SG_ EngOilFilterDiffPress : 0|8@1+ (0.5,0) [0|125] "kPa" Vector__XXX
 SG_ EngFuelFilterDiffPress : 0|8@1+ (2,0) [0|500] "kPa" Vector__XXX
 SG_ FuelLevel1 : 0|8@1+ (0.4,0) [0|100] "%" Vector__XXX
 SG_ WasherFluidLevel : 0|8@1+ (0.4,0) [0|100] "%" Vector__XXX
 SG_ EngStartEnableDevice2Config : 0|4@1+ (1,0) [0|15] "" Vector__XXX
 SG_ EngStartEnableDevice1Config : 0|4@1+ (1,0) [0|15] "" Vector__XXX
 SG_ EngStartEnableDevice2 : 0|2@1+ (1,0) [0|3] "" Vector__XXX
 SG_ EngStartEnableDevice1 : 0|2@1+ (1,0) [0|3] "" Vector__XXX
 SG_ PoweredVehicleWeight : 0|16@1+ (10,0) [0|642550] "kg" Vector__XXX
 SG_ GrossCombinationVehicleWeight : 0|16@1+ (10,0) [0|642550] "kg" Vector__XXX
 SG_ MxCntinuousRetarderTorqueLimitRq : 0|8@1+ (1,-125) [-125|125] "%" Vector__XXX
 SG_ MnCntinuousRetarderTorqueLimitRq : 0|8@1+ (1,-125) [-125|125] "%" Vector__XXX
 SG_ MxContinuousRetarderSpeedLimitRq : 0|8@1+ (1,0) [0|8000] "rpm" Vector__XXX
 SG_ MnContinuousRetarderSpeedLimitRq : 0|8@1+ (1,0) [0|8000] "rpm" Vector__XXX
 SG_ EngTorqueLimitRqMaxContinuous : 0|8@1+ (1,-125) [-125|125] "%" Vector__XXX
 SG_ EngTorqueLimitRqMinContinuous : 0|8@1+ (1,-125) [-125|125] "%" Vector__XXX
 SG_ EngSpeedLimitRqMaxContinuous : 0|8@1+ (1,0) [0|8000] "rpm" Vector__XXX
 SG_ EngSpeedLimitRqMinContinuous : 0|8@1+ (1,0) [0|8000] "rpm" Vector__XXX
 SG_ EngAverageCombustionTime : 0|16@1+ (0.01,0) [0|642.55] "ms" Vector__XXX
 SG_ EngDesiredCombustionTime : 0|16@1+ (0.01,0) [0|642.55] "ms" Vector__XXX
 SG_ EngCyl20CombustionTime : 0|16@1+ (0.01,0) [0|642.55] "ms" Vector__XXX
 SG_ EngCyl19CombustionTime : 0|16@1+ (0.01,0) [0|642.55] "ms" Vector__XXX
 SG_ EngCyl18CombustionTime : 0|16@1+ (0.01,0) [0|642.55] "ms" Vector__XXX
 SG_ EngCyl17CombustionTime : 0|16@1+ (0.01,0) [0|642.55] "ms" Vector__XXX
 SG_ EngCyl16CombustionTime : 0|16@1+ (0.01,0) [0|642.55] "ms" Vector__XXX
 SG_ EngCyl15CombustionTime : 0|16@1+ (0.01,0) [0|642.55] "ms" Vector__XXX
 SG_ EngCyl14CombustionTime : 0|16@1+ (0.01,0) [0|642.55] "ms" Vector__XXX
 SG_ EngCyl13CombustionTime : 0|16@1+ (0.01,0) [0|642.55] "ms" Vector__XXX
 SG_ EngCyl12CombustionTime : 0|16@1+ (0.01,0) [0|642.55] "ms" Vector__XXX
 SG_ EngCyl11CombustionTime : 0|16@1+ (0.01,0) [0|642.55] "ms" Vector__XXX
 SG_ EngCyl10CombustionTime : 0|16@1+ (0.01,0) [0|642.55] "ms" Vector__XXX
 SG_ EngCyl9CombustionTime : 0|16@1+ (0.01,0) [0|642.55] "ms" Vector__XXX
 SG_ EngCyl8CombustionTime : 0|16@1+ (0.01,0) [0|642.55] "ms" Vector__XXX
 SG_ EngCyl7CombustionTime : 0|16@1+ (0.01,0) [0|642.55] "ms" Vector__XXX
 SG_ EngCyl6CombustionTime : 0|16@1+ (0.01,0) [0|642.55] "ms" Vector__XXX
 SG_ EngCyl5CombustionTime : 0|16@1+ (0.01,0) [0|642.55] "ms" Vector__XXX
 SG_ EngCyl4CombustionTime : 0|16@1+ (0.01,0) [0|642.55] "ms" Vector__XXX
 SG_ EngCyl3CombustionTime : 0|16@1+ (0.01,0) [0|642.55] "ms" Vector__XXX
 SG_ EngCyl2CombustionTime : 0|16@1+ (0.01,0) [0|642.55] "ms" Vector__XXX
 SG_ EngCyl1CombustionTime : 0|16@1+ (0.01,0) [0|642.55] "ms" Vector__XXX
 SG_ TotalCountOfConfigChangesMade : 0|16@1+ (1,0) [0|64255] "counts" Vector__XXX
 SG_ TransOilLevelRq : 0|2@1+ (1,0) [0|3] "" Vector__XXX
 SG_ FifthWheelReleaseCtrl : 0|2@1+ (1,0) [0|3] "" Vector__XXX
 SG_ FfthWhlRleaseCtrlSecurityLockout : 0|2@1+ (1,0) [0|3] "" Vector__XXX
 SG_ TransferCaseSelectorSwitch : 0|3@1+ (1,0) [0|7] "" Vector__XXX
 SG_ SelectedMaxVehicleSpeedLimit : 0|8@1+ (1,0) [0|250] "" Vector__XXX
 SG_ RqCabZoneHeating : 0|2@1+ (1,0) [0|3] "" Vector__XXX
 SG_ RqEngZoneHeating : 0|2@1+ (1,0) [0|3] "" Vector__XXX
 SG_ AuxHeaterModeRq : 0|4@1+ (1,0) [0|15] "" Vector__XXX
 SG_ EngAutomaticStartEnableSwitch : 0|2@1+ (1,0) [0|3] "" Vector__XXX
 SG_ AtomaticGearShiftingEnableSwitch : 0|2@1+ (1,0) [0|3] "" Vector__XXX
 SG_ DslPrtcltFltrRgnrtionForceSwitch : 0|2@1+ (1,0) [0|3] "" Vector__XXX
 SG_ DslPrtcltFltrRgnrtnInhibitSwitch : 0|2@1+ (1,0) [0|3] "" Vector__XXX
 SG_ VhclLmtngSpdGovernorEnableSwitch : 0|2@1+ (1,0) [0|3] "" Vector__XXX
 SG_ VhclLmtngSpdGvrnrIncrementSwitch : 0|2@1+ (1,0) [0|3] "" Vector__XXX
 SG_ VhclLmtngSpdGvrnrDecrementSwitch : 0|2@1+ (1,0) [0|3] "" Vector__XXX
 SG_ SeatBeltSwitch : 0|2@1+ (1,0) [0|3] "" Vector__XXX
 SG_ OperatorSeatDirectionSwitch : 0|2@1+ (1,0) [0|3] "" Vector__XXX
 SG_ BatteryMainSwitchHoldRq : 0|2@1+ (1,0) [0|3] "" Vector__XXX
 SG_ AuxHeaterCoolantPumpRq : 0|2@1+ (1,0) [0|3] "" Vector__XXX
 SG_ CabInteriorTempCmd : 0|16@1+ (1,-273) [-273|1734.96875] "deg C" Vector__XXX
 SG_ RequestedPercentFanSpeed : 0|8@1+ (1,0) [0|100] "%" Vector__XXX
 SG_ IlluminationBrightnessPercent : 0|8@1+ (1,0) [0|100] "%" Vector__XXX
 SG_ UnitNumber : 0|8@1+ (1.02,0) [0|255] "per byte" Vector__XXX
 SG_ SerialNumber : 0|8@1+ (1.02,0) [0|255] "per byte" Vector__XXX
 SG_ Model : 0|8@1+ (1.02,0) [0|255] "per byte" Vector__XXX
 SG_ Make : 0|8@1+ (1.02,0) [0|255] "per byte" Vector__XXX
 SG_ CruiseCtrlLowSetLimitSpeed : 0|8@1+ (1,0) [0|250] "km/h" Vector__XXX
 SG_ CruiseCtrlHighSetLimitSpeed : 0|8@1+ (1,0) [0|250] "km/h" Vector__XXX
 SG_ AuxHeaterMaxOutputPower : 0|16@1+ (2,0) [0|128510] "W" Vector__XXX
 SG_ TripServiceBrakeApplications : 0|32@1+ (1.003984063746,0) [0|4227858431] "appl" Vector__XXX
 SG_ TripServiceBrakeDistance : 0|32@1+ (0.12500000000594,0) [0|526385151.9] "km" Vector__XXX
 SG_ TripCompressionBrakeDistance : 0|32@1+ (0.12500000000594,0) [0|526385151.9] "km" Vector__XXX
 SG_ TotalCompressionBrakeDistance : 0|32@1+ (0.12500000000594,0) [0|526385151.9] "km" Vector__XXX
 SG_ CbA_CRfrgrntCmpressorOutletPress : 0|8@1+ (16,0) [0|4000] "kPa" Vector__XXX
 SG_ Battery2Temp : 0|8@1+ (1,-40) [-40|210] "deg C" Vector__XXX
 SG_ Battery1Temp : 0|8@1+ (1,-40) [-40|210] "deg C" Vector__XXX
 SG_ EngFuelFilterRestrictedLampCmd : 0|2@1+ (1,0) [0|3] "" Vector__XXX
 SG_ EngAirFilterRestrictionLampCmd : 0|2@1+ (1,0) [0|3] "" Vector__XXX
 SG_ EngIdleManagementActiveLampCmd : 0|2@1+ (1,0) [0|3] "" Vector__XXX
 SG_ EngCoolantLevelLowLampCmd : 0|2@1+ (1,0) [0|3] "" Vector__XXX
 SG_ EngCoolantTempHighLampCmd : 0|2@1+ (1,0) [0|3] "" Vector__XXX
 SG_ EngOilPressLowLampCmd : 0|2@1+ (1,0) [0|3] "" Vector__XXX
 SG_ CmprssnBrkEnblSwtchIndctrLampCmd : 0|2@1+ (1,0) [0|3] "" Vector__XXX
 SG_ EngBrakeActiveLampCmd : 0|2@1+ (1,0) [0|3] "" Vector__XXX
 SG_ OBDMalfunctionIndicatorLampCmd : 0|2@1+ (1,0) [0|3] "" Vector__XXX
 SG_ EngRedStopLampCmd : 0|2@1+ (1,0) [0|3] "" Vector__XXX
 SG_ EngAmberWarningLampCmd : 0|2@1+ (1,0) [0|3] "" Vector__XXX
 SG_ EngProtectLampCmd : 0|2@1+ (1,0) [0|3] "" Vector__XXX
 SG_ RolloverSensorType : 0|4@1+ (1,0) [0|15] "" Vector__XXX
 SG_ RearCollisionSensor4Type : 0|4@1+ (1,0) [0|15] "" Vector__XXX
 SG_ RearCollisionSensor3Type : 0|4@1+ (1,0) [0|15] "" Vector__XXX
 SG_ RearCollisionSensor2Type : 0|4@1+ (1,0) [0|15] "" Vector__XXX
 SG_ RearCollisionSensor1Type : 0|4@1+ (1,0) [0|15] "" Vector__XXX
 SG_ SideCollisionSensorRearRightType : 0|4@1+ (1,0) [0|15] "" Vector__XXX
 SG_ SdCllisionSensorMidRearRightType : 0|4@1+ (1,0) [0|15] "" Vector__XXX
 SG_ SdCllsionSensorMidFrontRightType : 0|4@1+ (1,0) [0|15] "" Vector__XXX
 SG_ SdeCollisionSensorFrontRightType : 0|4@1+ (1,0) [0|15] "" Vector__XXX
 SG_ SideCollisionSensorRearLeftType : 0|4@1+ (1,0) [0|15] "" Vector__XXX
 SG_ SdCollisionSensorMidRearLeftType : 0|4@1+ (1,0) [0|15] "" Vector__XXX
 SG_ SdCllisionSensorMidFrontLeftType : 0|4@1+ (1,0) [0|15] "" Vector__XXX
 SG_ SideCollisionSensorFrontLeftType : 0|4@1+ (1,0) [0|15] "" Vector__XXX
 SG_ FrontalCollisionSensor4Type : 0|4@1+ (1,0) [0|15] "" Vector__XXX
 SG_ FrontalCollisionSensor3Type : 0|4@1+ (1,0) [0|15] "" Vector__XXX
 SG_ FrontalCollisionSensor2Type : 0|4@1+ (1,0) [0|15] "" Vector__XXX
 SG_ FrontalCollisionSensor1Type : 0|4@1+ (1,0) [0|15] "" Vector__XXX
 SG_ CrashChecksum : 0|4@1+ (1,0) [0|15] "" Vector__XXX
 SG_ CrashCounter : 0|4@1+ (1,0) [0|15] "" Vector__XXX
 SG_ CrashType : 0|5@1+ (1,0) [0|0] "" Vector__XXX
 SG_ EngChrgArClr2PrecoolerEfficiency : 0|8@1+ (0.4,0) [0|100] "%" Vector__XXX
 SG_ EngChrgArClr2PrecoolerOutletTemp : 0|16@1+ (0.03125,-273) [-273|1734.96875] "deg C" Vector__XXX
 SG_ EngChrgArClr2PrecoolerIntakeTemp : 0|16@1+ (0.03125,-273) [-273|1734.96875] "deg C" Vector__XXX
 SG_ EngChargeAirCooler2Efficiency : 0|8@1+ (0.4,0) [0|100] "%" Vector__XXX
 SG_ EngChrgeAirCooler2AmbientAirTemp : 0|16@1+ (0.03125,-273) [-273|1734.96875] "deg C" Vector__XXX
 SG_ EngChargeAirCooler2OutletTemp : 0|16@1+ (0.03125,-273) [-273|1734.96875] "deg C" Vector__XXX
 SG_ EngChargeAirCooler2IntakeTemp : 0|16@1+ (0.03125,-273) [-273|1734.96875] "deg C" Vector__XXX
 SG_ EngChrgArClr1PrecoolerEfficiency : 0|8@1+ (0.4,0) [0|100] "%" Vector__XXX
 SG_ EngChrgArClr1PrecoolerOutletTemp : 0|16@1+ (0.03125,-273) [-273|1734.96875] "deg C" Vector__XXX
 SG_ EngChrgArClr1PrecoolerIntakeTemp : 0|16@1+ (0.03125,-273) [-273|1734.96875] "deg C" Vector__XXX
 SG_ EngChargeAirCooler1Efficiency : 0|8@1+ (0.4,0) [0|100] "%" Vector__XXX
 SG_ EngChrgeAirCooler1AmbientAirTemp : 0|16@1+ (0.03125,-273) [-273|1734.96875] "deg C" Vector__XXX
 SG_ EngChargeAirCooler1IntakeTemp : 0|16@1+ (0.03125,-273) [-273|1734.96875] "deg C" Vector__XXX
 SG_ Joystick9Button9PressedStatus : 0|2@1+ (1,0) [0|3] "" Vector__XXX
 SG_ Joystick9Button10PressedStatus : 0|2@1+ (1,0) [0|3] "" Vector__XXX
 SG_ Joystick9Button11PressedStatus : 0|2@1+ (1,0) [0|3] "" Vector__XXX
 SG_ Joystick9Button12PressedStatus : 0|2@1+ (1,0) [0|3] "" Vector__XXX
 SG_ Joystick9Button5PressedStatus : 0|2@1+ (1,0) [0|3] "" Vector__XXX
 SG_ Joystick9Button6PressedStatus : 0|2@1+ (1,0) [0|3] "" Vector__XXX
 SG_ Joystick9Button7PressedStatus : 0|2@1+ (1,0) [0|3] "" Vector__XXX
 SG_ Joystick9Button8PressedStatus : 0|2@1+ (1,0) [0|3] "" Vector__XXX
 SG_ Joystick9Button1PressedStatus : 0|2@1+ (1,0) [0|3] "" Vector__XXX
 SG_ Joystick9Button2PressedStatus : 0|2@1+ (1,0) [0|3] "" Vector__XXX
 SG_ Joystick9Button3PressedStatus : 0|2@1+ (1,0) [0|3] "" Vector__XXX
 SG_ Joystick9Button4PressedStatus : 0|2@1+ (1,0) [0|3] "" Vector__XXX
 SG_ Joystick9XAxisDetentPosStatus : 0|2@1+ (1,0) [0|3] "" Vector__XXX
 SG_ Joystick9YAxisDetentPosStatus : 0|2@1+ (1,0) [0|3] "" Vector__XXX
 SG_ EngSpeed : 0|16@1+ (0.125,0) [0|8031.875] "rpm" Vector__XXX
 SG_ EngTorqueMode : 0|4@1+ (1,0) [0|15] "" Vector__XXX

CM_ SG_ 3221225472 TransRangeLowActuator "Identifies the status of the range low actuator in the auxiliary unit.";
CM_ SG_ 3221225472 TransRangeHighActuator "Identifies the status of the range high actuator in the auxiliary unit.";
CM_ SG_ 3221225472 TransShiftFingerGearActuator2 "Identifies the status of the actuator that moves the shift finger identified as gear actuator #2.";
CM_ SG_ 3221225472 TransShiftFingerRailActuator2 "Identifies the status of the actuator that moves the shift finger identified as rail actuator #2.";
CM_ SG_ 3221225472 TransShiftFingerGearActuator1 "Identifies the status of the actuator that moves the shift finger identified as gear actuator #1.";
CM_ SG_ 3221225472 TransShiftFingerRailActuator1 "Identifies the status of the actuator that moves the shift finger identified as rail actuator #1.";
CM_ SG_ 3221225472 TrnsShftFngerCenterRailIndicator "Identifies the status of the shift finger in the center rail position.";
CM_ SG_ 3221225472 TrnsShftFngerEngagementIndicator "Identifies the status of the shift finger in the engagement position.";
CM_ SG_ 3221225472 TransShiftFingerNeutralIndicator "Indicates the status of the shift finger in the neutral position.";
CM_ SG_ 3221225472 TransShiftFingerRailPos "The current position of the shift finger in the rail direction.";
CM_ SG_ 3221225472 TransShiftFingerGearPos "The current position of the shift finger in the gear direction.";
CM_ SG_ 3221225472 SrcAddrssOfCntrllngDvcFrTrnsCtrl "The source address of the SAE J1939 device currently controlling the transmission. Its value may be the source address";
CM_ SG_ 3221225472 TransInputShaftSpeed "Rotational velocity of the primary shaft transferring power into the transmission. When a torque converter is present, it is";
CM_ SG_ 3221225472 MomentaryEngMaxPowerEnable "Momentarily Requesting highest torque map from the engine control";
CM_ SG_ 3221225472 ProgressiveShiftDisable "Command signal used to indicate that progressive shifting by the engine should be disallowed.";
CM_ SG_ 3221225472 EngMomentaryOverspeedEnable "Command signal used to indicate that the engine speed may be boosted up to the maximum engine overspeed value to";
CM_ SG_ 3221225472 TransOutputShaftSpeed "Calculated speed of the transmission output shaft.";
CM_ SG_ 3221225472 TrnsTrqCnvrtrLckpTrnstnInProcess "State signal indicating whether or not the transmission torque converter lock up clutch is transitioning between being";
CM_ SG_ 3221225472 TransShiftInProcess "Indicates that the transmission is in process of shifting from the current gear to the selected gear. This state is generally";
CM_ SG_ 3221225472 TrnsTorqueConverterLockupEngaged "State signal which indicates whether the torque converter lockup is engaged.";
CM_ SG_ 3221225472 TransDrivelineEngaged "Driveline engaged indicates the transmission controlled portion of the driveline is engaged sufficiently to allow a transfer";
CM_ SG_ 3221225472 EngChargeAirCooler1OutletTemp "Temperature of combustion air after it exits from the Charge Air Cooler 1 but before any mixing of recirculated exhaust";
CM_ SG_ 3221225472 EngIntkVlvActuationSystemOilTemp "The temperature of the oil in the hydraulic system that powers the intake valve actuation system.";
CM_ SG_ 3221225472 EngIntakeManifold1AirTemp "Temperature of pre-combustion air found in intake manifold of engine air supply system. The higher resolution is required";
CM_ SG_ 3221225472 EngExhstGsRcirculation1DiffPress "Differential pressure across the Exhaust Gas Recirculation (EGR) system";
CM_ SG_ 3221225472 EngExhaustGasRecirculation1Temp "Temperature of Recirculated Exhaust Gas. This should not be used for Exhaust Gas Recirculation Mixer Intake";
CM_ SG_ 3221225472 EngECUTemp "Temperature of the engine electronic control unit.";
CM_ SG_ 3221225472 EngOilTemp2 "Temperature of the engine lubricant.";
CM_ SG_ 3221225472 EngFuelTemp1 "Temperature of fuel (or gas) passing through the first fuel control system. See SPN 3468 for the second control system";
CM_ SG_ 3221225472 EngIntercoolerThermostatOpening "The current position of the thermostat used to regulate the temperature of the engine intercooler. A value of 0%";
CM_ SG_ 3221225472 EngIntercoolerTemp "Temperature of liquid found in the intercooler located after the turbocharger.";
CM_ SG_ 3221225472 EngTurboOilTemp "Temperature of the turbocharger lubricant.";
CM_ SG_ 3221225472 EngOilTemp1 "Temperature of the engine lubricant.";
CM_ SG_ 3221225472 EngExhaustGasTempLeftManifold "Temperature of combustion byproducts within the left engine exhaust manifold. Single manifold engines should use";
CM_ SG_ 3221225472 EngExhaustGasTempRightManifold "Temperature of combustion byproducts within the right engine exhaust manifold. Single manifold engines should use";
CM_ SG_ 3221225472 TransOutputRetarder "Identifies the status of the transmission output retarder.";
CM_ SG_ 3221225472 EngExhaustGasPort20Temp "Temperature at the cylinder exhaust port of the engine.";
CM_ SG_ 3221225472 EngExhaustGasPort19Temp "Temperature at the cylinder exhaust port of the engine.";
CM_ SG_ 3221225472 EngExhaustGasPort18Temp "Temperature at the cylinder exhaust port of the engine.";
CM_ SG_ 3221225472 EngExhaustGasPort17Temp "Temperature at the cylinder exhaust port of the engine.";
CM_ SG_ 3221225472 EngExhaustGasPort16Temp "Temperature at the cylinder exhaust port of the engine.";
CM_ SG_ 3221225472 EngExhaustGasPort15Temp "Temperature at the cylinder exhaust port of the engine.";
CM_ SG_ 3221225472 EngExhaustGasPort14Temp "Temperature at the cylinder exhaust port of the engine.";
CM_ SG_ 3221225472 EngExhaustGasPort13Temp "Temperature at the cylinder exhaust port of the engine.";
CM_ SG_ 3221225472 EngExhaustGasPort12Temp "Temperature at the cylinder exhaust port of the engine.";
CM_ SG_ 3221225472 EngExhaustGasPort11Temp "Temperature at the cylinder exhaust port of the engine.";
CM_ SG_ 3221225472 EngExhaustGasPort10Temp "Temperature at the cylinder exhaust port of the engine.";
CM_ SG_ 3221225472 EngExhaustGasPort9Temp "Temperature at the cylinder exhaust port of the engine.";
CM_ SG_ 3221225472 EngExhaustGasPort8Temp "Temperature at the cylinder exhaust port of the engine.";
CM_ SG_ 3221225472 EngExhaustGasPort7Temp "Temperature at the cylinder exhaust port of the engine.";
CM_ SG_ 3221225472 EngExhaustGasPort6Temp "Temperature at the cylinder exhaust port of the engine.";
CM_ SG_ 3221225472 EngExhaustGasPort5Temp "Temperature at the cylinder exhaust port of the engine.";
CM_ SG_ 3221225472 EngExhaustGasPort4Temp "Temperature at the cylinder exhaust port of the engine.";
CM_ SG_ 3221225472 EngExhaustGasPort3Temp "Temperature at the cylinder exhaust port of the engine.";
CM_ SG_ 3221225472 EngExhaustGasPort2Temp "Temperature at the cylinder exhaust port of the engine.";
CM_ SG_ 3221225472 EngExhaustGasPort1Temp "Temperature at the cylinder exhaust port of the engine.";
CM_ SG_ 3221225472 PayloadPercentage "The current payload of the equipment, reported as a percentage of the equipment's rated payload limit.";
CM_ SG_ 3221225472 DataMemoryUsage "The used storage capacity of the data buffer memory internal to an ECU, such as a data logger.";
CM_ SG_ 3221225472 KeepAliveBatteryConsumption "The capacity consumed from the direct battery connection since the key was last turned off. This value is maintained and";
CM_ SG_ 3221225472 TravelVelocityCtrlPos "The position of the travel velocity control component reported as a percentage of the control's full displacement in each";
CM_ SG_ 3221225472 EngExhstGsOxygnSnsrClsdLpOprtion "Indicates whether the engine is using the Exhaust Gas Oxygen sensor to control the air/fuel ratio.";
CM_ SG_ 3221225472 EngExhstGsOxygnSnsrFlngCrrection "The amount of fueling change required by the system based on the measured Exhaust Oxygen value compared to the";
CM_ SG_ 3221225472 EngActualExhaustOxygen "The actual amount of oxygen in the exhaust represented as a percentage by volume with respect to the total volume of";
CM_ SG_ 3221225472 EngDesiredExhaustOxygen "The desired amount of oxygen in the exhaust represented as a percentage by volume with respect to the total volume of";
CM_ SG_ 3221225472 EngDesiredRatedExhaustOxygen "The desired amount of oxygen in the exhaust at rated conditions represented as a percentage by volume with respect to";
CM_ SG_ 3221225472 Jystick3GripXAxisDetentPosStatus "Reports when the current joystick grip position is in the detent position for that axis of travel.";
CM_ SG_ 3221225472 Jystick3GripYAxisDetentPosStatus "Reports when the current joystick grip position is in the detent position for that axis of travel.";
CM_ SG_ 3221225472 Jystick3ThetaAxisDetentPosStatus "Reports when the current joystick position is in the detent position for that axis of travel.";
CM_ SG_ 3221225472 Joystick3ThetaAxisPos "The position of the joystick in the relative motion of travel from the neutral position. Position value of 0 is Neutral and";
CM_ SG_ 3221225472 Jystck3ThtAxsClckwsPstvPosStatus "Reports when the current joystick position is on the positive travel side (forward, right, clockwise, up) relative to the";
CM_ SG_ 3221225472 Jystck3ThetaAxisNeutralPosStatus "Reports when the current joystick position is in the neutral position for that axis of travel. The neutral position";
CM_ SG_ 3221225472 Joystick3GripYAxisPos "The position of the joystick grip in the relative motion of travel from the neutral position. Position value of 0 is Neutral and";
CM_ SG_ 3221225472 Jystck3GrpYAxsLvrFrwrdPstvPsStts "Reports when the current joystick grip position is on the positive travel side (forward, right, clockwise, up) relative to the";
CM_ SG_ 3221225472 Jystck3GrpYAxsLvrBckNgtvPsStatus "Reports when the current joystick grip position is on the negative travel side (back, left, counterclockwise, down) relative";
CM_ SG_ 3221225472 Jystck3GripYAxisNeutralPosStatus "Reports when the current joystick grip position is in the neutral position for that axis of travel. The neutral position";
CM_ SG_ 3221225472 Joystick3GripXAxisPos "The position of the joystick grip in the relative motion of travel from the neutral position. Position value of 0 is Neutral and";
CM_ SG_ 3221225472 Jystck3GrpXAxsLvrRghtPstvPsSttus "Reports when the current joystick grip position is on the positive travel side (forward, right, clockwise, up) relative to the";
CM_ SG_ 3221225472 Jystck3GrpXAxsLvrLftNgtvPsStatus "Reports when the current joystick grip position is on the negative travel side (back, left, counterclockwise, down) relative";
CM_ SG_ 3221225472 Jystck3GripXAxisNeutralPosStatus "Reports when the current joystick grip position is in the neutral position for that axis of travel. The neutral position";
CM_ SG_ 3221225472 Jystck3ThtAxsCntrClckwsNgtvPsStt "Reports when the current joystick position is on the negative travel side (back, left, counterclockwise, down) relative to the";
CM_ SG_ 3221225472 Jystick2GripXAxisDetentPosStatus "Reports when the current joystick grip position is in the detent position for that axis of travel.";
CM_ SG_ 3221225472 Jystick2GripYAxisDetentPosStatus "Reports when the current joystick grip position is in the detent position for that axis of travel.";
CM_ SG_ 3221225472 Jystick2ThetaAxisDetentPosStatus "Reports when the current joystick position is in the detent position for that axis of travel.";
CM_ SG_ 3221225472 Joystick2ThetaAxisPos "The position of the joystick in the relative motion of travel from the neutral position. Position value of 0 is Neutral and";
CM_ SG_ 3221225472 Jystck2ThtAxsClckwsPstvPosStatus "Reports when the current joystick position is on the positive travel side (forward, right, clockwise, up) relative to the";
CM_ SG_ 3221225472 Jystck2ThetaAxisNeutralPosStatus "Reports when the current joystick position is in the neutral position for that axis of travel. The neutral position";
CM_ SG_ 3221225472 Joystick2GripYAxisPos "The position of the joystick grip in the relative motion of travel from the neutral position. Position value of 0 is Neutral and";
CM_ SG_ 3221225472 Jystck2GrpYAxsLvrFrwrdPstvPsStts "Reports when the current joystick grip position is on the positive travel side (forward, right, clockwise, up) relative to the";
CM_ SG_ 3221225472 Jystck2GrpYAxsLvrBckNgtvPsStatus "Reports when the current joystick grip position is on the negative travel side (back, left, counterclockwise, down) relative";
CM_ SG_ 3221225472 Jystck2GripYAxisNeutralPosStatus "Reports when the current joystick grip position is in the neutral position for that axis of travel. The neutral position";
CM_ SG_ 3221225472 Joystick2GripXAxisPos "The position of the joystick grip in the relative motion of travel from the neutral position. Position value of 0 is Neutral and";
CM_ SG_ 3221225472 Jystck2GrpXAxsLvrRghtPstvPsSttus "Reports when the current joystick grip position is on the positive travel side (forward, right, clockwise, up) relative to the";
CM_ SG_ 3221225472 Jystck2GrpXAxsLvrLftNgtvPsStatus "Reports when the current joystick grip position is on the negative travel side (back, left, counterclockwise, down) relative";
CM_ SG_ 3221225472 Jystck2GripXAxisNeutralPosStatus "Reports when the current joystick grip position is in the neutral position for that axis of travel. The neutral position";
CM_ SG_ 3221225472 Jystck2ThtAxsCntrClckwsNgtvPsStt "Reports when the current joystick position is on the negative travel side (back, left, counterclockwise, down) relative to the";
CM_ SG_ 3221225472 Jystick1GripXAxisDetentPosStatus "Reports when the current joystick grip position is in the detent position for that axis of travel.";
CM_ SG_ 3221225472 Jystick1GripYAxisDetentPosStatus "Reports when the current joystick grip position is in the detent position for that axis of travel.";
CM_ SG_ 3221225472 Jystick1ThetaAxisDetentPosStatus "Reports when the current joystick position is in the detent position for that axis of travel.";
CM_ SG_ 3221225472 Joystick1ThetaAxisPos "The position of the joystick in the relative motion of travel from the neutral position. Position value of 0 is Neutral and";
CM_ SG_ 3221225472 Jystck1ThtAxsClckwsPstvPosStatus "Reports when the current joystick position is on the positive travel side (forward, right, clockwise, up) relative to the";
CM_ SG_ 3221225472 Jystck1ThetaAxisNeutralPosStatus "Reports when the current joystick position is in the neutral position for that axis of travel. The neutral position";
CM_ SG_ 3221225472 Joystick1GripYAxisPos "The position of the joystick grip in the relative motion of travel from the neutral position. Position value of 0 is Neutral and";
CM_ SG_ 3221225472 Jystck1GrpYAxsLvrFrwrdPstvPsStts "Reports when the current joystick grip position is on the positive travel side (forward, right, clockwise, up) relative to the";
CM_ SG_ 3221225472 Jystck1GrpYAxsLvrBckNgtvPsStatus "Reports when the current joystick grip position is on the negative travel side (back, left, counterclockwise, down) relative";
CM_ SG_ 3221225472 Jystck1GripYAxisNeutralPosStatus "Reports when the current joystick grip position is in the neutral position for that axis of travel. The neutral position";
CM_ SG_ 3221225472 Joystick1GripXAxisPos "The position of the joystick grip in the relative motion of travel from the neutral position. Position value of 0 is Neutral and";
CM_ SG_ 3221225472 Jystck1GrpXAxsLvrRghtPstvPsSttus "Reports when the current joystick grip position is on the positive travel side (forward, right, clockwise, up) relative to the";
CM_ SG_ 3221225472 Jystck1GrpXAxsLvrLftNgtvPsStatus "Reports when the current joystick grip position is on the negative travel side (back, left, counterclockwise, down) relative";
CM_ SG_ 3221225472 Jystck1GripXAxisNeutralPosStatus "Reports when the current joystick grip position is in the neutral position for that axis of travel. The neutral position";
CM_ SG_ 3221225472 Jystck1ThtAxsCntrClckwsNgtvPsStt "Reports when the current joystick position is on the negative travel side (back, left, counterclockwise, down) relative to the";
CM_ SG_ 3221225472 EngFuelRackPos "Measured position of the engine fuel rack. A value of 0% rack represents no fueling and a value of 100% rack represents";
CM_ SG_ 3221225472 EngGasMassFlowRate1 "Gas mass flow rate delivered to an engine through its first fuel control system. See SPN 3467 for the second fuel control";
CM_ SG_ 3221225472 InstantaneousEstBrakePower "Estimate of the power developed by the engine.";
CM_ SG_ 3221225472 EngExhaustGasPress "Gage pressure of the exhaust gasses as measured at the turbine intake of the turbocharger.";
CM_ SG_ 3221225472 EngPrefilterOilPress "Gage pressure of the engine oil before the oil reaches the oil filter.";
CM_ SG_ 3221225472 TotalECURunTime "Total time accumulated over the life of the ECU, from ignition switch ON to ignition switch OFF. When the ECU is";
CM_ SG_ 3221225472 TotalECUDistance "Total distance accumulated over the life of the ECU. When the ECU is replaced this value shall be reset.";
CM_ SG_ 3221225472 EngExhstGsRcrcltion2MassFlowRate "Flow rate of gas through the second EGR system. Flow rate of the exhaust gas being recirculated from the 2nd EGR";
CM_ SG_ 3221225472 EngIntakeAirMassFlowRate "Mass flow rate of fresh air entering the engine air intake, before any EGR mixer, if used. Flow rate of fresh air conducted";
CM_ SG_ 3221225472 EngExhstGsRcrcltion1MassFlowRate "Flow rate of gas through the EGR system. Flow rate of the exhaust gas being recirculated into the combustion air.";
CM_ SG_ 3221225472 FuelPumpPrimerStatus "Parameter used to transmit the actual status of the fuel priming system. The fuel priming system is a system that purges";
CM_ SG_ 3221225472 EngVentilationStatus "Engine ventilation control states.";
CM_ SG_ 3221225472 EngCoolantPreheatedState "Indicates whether the engine coolant is pre-heated sufficiently for starting purposes.";
CM_ SG_ 3221225472 EngOilPreHeatedState "Indicates whether the engine oil pre-heated sufficiently for starting purposes.";
CM_ SG_ 3221225472 EngOilPrimingState "Determination of whether or not the engine is (or has recently been) sufficiently lubricated for starting purposes.";
CM_ SG_ 3221225472 EngOilPrimingPumpSwitch "Switch input for activating the engine oil priming pump.";
CM_ SG_ 3221225472 EngOilFilterOutletPress "Oil pressure (gauge) measured just downstream of oil filter.Used in conjunction with SPN1208 (pre-filter oil pressure) to";
CM_ SG_ 3221225472 EngWasteOilReservoirLevel "Level of crankcase blowby emulsion collected by a container. Normalized to percent, 0% represents completely empty";
CM_ SG_ 3221225472 EngFuelFilterDiffPress "Differential pressure measured across the fuel filter located between the fuel tank and the supply pump. See FiguresChange in fuel delivery pressure, measured across the filter, due to accumulation of solid or semisolid matter on the filter";
CM_ SG_ 3221225472 EngFuelSupplyPumpIntakePress "Absolute pressure of fuel at the fuel supply pump intake. See Figures SPN16_A & SPN16_B";
CM_ SG_ 3221225472 EngOilLevelRemoteReservoir "Ratio of current volume of engine oil in a remote reservoir to the maximum required volume. If a single switch (on/off) is";
CM_ SG_ 3221225472 EngExhstGsRcrclation1OutletPress "EGR outlet pressure is measured immediately after the EGR valve.";
CM_ SG_ 3221225472 EngExhstVlvActtionSystemOilPress "The absolute pressure of the oil in the hydraulic system that powers the engine exhaust valve actuation system";
CM_ SG_ 3221225472 EngExhstGsRcrclation1IntakePress "EGR intake gage pressure is measured after the EGR cooler and before the EGR valve.";
CM_ SG_ 3221225472 EngIntkVlvActationSystemOilPress "The gage pressure of the oil in the hydraulic system that powers the engine intake valve actuation system";
CM_ SG_ 3221225472 EngInjectorMeteringRail2Press "The gage pressure of fuel in the metering rail #2 as delivered from the supply pump to the injector metering intake. See";
CM_ SG_ 3221225472 EngInjectorTimingRail1Press "The gage pressure of fuel in the timing rail delivered from the supply pump to the injector timing intake.";
CM_ SG_ 3221225472 EngInjectorMeteringRail1Press "The gage pressure of fuel in the primary, or first, metering rail as delivered from the supply pump to the injector metering";
CM_ SG_ 3221225472 EngInjectionCtrlPress "The gage pressure of the engine oil in the hydraulic accumulator that powers an intensifier used for fuel injection.";
CM_ SG_ 3221225472 EngCoolantLevel "Ratio of volume of liquid found in engine cooling system to total cooling system volume. Typical monitoring location is in";
CM_ SG_ 3221225472 EngCoolantPress "Gage pressure of liquid found in engine cooling system.";
CM_ SG_ 3221225472 EngCrankcasePress "Gage pressure inside engine crankcase.";
CM_ SG_ 3221225472 EngOilPress "Gage pressure of oil in engine lubrication system as provided by oil pump.";
CM_ SG_ 3221225472 EngOilLevel "Ratio of current volume of engine sump oil to maximum required volume.";
CM_ SG_ 3221225472 EngExCrankcaseBlowbyPress "Differential crankcase blow-by pressure as measured through a tube with a venturi.";
CM_ SG_ 3221225472 EngFuelDeliveryPress "Gage pressure of fuel in system as delivered from supply pump to the injection pump. See Figures SPN16_A &";
CM_ SG_ 3221225472 SafetyWireStatus "Status signal which indicates that the safety wire has been activated. When the safety wire is activated, the engine will";
CM_ SG_ 3221225472 ElectricalLoad "Electrical power delivered by the engine to the electrical system connected to the generator.";
CM_ SG_ 3221225472 EngVriableGeometryTurbo1CtrlMode "Indicates if the variable geometry turbocharger control status is either open loop or closed loop.";
CM_ SG_ 3221225472 EngTrb1ClclatedTurbineIntakeTemp "Calculated value of turbine intake temperature based on engine operating conditions, such as intake manifold";
CM_ SG_ 3221225472 EngExhstGsRcirculation1ValveCtrl "Desired percentage of maximum Exhaust Gas Recirculation (EGR) valve opening. 0% means valve is closed. 100%";
CM_ SG_ 3221225472 EngVrblGeometryTurbo1ActuatorPos "Sensor that measures the position of the variable geometry turbocharger actuator. A position of 0% indicates the";
CM_ SG_ 3221225472 EngVrblGmtryTrbArCtrlShtoffValve "Isolates vehicle brake air from the Variable Geometry Turbocharger (VGT) system when engine is not running. This valve";
CM_ SG_ 3221225472 EngTrb1ClclatedTurbineOutletTemp "Calculated value of turbocharger compressor outlet air temperature. Temperature of air exiting the turbocharger";
CM_ SG_ 3221225472 CrnkAttmptCntOnPrsntStartAttempt "Reports the number of cranking cycles undergone during the present start attempt.";
CM_ SG_ 3221225472 EngIntakeManifoldPressCtrlMode "Indicates that the Boost Pressure Closed Loop Control status either open loop or closed loop.";
CM_ SG_ 3221225472 EngRotationDirection "Direction of engine rotation, as reported by the engine. Direction convention as viewed by an observer standing at the";
CM_ SG_ 3221225472 EngRatedSpeed "The maximum governed rotational velocity of the engine crankshaft under full load conditions. Note that the engine";
CM_ SG_ 3221225472 EngRatedPower "Net brake power that the engine will deliver continuously, specified for a given application at a rated speed.";
CM_ SG_ 3221225472 Aftertreatment2ExhaustDewPoint "Indicates that the temperature on the exhaust side of the aftertreatment has exceeded the dew point, as estimated by the";
CM_ SG_ 3221225472 Aftertreatment2IntakeDewPoint "Indicates that the temperature on the intake side of the aftertreatment system has exceeded the dew point, as estimated";
CM_ SG_ 3221225472 Aftertreatment1ExhaustDewPoint "Indicates that the temperature on the exhaust side of the aftertreatment has exceeded the dew point, as estimated by the";
CM_ SG_ 3221225472 Aftertreatment1IntakeDewPoint "Indicates that the temperature on the intake side of the aftertreatment system has exceeded the dew point, as estimated";
CM_ SG_ 3221225472 Aftrtreatment1ExhaustGasMassFlow "Measured/calculated exhaust gas mass upstream of the aftertreatment system in exhaust bank 1 and 2.";
CM_ SG_ 3221225472 EstEngPrsiticLossesPercentTorque "The calculated torque that indicates the estimated amount of torque loss due to engine parasitics, such as cooling fan, air";
CM_ SG_ 3221225472 EngnsDsrdOprtngSpdAsymmtryAdjstm "This byte is utilized in transmission gear selection routines and indicates the engine's preference of lower versus higher";
CM_ SG_ 3221225472 EnginesDesiredOperatingSpeed "An indication by the engine of the optimal operating speed of the engine for the current existing conditions. These";
CM_ SG_ 3221225472 NominalFrictionPercentTorque "The calculated torque that indicates the amount of torque required by the basic engine itself added by the loss torque of";
CM_ SG_ 3221225472 SrcAddrssOfCntrllngDvcForEngCtrl "The source address of the SAE J1939 device currently controlling the engine. It is used to expand the torque mode";
CM_ SG_ 3221225472 ActlEngPrcntTorqueHighResolution "This parameter displays an additional torque in percent of the reference engine torque.";
CM_ SG_ 3221225472 EngDemandPercentTorque "The requested torque output of the engine by all dynamic internal inputs, including smoke control, noise control and low";
CM_ SG_ 3221225472 EngStarterMode "There are several phases in a starting action and different reasons why a start cannot take place.";
CM_ SG_ 3221225472 EngSpeed "Actual engine speed which is calculated over a minimum crankshaft angle of 720 degrees divided by the number ofActual engine speed which is calculated over a minimum crankshaft angle of 720 degrees divided by the number of";
CM_ SG_ 3221225472 ActualEngPercentTorque "The calculated output torque of the engine. The data is transmitted in indicated torque as a percent of reference engine";
CM_ SG_ 3221225472 DriversDemandEngPercentTorque "The requested torque output of the engine by the driver. It is based on input from the following requestors external to the";
CM_ SG_ 3221225472 EngTorqueMode "State signal which indicates which engine torque mode is currently generating, limiting, or controlling the torque. NoteState signal which indicates which engine torque mode is currently generating, limiting, or controlling the torque. Note";
CM_ SG_ 3221225472 ECUType "The type of ECU. One example of a use of the ECU type could be for classifying ECU capabilities, such as I/O.";
CM_ SG_ 3221225472 ECULocation "The location of the ECU within a network.";
CM_ SG_ 3221225472 ECUSerialNumber "The serial number of the physical ECU.";
CM_ SG_ 3221225472 ECUPartNumber "The part number of the physical ECU.";
CM_ SG_ 3221225472 EngMinContinuousTorque "Applied limit for minimum continuous engine torque";
CM_ SG_ 3221225472 EngMaxContinuousTorque "Applied limit for maximum continuous engine torque.";
CM_ SG_ 3221225472 EngMinContinuousRPM "Applied limit for minimum continuous engine RPM";
CM_ SG_ 3221225472 EngMaxContinuousRPM "Applied limit for maximum continuous engine RPM";
CM_ SG_ 3221225472 EngHghLmtThrshldFrMnCntnsTrqFrmE "Maximum allowable value for minimum continuous torque from engine";
CM_ SG_ 3221225472 EngLwLmtThrshldFrMxTorqueFromEng "Minimum allowable value for maximum continuous torque from engine";
CM_ SG_ 3221225472 EngHghLmtThrshldFrMnCntnusEngRPM "Maximum allowable value for minimum continuous RPM from engine";
CM_ SG_ 3221225472 EngLwLmtThrsholdForMaxRPMFromEng "Minimum allowable value for maximum continuous RPM from engine";
CM_ SG_ 3221225472 SupportTSC1CtrlPurposeGroup4 "This parameter indicates which TSC1 control purposes are supported in group 4 of 4. One bit is used to convey the";
CM_ SG_ 3221225472 SupportTSC1CtrlPurposeGroup3 "This parameter indicates which TSC1 control purposes are supported in group 3 of 4. One bit is used to convey the";
CM_ SG_ 3221225472 SupportTSC1CtrlPurposeGroup2 "This parameter indicates which TSC1 control purposes are supported in group 2 of 4. One bit is used to convey the";
CM_ SG_ 3221225472 SupportTSC1CtrlPurposeGroup1 "This parameter indicates which TSC1 control purposes are supported in group 1 of 4. One bit is used to convey the";
CM_ SG_ 3221225472 SupportVariableRateTSC1Message "This parameter indicates which TSC1 transmission rates are supported by the engine ECU in addition to the required";
CM_ SG_ 3221225472 EngDefaultTorqueLimit "Companion parameter to Transmission Torque Limit (SPN 1845). This “echo” parameter provides confirmation to the";
CM_ SG_ 3221225472 EngMomentOfInertia "Moment of inertia for the engine, including items driven full-time by the engine such as fuel, oil and cooling pumps. The";
CM_ SG_ 3221225472 EngExRngRqstdSpdCtrlRngUpprLimit "The maximum engine speed regardless of load that the engine will allow when operating in a speed control/limit mode,";
CM_ SG_ 3221225472 EngRqstdTrqueCtrlRangeUpperLimit "The maximum engine torque that the engine will allow when operating in a torque control/limit mode.";
CM_ SG_ 3221225472 EngRqstdTrqueCtrlRangeLowerLimit "The minimum engine torque that the engine will allow when operating in a torque control/limit mode.";
CM_ SG_ 3221225472 EngRqstdSpeedCtrlRangeUpperLimit "The maximum engine speed regardless of load that the engine will allow when operating in a speed control/limit mode,";
CM_ SG_ 3221225472 EngRqstdSpeedCtrlRangeLowerLimit "The minimum engine speed that the engine will allow when operating in a speed control/limit mode.";
CM_ SG_ 3221225472 EngMaxMomentaryOverrideTimeLimit "The maximum time limit allowed to override the engine's high idle speed.";
CM_ SG_ 3221225472 EngMxMmentaryOverrideSpeedPoint7 "The maximum engine speed above high idle allowed by the engine control during a momentary high idle override. This";
CM_ SG_ 3221225472 EngReferenceTorque "This parameter is the 100% reference value for all defined indicated engine torque parameters. It is only defined once";
CM_ SG_ 3221225472 EngGain "The endspeed governor is defined as a linear line with the following equations (Capital letters mean physical values, small";
CM_ SG_ 3221225472 EngSpeedAtHighIdlePoint6 "Engine speed of high idle (point 6) of the engine torque map (see PGN 65251 and supporting document). In engine";
CM_ SG_ 3221225472 EngPercentTorqueAtPoint5 "The torque limit that indicates the available engine torque which can be provided by the engine at point 3, 4, and 5 of the";
CM_ SG_ 3221225472 EngSpeedAtPoint5 "Engine speed of point 3, 4, and 5 of the engine torque map (see PGN 65251 and supporting document). It is";
CM_ SG_ 3221225472 EngPercentTorqueAtPoint4 "The torque limit that indicates the available engine torque which can be provided by the engine at point 3, 4, and 5 of the";
CM_ SG_ 3221225472 EngSpeedAtPoint4 "Engine speed of point 3, 4, and 5 of the engine torque map (see PGN 65251 and supporting document). It is";
CM_ SG_ 3221225472 EngPercentTorqueAtPoint3 "The torque limit that indicates the available engine torque which can be provided by the engine at point 3, 4, and 5 of the";
CM_ SG_ 3221225472 EngSpeedAtPoint3 "Engine speed of point 3, 4, and 5 of the engine torque map (see PGN 65251 and supporting document). It is";
CM_ SG_ 3221225472 EngPercentTorqueAtPoint2 "The torque limit that indicates the available engine torque which can be provided by the engine at point 2 of the engine";
CM_ SG_ 3221225472 EngSpeedAtPoint2 "Engine speed of point 2 of the engine torque map (see PGN 65251 and supporting document). In engine configuration";
CM_ SG_ 3221225472 EngPercentTorqueAtIdlePoint1 "The torque limit that indicates the available engine torque which can be provided by the engine at idle speed. This";
CM_ SG_ 3221225472 EngSpeedAtIdlePoint1 "Stationary low idle speed of engine which includes influences due to engine temperature (after power up) and other";
CM_ SG_ 3221225472 PrkngBrakeActuatorFullyActivated "Signal which indicates when the parking brake actuator is fully activated.";
CM_ SG_ 3221225472 XBRAccelerationLimit "The brake system may temporarily or generally limit the maximum brake performance available for external systems. A";
CM_ SG_ 3221225472 XBRActiveCtrlMode "This parameter indicates which XBR Control Mode is executed by the brake system.";
CM_ SG_ 3221225472 XBRSystemState "This parameter indicates which external brake control is allowed.";
CM_ SG_ 3221225472 FoundationBrakeUse "This parameter indicates if the brake system presently uses the foundation brakes.";
CM_ SG_ 3221225472 HillHolderMode "Signal which indicates the current mode of the hill holder function.";
CM_ SG_ 3221225472 HaltBrakeMode "Signal which indicates the current mode of the halt brake function.";
CM_ SG_ 3221225472 BrakeTempWarning "This parameter indicates if the temperature in the service brakes exceeds a certain value. It can be used for a warning";
CM_ SG_ 3221225472 BrkLnngRmningRearAxle3RightWheel "The percentage of brake lining which can still be measured for the right wheel on the rear axle #3. 100% represents new";
CM_ SG_ 3221225472 BrkLnngRminingRearAxle3LeftWheel "The percentage of brake lining which can still be measured for the left wheel on the rear axle #3. 100% represents new";
CM_ SG_ 3221225472 BrkLnngRmningRearAxle2RightWheel "The percentage of brake lining which can still be measured for the right wheel on the rear axle #2. 100% represents new";
CM_ SG_ 3221225472 BrkLnngRminingRearAxle2LeftWheel "The percentage of brake lining which can still be measured for the left wheel on the rear axle #2. 100% represents new";
CM_ SG_ 3221225472 BrkLnngRmningRearAxle1RightWheel "The percentage of brake lining which can still be measured for the right wheel on the rear axle #1. 100% represents new";
CM_ SG_ 3221225472 BrkLnngRminingRearAxle1LeftWheel "The percentage of brake lining which can still be measured for the left wheel on the rear axle #1. 100% represents new";
CM_ SG_ 3221225472 BrkLnngRmningFrontAxleRightWheel "The percentage of brake lining which can still be measured for the right wheel on the front axle. 100% represents new";
CM_ SG_ 3221225472 BrkLnngRminingFrontAxleLeftWheel "The percentage of brake lining which can still be measured for the left wheel on the front axle. 100% represents new";
CM_ SG_ 3221225472 BrkAppPrssHghRngRrAxl3RightWheel "The brake application pressure for the right wheel on the rear axle #3.";
CM_ SG_ 3221225472 BrkAppPrssHghRngRrAxle3LeftWheel "The brake application pressure for the left wheel on the rear axle #3.";
CM_ SG_ 3221225472 BrkAppPrssHghRngRrAxl2RightWheel "The brake application pressure for the right wheel on the rear axle #2.";
CM_ SG_ 3221225472 BrkAppPrssHghRngRrAxle2LeftWheel "The brake application pressure for the left wheel on the rear axle #2.";
CM_ SG_ 3221225472 BrkAppPrssHghRngRrAxle1LeftWheel "The brake application pressure for the left wheel on the rear axle #1.";
CM_ SG_ 3221225472 BrkAppPrssHghRngFrntAxlRghtWheel "The brake application pressure for the right wheel on the front axle.";
CM_ SG_ 3221225472 BrkAppPrssHghRngFrntAxlLeftWheel "The brake application pressure for the left wheel on the front axle.";
CM_ SG_ 3221225472 BrkAppPrssHghRngRrAxl1RightWheel "The brake application pressure for the right wheel on the rear axle #1.";
CM_ SG_ 3221225472 RearAxleGroupEngagementStatus "Rear axle group engagement status";
CM_ SG_ 3221225472 FrontAxleGroupEngagementStatus "Front axle group engagement status";
CM_ SG_ 3221225472 DiffLockStateCentralRear "State used which indicates the condition of the central rear differential lock. The differential locks are located as defined";
CM_ SG_ 3221225472 DiffLockStateCentralFront "State used which indicates the condition of the central front differential lock. The differential locks are located as defined";
CM_ SG_ 3221225472 DiffLockStateCentral "State used which indicates the condition of the central differential lock. The differential locks are located as defined in";
CM_ SG_ 3221225472 DiffLockStateRearAxle2 "State used which indicates the condition of the rear axle 2 differential lock. The differential locks are located as defined in";
CM_ SG_ 3221225472 DiffLockStateRearAxle1 "State used which indicates the condition of the rear axle 1 differential lock. The differential locks are located as defined in";
CM_ SG_ 3221225472 DiffLockStateFrontAxle2 "State used which indicates the condition of the front axle 2 differential lock. The differential locks are located as defined in";
CM_ SG_ 3221225472 DiffLockStateFrontAxle1 "State used which indicates the condition of the front axle 1 differential lock. The differential locks are located as defined";
CM_ SG_ 3221225472 Location "To identify to which of several similar devices (such as tires or fuel tanks) the information applies.";
CM_ SG_ 3221225472 SeaWaterPumpOutletPress "Gauge pressure of liquid found at outlet of sea water pump in sea water cooling system.";
CM_ SG_ 3221225472 EngAuxCoolantTemp "Temperature of coolant found in the intercooler which is located after the turbocharger.";
CM_ SG_ 3221225472 EngAuxCoolantPress "Gage pressure of coolant found in the intercooler which is located after the turbocharger.";
CM_ SG_ 3221225472 Driver2Identification "Used to obtain the driver identity.";
CM_ SG_ 3221225472 Driver1Identification "Used to obtain the driver identity.";
CM_ SG_ 3221225472 FuelLevel2 "Ratio of volume of fuel to the total volume of fuel in the second or right-side storage container. When Fuel Level 2 is not";
CM_ SG_ 3221225472 CargoAmbientTemp "Temperature of air inside vehicle container used to accommodate cargo.";
CM_ SG_ 3221225472 EngOilFilterDiffPress "Change in engine oil pressure, measured across the filter, due to the filter and any accumulation of solid or semisolid";
CM_ SG_ 3221225472 FuelLevel1 "Ratio of volume of fuel to the total volume of fuel storage container.";
CM_ SG_ 3221225472 WasherFluidLevel "Ratio of volume of liquid to total container volume of fluid reservoir in windshield wash system.";
CM_ SG_ 3221225472 EngStartEnableDevice2Config "The start enable device installed for start enable device 2.";
CM_ SG_ 3221225472 EngStartEnableDevice1Config "The start enable device installed for start enable device 1.";
CM_ SG_ 3221225472 EngStartEnableDevice2 "Devices that assist an engine in starting, e.g. intake heaters, ether, or an alternate/secondary starting aid. May be of the";
CM_ SG_ 3221225472 EngStartEnableDevice1 "Devices that assist an Engine in starting, e.g. intake heaters and ether. Primary starting aid.";
CM_ SG_ 3221225472 PoweredVehicleWeight "Total mass imposed by the tires of the powered vehicle on the road surface. Does not include the trailer.";
CM_ SG_ 3221225472 GrossCombinationVehicleWeight "The total weight of the truck and all attached trailers.";
CM_ SG_ 3221225472 MxCntinuousRetarderTorqueLimitRq "Requested maximum continuous retarder torque (operating range: -125 to 0%)";
CM_ SG_ 3221225472 MnCntinuousRetarderTorqueLimitRq "Requested minimum continuous retarder torque (operating range: -125 to 0%)";
CM_ SG_ 3221225472 MxContinuousRetarderSpeedLimitRq "Requested maximum continuous retarder speed";
CM_ SG_ 3221225472 MnContinuousRetarderSpeedLimitRq "Requested minimum continuous retarder speed";
CM_ SG_ 3221225472 EngTorqueLimitRqMaxContinuous "Requested maximum continuous engine torque (operating range: 0 to 125%)";
CM_ SG_ 3221225472 EngTorqueLimitRqMinContinuous "Requested minimum continuous engine torque (operating range: 0 to 125%)";
CM_ SG_ 3221225472 EngSpeedLimitRqMaxContinuous "Requested maximum continuous engine speed";
CM_ SG_ 3221225472 EngSpeedLimitRqMinContinuous "Requested minimum continuous engine speed";
CM_ SG_ 3221225472 EngAverageCombustionTime "The average combustion time of all cylinders of an engine.";
CM_ SG_ 3221225472 EngDesiredCombustionTime "The desired combustion time based upon engine load and speed lookup maps.";
CM_ SG_ 3221225472 EngCyl20CombustionTime "The amount of time from when the ignition of the fuel is initiated to when the fuel is completely ignited (i.e., the flame front";
CM_ SG_ 3221225472 EngCyl19CombustionTime "The amount of time from when the ignition of the fuel is initiated to when the fuel is completely ignited (i.e., the flame front";
CM_ SG_ 3221225472 EngCyl18CombustionTime "The amount of time from when the ignition of the fuel is initiated to when the fuel is completely ignited (i.e., the flame front";
CM_ SG_ 3221225472 EngCyl17CombustionTime "The amount of time from when the ignition of the fuel is initiated to when the fuel is completely ignited (i.e., the flame front";
CM_ SG_ 3221225472 EngCyl16CombustionTime "The amount of time from when the ignition of the fuel is initiated to when the fuel is completely ignited (i.e., the flame front";
CM_ SG_ 3221225472 EngCyl15CombustionTime "The amount of time from when the ignition of the fuel is initiated to when the fuel is completely ignited (i.e., the flame front";
CM_ SG_ 3221225472 EngCyl14CombustionTime "The amount of time from when the ignition of the fuel is initiated to when the fuel is completely ignited (i.e., the flame front";
CM_ SG_ 3221225472 EngCyl13CombustionTime "The amount of time from when the ignition of the fuel is initiated to when the fuel is completely ignited (i.e., the flame front";
CM_ SG_ 3221225472 EngCyl12CombustionTime "The amount of time from when the ignition of the fuel is initiated to when the fuel is completely ignited (i.e., the flame front";
CM_ SG_ 3221225472 EngCyl11CombustionTime "The amount of time from when the ignition of the fuel is initiated to when the fuel is completely ignited (i.e., the flame front";
CM_ SG_ 3221225472 EngCyl10CombustionTime "The amount of time from when the ignition of the fuel is initiated to when the fuel is completely ignited (i.e., the flame front";
CM_ SG_ 3221225472 EngCyl9CombustionTime "The amount of time from when the ignition of the fuel is initiated to when the fuel is completely ignited (i.e., the flame front";
CM_ SG_ 3221225472 EngCyl8CombustionTime "The amount of time from when the ignition of the fuel is initiated to when the fuel is completely ignited (i.e., the flame front";
CM_ SG_ 3221225472 EngCyl7CombustionTime "The amount of time from when the ignition of the fuel is initiated to when the fuel is completely ignited (i.e., the flame front";
CM_ SG_ 3221225472 EngCyl6CombustionTime "The amount of time from when the ignition of the fuel is initiated to when the fuel is completely ignited (i.e., the flame front";
CM_ SG_ 3221225472 EngCyl5CombustionTime "The amount of time from when the ignition of the fuel is initiated to when the fuel is completely ignited (i.e., the flame front";
CM_ SG_ 3221225472 EngCyl4CombustionTime "The amount of time from when the ignition of the fuel is initiated to when the fuel is completely ignited (i.e., the flame front";
CM_ SG_ 3221225472 EngCyl3CombustionTime "The amount of time from when the ignition of the fuel is initiated to when the fuel is completely ignited (i.e., the flame front";
CM_ SG_ 3221225472 EngCyl2CombustionTime "The amount of time from when the ignition of the fuel is initiated to when the fuel is completely ignited (i.e., the flame front";
CM_ SG_ 3221225472 EngCyl1CombustionTime "The amount of time from when the ignition of the fuel is initiated to when the fuel is completely ignited (i.e., the flame front";
CM_ SG_ 3221225472 TotalCountOfConfigChangesMade "Total number of times changes have been made to any of the configurable parameters.";
CM_ SG_ 3221225472 TransOilLevelRq "Conveys operator or vehicle system desire for a transmission oil level reading to be taken.";
CM_ SG_ 3221225472 FifthWheelReleaseCtrl "Operator input used to release the fifth wheel. Fifth Wheel Release Control Security Lockout and other conditions must be";
CM_ SG_ 3221225472 FfthWhlRleaseCtrlSecurityLockout "Operator's fifth wheel release control interlock. This operator input must be enabled prior to activating the fifth wheel";
CM_ SG_ 3221225472 TransferCaseSelectorSwitch "Operator switch to select the condition of the transfer case. States 000 and 001 should be used if the transfer case only";
CM_ SG_ 3221225472 SelectedMaxVehicleSpeedLimit "User selected maximum vehicle speed. If one is selected, then this SPN must equal one of the maximum vehicle speeds";
CM_ SG_ 3221225472 RqCabZoneHeating "Request to activate cab zone heating.";
CM_ SG_ 3221225472 RqEngZoneHeating "Request to activate engine zone heating.";
CM_ SG_ 3221225472 AuxHeaterModeRq "Request to activate the auxiliary heater.";
CM_ SG_ 3221225472 EngAutomaticStartEnableSwitch "Switch signal which enables the idle management system to be enabled. When this system is enabled with the engine in";
CM_ SG_ 3221225472 AtomaticGearShiftingEnableSwitch "Indicates that automated gear shifting is enabled via a switch";
CM_ SG_ 3221225472 DslPrtcltFltrRgnrtionForceSwitch "Indicates the state of a switch available to the operator that forces diesel particulate filter regeneration.";
CM_ SG_ 3221225472 DslPrtcltFltrRgnrtnInhibitSwitch "Indicates the state of a switch available to the operator that inhibits diesel particulate filter regeneration.";
CM_ SG_ 3221225472 VhclLmtngSpdGovernorEnableSwitch "Switch signal which enables the Vehicle Limiting Speed Governor (VLSG) such that the vehicle speed may be either";
CM_ SG_ 3221225472 VhclLmtngSpdGvrnrIncrementSwitch "Switch signal which increases the Vehicle Limiting Speed Governor (VLSG).";
CM_ SG_ 3221225472 VhclLmtngSpdGvrnrDecrementSwitch "Switch signal which decreases the Vehicle Limiting Speed Governor (VLSG).";
CM_ SG_ 3221225472 SeatBeltSwitch "State of switch used to determine if Seat Belt is buckled";
CM_ SG_ 3221225472 OperatorSeatDirectionSwitch "Senses whether the operator seat is in the forward driving position";
CM_ SG_ 3221225472 BatteryMainSwitchHoldRq "Request to hold the battery main switch.";
CM_ SG_ 3221225472 AuxHeaterCoolantPumpRq "Indicates whether to activate the auxiliary heater coolant water pump.";
CM_ SG_ 3221225472 CabInteriorTempCmd "Parameter used to command a certain cab interior temperature.";
CM_ SG_ 3221225472 RequestedPercentFanSpeed "Fan speed as a ratio of the actual fan drive (current speed) to the fully engaged fan drive (maximum fan speed). A two";
CM_ SG_ 3221225472 IlluminationBrightnessPercent "Commanded backlight brightness level for all cab displays";
CM_ SG_ 3221225472 UnitNumber "Owner assigned unit number for the power unit of the vehicle.";
CM_ SG_ 3221225472 SerialNumber "Serial number of the component.";
CM_ SG_ 3221225472 Model "Model of the component.";
CM_ SG_ 3221225472 Make "Make of the component corresponding to the codes defined in the American Trucking Association Vehicle Maintenance";
CM_ SG_ 3221225472 CruiseCtrlLowSetLimitSpeed "Minimum vehicle velocity at which cruise can be set or minimum vehicle velocity for cruise operation before it will exit";
CM_ SG_ 3221225472 CruiseCtrlHighSetLimitSpeed "Maximum vehicle velocity at which cruise can be set.";
CM_ SG_ 3221225472 AuxHeaterMaxOutputPower "The maximum output power of the auxiliary heater.";
CM_ SG_ 3221225472 TripServiceBrakeApplications "Total number of times the service brakes have been activated since the last trip reset. Brake applications of less than 0.5";
CM_ SG_ 3221225472 TripServiceBrakeDistance "Total distance over which the service brakes have been active since the last trip reset.";
CM_ SG_ 3221225472 TripCompressionBrakeDistance "Total distance over which the compression brakes have been active since the last trip reset.";
CM_ SG_ 3221225472 TotalCompressionBrakeDistance "Total distance over which the compression brakes have been active for the life of the engine.";
CM_ SG_ 3221225472 CbA_CRfrgrntCmpressorOutletPress "This is the gage pressure at the compressor outlet in the cab air conditioning system.";
CM_ SG_ 3221225472 Battery2Temp "Temperature of the battery 2. The relation to physical location is determined by the equipment manufacturer.";
CM_ SG_ 3221225472 Battery1Temp "Temperature of the battery 1. The relation to physical location is determined by the equipment manufacturer.";
CM_ SG_ 3221225472 EngFuelFilterRestrictedLampCmd "Command signal directly controlling the Vehicle Fuel Filter Restricted Lamp.";
CM_ SG_ 3221225472 EngAirFilterRestrictionLampCmd "Command signal directly controlling the Engine Air Filter Restriction Lamp.";
CM_ SG_ 3221225472 EngIdleManagementActiveLampCmd "Command signal directly controlling the Engine Idle Management Active Lamp";
CM_ SG_ 3221225472 EngCoolantLevelLowLampCmd "Command signal directly controlling the Engine Coolant Level Low Lamp";
CM_ SG_ 3221225472 EngCoolantTempHighLampCmd "Command signal directly controlling the Engine Coolant Temperature High Lamp";
CM_ SG_ 3221225472 EngOilPressLowLampCmd "Command signal directly controlling the Engine Oil Pressure Low Lamp";
CM_ SG_ 3221225472 CmprssnBrkEnblSwtchIndctrLampCmd "Command signal directly controlling Compression Brake Enable Switch Indicator Lamp. The compression brake switch";
CM_ SG_ 3221225472 EngBrakeActiveLampCmd "Command signal directly controlling the Engine Brake Active Lamp";
CM_ SG_ 3221225472 OBDMalfunctionIndicatorLampCmd "Command signal directly controlling the OBD Malfunction Indicator Lamp";
CM_ SG_ 3221225472 EngRedStopLampCmd "Command signal directly controlling the Engine Red Stop Lamp";
CM_ SG_ 3221225472 EngAmberWarningLampCmd "Command signal directly controlling the Engine Amber Warning Lamp";
CM_ SG_ 3221225472 EngProtectLampCmd "Command signal directly controlling the Engine Protect Lamp";
CM_ SG_ 3221225472 RolloverSensorType "Type of Rollover Sensor.";
CM_ SG_ 3221225472 RearCollisionSensor4Type "Type of Rear Collision Sensor 4.";
CM_ SG_ 3221225472 RearCollisionSensor3Type "Type of Rear Collision Sensor 3.";
CM_ SG_ 3221225472 RearCollisionSensor2Type "Type of Rear Collision Sensor 2.";
CM_ SG_ 3221225472 RearCollisionSensor1Type "Type of Rear Collision Sensor 1.";
CM_ SG_ 3221225472 SideCollisionSensorRearRightType "Type of Side Collision Sensor Rear - Right.";
CM_ SG_ 3221225472 SdCllisionSensorMidRearRightType "Type of Side Collision Sensor Mid Rear - Right.";
CM_ SG_ 3221225472 SdCllsionSensorMidFrontRightType "Type of Side Collision Sensor Mid Front - Right.";
CM_ SG_ 3221225472 SdeCollisionSensorFrontRightType "Type of Side Collision Sensor Front - Right.";
CM_ SG_ 3221225472 SideCollisionSensorRearLeftType "Type of Side Collision Sensor Rear - Left.";
CM_ SG_ 3221225472 SdCollisionSensorMidRearLeftType "Type of Side Collision Sensor Mid Rear - Left.";
CM_ SG_ 3221225472 SdCllisionSensorMidFrontLeftType "Type of Side Collision Sensor Mid Front - Left.";
CM_ SG_ 3221225472 SideCollisionSensorFrontLeftType "Type of Side Collision Sensor Front - Left.";
CM_ SG_ 3221225472 FrontalCollisionSensor4Type "Type of Frontal Collision Sensor 4.";
CM_ SG_ 3221225472 FrontalCollisionSensor3Type "Type of Frontal Collision Sensor 3.";
CM_ SG_ 3221225472 FrontalCollisionSensor2Type "Type of Frontal Collision Sensor 2.";
CM_ SG_ 3221225472 FrontalCollisionSensor1Type "Type of Frontal Collision Sensor 1.";
CM_ SG_ 3221225472 CrashChecksum "The Crash Checksum is used to verify the signal path from the airbag ECU to other devices in case of a crash.";
CM_ SG_ 3221225472 CrashCounter "The Crash Counter prevents other ECUs from reacting to a faulty transmission of the Crash Notification PGN and serves";
CM_ SG_ 3221225472 CrashType "Type of crash event.";
CM_ SG_ 3221225472 EngChrgArClr2PrecoolerEfficiency "Engine charge air cooler 2 (CAC2) precooler efficiency is an indication of the precooler’s ability to reduce the temperature";
CM_ SG_ 3221225472 EngChrgArClr2PrecoolerOutletTemp "Temperature of the combustion air measured at the charge air cooler 2 precooler outlet.";
CM_ SG_ 3221225472 EngChrgArClr2PrecoolerIntakeTemp "Temperature of the combustion air measured at the charge air cooler 2 precooler Intake.";
CM_ SG_ 3221225472 EngChargeAirCooler2Efficiency "Engine charge air cooler 2 (CAC2) is an indication of the CAC’s ability to reduce the temperature of the combustion air";
CM_ SG_ 3221225472 EngChrgeAirCooler2AmbientAirTemp "Temperature of the air surrounding charge air cooler 2.";
CM_ SG_ 3221225472 EngChargeAirCooler2OutletTemp "Temperature of combustion air after it exits from the Charge Air Cooler 2 but before any mixing of recirculated exhaust";
CM_ SG_ 3221225472 EngChargeAirCooler2IntakeTemp "Temperature of the combustion air measured at the charge air cooler 2 Intake.";
CM_ SG_ 3221225472 EngChrgArClr1PrecoolerEfficiency "Engine charge air cooler 1 (CAC1) precooler efficiency is an indication of the precooler’s ability to reduce the temperature";
CM_ SG_ 3221225472 EngChrgArClr1PrecoolerOutletTemp "Temperature of the combustion air measured at the charge air cooler 1 precooler outlet.";
CM_ SG_ 3221225472 EngChrgArClr1PrecoolerIntakeTemp "Temperature of the combustion air measured at the charge air cooler 1 precooler intake.";
CM_ SG_ 3221225472 EngChargeAirCooler1Efficiency "Engine charge air cooler 1(CAC1) efficiency is an indication of the CAC’s ability to reduce the temperature of the";
CM_ SG_ 3221225472 EngChrgeAirCooler1AmbientAirTemp "Temperature of the air surrounding charge air cooler 1.";
CM_ SG_ 3221225472 EngChargeAirCooler1IntakeTemp "Temperature of the combustion air measured at the CAC 1 Intake.";
CM_ SG_ 3221225472 Joystick9Button9PressedStatus "Reports when the joystick button has been pressed.";
CM_ SG_ 3221225472 Joystick9Button10PressedStatus "Reports when the joystick button has been pressed.";
CM_ SG_ 3221225472 Joystick9Button11PressedStatus "Reports when the joystick button has been pressed.";
CM_ SG_ 3221225472 Joystick9Button12PressedStatus "Reports when the joystick button has been pressed.";
CM_ SG_ 3221225472 Joystick9Button5PressedStatus "Reports when the joystick button has been pressed.";
CM_ SG_ 3221225472 Joystick9Button6PressedStatus "Reports when the joystick button has been pressed.";
CM_ SG_ 3221225472 Joystick9Button7PressedStatus "Reports when the joystick button has been pressed.";
CM_ SG_ 3221225472 Joystick9Button8PressedStatus "Reports when the joystick button has been pressed.";
CM_ SG_ 3221225472 Joystick9Button1PressedStatus "Reports when the joystick button has been pressed.";
CM_ SG_ 3221225472 Joystick9Button2PressedStatus "Reports when the joystick button has been pressed.";
CM_ SG_ 3221225472 Joystick9Button3PressedStatus "Reports when the joystick button has been pressed.";
CM_ SG_ 3221225472 Joystick9Button4PressedStatus "Reports when the joystick button has been pressed.";
CM_ SG_ 3221225472 Joystick9XAxisDetentPosStatus "Reports when the current joystick position is in the detent position for that axis of travel.";
CM_ SG_ 3221225472 Joystick9YAxisDetentPosStatus "Reports when the current joystick position is in the detent position for that axis of travel.";
BA_DEF_ SG_  "SigType" ENUM  "Default","Range","RangeSigned","ASCII","Discrete","Control","ReferencePGN","DTC","StringDelimiter","StringLength","StringLengthControl";
BA_DEF_ SG_  "GenSigStartValue" INT 0 10000;
BA_DEF_ SG_  "GenSigSendType" ENUM  "Cyclic","OnWrite","reserved","OnChange","reserved","reserved","reserved","NoSigSendType";
BA_DEF_ SG_  "GenSigILSupport" ENUM  "Yes","No";
BA_DEF_ SG_  "GenSigEVName" STRING ;
BA_DEF_ SG_  "SPN" INT 0 524287;
BA_DEF_ SG_  "SAEDocument" STRING ;
BA_DEF_ BO_  "GenMsgILSupport" ENUM  "Yes","No";
BA_DEF_ BO_  "GenMsgRequestable" INT 0 1;
BA_DEF_ BO_  "GenMsgSendType" ENUM  "cyclic","reserved","cyclicIfActive","reserved","reserved","reserved","reserved","reserved","noMsgSendType";
BA_DEF_ BO_  "VFrameFormat" ENUM  "StandardCAN","ExtendedCAN","reserved","J1939PG";
BA_DEF_ BO_  "SingleFrame" INT 0 1;
BA_DEF_ BO_  "GenMsgCycleTime" INT 0 3600000;
BA_DEF_ BO_  "SAE_Document" STRING ;
BA_DEF_ SG_  "SystemSignalLongSymbol" STRING ;
BA_DEF_DEF_  "SigType" "Default";
BA_DEF_DEF_  "GenSigStartValue" 0;
BA_DEF_DEF_  "GenSigSendType" "NoSigSendType";
BA_DEF_DEF_  "GenSigILSupport" "Yes";
BA_DEF_DEF_  "GenSigEVName" "Env@Nodename_@Signame";
BA_DEF_DEF_  "SPN" 0;
BA_DEF_DEF_  "SAEDocument" "";
BA_DEF_DEF_  "GenMsgILSupport" "Yes";
BA_DEF_DEF_  "GenMsgRequestable" 1;
BA_DEF_DEF_  "GenMsgSendType" "noMsgSendType";
BA_DEF_DEF_  "VFrameFormat" "J1939PG";
BA_DEF_DEF_  "SingleFrame" 1;
BA_DEF_DEF_  "GenMsgCycleTime" 0;
BA_DEF_DEF_  "SAE_Document" "";
BA_DEF_DEF_  "SystemSignalLongSymbol" "";
BA_ "SigType" SG_ 3221225472 TransRangeLowActuator 5;
BA_ "SPN" SG_ 3221225472 TransRangeLowActuator 769;
BA_ "SAEDocument" SG_ 3221225472 TransRangeLowActuator "J1939-71";
BA_ "SigType" SG_ 3221225472 TransRangeHighActuator 5;
BA_ "SPN" SG_ 3221225472 TransRangeHighActuator 768;
BA_ "SAEDocument" SG_ 3221225472 TransRangeHighActuator "J1939-71";
BA_ "SigType" SG_ 3221225472 TransShiftFingerGearActuator2 5;
BA_ "SPN" SG_ 3221225472 TransShiftFingerGearActuator2 784;
BA_ "SAEDocument" SG_ 3221225472 TransShiftFingerGearActuator2 "J1939-71";
BA_ "SigType" SG_ 3221225472 TransShiftFingerRailActuator2 5;
BA_ "SPN" SG_ 3221225472 TransShiftFingerRailActuator2 783;
BA_ "SAEDocument" SG_ 3221225472 TransShiftFingerRailActuator2 "J1939-71";
BA_ "SigType" SG_ 3221225472 TransShiftFingerGearActuator1 5;
BA_ "SPN" SG_ 3221225472 TransShiftFingerGearActuator1 773;
BA_ "SAEDocument" SG_ 3221225472 TransShiftFingerGearActuator1 "J1939-71";
BA_ "SigType" SG_ 3221225472 TransShiftFingerRailActuator1 5;
BA_ "SPN" SG_ 3221225472 TransShiftFingerRailActuator1 772;
BA_ "SAEDocument" SG_ 3221225472 TransShiftFingerRailActuator1 "J1939-71";
BA_ "SigType" SG_ 3221225472 TrnsShftFngerCenterRailIndicator 5;
BA_ "SPN" SG_ 3221225472 TrnsShftFngerCenterRailIndicator 782;
BA_ "SAEDocument" SG_ 3221225472 TrnsShftFngerCenterRailIndicator "J1939-71";
BA_ "SigType" SG_ 3221225472 TrnsShftFngerEngagementIndicator 5;
BA_ "SPN" SG_ 3221225472 TrnsShftFngerEngagementIndicator 781;
BA_ "SAEDocument" SG_ 3221225472 TrnsShftFngerEngagementIndicator "J1939-71";
BA_ "SigType" SG_ 3221225472 TransShiftFingerNeutralIndicator 5;
BA_ "SPN" SG_ 3221225472 TransShiftFingerNeutralIndicator 780;
BA_ "SAEDocument" SG_ 3221225472 TransShiftFingerNeutralIndicator "J1939-71";
BA_ "SigType" SG_ 3221225472 TransShiftFingerRailPos 1;
BA_ "SPN" SG_ 3221225472 TransShiftFingerRailPos 60;
BA_ "SAEDocument" SG_ 3221225472 TransShiftFingerRailPos "J1939-71";
BA_ "SigType" SG_ 3221225472 TransShiftFingerGearPos 1;
BA_ "SPN" SG_ 3221225472 TransShiftFingerGearPos 59;
BA_ "SAEDocument" SG_ 3221225472 TransShiftFingerGearPos "J1939-71";
BA_ "SPN" SG_ 3221225472 SrcAddrssOfCntrllngDvcFrTrnsCtrl 1482;
BA_ "SAEDocument" SG_ 3221225472 SrcAddrssOfCntrllngDvcFrTrnsCtrl "J1939-71";
BA_ "SigType" SG_ 3221225472 TransInputShaftSpeed 1;
BA_ "SPN" SG_ 3221225472 TransInputShaftSpeed 161;
BA_ "SAEDocument" SG_ 3221225472 TransInputShaftSpeed "J1939-71";
BA_ "SigType" SG_ 3221225472 MomentaryEngMaxPowerEnable 5;
BA_ "SPN" SG_ 3221225472 MomentaryEngMaxPowerEnable 5015;
BA_ "SAEDocument" SG_ 3221225472 MomentaryEngMaxPowerEnable "J1939-71";
BA_ "SigType" SG_ 3221225472 ProgressiveShiftDisable 5;
BA_ "SPN" SG_ 3221225472 ProgressiveShiftDisable 607;
BA_ "SAEDocument" SG_ 3221225472 ProgressiveShiftDisable "J1939-71";
BA_ "SigType" SG_ 3221225472 EngMomentaryOverspeedEnable 5;
BA_ "SPN" SG_ 3221225472 EngMomentaryOverspeedEnable 606;
BA_ "SAEDocument" SG_ 3221225472 EngMomentaryOverspeedEnable "J1939-71";
BA_ "SigType" SG_ 3221225472 TransOutputShaftSpeed 1;
BA_ "SPN" SG_ 3221225472 TransOutputShaftSpeed 191;
BA_ "SAEDocument" SG_ 3221225472 TransOutputShaftSpeed "J1939-71";
BA_ "SigType" SG_ 3221225472 TrnsTrqCnvrtrLckpTrnstnInProcess 4;
BA_ "SPN" SG_ 3221225472 TrnsTrqCnvrtrLckpTrnstnInProcess 4816;
BA_ "SAEDocument" SG_ 3221225472 TrnsTrqCnvrtrLckpTrnstnInProcess "J1939-71";
BA_ "SigType" SG_ 3221225472 TransShiftInProcess 4;
BA_ "SPN" SG_ 3221225472 TransShiftInProcess 574;
BA_ "SAEDocument" SG_ 3221225472 TransShiftInProcess "J1939-71";
BA_ "SigType" SG_ 3221225472 TrnsTorqueConverterLockupEngaged 5;
BA_ "SPN" SG_ 3221225472 TrnsTorqueConverterLockupEngaged 573;
BA_ "SAEDocument" SG_ 3221225472 TrnsTorqueConverterLockupEngaged "J1939-71";
BA_ "SigType" SG_ 3221225472 TransDrivelineEngaged 4;
BA_ "SPN" SG_ 3221225472 TransDrivelineEngaged 560;
BA_ "SAEDocument" SG_ 3221225472 TransDrivelineEngaged "J1939-71";
BA_ "SigType" SG_ 3221225472 EngChargeAirCooler1OutletTemp 1;
BA_ "SPN" SG_ 3221225472 EngChargeAirCooler1OutletTemp 2630;
BA_ "SAEDocument" SG_ 3221225472 EngChargeAirCooler1OutletTemp "J1939-71";
BA_ "SigType" SG_ 3221225472 EngIntkVlvActuationSystemOilTemp 1;
BA_ "SPN" SG_ 3221225472 EngIntkVlvActuationSystemOilTemp 2986;
BA_ "SAEDocument" SG_ 3221225472 EngIntkVlvActuationSystemOilTemp "J1939-71";
BA_ "SigType" SG_ 3221225472 EngIntakeManifold1AirTemp 1;
BA_ "SPN" SG_ 3221225472 EngIntakeManifold1AirTemp 1636;
BA_ "SAEDocument" SG_ 3221225472 EngIntakeManifold1AirTemp "J1939-71";
BA_ "SigType" SG_ 3221225472 EngExhstGsRcirculation1DiffPress 1;
BA_ "SPN" SG_ 3221225472 EngExhstGsRcirculation1DiffPress 411;
BA_ "SAEDocument" SG_ 3221225472 EngExhstGsRcirculation1DiffPress "J1939-71";
BA_ "SigType" SG_ 3221225472 EngExhaustGasRecirculation1Temp 1;
BA_ "SPN" SG_ 3221225472 EngExhaustGasRecirculation1Temp 412;
BA_ "SAEDocument" SG_ 3221225472 EngExhaustGasRecirculation1Temp "J1939-71";
BA_ "SigType" SG_ 3221225472 EngECUTemp 1;
BA_ "SPN" SG_ 3221225472 EngECUTemp 1136;
BA_ "SAEDocument" SG_ 3221225472 EngECUTemp "J1939-71";
BA_ "SigType" SG_ 3221225472 EngOilTemp2 1;
BA_ "SPN" SG_ 3221225472 EngOilTemp2 1135;
BA_ "SAEDocument" SG_ 3221225472 EngOilTemp2 "J1939-71";
BA_ "SigType" SG_ 3221225472 EngFuelTemp1 1;
BA_ "SPN" SG_ 3221225472 EngFuelTemp1 174;
BA_ "SAEDocument" SG_ 3221225472 EngFuelTemp1 "J1939-71";
BA_ "SigType" SG_ 3221225472 EngIntercoolerThermostatOpening 1;
BA_ "SPN" SG_ 3221225472 EngIntercoolerThermostatOpening 1134;
BA_ "SAEDocument" SG_ 3221225472 EngIntercoolerThermostatOpening "J1939-71";
BA_ "SigType" SG_ 3221225472 EngIntercoolerTemp 1;
BA_ "SPN" SG_ 3221225472 EngIntercoolerTemp 52;
BA_ "SAEDocument" SG_ 3221225472 EngIntercoolerTemp "J1939-71";
BA_ "SigType" SG_ 3221225472 EngTurboOilTemp 1;
BA_ "SPN" SG_ 3221225472 EngTurboOilTemp 176;
BA_ "SAEDocument" SG_ 3221225472 EngTurboOilTemp "J1939-71";
BA_ "SigType" SG_ 3221225472 EngOilTemp1 1;
BA_ "SPN" SG_ 3221225472 EngOilTemp1 175;
BA_ "SAEDocument" SG_ 3221225472 EngOilTemp1 "J1939-71";
BA_ "SigType" SG_ 3221225472 EngExhaustGasTempLeftManifold 1;
BA_ "SPN" SG_ 3221225472 EngExhaustGasTempLeftManifold 2434;
BA_ "SAEDocument" SG_ 3221225472 EngExhaustGasTempLeftManifold "J1939-71";
BA_ "SigType" SG_ 3221225472 EngExhaustGasTempRightManifold 1;
BA_ "SPN" SG_ 3221225472 EngExhaustGasTempRightManifold 2433;
BA_ "SAEDocument" SG_ 3221225472 EngExhaustGasTempRightManifold "J1939-71";
BA_ "SigType" SG_ 3221225472 TransOutputRetarder 5;
BA_ "SPN" SG_ 3221225472 TransOutputRetarder 748;
BA_ "SAEDocument" SG_ 3221225472 TransOutputRetarder "J1939-71";
BA_ "SigType" SG_ 3221225472 EngExhaustGasPort20Temp 1;
BA_ "SPN" SG_ 3221225472 EngExhaustGasPort20Temp 1156;
BA_ "SAEDocument" SG_ 3221225472 EngExhaustGasPort20Temp "J1939-71";
BA_ "SigType" SG_ 3221225472 EngExhaustGasPort19Temp 1;
BA_ "SPN" SG_ 3221225472 EngExhaustGasPort19Temp 1155;
BA_ "SAEDocument" SG_ 3221225472 EngExhaustGasPort19Temp "J1939-71";
BA_ "SigType" SG_ 3221225472 EngExhaustGasPort18Temp 1;
BA_ "SPN" SG_ 3221225472 EngExhaustGasPort18Temp 1154;
BA_ "SAEDocument" SG_ 3221225472 EngExhaustGasPort18Temp "J1939-71";
BA_ "SigType" SG_ 3221225472 EngExhaustGasPort17Temp 1;
BA_ "SPN" SG_ 3221225472 EngExhaustGasPort17Temp 1153;
BA_ "SAEDocument" SG_ 3221225472 EngExhaustGasPort17Temp "J1939-71";
BA_ "SigType" SG_ 3221225472 EngExhaustGasPort16Temp 1;
BA_ "SPN" SG_ 3221225472 EngExhaustGasPort16Temp 1152;
BA_ "SAEDocument" SG_ 3221225472 EngExhaustGasPort16Temp "J1939-71";
BA_ "SigType" SG_ 3221225472 EngExhaustGasPort15Temp 1;
BA_ "SPN" SG_ 3221225472 EngExhaustGasPort15Temp 1151;
BA_ "SAEDocument" SG_ 3221225472 EngExhaustGasPort15Temp "J1939-71";
BA_ "SigType" SG_ 3221225472 EngExhaustGasPort14Temp 1;
BA_ "SPN" SG_ 3221225472 EngExhaustGasPort14Temp 1150;
BA_ "SAEDocument" SG_ 3221225472 EngExhaustGasPort14Temp "J1939-71";
BA_ "SigType" SG_ 3221225472 EngExhaustGasPort13Temp 1;
BA_ "SPN" SG_ 3221225472 EngExhaustGasPort13Temp 1149;
BA_ "SAEDocument" SG_ 3221225472 EngExhaustGasPort13Temp "J1939-71";
BA_ "SigType" SG_ 3221225472 EngExhaustGasPort12Temp 1;
BA_ "SPN" SG_ 3221225472 EngExhaustGasPort12Temp 1148;
BA_ "SAEDocument" SG_ 3221225472 EngExhaustGasPort12Temp "J1939-71";
BA_ "SigType" SG_ 3221225472 EngExhaustGasPort11Temp 1;
BA_ "SPN" SG_ 3221225472 EngExhaustGasPort11Temp 1147;
BA_ "SAEDocument" SG_ 3221225472 EngExhaustGasPort11Temp "J1939-71";
BA_ "SigType" SG_ 3221225472 EngExhaustGasPort10Temp 1;
BA_ "SPN" SG_ 3221225472 EngExhaustGasPort10Temp 1146;
BA_ "SAEDocument" SG_ 3221225472 EngExhaustGasPort10Temp "J1939-71";
BA_ "SigType" SG_ 3221225472 EngExhaustGasPort9Temp 1;
BA_ "SPN" SG_ 3221225472 EngExhaustGasPort9Temp 1145;
BA_ "SAEDocument" SG_ 3221225472 EngExhaustGasPort9Temp "J1939-71";
BA_ "SigType" SG_ 3221225472 EngExhaustGasPort8Temp 1;
BA_ "SPN" SG_ 3221225472 EngExhaustGasPort8Temp 1144;
BA_ "SAEDocument" SG_ 3221225472 EngExhaustGasPort8Temp "J1939-71";
BA_ "SigType" SG_ 3221225472 EngExhaustGasPort7Temp 1;
BA_ "SPN" SG_ 3221225472 EngExhaustGasPort7Temp 1143;
BA_ "SAEDocument" SG_ 3221225472 EngExhaustGasPort7Temp "J1939-71";
BA_ "SigType" SG_ 3221225472 EngExhaustGasPort6Temp 1;
BA_ "SPN" SG_ 3221225472 EngExhaustGasPort6Temp 1142;
BA_ "SAEDocument" SG_ 3221225472 EngExhaustGasPort6Temp "J1939-71";
BA_ "SigType" SG_ 3221225472 EngExhaustGasPort5Temp 1;
BA_ "SPN" SG_ 3221225472 EngExhaustGasPort5Temp 1141;
BA_ "SAEDocument" SG_ 3221225472 EngExhaustGasPort5Temp "J1939-71";
BA_ "SigType" SG_ 3221225472 EngExhaustGasPort4Temp 1;
BA_ "SPN" SG_ 3221225472 EngExhaustGasPort4Temp 1140;
BA_ "SAEDocument" SG_ 3221225472 EngExhaustGasPort4Temp "J1939-71";
BA_ "SigType" SG_ 3221225472 EngExhaustGasPort3Temp 1;
BA_ "SPN" SG_ 3221225472 EngExhaustGasPort3Temp 1139;
BA_ "SAEDocument" SG_ 3221225472 EngExhaustGasPort3Temp "J1939-71";
BA_ "SigType" SG_ 3221225472 EngExhaustGasPort2Temp 1;
BA_ "SPN" SG_ 3221225472 EngExhaustGasPort2Temp 1138;
BA_ "SAEDocument" SG_ 3221225472 EngExhaustGasPort2Temp "J1939-71";
BA_ "SigType" SG_ 3221225472 EngExhaustGasPort1Temp 1;
BA_ "SPN" SG_ 3221225472 EngExhaustGasPort1Temp 1137;
BA_ "SAEDocument" SG_ 3221225472 EngExhaustGasPort1Temp "J1939-71";
BA_ "SigType" SG_ 3221225472 PayloadPercentage 1;
BA_ "SPN" SG_ 3221225472 PayloadPercentage 2600;
BA_ "SAEDocument" SG_ 3221225472 PayloadPercentage "J1939-71";
BA_ "SigType" SG_ 3221225472 DataMemoryUsage 1;
BA_ "SPN" SG_ 3221225472 DataMemoryUsage 2802;
BA_ "SAEDocument" SG_ 3221225472 DataMemoryUsage "J1939-71";
BA_ "SigType" SG_ 3221225472 KeepAliveBatteryConsumption 1;
BA_ "SPN" SG_ 3221225472 KeepAliveBatteryConsumption 2803;
BA_ "SAEDocument" SG_ 3221225472 KeepAliveBatteryConsumption "J1939-71";
BA_ "SigType" SG_ 3221225472 TravelVelocityCtrlPos 1;
BA_ "SPN" SG_ 3221225472 TravelVelocityCtrlPos 2601;
BA_ "SAEDocument" SG_ 3221225472 TravelVelocityCtrlPos "J1939-71";
BA_ "SigType" SG_ 3221225472 EngExhstGsOxygnSnsrClsdLpOprtion 5;
BA_ "SPN" SG_ 3221225472 EngExhstGsOxygnSnsrClsdLpOprtion 1696;
BA_ "SAEDocument" SG_ 3221225472 EngExhstGsOxygnSnsrClsdLpOprtion "J1939-71";
BA_ "SPN" SG_ 3221225472 EngExhstGsOxygnSnsrFlngCrrection 1695;
BA_ "SAEDocument" SG_ 3221225472 EngExhstGsOxygnSnsrFlngCrrection "J1939-71";
BA_ "SigType" SG_ 3221225472 EngActualExhaustOxygen 1;
BA_ "SPN" SG_ 3221225472 EngActualExhaustOxygen 1119;
BA_ "SAEDocument" SG_ 3221225472 EngActualExhaustOxygen "J1939-71";
BA_ "SigType" SG_ 3221225472 EngDesiredExhaustOxygen 1;
BA_ "SPN" SG_ 3221225472 EngDesiredExhaustOxygen 1118;
BA_ "SAEDocument" SG_ 3221225472 EngDesiredExhaustOxygen "J1939-71";
BA_ "SigType" SG_ 3221225472 EngDesiredRatedExhaustOxygen 1;
BA_ "SPN" SG_ 3221225472 EngDesiredRatedExhaustOxygen 1117;
BA_ "SAEDocument" SG_ 3221225472 EngDesiredRatedExhaustOxygen "J1939-71";
BA_ "SigType" SG_ 3221225472 Jystick3GripXAxisDetentPosStatus 4;
BA_ "SPN" SG_ 3221225472 Jystick3GripXAxisDetentPosStatus 2756;
BA_ "SAEDocument" SG_ 3221225472 Jystick3GripXAxisDetentPosStatus "J1939-71";
BA_ "SigType" SG_ 3221225472 Jystick3GripYAxisDetentPosStatus 4;
BA_ "SPN" SG_ 3221225472 Jystick3GripYAxisDetentPosStatus 2757;
BA_ "SAEDocument" SG_ 3221225472 Jystick3GripYAxisDetentPosStatus "J1939-71";
BA_ "SigType" SG_ 3221225472 Jystick3ThetaAxisDetentPosStatus 4;
BA_ "SPN" SG_ 3221225472 Jystick3ThetaAxisDetentPosStatus 2758;
BA_ "SAEDocument" SG_ 3221225472 Jystick3ThetaAxisDetentPosStatus "J1939-71";
BA_ "SPN" SG_ 3221225472 Joystick3ThetaAxisPos 2738;
BA_ "SAEDocument" SG_ 3221225472 Joystick3ThetaAxisPos "J1939-71";
BA_ "SigType" SG_ 3221225472 Jystck3ThtAxsClckwsPstvPosStatus 4;
BA_ "SPN" SG_ 3221225472 Jystck3ThtAxsClckwsPstvPosStatus 2743;
BA_ "SAEDocument" SG_ 3221225472 Jystck3ThtAxsClckwsPstvPosStatus "J1939-71";
BA_ "SigType" SG_ 3221225472 Jystck3ThetaAxisNeutralPosStatus 4;
BA_ "SPN" SG_ 3221225472 Jystck3ThetaAxisNeutralPosStatus 2753;
BA_ "SAEDocument" SG_ 3221225472 Jystck3ThetaAxisNeutralPosStatus "J1939-71";
BA_ "SPN" SG_ 3221225472 Joystick3GripYAxisPos 2737;
BA_ "SAEDocument" SG_ 3221225472 Joystick3GripYAxisPos "J1939-71";
BA_ "SigType" SG_ 3221225472 Jystck3GrpYAxsLvrFrwrdPstvPsStts 4;
BA_ "SPN" SG_ 3221225472 Jystck3GrpYAxsLvrFrwrdPstvPsStts 2742;
BA_ "SAEDocument" SG_ 3221225472 Jystck3GrpYAxsLvrFrwrdPstvPsStts "J1939-71";
BA_ "SigType" SG_ 3221225472 Jystck3GrpYAxsLvrBckNgtvPsStatus 4;
BA_ "SPN" SG_ 3221225472 Jystck3GrpYAxsLvrBckNgtvPsStatus 2747;
BA_ "SAEDocument" SG_ 3221225472 Jystck3GrpYAxsLvrBckNgtvPsStatus "J1939-71";
BA_ "SigType" SG_ 3221225472 Jystck3GripYAxisNeutralPosStatus 4;
BA_ "SPN" SG_ 3221225472 Jystck3GripYAxisNeutralPosStatus 2752;
BA_ "SAEDocument" SG_ 3221225472 Jystck3GripYAxisNeutralPosStatus "J1939-71";
BA_ "SPN" SG_ 3221225472 Joystick3GripXAxisPos 2736;
BA_ "SAEDocument" SG_ 3221225472 Joystick3GripXAxisPos "J1939-71";
BA_ "SigType" SG_ 3221225472 Jystck3GrpXAxsLvrRghtPstvPsSttus 4;
BA_ "SPN" SG_ 3221225472 Jystck3GrpXAxsLvrRghtPstvPsSttus 2741;
BA_ "SAEDocument" SG_ 3221225472 Jystck3GrpXAxsLvrRghtPstvPsSttus "J1939-71";
BA_ "SigType" SG_ 3221225472 Jystck3GrpXAxsLvrLftNgtvPsStatus 4;
BA_ "SPN" SG_ 3221225472 Jystck3GrpXAxsLvrLftNgtvPsStatus 2746;
BA_ "SAEDocument" SG_ 3221225472 Jystck3GrpXAxsLvrLftNgtvPsStatus "J1939-71";
BA_ "SigType" SG_ 3221225472 Jystck3GripXAxisNeutralPosStatus 4;
BA_ "SPN" SG_ 3221225472 Jystck3GripXAxisNeutralPosStatus 2751;
BA_ "SAEDocument" SG_ 3221225472 Jystck3GripXAxisNeutralPosStatus "J1939-71";
BA_ "SigType" SG_ 3221225472 Jystck3ThtAxsCntrClckwsNgtvPsStt 4;
BA_ "SPN" SG_ 3221225472 Jystck3ThtAxsCntrClckwsNgtvPsStt 2748;
BA_ "SAEDocument" SG_ 3221225472 Jystck3ThtAxsCntrClckwsNgtvPsStt "J1939-71";
BA_ "SigType" SG_ 3221225472 Jystick2GripXAxisDetentPosStatus 4;
BA_ "SPN" SG_ 3221225472 Jystick2GripXAxisDetentPosStatus 2719;
BA_ "SAEDocument" SG_ 3221225472 Jystick2GripXAxisDetentPosStatus "J1939-71";
BA_ "SigType" SG_ 3221225472 Jystick2GripYAxisDetentPosStatus 4;
BA_ "SPN" SG_ 3221225472 Jystick2GripYAxisDetentPosStatus 2720;
BA_ "SAEDocument" SG_ 3221225472 Jystick2GripYAxisDetentPosStatus "J1939-71";
BA_ "SigType" SG_ 3221225472 Jystick2ThetaAxisDetentPosStatus 4;
BA_ "SPN" SG_ 3221225472 Jystick2ThetaAxisDetentPosStatus 2721;
BA_ "SAEDocument" SG_ 3221225472 Jystick2ThetaAxisDetentPosStatus "J1939-71";
BA_ "SPN" SG_ 3221225472 Joystick2ThetaAxisPos 2701;
BA_ "SAEDocument" SG_ 3221225472 Joystick2ThetaAxisPos "J1939-71";
BA_ "SigType" SG_ 3221225472 Jystck2ThtAxsClckwsPstvPosStatus 4;
BA_ "SPN" SG_ 3221225472 Jystck2ThtAxsClckwsPstvPosStatus 2706;
BA_ "SAEDocument" SG_ 3221225472 Jystck2ThtAxsClckwsPstvPosStatus "J1939-71";
BA_ "SigType" SG_ 3221225472 Jystck2ThetaAxisNeutralPosStatus 4;
BA_ "SPN" SG_ 3221225472 Jystck2ThetaAxisNeutralPosStatus 2716;
BA_ "SAEDocument" SG_ 3221225472 Jystck2ThetaAxisNeutralPosStatus "J1939-71";
BA_ "SPN" SG_ 3221225472 Joystick2GripYAxisPos 2700;
BA_ "SAEDocument" SG_ 3221225472 Joystick2GripYAxisPos "J1939-71";
BA_ "SigType" SG_ 3221225472 Jystck2GrpYAxsLvrFrwrdPstvPsStts 4;
BA_ "SPN" SG_ 3221225472 Jystck2GrpYAxsLvrFrwrdPstvPsStts 2705;
BA_ "SAEDocument" SG_ 3221225472 Jystck2GrpYAxsLvrFrwrdPstvPsStts "J1939-71";
BA_ "SigType" SG_ 3221225472 Jystck2GrpYAxsLvrBckNgtvPsStatus 4;
BA_ "SPN" SG_ 3221225472 Jystck2GrpYAxsLvrBckNgtvPsStatus 2710;
BA_ "SAEDocument" SG_ 3221225472 Jystck2GrpYAxsLvrBckNgtvPsStatus "J1939-71";
BA_ "SigType" SG_ 3221225472 Jystck2GripYAxisNeutralPosStatus 4;
BA_ "SPN" SG_ 3221225472 Jystck2GripYAxisNeutralPosStatus 2715;
BA_ "SAEDocument" SG_ 3221225472 Jystck2GripYAxisNeutralPosStatus "J1939-71";
BA_ "SPN" SG_ 3221225472 Joystick2GripXAxisPos 2699;
BA_ "SAEDocument" SG_ 3221225472 Joystick2GripXAxisPos "J1939-71";
BA_ "SigType" SG_ 3221225472 Jystck2GrpXAxsLvrRghtPstvPsSttus 4;
BA_ "SPN" SG_ 3221225472 Jystck2GrpXAxsLvrRghtPstvPsSttus 2704;
BA_ "SAEDocument" SG_ 3221225472 Jystck2GrpXAxsLvrRghtPstvPsSttus "J1939-71";
BA_ "SigType" SG_ 3221225472 Jystck2GrpXAxsLvrLftNgtvPsStatus 4;
BA_ "SPN" SG_ 3221225472 Jystck2GrpXAxsLvrLftNgtvPsStatus 2709;
BA_ "SAEDocument" SG_ 3221225472 Jystck2GrpXAxsLvrLftNgtvPsStatus "J1939-71";
BA_ "SigType" SG_ 3221225472 Jystck2GripXAxisNeutralPosStatus 4;
BA_ "SPN" SG_ 3221225472 Jystck2GripXAxisNeutralPosStatus 2714;
BA_ "SAEDocument" SG_ 3221225472 Jystck2GripXAxisNeutralPosStatus "J1939-71";
BA_ "SigType" SG_ 3221225472 Jystck2ThtAxsCntrClckwsNgtvPsStt 4;
BA_ "SPN" SG_ 3221225472 Jystck2ThtAxsCntrClckwsNgtvPsStt 2711;
BA_ "SAEDocument" SG_ 3221225472 Jystck2ThtAxsCntrClckwsNgtvPsStt "J1939-71";
BA_ "SigType" SG_ 3221225472 Jystick1GripXAxisDetentPosStatus 4;
BA_ "SPN" SG_ 3221225472 Jystick1GripXAxisDetentPosStatus 2682;
BA_ "SAEDocument" SG_ 3221225472 Jystick1GripXAxisDetentPosStatus "J1939-71";
BA_ "SigType" SG_ 3221225472 Jystick1GripYAxisDetentPosStatus 4;
BA_ "SPN" SG_ 3221225472 Jystick1GripYAxisDetentPosStatus 2683;
BA_ "SAEDocument" SG_ 3221225472 Jystick1GripYAxisDetentPosStatus "J1939-71";
BA_ "SigType" SG_ 3221225472 Jystick1ThetaAxisDetentPosStatus 4;
BA_ "SPN" SG_ 3221225472 Jystick1ThetaAxisDetentPosStatus 2684;
BA_ "SAEDocument" SG_ 3221225472 Jystick1ThetaAxisDetentPosStatus "J1939-71";
BA_ "SPN" SG_ 3221225472 Joystick1ThetaAxisPos 2664;
BA_ "SAEDocument" SG_ 3221225472 Joystick1ThetaAxisPos "J1939-71";
BA_ "SigType" SG_ 3221225472 Jystck1ThtAxsClckwsPstvPosStatus 4;
BA_ "SPN" SG_ 3221225472 Jystck1ThtAxsClckwsPstvPosStatus 2669;
BA_ "SAEDocument" SG_ 3221225472 Jystck1ThtAxsClckwsPstvPosStatus "J1939-71";
BA_ "SigType" SG_ 3221225472 Jystck1ThetaAxisNeutralPosStatus 4;
BA_ "SPN" SG_ 3221225472 Jystck1ThetaAxisNeutralPosStatus 2679;
BA_ "SAEDocument" SG_ 3221225472 Jystck1ThetaAxisNeutralPosStatus "J1939-71";
BA_ "SPN" SG_ 3221225472 Joystick1GripYAxisPos 2663;
BA_ "SAEDocument" SG_ 3221225472 Joystick1GripYAxisPos "J1939-71";
BA_ "SigType" SG_ 3221225472 Jystck1GrpYAxsLvrFrwrdPstvPsStts 4;
BA_ "SPN" SG_ 3221225472 Jystck1GrpYAxsLvrFrwrdPstvPsStts 2668;
BA_ "SAEDocument" SG_ 3221225472 Jystck1GrpYAxsLvrFrwrdPstvPsStts "J1939-71";
BA_ "SigType" SG_ 3221225472 Jystck1GrpYAxsLvrBckNgtvPsStatus 4;
BA_ "SPN" SG_ 3221225472 Jystck1GrpYAxsLvrBckNgtvPsStatus 2673;
BA_ "SAEDocument" SG_ 3221225472 Jystck1GrpYAxsLvrBckNgtvPsStatus "J1939-71";
BA_ "SigType" SG_ 3221225472 Jystck1GripYAxisNeutralPosStatus 4;
BA_ "SPN" SG_ 3221225472 Jystck1GripYAxisNeutralPosStatus 2678;
BA_ "SAEDocument" SG_ 3221225472 Jystck1GripYAxisNeutralPosStatus "J1939-71";
BA_ "SPN" SG_ 3221225472 Joystick1GripXAxisPos 2662;
BA_ "SAEDocument" SG_ 3221225472 Joystick1GripXAxisPos "J1939-71";
BA_ "SigType" SG_ 3221225472 Jystck1GrpXAxsLvrRghtPstvPsSttus 4;
BA_ "SPN" SG_ 3221225472 Jystck1GrpXAxsLvrRghtPstvPsSttus 2667;
BA_ "SAEDocument" SG_ 3221225472 Jystck1GrpXAxsLvrRghtPstvPsSttus "J1939-71";
BA_ "SigType" SG_ 3221225472 Jystck1GrpXAxsLvrLftNgtvPsStatus 4;
BA_ "SPN" SG_ 3221225472 Jystck1GrpXAxsLvrLftNgtvPsStatus 2672;
BA_ "SAEDocument" SG_ 3221225472 Jystck1GrpXAxsLvrLftNgtvPsStatus "J1939-71";
BA_ "SigType" SG_ 3221225472 Jystck1GripXAxisNeutralPosStatus 4;
BA_ "SPN" SG_ 3221225472 Jystck1GripXAxisNeutralPosStatus 2677;
BA_ "SAEDocument" SG_ 3221225472 Jystck1GripXAxisNeutralPosStatus "J1939-71";
BA_ "SigType" SG_ 3221225472 Jystck1ThtAxsCntrClckwsNgtvPsStt 4;
BA_ "SPN" SG_ 3221225472 Jystck1ThtAxsCntrClckwsNgtvPsStt 2674;
BA_ "SAEDocument" SG_ 3221225472 Jystck1ThtAxsCntrClckwsNgtvPsStt "J1939-71";
BA_ "SigType" SG_ 3221225472 EngFuelRackPos 1;
BA_ "SPN" SG_ 3221225472 EngFuelRackPos 1210;
BA_ "SAEDocument" SG_ 3221225472 EngFuelRackPos "J1939-71";
BA_ "SigType" SG_ 3221225472 EngGasMassFlowRate1 1;
BA_ "SPN" SG_ 3221225472 EngGasMassFlowRate1 1241;
BA_ "SAEDocument" SG_ 3221225472 EngGasMassFlowRate1 "J1939-71";
BA_ "SigType" SG_ 3221225472 InstantaneousEstBrakePower 1;
BA_ "SPN" SG_ 3221225472 InstantaneousEstBrakePower 1242;
BA_ "SAEDocument" SG_ 3221225472 InstantaneousEstBrakePower "J1939-71";
BA_ "SigType" SG_ 3221225472 EngExhaustGasPress 1;
BA_ "SPN" SG_ 3221225472 EngExhaustGasPress 1209;
BA_ "SAEDocument" SG_ 3221225472 EngExhaustGasPress "J1939-71";
BA_ "SigType" SG_ 3221225472 EngPrefilterOilPress 1;
BA_ "SPN" SG_ 3221225472 EngPrefilterOilPress 1208;
BA_ "SAEDocument" SG_ 3221225472 EngPrefilterOilPress "J1939-71";
BA_ "SigType" SG_ 3221225472 TotalECURunTime 1;
BA_ "SPN" SG_ 3221225472 TotalECURunTime 1033;
BA_ "SAEDocument" SG_ 3221225472 TotalECURunTime "J1939-71";
BA_ "SigType" SG_ 3221225472 TotalECUDistance 1;
BA_ "SPN" SG_ 3221225472 TotalECUDistance 1032;
BA_ "SAEDocument" SG_ 3221225472 TotalECUDistance "J1939-71";
BA_ "SigType" SG_ 3221225472 EngExhstGsRcrcltion2MassFlowRate 1;
BA_ "SPN" SG_ 3221225472 EngExhstGsRcrcltion2MassFlowRate 5257;
BA_ "SAEDocument" SG_ 3221225472 EngExhstGsRcrcltion2MassFlowRate "J1939-71";
BA_ "SigType" SG_ 3221225472 EngIntakeAirMassFlowRate 1;
BA_ "SPN" SG_ 3221225472 EngIntakeAirMassFlowRate 132;
BA_ "SAEDocument" SG_ 3221225472 EngIntakeAirMassFlowRate "J1939-71";
BA_ "SigType" SG_ 3221225472 EngExhstGsRcrcltion1MassFlowRate 1;
BA_ "SPN" SG_ 3221225472 EngExhstGsRcrcltion1MassFlowRate 2659;
BA_ "SAEDocument" SG_ 3221225472 EngExhstGsRcrcltion1MassFlowRate "J1939-71";
BA_ "SigType" SG_ 3221225472 FuelPumpPrimerStatus 5;
BA_ "SPN" SG_ 3221225472 FuelPumpPrimerStatus 4083;
BA_ "SAEDocument" SG_ 3221225472 FuelPumpPrimerStatus "J1939-71";
BA_ "SPN" SG_ 3221225472 EngVentilationStatus 3554;
BA_ "SAEDocument" SG_ 3221225472 EngVentilationStatus "J1939-71";
BA_ "SigType" SG_ 3221225472 EngCoolantPreheatedState 5;
BA_ "SPN" SG_ 3221225472 EngCoolantPreheatedState 3553;
BA_ "SAEDocument" SG_ 3221225472 EngCoolantPreheatedState "J1939-71";
BA_ "SigType" SG_ 3221225472 EngOilPreHeatedState 5;
BA_ "SPN" SG_ 3221225472 EngOilPreHeatedState 3552;
BA_ "SAEDocument" SG_ 3221225472 EngOilPreHeatedState "J1939-71";
BA_ "SigType" SG_ 3221225472 EngOilPrimingState 5;
BA_ "SPN" SG_ 3221225472 EngOilPrimingState 3551;
BA_ "SAEDocument" SG_ 3221225472 EngOilPrimingState "J1939-71";
BA_ "SigType" SG_ 3221225472 EngOilPrimingPumpSwitch 4;
BA_ "SPN" SG_ 3221225472 EngOilPrimingPumpSwitch 3550;
BA_ "SAEDocument" SG_ 3221225472 EngOilPrimingPumpSwitch "J1939-71";
BA_ "SigType" SG_ 3221225472 EngOilFilterOutletPress 1;
BA_ "SPN" SG_ 3221225472 EngOilFilterOutletPress 3549;
BA_ "SAEDocument" SG_ 3221225472 EngOilFilterOutletPress "J1939-71";
BA_ "SigType" SG_ 3221225472 EngWasteOilReservoirLevel 1;
BA_ "SPN" SG_ 3221225472 EngWasteOilReservoirLevel 3548;
BA_ "SAEDocument" SG_ 3221225472 EngWasteOilReservoirLevel "J1939-71";
BA_ "SigType" SG_ 3221225472 EngFuelFilterDiffPress 1;
BA_ "SPN" SG_ 3221225472 EngFuelFilterDiffPress 95;
BA_ "SAEDocument" SG_ 3221225472 EngFuelFilterDiffPress "J1939-71";
BA_ "SigType" SG_ 3221225472 EngFuelSupplyPumpIntakePress 1;
BA_ "SPN" SG_ 3221225472 EngFuelSupplyPumpIntakePress 1381;
BA_ "SAEDocument" SG_ 3221225472 EngFuelSupplyPumpIntakePress "J1939-71";
BA_ "SigType" SG_ 3221225472 EngOilLevelRemoteReservoir 1;
BA_ "SPN" SG_ 3221225472 EngOilLevelRemoteReservoir 1380;
BA_ "SAEDocument" SG_ 3221225472 EngOilLevelRemoteReservoir "J1939-71";
BA_ "SigType" SG_ 3221225472 EngExhstGsRcrclation1OutletPress 1;
BA_ "SPN" SG_ 3221225472 EngExhstGsRcrclation1OutletPress 5019;
BA_ "SAEDocument" SG_ 3221225472 EngExhstGsRcrclation1OutletPress "J1939-71";
BA_ "SigType" SG_ 3221225472 EngExhstVlvActtionSystemOilPress 1;
BA_ "SPN" SG_ 3221225472 EngExhstVlvActtionSystemOilPress 4287;
BA_ "SAEDocument" SG_ 3221225472 EngExhstVlvActtionSystemOilPress "J1939-71";
BA_ "SigType" SG_ 3221225472 EngExhstGsRcrclation1IntakePress 1;
BA_ "SPN" SG_ 3221225472 EngExhstGsRcrclation1IntakePress 3358;
BA_ "SAEDocument" SG_ 3221225472 EngExhstGsRcrclation1IntakePress "J1939-71";
BA_ "SigType" SG_ 3221225472 EngIntkVlvActationSystemOilPress 1;
BA_ "SPN" SG_ 3221225472 EngIntkVlvActationSystemOilPress 2948;
BA_ "SAEDocument" SG_ 3221225472 EngIntkVlvActationSystemOilPress "J1939-71";
BA_ "SigType" SG_ 3221225472 EngInjectorMeteringRail2Press 1;
BA_ "SPN" SG_ 3221225472 EngInjectorMeteringRail2Press 1349;
BA_ "SAEDocument" SG_ 3221225472 EngInjectorMeteringRail2Press "J1939-71";
BA_ "SigType" SG_ 3221225472 EngInjectorTimingRail1Press 1;
BA_ "SPN" SG_ 3221225472 EngInjectorTimingRail1Press 156;
BA_ "SAEDocument" SG_ 3221225472 EngInjectorTimingRail1Press "J1939-71";
BA_ "SigType" SG_ 3221225472 EngInjectorMeteringRail1Press 1;
BA_ "SPN" SG_ 3221225472 EngInjectorMeteringRail1Press 157;
BA_ "SAEDocument" SG_ 3221225472 EngInjectorMeteringRail1Press "J1939-71";
BA_ "SigType" SG_ 3221225472 EngInjectionCtrlPress 1;
BA_ "SPN" SG_ 3221225472 EngInjectionCtrlPress 164;
BA_ "SAEDocument" SG_ 3221225472 EngInjectionCtrlPress "J1939-71";
BA_ "SigType" SG_ 3221225472 EngCoolantLevel 1;
BA_ "SPN" SG_ 3221225472 EngCoolantLevel 111;
BA_ "SAEDocument" SG_ 3221225472 EngCoolantLevel "J1939-71";
BA_ "SigType" SG_ 3221225472 EngCoolantPress 1;
BA_ "SPN" SG_ 3221225472 EngCoolantPress 109;
BA_ "SAEDocument" SG_ 3221225472 EngCoolantPress "J1939-71";
BA_ "SigType" SG_ 3221225472 EngCrankcasePress 1;
BA_ "SPN" SG_ 3221225472 EngCrankcasePress 101;
BA_ "SAEDocument" SG_ 3221225472 EngCrankcasePress "J1939-71";
BA_ "SigType" SG_ 3221225472 EngOilPress 1;
BA_ "SPN" SG_ 3221225472 EngOilPress 100;
BA_ "SAEDocument" SG_ 3221225472 EngOilPress "J1939-71";
BA_ "SigType" SG_ 3221225472 EngOilLevel 1;
BA_ "SPN" SG_ 3221225472 EngOilLevel 98;
BA_ "SAEDocument" SG_ 3221225472 EngOilLevel "J1939-71";
BA_ "SigType" SG_ 3221225472 EngExCrankcaseBlowbyPress 1;
BA_ "SPN" SG_ 3221225472 EngExCrankcaseBlowbyPress 22;
BA_ "SAEDocument" SG_ 3221225472 EngExCrankcaseBlowbyPress "J1939-71";
BA_ "SigType" SG_ 3221225472 EngFuelDeliveryPress 1;
BA_ "SPN" SG_ 3221225472 EngFuelDeliveryPress 94;
BA_ "SAEDocument" SG_ 3221225472 EngFuelDeliveryPress "J1939-71";
BA_ "SigType" SG_ 3221225472 SafetyWireStatus 5;
BA_ "SPN" SG_ 3221225472 SafetyWireStatus 1205;
BA_ "SAEDocument" SG_ 3221225472 SafetyWireStatus "J1939-71";
BA_ "SigType" SG_ 3221225472 ElectricalLoad 1;
BA_ "SPN" SG_ 3221225472 ElectricalLoad 1204;
BA_ "SAEDocument" SG_ 3221225472 ElectricalLoad "J1939-71";
BA_ "SigType" SG_ 3221225472 EngVriableGeometryTurbo1CtrlMode 5;
BA_ "SPN" SG_ 3221225472 EngVriableGeometryTurbo1CtrlMode 5457;
BA_ "SAEDocument" SG_ 3221225472 EngVriableGeometryTurbo1CtrlMode "J1939-71";
BA_ "SPN" SG_ 3221225472 EngTrb1ClclatedTurbineIntakeTemp 2789;
BA_ "SAEDocument" SG_ 3221225472 EngTrb1ClclatedTurbineIntakeTemp "J1939-71";
BA_ "SPN" SG_ 3221225472 EngExhstGsRcirculation1ValveCtrl 2791;
BA_ "SAEDocument" SG_ 3221225472 EngExhstGsRcirculation1ValveCtrl "J1939-71";
BA_ "SigType" SG_ 3221225472 EngVrblGeometryTurbo1ActuatorPos 1;
BA_ "SPN" SG_ 3221225472 EngVrblGeometryTurbo1ActuatorPos 2795;
BA_ "SAEDocument" SG_ 3221225472 EngVrblGeometryTurbo1ActuatorPos "J1939-71";
BA_ "SigType" SG_ 3221225472 EngVrblGmtryTrbArCtrlShtoffValve 5;
BA_ "SPN" SG_ 3221225472 EngVrblGmtryTrbArCtrlShtoffValve 2792;
BA_ "SAEDocument" SG_ 3221225472 EngVrblGmtryTrbArCtrlShtoffValve "J1939-71";
BA_ "SPN" SG_ 3221225472 EngTrb1ClclatedTurbineOutletTemp 2790;
BA_ "SAEDocument" SG_ 3221225472 EngTrb1ClclatedTurbineOutletTemp "J1939-71";
BA_ "SPN" SG_ 3221225472 CrnkAttmptCntOnPrsntStartAttempt 3671;
BA_ "SAEDocument" SG_ 3221225472 CrnkAttmptCntOnPrsntStartAttempt "J1939-71";
BA_ "SigType" SG_ 3221225472 EngIntakeManifoldPressCtrlMode 5;
BA_ "SPN" SG_ 3221225472 EngIntakeManifoldPressCtrlMode 5465;
BA_ "SAEDocument" SG_ 3221225472 EngIntakeManifoldPressCtrlMode "J1939-71";
BA_ "SigType" SG_ 3221225472 EngRotationDirection 4;
BA_ "SPN" SG_ 3221225472 EngRotationDirection 3669;
BA_ "SAEDocument" SG_ 3221225472 EngRotationDirection "J1939-71";
BA_ "SigType" SG_ 3221225472 EngRatedSpeed 1;
BA_ "SPN" SG_ 3221225472 EngRatedSpeed 189;
BA_ "SAEDocument" SG_ 3221225472 EngRatedSpeed "J1939-71";
BA_ "SigType" SG_ 3221225472 EngRatedPower 1;
BA_ "SPN" SG_ 3221225472 EngRatedPower 166;
BA_ "SAEDocument" SG_ 3221225472 EngRatedPower "J1939-71";
BA_ "SigType" SG_ 3221225472 Aftertreatment2ExhaustDewPoint 5;
BA_ "SPN" SG_ 3221225472 Aftertreatment2ExhaustDewPoint 3240;
BA_ "SAEDocument" SG_ 3221225472 Aftertreatment2ExhaustDewPoint "J1939-71";
BA_ "SigType" SG_ 3221225472 Aftertreatment2IntakeDewPoint 5;
BA_ "SPN" SG_ 3221225472 Aftertreatment2IntakeDewPoint 3239;
BA_ "SAEDocument" SG_ 3221225472 Aftertreatment2IntakeDewPoint "J1939-71";
BA_ "SigType" SG_ 3221225472 Aftertreatment1ExhaustDewPoint 5;
BA_ "SPN" SG_ 3221225472 Aftertreatment1ExhaustDewPoint 3238;
BA_ "SAEDocument" SG_ 3221225472 Aftertreatment1ExhaustDewPoint "J1939-71";
BA_ "SigType" SG_ 3221225472 Aftertreatment1IntakeDewPoint 5;
BA_ "SPN" SG_ 3221225472 Aftertreatment1IntakeDewPoint 3237;
BA_ "SAEDocument" SG_ 3221225472 Aftertreatment1IntakeDewPoint "J1939-71";
BA_ "SigType" SG_ 3221225472 Aftrtreatment1ExhaustGasMassFlow 1;
BA_ "SPN" SG_ 3221225472 Aftrtreatment1ExhaustGasMassFlow 3236;
BA_ "SAEDocument" SG_ 3221225472 Aftrtreatment1ExhaustGasMassFlow "J1939-71";
BA_ "SPN" SG_ 3221225472 EstEngPrsiticLossesPercentTorque 2978;
BA_ "SAEDocument" SG_ 3221225472 EstEngPrsiticLossesPercentTorque "J1939-71";
BA_ "SPN" SG_ 3221225472 EngnsDsrdOprtngSpdAsymmtryAdjstm 519;
BA_ "SAEDocument" SG_ 3221225472 EngnsDsrdOprtngSpdAsymmtryAdjstm "J1939-71";
BA_ "SPN" SG_ 3221225472 EnginesDesiredOperatingSpeed 515;
BA_ "SAEDocument" SG_ 3221225472 EnginesDesiredOperatingSpeed "J1939-71";
BA_ "SPN" SG_ 3221225472 NominalFrictionPercentTorque 514;
BA_ "SAEDocument" SG_ 3221225472 NominalFrictionPercentTorque "J1939-71";
BA_ "SPN" SG_ 3221225472 SrcAddrssOfCntrllngDvcForEngCtrl 1483;
BA_ "SAEDocument" SG_ 3221225472 SrcAddrssOfCntrllngDvcForEngCtrl "J1939-71";
BA_ "SPN" SG_ 3221225472 ActlEngPrcntTorqueHighResolution 4154;
BA_ "SAEDocument" SG_ 3221225472 ActlEngPrcntTorqueHighResolution "J1939-71";
BA_ "SigType" SG_ 3221225472 EngDemandPercentTorque 1;
BA_ "SPN" SG_ 3221225472 EngDemandPercentTorque 2432;
BA_ "SAEDocument" SG_ 3221225472 EngDemandPercentTorque "J1939-71";
BA_ "SPN" SG_ 3221225472 EngStarterMode 1675;
BA_ "SAEDocument" SG_ 3221225472 EngStarterMode "J1939-71";
BA_ "SigType" SG_ 3221225472 EngSpeed 1;
BA_ "SPN" SG_ 3221225472 EngSpeed 190;
BA_ "SAEDocument" SG_ 3221225472 EngSpeed "J1939-71";
BA_ "SigType" SG_ 3221225472 ActualEngPercentTorque 1;
BA_ "SPN" SG_ 3221225472 ActualEngPercentTorque 513;
BA_ "SAEDocument" SG_ 3221225472 ActualEngPercentTorque "J1939-71";
BA_ "SigType" SG_ 3221225472 DriversDemandEngPercentTorque 1;
BA_ "SPN" SG_ 3221225472 DriversDemandEngPercentTorque 512;
BA_ "SAEDocument" SG_ 3221225472 DriversDemandEngPercentTorque "J1939-71";
BA_ "SPN" SG_ 3221225472 EngTorqueMode 899;
BA_ "SAEDocument" SG_ 3221225472 EngTorqueMode "J1939-71";
BA_ "SigType" SG_ 3221225472 ECUType 1;
BA_ "SPN" SG_ 3221225472 ECUType 2904;
BA_ "SAEDocument" SG_ 3221225472 ECUType "J1939-71";
BA_ "SigType" SG_ 3221225472 ECULocation 1;
BA_ "SPN" SG_ 3221225472 ECULocation 2903;
BA_ "SAEDocument" SG_ 3221225472 ECULocation "J1939-71";
BA_ "SigType" SG_ 3221225472 ECUSerialNumber 1;
BA_ "SPN" SG_ 3221225472 ECUSerialNumber 2902;
BA_ "SAEDocument" SG_ 3221225472 ECUSerialNumber "J1939-71";
BA_ "SigType" SG_ 3221225472 ECUPartNumber 1;
BA_ "SPN" SG_ 3221225472 ECUPartNumber 2901;
BA_ "SAEDocument" SG_ 3221225472 ECUPartNumber "J1939-71";
BA_ "SPN" SG_ 3221225472 EngMinContinuousTorque 1775;
BA_ "SAEDocument" SG_ 3221225472 EngMinContinuousTorque "J1939-71";
BA_ "SPN" SG_ 3221225472 EngMaxContinuousTorque 1774;
BA_ "SAEDocument" SG_ 3221225472 EngMaxContinuousTorque "J1939-71";
BA_ "SPN" SG_ 3221225472 EngMinContinuousRPM 1773;
BA_ "SAEDocument" SG_ 3221225472 EngMinContinuousRPM "J1939-71";
BA_ "SPN" SG_ 3221225472 EngMaxContinuousRPM 1772;
BA_ "SAEDocument" SG_ 3221225472 EngMaxContinuousRPM "J1939-71";
BA_ "SPN" SG_ 3221225472 EngHghLmtThrshldFrMnCntnsTrqFrmE 1771;
BA_ "SAEDocument" SG_ 3221225472 EngHghLmtThrshldFrMnCntnsTrqFrmE "J1939-71";
BA_ "SPN" SG_ 3221225472 EngLwLmtThrshldFrMxTorqueFromEng 1770;
BA_ "SAEDocument" SG_ 3221225472 EngLwLmtThrshldFrMxTorqueFromEng "J1939-71";
BA_ "SPN" SG_ 3221225472 EngHghLmtThrshldFrMnCntnusEngRPM 1769;
BA_ "SAEDocument" SG_ 3221225472 EngHghLmtThrshldFrMnCntnusEngRPM "J1939-71";
BA_ "SPN" SG_ 3221225472 EngLwLmtThrsholdForMaxRPMFromEng 1768;
BA_ "SAEDocument" SG_ 3221225472 EngLwLmtThrsholdForMaxRPMFromEng "J1939-71";
BA_ "SPN" SG_ 3221225472 SupportTSC1CtrlPurposeGroup4 3348;
BA_ "SAEDocument" SG_ 3221225472 SupportTSC1CtrlPurposeGroup4 "J1939-71";
BA_ "SPN" SG_ 3221225472 SupportTSC1CtrlPurposeGroup3 3347;
BA_ "SAEDocument" SG_ 3221225472 SupportTSC1CtrlPurposeGroup3 "J1939-71";
BA_ "SPN" SG_ 3221225472 SupportTSC1CtrlPurposeGroup2 3346;
BA_ "SAEDocument" SG_ 3221225472 SupportTSC1CtrlPurposeGroup2 "J1939-71";
BA_ "SPN" SG_ 3221225472 SupportTSC1CtrlPurposeGroup1 3345;
BA_ "SAEDocument" SG_ 3221225472 SupportTSC1CtrlPurposeGroup1 "J1939-71";
BA_ "SPN" SG_ 3221225472 SupportVariableRateTSC1Message 3344;
BA_ "SAEDocument" SG_ 3221225472 SupportVariableRateTSC1Message "J1939-71";
BA_ "SigType" SG_ 3221225472 EngDefaultTorqueLimit 1;
BA_ "SPN" SG_ 3221225472 EngDefaultTorqueLimit 1846;
BA_ "SAEDocument" SG_ 3221225472 EngDefaultTorqueLimit "J1939-71";
BA_ "SPN" SG_ 3221225472 EngMomentOfInertia 1794;
BA_ "SAEDocument" SG_ 3221225472 EngMomentOfInertia "J1939-71";
BA_ "SigType" SG_ 3221225472 EngExRngRqstdSpdCtrlRngUpprLimit 1;
BA_ "SPN" SG_ 3221225472 EngExRngRqstdSpdCtrlRngUpprLimit 1712;
BA_ "SAEDocument" SG_ 3221225472 EngExRngRqstdSpdCtrlRngUpprLimit "J1939-71";
BA_ "SigType" SG_ 3221225472 EngRqstdTrqueCtrlRangeUpperLimit 1;
BA_ "SPN" SG_ 3221225472 EngRqstdTrqueCtrlRangeUpperLimit 538;
BA_ "SAEDocument" SG_ 3221225472 EngRqstdTrqueCtrlRangeUpperLimit "J1939-71";
BA_ "SigType" SG_ 3221225472 EngRqstdTrqueCtrlRangeLowerLimit 1;
BA_ "SPN" SG_ 3221225472 EngRqstdTrqueCtrlRangeLowerLimit 537;
BA_ "SAEDocument" SG_ 3221225472 EngRqstdTrqueCtrlRangeLowerLimit "J1939-71";
BA_ "SigType" SG_ 3221225472 EngRqstdSpeedCtrlRangeUpperLimit 1;
BA_ "SPN" SG_ 3221225472 EngRqstdSpeedCtrlRangeUpperLimit 536;
BA_ "SAEDocument" SG_ 3221225472 EngRqstdSpeedCtrlRangeUpperLimit "J1939-71";
BA_ "SigType" SG_ 3221225472 EngRqstdSpeedCtrlRangeLowerLimit 1;
BA_ "SPN" SG_ 3221225472 EngRqstdSpeedCtrlRangeLowerLimit 535;
BA_ "SAEDocument" SG_ 3221225472 EngRqstdSpeedCtrlRangeLowerLimit "J1939-71";
BA_ "SigType" SG_ 3221225472 EngMaxMomentaryOverrideTimeLimit 1;
BA_ "SPN" SG_ 3221225472 EngMaxMomentaryOverrideTimeLimit 534;
BA_ "SAEDocument" SG_ 3221225472 EngMaxMomentaryOverrideTimeLimit "J1939-71";
BA_ "SigType" SG_ 3221225472 EngMxMmentaryOverrideSpeedPoint7 1;
BA_ "SPN" SG_ 3221225472 EngMxMmentaryOverrideSpeedPoint7 533;
BA_ "SAEDocument" SG_ 3221225472 EngMxMmentaryOverrideSpeedPoint7 "J1939-71";
BA_ "SigType" SG_ 3221225472 EngReferenceTorque 1;
BA_ "SPN" SG_ 3221225472 EngReferenceTorque 544;
BA_ "SAEDocument" SG_ 3221225472 EngReferenceTorque "J1939-71";
BA_ "SigType" SG_ 3221225472 EngGain 1;
BA_ "SPN" SG_ 3221225472 EngGain 545;
BA_ "SAEDocument" SG_ 3221225472 EngGain "J1939-71";
BA_ "SigType" SG_ 3221225472 EngSpeedAtHighIdlePoint6 1;
BA_ "SPN" SG_ 3221225472 EngSpeedAtHighIdlePoint6 532;
BA_ "SAEDocument" SG_ 3221225472 EngSpeedAtHighIdlePoint6 "J1939-71";
BA_ "SigType" SG_ 3221225472 EngPercentTorqueAtPoint5 1;
BA_ "SPN" SG_ 3221225472 EngPercentTorqueAtPoint5 543;
BA_ "SAEDocument" SG_ 3221225472 EngPercentTorqueAtPoint5 "J1939-71";
BA_ "SigType" SG_ 3221225472 EngSpeedAtPoint5 1;
BA_ "SPN" SG_ 3221225472 EngSpeedAtPoint5 531;
BA_ "SAEDocument" SG_ 3221225472 EngSpeedAtPoint5 "J1939-71";
BA_ "SigType" SG_ 3221225472 EngPercentTorqueAtPoint4 1;
BA_ "SPN" SG_ 3221225472 EngPercentTorqueAtPoint4 542;
BA_ "SAEDocument" SG_ 3221225472 EngPercentTorqueAtPoint4 "J1939-71";
BA_ "SigType" SG_ 3221225472 EngSpeedAtPoint4 1;
BA_ "SPN" SG_ 3221225472 EngSpeedAtPoint4 530;
BA_ "SAEDocument" SG_ 3221225472 EngSpeedAtPoint4 "J1939-71";
BA_ "SigType" SG_ 3221225472 EngPercentTorqueAtPoint3 1;
BA_ "SPN" SG_ 3221225472 EngPercentTorqueAtPoint3 541;
BA_ "SAEDocument" SG_ 3221225472 EngPercentTorqueAtPoint3 "J1939-71";
BA_ "SigType" SG_ 3221225472 EngSpeedAtPoint3 1;
BA_ "SPN" SG_ 3221225472 EngSpeedAtPoint3 529;
BA_ "SAEDocument" SG_ 3221225472 EngSpeedAtPoint3 "J1939-71";
BA_ "SigType" SG_ 3221225472 EngPercentTorqueAtPoint2 1;
BA_ "SPN" SG_ 3221225472 EngPercentTorqueAtPoint2 540;
BA_ "SAEDocument" SG_ 3221225472 EngPercentTorqueAtPoint2 "J1939-71";
BA_ "SigType" SG_ 3221225472 EngSpeedAtPoint2 1;
BA_ "SPN" SG_ 3221225472 EngSpeedAtPoint2 528;
BA_ "SAEDocument" SG_ 3221225472 EngSpeedAtPoint2 "J1939-71";
BA_ "SigType" SG_ 3221225472 EngPercentTorqueAtIdlePoint1 1;
BA_ "SPN" SG_ 3221225472 EngPercentTorqueAtIdlePoint1 539;
BA_ "SAEDocument" SG_ 3221225472 EngPercentTorqueAtIdlePoint1 "J1939-71";
BA_ "SigType" SG_ 3221225472 EngSpeedAtIdlePoint1 1;
BA_ "SPN" SG_ 3221225472 EngSpeedAtIdlePoint1 188;
BA_ "SAEDocument" SG_ 3221225472 EngSpeedAtIdlePoint1 "J1939-71";
BA_ "SigType" SG_ 3221225472 PrkngBrakeActuatorFullyActivated 4;
BA_ "SPN" SG_ 3221225472 PrkngBrakeActuatorFullyActivated 5275;
BA_ "SAEDocument" SG_ 3221225472 PrkngBrakeActuatorFullyActivated "J1939-71";
BA_ "SPN" SG_ 3221225472 XBRAccelerationLimit 2921;
BA_ "SAEDocument" SG_ 3221225472 XBRAccelerationLimit "J1939-71";
BA_ "SPN" SG_ 3221225472 XBRActiveCtrlMode 2918;
BA_ "SAEDocument" SG_ 3221225472 XBRActiveCtrlMode "J1939-71";
BA_ "SigType" SG_ 3221225472 XBRSystemState 5;
BA_ "SPN" SG_ 3221225472 XBRSystemState 2917;
BA_ "SAEDocument" SG_ 3221225472 XBRSystemState "J1939-71";
BA_ "SigType" SG_ 3221225472 FoundationBrakeUse 5;
BA_ "SPN" SG_ 3221225472 FoundationBrakeUse 2919;
BA_ "SAEDocument" SG_ 3221225472 FoundationBrakeUse "J1939-71";
BA_ "SPN" SG_ 3221225472 HillHolderMode 2912;
BA_ "SAEDocument" SG_ 3221225472 HillHolderMode "J1939-71";
BA_ "SPN" SG_ 3221225472 HaltBrakeMode 2913;
BA_ "SAEDocument" SG_ 3221225472 HaltBrakeMode "J1939-71";
BA_ "SigType" SG_ 3221225472 BrakeTempWarning 5;
BA_ "SPN" SG_ 3221225472 BrakeTempWarning 3839;
BA_ "SAEDocument" SG_ 3221225472 BrakeTempWarning "J1939-71";
BA_ "SigType" SG_ 3221225472 BrkLnngRmningRearAxle3RightWheel 1;
BA_ "SPN" SG_ 3221225472 BrkLnngRmningRearAxle3RightWheel 1106;
BA_ "SAEDocument" SG_ 3221225472 BrkLnngRmningRearAxle3RightWheel "J1939-71";
BA_ "SigType" SG_ 3221225472 BrkLnngRminingRearAxle3LeftWheel 1;
BA_ "SPN" SG_ 3221225472 BrkLnngRminingRearAxle3LeftWheel 1105;
BA_ "SAEDocument" SG_ 3221225472 BrkLnngRminingRearAxle3LeftWheel "J1939-71";
BA_ "SigType" SG_ 3221225472 BrkLnngRmningRearAxle2RightWheel 1;
BA_ "SPN" SG_ 3221225472 BrkLnngRmningRearAxle2RightWheel 1104;
BA_ "SAEDocument" SG_ 3221225472 BrkLnngRmningRearAxle2RightWheel "J1939-71";
BA_ "SigType" SG_ 3221225472 BrkLnngRminingRearAxle2LeftWheel 1;
BA_ "SPN" SG_ 3221225472 BrkLnngRminingRearAxle2LeftWheel 1103;
BA_ "SAEDocument" SG_ 3221225472 BrkLnngRminingRearAxle2LeftWheel "J1939-71";
BA_ "SigType" SG_ 3221225472 BrkLnngRmningRearAxle1RightWheel 1;
BA_ "SPN" SG_ 3221225472 BrkLnngRmningRearAxle1RightWheel 1102;
BA_ "SAEDocument" SG_ 3221225472 BrkLnngRmningRearAxle1RightWheel "J1939-71";
BA_ "SigType" SG_ 3221225472 BrkLnngRminingRearAxle1LeftWheel 1;
BA_ "SPN" SG_ 3221225472 BrkLnngRminingRearAxle1LeftWheel 1101;
BA_ "SAEDocument" SG_ 3221225472 BrkLnngRminingRearAxle1LeftWheel "J1939-71";
BA_ "SigType" SG_ 3221225472 BrkLnngRmningFrontAxleRightWheel 1;
BA_ "SPN" SG_ 3221225472 BrkLnngRmningFrontAxleRightWheel 1100;
BA_ "SAEDocument" SG_ 3221225472 BrkLnngRmningFrontAxleRightWheel "J1939-71";
BA_ "SigType" SG_ 3221225472 BrkLnngRminingFrontAxleLeftWheel 1;
BA_ "SPN" SG_ 3221225472 BrkLnngRminingFrontAxleLeftWheel 1099;
BA_ "SAEDocument" SG_ 3221225472 BrkLnngRminingFrontAxleLeftWheel "J1939-71";
BA_ "SigType" SG_ 3221225472 BrkAppPrssHghRngRrAxl3RightWheel 1;
BA_ "SPN" SG_ 3221225472 BrkAppPrssHghRngRrAxl3RightWheel 1098;
BA_ "SAEDocument" SG_ 3221225472 BrkAppPrssHghRngRrAxl3RightWheel "J1939-71";
BA_ "SigType" SG_ 3221225472 BrkAppPrssHghRngRrAxle3LeftWheel 1;
BA_ "SPN" SG_ 3221225472 BrkAppPrssHghRngRrAxle3LeftWheel 1097;
BA_ "SAEDocument" SG_ 3221225472 BrkAppPrssHghRngRrAxle3LeftWheel "J1939-71";
BA_ "SigType" SG_ 3221225472 BrkAppPrssHghRngRrAxl2RightWheel 1;
BA_ "SPN" SG_ 3221225472 BrkAppPrssHghRngRrAxl2RightWheel 1096;
BA_ "SAEDocument" SG_ 3221225472 BrkAppPrssHghRngRrAxl2RightWheel "J1939-71";
BA_ "SigType" SG_ 3221225472 BrkAppPrssHghRngRrAxle2LeftWheel 1;
BA_ "SPN" SG_ 3221225472 BrkAppPrssHghRngRrAxle2LeftWheel 1095;
BA_ "SAEDocument" SG_ 3221225472 BrkAppPrssHghRngRrAxle2LeftWheel "J1939-71";
BA_ "SigType" SG_ 3221225472 BrkAppPrssHghRngRrAxle1LeftWheel 1;
BA_ "SPN" SG_ 3221225472 BrkAppPrssHghRngRrAxle1LeftWheel 1093;
BA_ "SAEDocument" SG_ 3221225472 BrkAppPrssHghRngRrAxle1LeftWheel "J1939-71";
BA_ "SigType" SG_ 3221225472 BrkAppPrssHghRngFrntAxlRghtWheel 1;
BA_ "SPN" SG_ 3221225472 BrkAppPrssHghRngFrntAxlRghtWheel 1092;
BA_ "SAEDocument" SG_ 3221225472 BrkAppPrssHghRngFrntAxlRghtWheel "J1939-71";
BA_ "SigType" SG_ 3221225472 BrkAppPrssHghRngFrntAxlLeftWheel 1;
BA_ "SPN" SG_ 3221225472 BrkAppPrssHghRngFrntAxlLeftWheel 1091;
BA_ "SAEDocument" SG_ 3221225472 BrkAppPrssHghRngFrntAxlLeftWheel "J1939-71";
BA_ "SigType" SG_ 3221225472 BrkAppPrssHghRngRrAxl1RightWheel 1;
BA_ "SPN" SG_ 3221225472 BrkAppPrssHghRngRrAxl1RightWheel 1094;
BA_ "SAEDocument" SG_ 3221225472 BrkAppPrssHghRngRrAxl1RightWheel "J1939-71";
BA_ "SigType" SG_ 3221225472 RearAxleGroupEngagementStatus 5;
BA_ "SPN" SG_ 3221225472 RearAxleGroupEngagementStatus 3820;
BA_ "SAEDocument" SG_ 3221225472 RearAxleGroupEngagementStatus "J1939-71";
BA_ "SigType" SG_ 3221225472 FrontAxleGroupEngagementStatus 5;
BA_ "SPN" SG_ 3221225472 FrontAxleGroupEngagementStatus 3819;
BA_ "SAEDocument" SG_ 3221225472 FrontAxleGroupEngagementStatus "J1939-71";
BA_ "SigType" SG_ 3221225472 DiffLockStateCentralRear 5;
BA_ "SPN" SG_ 3221225472 DiffLockStateCentralRear 566;
BA_ "SAEDocument" SG_ 3221225472 DiffLockStateCentralRear "J1939-71";
BA_ "SigType" SG_ 3221225472 DiffLockStateCentralFront 5;
BA_ "SPN" SG_ 3221225472 DiffLockStateCentralFront 565;
BA_ "SAEDocument" SG_ 3221225472 DiffLockStateCentralFront "J1939-71";
BA_ "SigType" SG_ 3221225472 DiffLockStateCentral 5;
BA_ "SPN" SG_ 3221225472 DiffLockStateCentral 564;
BA_ "SAEDocument" SG_ 3221225472 DiffLockStateCentral "J1939-71";
BA_ "SigType" SG_ 3221225472 DiffLockStateRearAxle2 5;
BA_ "SPN" SG_ 3221225472 DiffLockStateRearAxle2 570;
BA_ "SAEDocument" SG_ 3221225472 DiffLockStateRearAxle2 "J1939-71";
BA_ "SigType" SG_ 3221225472 DiffLockStateRearAxle1 5;
BA_ "SPN" SG_ 3221225472 DiffLockStateRearAxle1 569;
BA_ "SAEDocument" SG_ 3221225472 DiffLockStateRearAxle1 "J1939-71";
BA_ "SigType" SG_ 3221225472 DiffLockStateFrontAxle2 5;
BA_ "SPN" SG_ 3221225472 DiffLockStateFrontAxle2 568;
BA_ "SAEDocument" SG_ 3221225472 DiffLockStateFrontAxle2 "J1939-71";
BA_ "SigType" SG_ 3221225472 DiffLockStateFrontAxle1 5;
BA_ "SPN" SG_ 3221225472 DiffLockStateFrontAxle1 567;
BA_ "SAEDocument" SG_ 3221225472 DiffLockStateFrontAxle1 "J1939-71";
BA_ "SigType" SG_ 3221225472 Location 1;
BA_ "SPN" SG_ 3221225472 Location 927;
BA_ "SAEDocument" SG_ 3221225472 Location "J1939-71";
BA_ "SigType" SG_ 3221225472 SeaWaterPumpOutletPress 1;
BA_ "SPN" SG_ 3221225472 SeaWaterPumpOutletPress 2435;
BA_ "SAEDocument" SG_ 3221225472 SeaWaterPumpOutletPress "J1939-71";
BA_ "SigType" SG_ 3221225472 EngAuxCoolantTemp 1;
BA_ "SPN" SG_ 3221225472 EngAuxCoolantTemp 1212;
BA_ "SAEDocument" SG_ 3221225472 EngAuxCoolantTemp "J1939-71";
BA_ "SigType" SG_ 3221225472 EngAuxCoolantPress 1;
BA_ "SPN" SG_ 3221225472 EngAuxCoolantPress 1203;
BA_ "SAEDocument" SG_ 3221225472 EngAuxCoolantPress "J1939-71";
BA_ "SigType" SG_ 3221225472 Driver2Identification 1;
BA_ "SPN" SG_ 3221225472 Driver2Identification 1626;
BA_ "SAEDocument" SG_ 3221225472 Driver2Identification "J1939-71";
BA_ "SigType" SG_ 3221225472 Driver1Identification 1;
BA_ "SPN" SG_ 3221225472 Driver1Identification 1625;
BA_ "SAEDocument" SG_ 3221225472 Driver1Identification "J1939-71";
BA_ "SigType" SG_ 3221225472 FuelLevel2 1;
BA_ "SPN" SG_ 3221225472 FuelLevel2 38;
BA_ "SAEDocument" SG_ 3221225472 FuelLevel2 "J1939-71";
BA_ "SigType" SG_ 3221225472 CargoAmbientTemp 1;
BA_ "SPN" SG_ 3221225472 CargoAmbientTemp 169;
BA_ "SAEDocument" SG_ 3221225472 CargoAmbientTemp "J1939-71";
BA_ "SigType" SG_ 3221225472 EngOilFilterDiffPress 1;
BA_ "SPN" SG_ 3221225472 EngOilFilterDiffPress 99;
BA_ "SAEDocument" SG_ 3221225472 EngOilFilterDiffPress "J1939-71";
BA_ "SigType" SG_ 3221225472 FuelLevel1 1;
BA_ "SPN" SG_ 3221225472 FuelLevel1 96;
BA_ "SAEDocument" SG_ 3221225472 FuelLevel1 "J1939-71";
BA_ "SigType" SG_ 3221225472 WasherFluidLevel 1;
BA_ "SPN" SG_ 3221225472 WasherFluidLevel 80;
BA_ "SAEDocument" SG_ 3221225472 WasherFluidLevel "J1939-71";
BA_ "SPN" SG_ 3221225472 EngStartEnableDevice2Config 2898;
BA_ "SAEDocument" SG_ 3221225472 EngStartEnableDevice2Config "J1939-71";
BA_ "SPN" SG_ 3221225472 EngStartEnableDevice1Config 2899;
BA_ "SAEDocument" SG_ 3221225472 EngStartEnableDevice1Config "J1939-71";
BA_ "SigType" SG_ 3221225472 EngStartEnableDevice2 5;
BA_ "SPN" SG_ 3221225472 EngStartEnableDevice2 1804;
BA_ "SAEDocument" SG_ 3221225472 EngStartEnableDevice2 "J1939-71";
BA_ "SigType" SG_ 3221225472 EngStartEnableDevice1 5;
BA_ "SPN" SG_ 3221225472 EngStartEnableDevice1 626;
BA_ "SAEDocument" SG_ 3221225472 EngStartEnableDevice1 "J1939-71";
BA_ "SigType" SG_ 3221225472 PoweredVehicleWeight 1;
BA_ "SPN" SG_ 3221225472 PoweredVehicleWeight 1585;
BA_ "SAEDocument" SG_ 3221225472 PoweredVehicleWeight "J1939-71";
BA_ "SigType" SG_ 3221225472 GrossCombinationVehicleWeight 1;
BA_ "SPN" SG_ 3221225472 GrossCombinationVehicleWeight 1760;
BA_ "SAEDocument" SG_ 3221225472 GrossCombinationVehicleWeight "J1939-71";
BA_ "SPN" SG_ 3221225472 MxCntinuousRetarderTorqueLimitRq 1791;
BA_ "SAEDocument" SG_ 3221225472 MxCntinuousRetarderTorqueLimitRq "J1939-71";
BA_ "SPN" SG_ 3221225472 MnCntinuousRetarderTorqueLimitRq 1790;
BA_ "SAEDocument" SG_ 3221225472 MnCntinuousRetarderTorqueLimitRq "J1939-71";
BA_ "SPN" SG_ 3221225472 MxContinuousRetarderSpeedLimitRq 1789;
BA_ "SAEDocument" SG_ 3221225472 MxContinuousRetarderSpeedLimitRq "J1939-71";
BA_ "SPN" SG_ 3221225472 MnContinuousRetarderSpeedLimitRq 1788;
BA_ "SAEDocument" SG_ 3221225472 MnContinuousRetarderSpeedLimitRq "J1939-71";
BA_ "SPN" SG_ 3221225472 EngTorqueLimitRqMaxContinuous 1787;
BA_ "SAEDocument" SG_ 3221225472 EngTorqueLimitRqMaxContinuous "J1939-71";
BA_ "SPN" SG_ 3221225472 EngTorqueLimitRqMinContinuous 1786;
BA_ "SAEDocument" SG_ 3221225472 EngTorqueLimitRqMinContinuous "J1939-71";
BA_ "SPN" SG_ 3221225472 EngSpeedLimitRqMaxContinuous 1785;
BA_ "SAEDocument" SG_ 3221225472 EngSpeedLimitRqMaxContinuous "J1939-71";
BA_ "SPN" SG_ 3221225472 EngSpeedLimitRqMinContinuous 1784;
BA_ "SAEDocument" SG_ 3221225472 EngSpeedLimitRqMinContinuous "J1939-71";
BA_ "SigType" SG_ 3221225472 EngAverageCombustionTime 1;
BA_ "SPN" SG_ 3221225472 EngAverageCombustionTime 1465;
BA_ "SAEDocument" SG_ 3221225472 EngAverageCombustionTime "J1939-71";
BA_ "SigType" SG_ 3221225472 EngDesiredCombustionTime 1;
BA_ "SPN" SG_ 3221225472 EngDesiredCombustionTime 1464;
BA_ "SAEDocument" SG_ 3221225472 EngDesiredCombustionTime "J1939-71";
BA_ "SigType" SG_ 3221225472 EngCyl20CombustionTime 1;
BA_ "SPN" SG_ 3221225472 EngCyl20CombustionTime 1463;
BA_ "SAEDocument" SG_ 3221225472 EngCyl20CombustionTime "J1939-71";
BA_ "SigType" SG_ 3221225472 EngCyl19CombustionTime 1;
BA_ "SPN" SG_ 3221225472 EngCyl19CombustionTime 1462;
BA_ "SAEDocument" SG_ 3221225472 EngCyl19CombustionTime "J1939-71";
BA_ "SigType" SG_ 3221225472 EngCyl18CombustionTime 1;
BA_ "SPN" SG_ 3221225472 EngCyl18CombustionTime 1461;
BA_ "SAEDocument" SG_ 3221225472 EngCyl18CombustionTime "J1939-71";
BA_ "SigType" SG_ 3221225472 EngCyl17CombustionTime 1;
BA_ "SPN" SG_ 3221225472 EngCyl17CombustionTime 1460;
BA_ "SAEDocument" SG_ 3221225472 EngCyl17CombustionTime "J1939-71";
BA_ "SigType" SG_ 3221225472 EngCyl16CombustionTime 1;
BA_ "SPN" SG_ 3221225472 EngCyl16CombustionTime 1459;
BA_ "SAEDocument" SG_ 3221225472 EngCyl16CombustionTime "J1939-71";
BA_ "SigType" SG_ 3221225472 EngCyl15CombustionTime 1;
BA_ "SPN" SG_ 3221225472 EngCyl15CombustionTime 1458;
BA_ "SAEDocument" SG_ 3221225472 EngCyl15CombustionTime "J1939-71";
BA_ "SigType" SG_ 3221225472 EngCyl14CombustionTime 1;
BA_ "SPN" SG_ 3221225472 EngCyl14CombustionTime 1457;
BA_ "SAEDocument" SG_ 3221225472 EngCyl14CombustionTime "J1939-71";
BA_ "SigType" SG_ 3221225472 EngCyl13CombustionTime 1;
BA_ "SPN" SG_ 3221225472 EngCyl13CombustionTime 1456;
BA_ "SAEDocument" SG_ 3221225472 EngCyl13CombustionTime "J1939-71";
BA_ "SigType" SG_ 3221225472 EngCyl12CombustionTime 1;
BA_ "SPN" SG_ 3221225472 EngCyl12CombustionTime 1455;
BA_ "SAEDocument" SG_ 3221225472 EngCyl12CombustionTime "J1939-71";
BA_ "SigType" SG_ 3221225472 EngCyl11CombustionTime 1;
BA_ "SPN" SG_ 3221225472 EngCyl11CombustionTime 1454;
BA_ "SAEDocument" SG_ 3221225472 EngCyl11CombustionTime "J1939-71";
BA_ "SigType" SG_ 3221225472 EngCyl10CombustionTime 1;
BA_ "SPN" SG_ 3221225472 EngCyl10CombustionTime 1453;
BA_ "SAEDocument" SG_ 3221225472 EngCyl10CombustionTime "J1939-71";
BA_ "SigType" SG_ 3221225472 EngCyl9CombustionTime 1;
BA_ "SPN" SG_ 3221225472 EngCyl9CombustionTime 1452;
BA_ "SAEDocument" SG_ 3221225472 EngCyl9CombustionTime "J1939-71";
BA_ "SigType" SG_ 3221225472 EngCyl8CombustionTime 1;
BA_ "SPN" SG_ 3221225472 EngCyl8CombustionTime 1451;
BA_ "SAEDocument" SG_ 3221225472 EngCyl8CombustionTime "J1939-71";
BA_ "SigType" SG_ 3221225472 EngCyl7CombustionTime 1;
BA_ "SPN" SG_ 3221225472 EngCyl7CombustionTime 1450;
BA_ "SAEDocument" SG_ 3221225472 EngCyl7CombustionTime "J1939-71";
BA_ "SigType" SG_ 3221225472 EngCyl6CombustionTime 1;
BA_ "SPN" SG_ 3221225472 EngCyl6CombustionTime 1449;
BA_ "SAEDocument" SG_ 3221225472 EngCyl6CombustionTime "J1939-71";
BA_ "SigType" SG_ 3221225472 EngCyl5CombustionTime 1;
BA_ "SPN" SG_ 3221225472 EngCyl5CombustionTime 1448;
BA_ "SAEDocument" SG_ 3221225472 EngCyl5CombustionTime "J1939-71";
BA_ "SigType" SG_ 3221225472 EngCyl4CombustionTime 1;
BA_ "SPN" SG_ 3221225472 EngCyl4CombustionTime 1447;
BA_ "SAEDocument" SG_ 3221225472 EngCyl4CombustionTime "J1939-71";
BA_ "SigType" SG_ 3221225472 EngCyl3CombustionTime 1;
BA_ "SPN" SG_ 3221225472 EngCyl3CombustionTime 1446;
BA_ "SAEDocument" SG_ 3221225472 EngCyl3CombustionTime "J1939-71";
BA_ "SigType" SG_ 3221225472 EngCyl2CombustionTime 1;
BA_ "SPN" SG_ 3221225472 EngCyl2CombustionTime 1445;
BA_ "SAEDocument" SG_ 3221225472 EngCyl2CombustionTime "J1939-71";
BA_ "SigType" SG_ 3221225472 EngCyl1CombustionTime 1;
BA_ "SPN" SG_ 3221225472 EngCyl1CombustionTime 1444;
BA_ "SAEDocument" SG_ 3221225472 EngCyl1CombustionTime "J1939-71";
BA_ "SigType" SG_ 3221225472 TotalCountOfConfigChangesMade 1;
BA_ "SPN" SG_ 3221225472 TotalCountOfConfigChangesMade 2887;
BA_ "SAEDocument" SG_ 3221225472 TotalCountOfConfigChangesMade "J1939-71";
BA_ "SigType" SG_ 3221225472 TransOilLevelRq 5;
BA_ "SPN" SG_ 3221225472 TransOilLevelRq 3809;
BA_ "SAEDocument" SG_ 3221225472 TransOilLevelRq "J1939-71";
BA_ "SigType" SG_ 3221225472 FifthWheelReleaseCtrl 4;
BA_ "SPN" SG_ 3221225472 FifthWheelReleaseCtrl 3314;
BA_ "SAEDocument" SG_ 3221225472 FifthWheelReleaseCtrl "J1939-71";
BA_ "SigType" SG_ 3221225472 FfthWhlRleaseCtrlSecurityLockout 4;
BA_ "SPN" SG_ 3221225472 FfthWhlRleaseCtrlSecurityLockout 3315;
BA_ "SAEDocument" SG_ 3221225472 FfthWhlRleaseCtrlSecurityLockout "J1939-71";
BA_ "SPN" SG_ 3221225472 TransferCaseSelectorSwitch 2796;
BA_ "SAEDocument" SG_ 3221225472 TransferCaseSelectorSwitch "J1939-71";
BA_ "SPN" SG_ 3221225472 SelectedMaxVehicleSpeedLimit 2596;
BA_ "SAEDocument" SG_ 3221225472 SelectedMaxVehicleSpeedLimit "J1939-71";
BA_ "SigType" SG_ 3221225472 RqCabZoneHeating 5;
BA_ "SPN" SG_ 3221225472 RqCabZoneHeating 1686;
BA_ "SAEDocument" SG_ 3221225472 RqCabZoneHeating "J1939-71";
BA_ "SigType" SG_ 3221225472 RqEngZoneHeating 5;
BA_ "SPN" SG_ 3221225472 RqEngZoneHeating 1685;
BA_ "SAEDocument" SG_ 3221225472 RqEngZoneHeating "J1939-71";
BA_ "SPN" SG_ 3221225472 AuxHeaterModeRq 1683;
BA_ "SAEDocument" SG_ 3221225472 AuxHeaterModeRq "J1939-71";
BA_ "SigType" SG_ 3221225472 EngAutomaticStartEnableSwitch 4;
BA_ "SPN" SG_ 3221225472 EngAutomaticStartEnableSwitch 1656;
BA_ "SAEDocument" SG_ 3221225472 EngAutomaticStartEnableSwitch "J1939-71";
BA_ "SigType" SG_ 3221225472 AtomaticGearShiftingEnableSwitch 4;
BA_ "SPN" SG_ 3221225472 AtomaticGearShiftingEnableSwitch 1666;
BA_ "SAEDocument" SG_ 3221225472 AtomaticGearShiftingEnableSwitch "J1939-71";
BA_ "SigType" SG_ 3221225472 DslPrtcltFltrRgnrtionForceSwitch 4;
BA_ "SPN" SG_ 3221225472 DslPrtcltFltrRgnrtionForceSwitch 3696;
BA_ "SAEDocument" SG_ 3221225472 DslPrtcltFltrRgnrtionForceSwitch "J1939-71";
BA_ "SigType" SG_ 3221225472 DslPrtcltFltrRgnrtnInhibitSwitch 4;
BA_ "SPN" SG_ 3221225472 DslPrtcltFltrRgnrtnInhibitSwitch 3695;
BA_ "SAEDocument" SG_ 3221225472 DslPrtcltFltrRgnrtnInhibitSwitch "J1939-71";
BA_ "SigType" SG_ 3221225472 VhclLmtngSpdGovernorEnableSwitch 4;
BA_ "SPN" SG_ 3221225472 VhclLmtngSpdGovernorEnableSwitch 1653;
BA_ "SAEDocument" SG_ 3221225472 VhclLmtngSpdGovernorEnableSwitch "J1939-71";
BA_ "SigType" SG_ 3221225472 VhclLmtngSpdGvrnrIncrementSwitch 4;
BA_ "SPN" SG_ 3221225472 VhclLmtngSpdGvrnrIncrementSwitch 1654;
BA_ "SAEDocument" SG_ 3221225472 VhclLmtngSpdGvrnrIncrementSwitch "J1939-71";
BA_ "SigType" SG_ 3221225472 VhclLmtngSpdGvrnrDecrementSwitch 4;
BA_ "SPN" SG_ 3221225472 VhclLmtngSpdGvrnrDecrementSwitch 1655;
BA_ "SAEDocument" SG_ 3221225472 VhclLmtngSpdGvrnrDecrementSwitch "J1939-71";
BA_ "SigType" SG_ 3221225472 SeatBeltSwitch 4;
BA_ "SPN" SG_ 3221225472 SeatBeltSwitch 1856;
BA_ "SAEDocument" SG_ 3221225472 SeatBeltSwitch "J1939-71";
BA_ "SigType" SG_ 3221225472 OperatorSeatDirectionSwitch 4;
BA_ "SPN" SG_ 3221225472 OperatorSeatDirectionSwitch 1714;
BA_ "SAEDocument" SG_ 3221225472 OperatorSeatDirectionSwitch "J1939-71";
BA_ "SigType" SG_ 3221225472 BatteryMainSwitchHoldRq 5;
BA_ "SPN" SG_ 3221225472 BatteryMainSwitchHoldRq 1682;
BA_ "SAEDocument" SG_ 3221225472 BatteryMainSwitchHoldRq "J1939-71";
BA_ "SigType" SG_ 3221225472 AuxHeaterCoolantPumpRq 5;
BA_ "SPN" SG_ 3221225472 AuxHeaterCoolantPumpRq 1684;
BA_ "SAEDocument" SG_ 3221225472 AuxHeaterCoolantPumpRq "J1939-71";
BA_ "SPN" SG_ 3221225472 CabInteriorTempCmd 1691;
BA_ "SAEDocument" SG_ 3221225472 CabInteriorTempCmd "J1939-71";
BA_ "SPN" SG_ 3221225472 RequestedPercentFanSpeed 986;
BA_ "SAEDocument" SG_ 3221225472 RequestedPercentFanSpeed "J1939-71";
BA_ "SPN" SG_ 3221225472 IlluminationBrightnessPercent 1487;
BA_ "SAEDocument" SG_ 3221225472 IlluminationBrightnessPercent "J1939-71";
BA_ "SigType" SG_ 3221225472 UnitNumber 1;
BA_ "SPN" SG_ 3221225472 UnitNumber 233;
BA_ "SAEDocument" SG_ 3221225472 UnitNumber "J1939-71";
BA_ "SigType" SG_ 3221225472 SerialNumber 1;
BA_ "SPN" SG_ 3221225472 SerialNumber 588;
BA_ "SAEDocument" SG_ 3221225472 SerialNumber "J1939-71";
BA_ "SigType" SG_ 3221225472 Model 1;
BA_ "SPN" SG_ 3221225472 Model 587;
BA_ "SAEDocument" SG_ 3221225472 Model "J1939-71";
BA_ "SigType" SG_ 3221225472 Make 1;
BA_ "SPN" SG_ 3221225472 Make 586;
BA_ "SAEDocument" SG_ 3221225472 Make "J1939-71";
BA_ "SigType" SG_ 3221225472 CruiseCtrlLowSetLimitSpeed 1;
BA_ "SPN" SG_ 3221225472 CruiseCtrlLowSetLimitSpeed 88;
BA_ "SAEDocument" SG_ 3221225472 CruiseCtrlLowSetLimitSpeed "J1939-71";
BA_ "SigType" SG_ 3221225472 CruiseCtrlHighSetLimitSpeed 1;
BA_ "SPN" SG_ 3221225472 CruiseCtrlHighSetLimitSpeed 87;
BA_ "SAEDocument" SG_ 3221225472 CruiseCtrlHighSetLimitSpeed "J1939-71";
BA_ "SigType" SG_ 3221225472 AuxHeaterMaxOutputPower 1;
BA_ "SPN" SG_ 3221225472 AuxHeaterMaxOutputPower 1690;
BA_ "SAEDocument" SG_ 3221225472 AuxHeaterMaxOutputPower "J1939-71";
BA_ "SigType" SG_ 3221225472 TripServiceBrakeApplications 1;
BA_ "SPN" SG_ 3221225472 TripServiceBrakeApplications 993;
BA_ "SAEDocument" SG_ 3221225472 TripServiceBrakeApplications "J1939-71";
BA_ "SigType" SG_ 3221225472 TripServiceBrakeDistance 1;
BA_ "SPN" SG_ 3221225472 TripServiceBrakeDistance 992;
BA_ "SAEDocument" SG_ 3221225472 TripServiceBrakeDistance "J1939-71";
BA_ "SigType" SG_ 3221225472 TripCompressionBrakeDistance 1;
BA_ "SPN" SG_ 3221225472 TripCompressionBrakeDistance 991;
BA_ "SAEDocument" SG_ 3221225472 TripCompressionBrakeDistance "J1939-71";
BA_ "SigType" SG_ 3221225472 TotalCompressionBrakeDistance 1;
BA_ "SPN" SG_ 3221225472 TotalCompressionBrakeDistance 990;
BA_ "SAEDocument" SG_ 3221225472 TotalCompressionBrakeDistance "J1939-71";
BA_ "SigType" SG_ 3221225472 CbA_CRfrgrntCmpressorOutletPress 1;
BA_ "SPN" SG_ 3221225472 CbA_CRfrgrntCmpressorOutletPress 2609;
BA_ "SAEDocument" SG_ 3221225472 CbA_CRfrgrntCmpressorOutletPress "J1939-71";
BA_ "SigType" SG_ 3221225472 Battery2Temp 1;
BA_ "SPN" SG_ 3221225472 Battery2Temp 1801;
BA_ "SAEDocument" SG_ 3221225472 Battery2Temp "J1939-71";
BA_ "SigType" SG_ 3221225472 Battery1Temp 1;
BA_ "SPN" SG_ 3221225472 Battery1Temp 1800;
BA_ "SAEDocument" SG_ 3221225472 Battery1Temp "J1939-71";
BA_ "SigType" SG_ 3221225472 EngFuelFilterRestrictedLampCmd 5;
BA_ "SPN" SG_ 3221225472 EngFuelFilterRestrictedLampCmd 5469;
BA_ "SAEDocument" SG_ 3221225472 EngFuelFilterRestrictedLampCmd "J1939-71";
BA_ "SigType" SG_ 3221225472 EngAirFilterRestrictionLampCmd 5;
BA_ "SPN" SG_ 3221225472 EngAirFilterRestrictionLampCmd 5086;
BA_ "SAEDocument" SG_ 3221225472 EngAirFilterRestrictionLampCmd "J1939-71";
BA_ "SigType" SG_ 3221225472 EngIdleManagementActiveLampCmd 5;
BA_ "SPN" SG_ 3221225472 EngIdleManagementActiveLampCmd 5085;
BA_ "SAEDocument" SG_ 3221225472 EngIdleManagementActiveLampCmd "J1939-71";
BA_ "SigType" SG_ 3221225472 EngCoolantLevelLowLampCmd 5;
BA_ "SPN" SG_ 3221225472 EngCoolantLevelLowLampCmd 5084;
BA_ "SAEDocument" SG_ 3221225472 EngCoolantLevelLowLampCmd "J1939-71";
BA_ "SigType" SG_ 3221225472 EngCoolantTempHighLampCmd 5;
BA_ "SPN" SG_ 3221225472 EngCoolantTempHighLampCmd 5083;
BA_ "SAEDocument" SG_ 3221225472 EngCoolantTempHighLampCmd "J1939-71";
BA_ "SigType" SG_ 3221225472 EngOilPressLowLampCmd 5;
BA_ "SPN" SG_ 3221225472 EngOilPressLowLampCmd 5082;
BA_ "SAEDocument" SG_ 3221225472 EngOilPressLowLampCmd "J1939-71";
BA_ "SigType" SG_ 3221225472 CmprssnBrkEnblSwtchIndctrLampCmd 5;
BA_ "SPN" SG_ 3221225472 CmprssnBrkEnblSwtchIndctrLampCmd 3987;
BA_ "SAEDocument" SG_ 3221225472 CmprssnBrkEnblSwtchIndctrLampCmd "J1939-71";
BA_ "SigType" SG_ 3221225472 EngBrakeActiveLampCmd 5;
BA_ "SPN" SG_ 3221225472 EngBrakeActiveLampCmd 5081;
BA_ "SAEDocument" SG_ 3221225472 EngBrakeActiveLampCmd "J1939-71";
BA_ "SigType" SG_ 3221225472 OBDMalfunctionIndicatorLampCmd 5;
BA_ "SPN" SG_ 3221225472 OBDMalfunctionIndicatorLampCmd 5080;
BA_ "SAEDocument" SG_ 3221225472 OBDMalfunctionIndicatorLampCmd "J1939-71";
BA_ "SigType" SG_ 3221225472 EngRedStopLampCmd 5;
BA_ "SPN" SG_ 3221225472 EngRedStopLampCmd 5079;
BA_ "SAEDocument" SG_ 3221225472 EngRedStopLampCmd "J1939-71";
BA_ "SigType" SG_ 3221225472 EngAmberWarningLampCmd 5;
BA_ "SPN" SG_ 3221225472 EngAmberWarningLampCmd 5078;
BA_ "SAEDocument" SG_ 3221225472 EngAmberWarningLampCmd "J1939-71";
BA_ "SigType" SG_ 3221225472 EngProtectLampCmd 5;
BA_ "SPN" SG_ 3221225472 EngProtectLampCmd 5077;
BA_ "SAEDocument" SG_ 3221225472 EngProtectLampCmd "J1939-71";
BA_ "SPN" SG_ 3221225472 RolloverSensorType 4934;
BA_ "SAEDocument" SG_ 3221225472 RolloverSensorType "J1939-71";
BA_ "SPN" SG_ 3221225472 RearCollisionSensor4Type 4933;
BA_ "SAEDocument" SG_ 3221225472 RearCollisionSensor4Type "J1939-71";
BA_ "SPN" SG_ 3221225472 RearCollisionSensor3Type 4932;
BA_ "SAEDocument" SG_ 3221225472 RearCollisionSensor3Type "J1939-71";
BA_ "SPN" SG_ 3221225472 RearCollisionSensor2Type 4931;
BA_ "SAEDocument" SG_ 3221225472 RearCollisionSensor2Type "J1939-71";
BA_ "SPN" SG_ 3221225472 RearCollisionSensor1Type 4930;
BA_ "SAEDocument" SG_ 3221225472 RearCollisionSensor1Type "J1939-71";
BA_ "SPN" SG_ 3221225472 SideCollisionSensorRearRightType 4929;
BA_ "SAEDocument" SG_ 3221225472 SideCollisionSensorRearRightType "J1939-71";
BA_ "SPN" SG_ 3221225472 SdCllisionSensorMidRearRightType 4928;
BA_ "SAEDocument" SG_ 3221225472 SdCllisionSensorMidRearRightType "J1939-71";
BA_ "SPN" SG_ 3221225472 SdCllsionSensorMidFrontRightType 4927;
BA_ "SAEDocument" SG_ 3221225472 SdCllsionSensorMidFrontRightType "J1939-71";
BA_ "SPN" SG_ 3221225472 SdeCollisionSensorFrontRightType 4926;
BA_ "SAEDocument" SG_ 3221225472 SdeCollisionSensorFrontRightType "J1939-71";
BA_ "SPN" SG_ 3221225472 SideCollisionSensorRearLeftType 4925;
BA_ "SAEDocument" SG_ 3221225472 SideCollisionSensorRearLeftType "J1939-71";
BA_ "SPN" SG_ 3221225472 SdCollisionSensorMidRearLeftType 4924;
BA_ "SAEDocument" SG_ 3221225472 SdCollisionSensorMidRearLeftType "J1939-71";
BA_ "SPN" SG_ 3221225472 SdCllisionSensorMidFrontLeftType 4923;
BA_ "SAEDocument" SG_ 3221225472 SdCllisionSensorMidFrontLeftType "J1939-71";
BA_ "SPN" SG_ 3221225472 SideCollisionSensorFrontLeftType 4922;
BA_ "SAEDocument" SG_ 3221225472 SideCollisionSensorFrontLeftType "J1939-71";
BA_ "SPN" SG_ 3221225472 FrontalCollisionSensor4Type 4921;
BA_ "SAEDocument" SG_ 3221225472 FrontalCollisionSensor4Type "J1939-71";
BA_ "SPN" SG_ 3221225472 FrontalCollisionSensor3Type 4920;
BA_ "SAEDocument" SG_ 3221225472 FrontalCollisionSensor3Type "J1939-71";
BA_ "SPN" SG_ 3221225472 FrontalCollisionSensor2Type 4919;
BA_ "SAEDocument" SG_ 3221225472 FrontalCollisionSensor2Type "J1939-71";
BA_ "SPN" SG_ 3221225472 FrontalCollisionSensor1Type 4918;
BA_ "SAEDocument" SG_ 3221225472 FrontalCollisionSensor1Type "J1939-71";
BA_ "SPN" SG_ 3221225472 CrashChecksum 4975;
BA_ "SAEDocument" SG_ 3221225472 CrashChecksum "J1939-71";
BA_ "SPN" SG_ 3221225472 CrashCounter 4974;
BA_ "SAEDocument" SG_ 3221225472 CrashCounter "J1939-71";
BA_ "SPN" SG_ 3221225472 CrashType 4973;
BA_ "SAEDocument" SG_ 3221225472 CrashType "J1939-71";
BA_ "SigType" SG_ 3221225472 EngChrgArClr2PrecoolerEfficiency 1;
BA_ "SPN" SG_ 3221225472 EngChrgArClr2PrecoolerEfficiency 5288;
BA_ "SAEDocument" SG_ 3221225472 EngChrgArClr2PrecoolerEfficiency "J1939-71";
BA_ "SigType" SG_ 3221225472 EngChrgArClr2PrecoolerOutletTemp 1;
BA_ "SPN" SG_ 3221225472 EngChrgArClr2PrecoolerOutletTemp 5287;
BA_ "SAEDocument" SG_ 3221225472 EngChrgArClr2PrecoolerOutletTemp "J1939-71";
BA_ "SigType" SG_ 3221225472 EngChrgArClr2PrecoolerIntakeTemp 1;
BA_ "SPN" SG_ 3221225472 EngChrgArClr2PrecoolerIntakeTemp 5286;
BA_ "SAEDocument" SG_ 3221225472 EngChrgArClr2PrecoolerIntakeTemp "J1939-71";
BA_ "SigType" SG_ 3221225472 EngChargeAirCooler2Efficiency 1;
BA_ "SPN" SG_ 3221225472 EngChargeAirCooler2Efficiency 5292;
BA_ "SAEDocument" SG_ 3221225472 EngChargeAirCooler2Efficiency "J1939-71";
BA_ "SigType" SG_ 3221225472 EngChrgeAirCooler2AmbientAirTemp 1;
BA_ "SPN" SG_ 3221225472 EngChrgeAirCooler2AmbientAirTemp 5291;
BA_ "SAEDocument" SG_ 3221225472 EngChrgeAirCooler2AmbientAirTemp "J1939-71";
BA_ "SigType" SG_ 3221225472 EngChargeAirCooler2OutletTemp 1;
BA_ "SPN" SG_ 3221225472 EngChargeAirCooler2OutletTemp 5290;
BA_ "SAEDocument" SG_ 3221225472 EngChargeAirCooler2OutletTemp "J1939-71";
BA_ "SigType" SG_ 3221225472 EngChargeAirCooler2IntakeTemp 1;
BA_ "SPN" SG_ 3221225472 EngChargeAirCooler2IntakeTemp 5289;
BA_ "SAEDocument" SG_ 3221225472 EngChargeAirCooler2IntakeTemp "J1939-71";
BA_ "SigType" SG_ 3221225472 EngChrgArClr1PrecoolerEfficiency 1;
BA_ "SPN" SG_ 3221225472 EngChrgArClr1PrecoolerEfficiency 5282;
BA_ "SAEDocument" SG_ 3221225472 EngChrgArClr1PrecoolerEfficiency "J1939-71";
BA_ "SigType" SG_ 3221225472 EngChrgArClr1PrecoolerOutletTemp 1;
BA_ "SPN" SG_ 3221225472 EngChrgArClr1PrecoolerOutletTemp 5281;
BA_ "SAEDocument" SG_ 3221225472 EngChrgArClr1PrecoolerOutletTemp "J1939-71";
BA_ "SigType" SG_ 3221225472 EngChrgArClr1PrecoolerIntakeTemp 1;
BA_ "SPN" SG_ 3221225472 EngChrgArClr1PrecoolerIntakeTemp 5280;
BA_ "SAEDocument" SG_ 3221225472 EngChrgArClr1PrecoolerIntakeTemp "J1939-71";
BA_ "SigType" SG_ 3221225472 EngChargeAirCooler1Efficiency 1;
BA_ "SPN" SG_ 3221225472 EngChargeAirCooler1Efficiency 5285;
BA_ "SAEDocument" SG_ 3221225472 EngChargeAirCooler1Efficiency "J1939-71";
BA_ "SigType" SG_ 3221225472 EngChrgeAirCooler1AmbientAirTemp 1;
BA_ "SPN" SG_ 3221225472 EngChrgeAirCooler1AmbientAirTemp 5284;
BA_ "SAEDocument" SG_ 3221225472 EngChrgeAirCooler1AmbientAirTemp "J1939-71";
BA_ "SigType" SG_ 3221225472 EngChargeAirCooler1IntakeTemp 1;
BA_ "SPN" SG_ 3221225472 EngChargeAirCooler1IntakeTemp 5283;
BA_ "SAEDocument" SG_ 3221225472 EngChargeAirCooler1IntakeTemp "J1939-71";
BA_ "SigType" SG_ 3221225472 Joystick9Button9PressedStatus 4;
BA_ "SPN" SG_ 3221225472 Joystick9Button9PressedStatus 4697;
BA_ "SAEDocument" SG_ 3221225472 Joystick9Button9PressedStatus "J1939-71";
BA_ "SigType" SG_ 3221225472 Joystick9Button10PressedStatus 4;
BA_ "SPN" SG_ 3221225472 Joystick9Button10PressedStatus 4696;
BA_ "SAEDocument" SG_ 3221225472 Joystick9Button10PressedStatus "J1939-71";
BA_ "SigType" SG_ 3221225472 Joystick9Button11PressedStatus 4;
BA_ "SPN" SG_ 3221225472 Joystick9Button11PressedStatus 4695;
BA_ "SAEDocument" SG_ 3221225472 Joystick9Button11PressedStatus "J1939-71";
BA_ "SigType" SG_ 3221225472 Joystick9Button12PressedStatus 4;
BA_ "SPN" SG_ 3221225472 Joystick9Button12PressedStatus 4694;
BA_ "SAEDocument" SG_ 3221225472 Joystick9Button12PressedStatus "J1939-71";
BA_ "SigType" SG_ 3221225472 Joystick9Button5PressedStatus 4;
BA_ "SPN" SG_ 3221225472 Joystick9Button5PressedStatus 4693;
BA_ "SAEDocument" SG_ 3221225472 Joystick9Button5PressedStatus "J1939-71";
BA_ "SigType" SG_ 3221225472 Joystick9Button6PressedStatus 4;
BA_ "SPN" SG_ 3221225472 Joystick9Button6PressedStatus 4692;
BA_ "SAEDocument" SG_ 3221225472 Joystick9Button6PressedStatus "J1939-71";
BA_ "SigType" SG_ 3221225472 Joystick9Button7PressedStatus 4;
BA_ "SPN" SG_ 3221225472 Joystick9Button7PressedStatus 4691;
BA_ "SAEDocument" SG_ 3221225472 Joystick9Button7PressedStatus "J1939-71";
BA_ "SigType" SG_ 3221225472 Joystick9Button8PressedStatus 4;
BA_ "SPN" SG_ 3221225472 Joystick9Button8PressedStatus 4690;
BA_ "SAEDocument" SG_ 3221225472 Joystick9Button8PressedStatus "J1939-71";
BA_ "SigType" SG_ 3221225472 Joystick9Button1PressedStatus 4;
BA_ "SPN" SG_ 3221225472 Joystick9Button1PressedStatus 4689;
BA_ "SAEDocument" SG_ 3221225472 Joystick9Button1PressedStatus "J1939-71";
BA_ "SigType" SG_ 3221225472 Joystick9Button2PressedStatus 4;
BA_ "SPN" SG_ 3221225472 Joystick9Button2PressedStatus 4688;
BA_ "SAEDocument" SG_ 3221225472 Joystick9Button2PressedStatus "J1939-71";
BA_ "SigType" SG_ 3221225472 Joystick9Button3PressedStatus 4;
BA_ "SPN" SG_ 3221225472 Joystick9Button3PressedStatus 4687;
BA_ "SAEDocument" SG_ 3221225472 Joystick9Button3PressedStatus "J1939-71";
BA_ "SigType" SG_ 3221225472 Joystick9Button4PressedStatus 4;
BA_ "SPN" SG_ 3221225472 Joystick9Button4PressedStatus 4686;
BA_ "SAEDocument" SG_ 3221225472 Joystick9Button4PressedStatus "J1939-71";
BA_ "SigType" SG_ 3221225472 Joystick9XAxisDetentPosStatus 4;
BA_ "SPN" SG_ 3221225472 Joystick9XAxisDetentPosStatus 4685;
BA_ "SAEDocument" SG_ 3221225472 Joystick9XAxisDetentPosStatus "J1939-71";
BA_ "SigType" SG_ 3221225472 Joystick9YAxisDetentPosStatus 4;
BA_ "SPN" SG_ 3221225472 Joystick9YAxisDetentPosStatus 4684;
BA_ "SAEDocument" SG_ 3221225472 Joystick9YAxisDetentPosStatus "J1939-71";
VAL_ 3221225472 TransRangeLowActuator 3 "Not available" 2 "Error" 1 "On" 0 "Off" ;
VAL_ 3221225472 TransRangeHighActuator 3 "Not available" 2 "Error" 1 "On" 0 "Off" ;
VAL_ 3221225472 TransShiftFingerGearActuator2 3 "Not available" 2 "Error" 1 "On" 0 "Off" ;
VAL_ 3221225472 TransShiftFingerRailActuator2 3 "Not available" 2 "Error" 1 "On" 0 "Off" ;
VAL_ 3221225472 TransShiftFingerGearActuator1 3 "Not available" 2 "Error" 1 "On" 0 "Off" ;
VAL_ 3221225472 TransShiftFingerRailActuator1 3 "Not available" 2 "Error" 1 "On" 0 "Off" ;
VAL_ 3221225472 TrnsShftFngerCenterRailIndicator 3 "Not available" 2 "Error" 1 "On" 0 "Off" ;
VAL_ 3221225472 TrnsShftFngerEngagementIndicator 3 "Not available" 2 "Error" 1 "On" 0 "Off" ;
VAL_ 3221225472 TransShiftFingerNeutralIndicator 3 "Not available" 2 "Error" 1 "On" 0 "Off" ;
VAL_ 3221225472 MomentaryEngMaxPowerEnable 3 "not available" 2 "fault" 1 "momentarily requesting maximum power available" 0 "not requesting maximum power available" ;
VAL_ 3221225472 ProgressiveShiftDisable 2 "Reserved" 3 "Take no action" 1 "Progressive shift is disabled" 0 "Progressive shift is not disabled" ;
VAL_ 3221225472 EngMomentaryOverspeedEnable 3 "Take no action" 2 "Reserved" 1 "Momentary engine overspeed is enabled" 0 "Momentary engine overspeed is disabled" ;
VAL_ 3221225472 TrnsTrqCnvrtrLckpTrnstnInProcess 3 "Not available" 2 "Error" 1 "Transition is in process" 0 "Transition is not in process" ;
VAL_ 3221225472 TransShiftInProcess 3 "Not available" 2 "Error" 1 "Shift in process" 0 "Shift is not in process" ;
VAL_ 3221225472 TrnsTorqueConverterLockupEngaged 3 "Not available" 2 "Error" 1 "Torque converter lockup engaged" 0 "Torque converter lockup disengaged" ;
VAL_ 3221225472 TransDrivelineEngaged 3 "Not available" 2 "Error" 1 "Driveline engaged" 0 "Driveline disengaged" ;
VAL_ 3221225472 TransOutputRetarder 3 "Not available" 2 "Error" 1 "On" 0 "Off" ;
VAL_ 3221225472 EngExhstGsOxygnSnsrClsdLpOprtion 3 "Dont Care/take no action" 2 "Reserved" 1 "Engine using the Exhaust Gas Oxygen sensor for a closed loop operation" 0 "Engine not using the Exhaust Gas Oxygen sensor open loop" ;
VAL_ 3221225472 Jystick3GripXAxisDetentPosStatus 3 "Not Available" 2 "Error Indicator" 1 "In the Detent Position" 0 "Not in the Detent Position" ;
VAL_ 3221225472 Jystick3GripYAxisDetentPosStatus 3 "Not Available" 2 "Error Indicator" 1 "In the Detent Position" 0 "Not in the Detent Position" ;
VAL_ 3221225472 Jystick3ThetaAxisDetentPosStatus 3 "Not Available" 2 "Error Indicator" 1 "In the Detent Position" 0 "Not in the Detent Position" ;
VAL_ 3221225472 Jystck3ThtAxsClckwsPstvPosStatus 3 "Not Available" 2 "Error Indicator" 1 "On positive side of Neutral" 0 "Not on Positive side of Neutral" ;
VAL_ 3221225472 Jystck3ThetaAxisNeutralPosStatus 3 "Not Available" 2 "Error Indicator" 1 "In Neutral Position" 0 "Not in Neutral Position" ;
VAL_ 3221225472 Jystck3GrpYAxsLvrFrwrdPstvPsStts 3 "Not Available" 2 "Error Indicator" 1 "On positive side of Neutral" 0 "Not on Positive side of Neutral" ;
VAL_ 3221225472 Jystck3GrpYAxsLvrBckNgtvPsStatus 3 "Not Available" 2 "Error Indicator" 1 "On negative side of Neutral" 0 "Not on negative side of Neutral" ;
VAL_ 3221225472 Jystck3GripYAxisNeutralPosStatus 3 "Not Available" 2 "Error Indicator" 1 "In Neutral Position" 0 "Not in Neutral Position" ;
VAL_ 3221225472 Jystck3GrpXAxsLvrRghtPstvPsSttus 3 "Not Available" 2 "Error Indicator" 1 "On positive side of Neutral" 0 "Not on Positive side of Neutral" ;
VAL_ 3221225472 Jystck3GrpXAxsLvrLftNgtvPsStatus 3 "Not Available" 2 "Error Indicator" 1 "On negative side of Neutral" 0 "Not on negative side of Neutral" ;
VAL_ 3221225472 Jystck3GripXAxisNeutralPosStatus 3 "Not Available" 2 "Error Indicator" 1 "On negative side of Neutral" 0 "Not on negative side of Neutral" ;
VAL_ 3221225472 Jystck3ThtAxsCntrClckwsNgtvPsStt 3 "Not Available" 2 "Error Indicator" 1 "On negative side of Neutral" 0 "Not on negative side of Neutral" ;
VAL_ 3221225472 Jystick2GripXAxisDetentPosStatus 3 "Not Available" 2 "Error Indicator" 1 "In the Detent Position" 0 "Not in the Detent Position" ;
VAL_ 3221225472 Jystick2GripYAxisDetentPosStatus 3 "Not Available" 2 "Error Indicator" 1 "In the Detent Position" 0 "Not in the Detent Position" ;
VAL_ 3221225472 Jystick2ThetaAxisDetentPosStatus 3 "Not Available" 2 "Error Indicator" 1 "In the Detent Position" 0 "Not in the Detent Position" ;
VAL_ 3221225472 Jystck2ThtAxsClckwsPstvPosStatus 3 "Not Available" 2 "Error Indicator" 1 "On positive side of Neutral" 0 "Not on Positive side of Neutral" ;
VAL_ 3221225472 Jystck2ThetaAxisNeutralPosStatus 3 "Not Available" 2 "Error Indicator" 1 "In Neutral Position" 0 "Not in Neutral Position" ;
VAL_ 3221225472 Jystck2GrpYAxsLvrFrwrdPstvPsStts 3 "Not Available" 2 "Error Indicator" 1 "On positive side of Neutral" 0 "Not on Positive side of Neutral" ;
VAL_ 3221225472 Jystck2GrpYAxsLvrBckNgtvPsStatus 3 "Not Available" 2 "Error Indicator" 1 "On negative side of Neutral" 0 "Not on negative side of Neutral" ;
VAL_ 3221225472 Jystck2GripYAxisNeutralPosStatus 3 "Not Available" 2 "Error Indicator" 1 "In Neutral Position" 0 "Not in Neutral Position" ;
VAL_ 3221225472 Jystck2GrpXAxsLvrRghtPstvPsSttus 3 "Not Available" 2 "Error Indicator" 1 "On positive side of Neutral" 0 "Not on Positive side of Neutral" ;
VAL_ 3221225472 Jystck2GrpXAxsLvrLftNgtvPsStatus 3 "Not Available" 2 "Error Indicator" 1 "On negative side of Neutral" 0 "Not on negative side of Neutral" ;
VAL_ 3221225472 Jystck2GripXAxisNeutralPosStatus 3 "Not Available" 2 "Error Indicator" 1 "On negative side of Neutral" 0 "Not on negative side of Neutral" ;
VAL_ 3221225472 Jystck2ThtAxsCntrClckwsNgtvPsStt 3 "Not Available" 2 "Error Indicator" 1 "On negative side of Neutral" 0 "Not on negative side of Neutral" ;
VAL_ 3221225472 Jystick1GripXAxisDetentPosStatus 3 "Not Available" 2 "Error Indicator" 1 "In the Detent Position" 0 "Not in the Detent Position" ;
VAL_ 3221225472 Jystick1GripYAxisDetentPosStatus 3 "Not Available" 2 "Error Indicator" 1 "In the Detent Position" 0 "Not in the Detent Position" ;
VAL_ 3221225472 Jystick1ThetaAxisDetentPosStatus 3 "Not Available" 2 "Error Indicator" 1 "In the Detent Position" 0 "Not in the Detent Position" ;
VAL_ 3221225472 Jystck1ThtAxsClckwsPstvPosStatus 3 "Not Available" 2 "Error Indicator" 1 "On positive side of Neutral" 0 "Not on Positive side of Neutral" ;
VAL_ 3221225472 Jystck1ThetaAxisNeutralPosStatus 3 "Not Available" 2 "Error Indicator" 1 "In Neutral Position" 0 "Not in Neutral Position" ;
VAL_ 3221225472 Jystck1GrpYAxsLvrFrwrdPstvPsStts 3 "Not Available" 2 "Error Indicator" 1 "On positive side of Neutral" 0 "Not on Positive side of Neutral" ;
VAL_ 3221225472 Jystck1GrpYAxsLvrBckNgtvPsStatus 3 "Not Available" 2 "Error Indicator" 1 "On negative side of Neutral" 0 "Not on negative side of Neutral" ;
VAL_ 3221225472 Jystck1GripYAxisNeutralPosStatus 3 "Not Available" 2 "Error Indicator" 1 "In Neutral Position" 0 "Not in Neutral Position" ;
VAL_ 3221225472 Jystck1GrpXAxsLvrRghtPstvPsSttus 3 "Not Available" 2 "Error Indicator" 1 "On positive side of Neutral" 0 "Not on Positive side of Neutral" ;
VAL_ 3221225472 Jystck1GrpXAxsLvrLftNgtvPsStatus 3 "Not Available" 2 "Error Indicator" 1 "On negative side of Neutral" 0 "Not on negative side of Neutral" ;
VAL_ 3221225472 Jystck1GripXAxisNeutralPosStatus 3 "Not Available" 2 "Error Indicator" 1 "In Neutral Position" 0 "Not in Neutral Position" ;
VAL_ 3221225472 Jystck1ThtAxsCntrClckwsNgtvPsStt 3 "Not Available" 2 "Error Indicator" 1 "On negative side of Neutral" 0 "Not on negative side of Neutral" ;
VAL_ 3221225472 FuelPumpPrimerStatus 3 "Unavailable" 2 "Error" 1 "On" 0 "Off" ;
VAL_ 3221225472 EngVentilationStatus 4 "Reserved for SAE assignment" 7 "Not available or not installe" 6 "Not able to determine if sufficiently vented" 5 "Reserved for SAE assignment" 3 "Currently venting engine cranks w/o gas or ignition to clear intake and exhaust systems with air" 2 "Ventilation delay delay without cranking between ventilation and start engine states" 1 "Ventilation needed combustible gases may be present in intake and exhaust systems" 0 "Sufficiently vented all combustible gases have been evacuated from intake and exhaust systems" ;
VAL_ 3221225472 EngCoolantPreheatedState 3 "Not available or not installed" 2 "Unable to determine engine coolant preheated sufficiently" 1 "Sufficiently preheated" 0 "Not sufficiently preheated" ;
VAL_ 3221225472 EngOilPreHeatedState 3 "Not available or not installed" 2 "Unable to determine if engine oil is preheated sufficiently" 1 "Sufficiently preheated" 0 "Not sufficiently preheated" ;
VAL_ 3221225472 EngOilPrimingState 3 "Not available or not installed" 2 "Unable to determine if sufficiently lubricated" 1 "Sufficiently lubricated" 0 "Not sufficiently lubricated" ;
VAL_ 3221225472 EngOilPrimingPumpSwitch 3 "Not available or not installed" 2 "Error" 1 "On" 0 "Off" ;
VAL_ 3221225472 SafetyWireStatus 3 "Not available" 2 "Error" 1 "Safety wire has been activated" 0 "Safety wire has not been activated" ;
VAL_ 3221225472 EngVriableGeometryTurbo1CtrlMode 3 "not available" 2 "SAE reserved" 1 "closed loop" 0 "open loop" ;
VAL_ 3221225472 EngVrblGmtryTrbArCtrlShtoffValve 3 "Not available" 2 "Reserved" 1 "VGT Air Control Shutoff Valve is On" 0 "VGT Air Control Shutoff Valve is Off" ;
VAL_ 3221225472 EngIntakeManifoldPressCtrlMode 3 "Not available" 2 "SAE reserved" 1 "Closed loop" 0 "Open loop" ;
VAL_ 3221225472 EngRotationDirection 3 "Not Available" 2 "Reserved" 1 "ClockWise CW" 0 "CounterClockWise CCW" ;
VAL_ 3221225472 Aftertreatment2ExhaustDewPoint 3 "Not available" 2 "Error" 1 "Exceeded the dew point" 0 "Not exceeded the dew point" ;
VAL_ 3221225472 Aftertreatment2IntakeDewPoint 3 "Not available" 2 "Error" 1 "Exceeded the dew point" 0 "Not exceeded the dew point" ;
VAL_ 3221225472 Aftertreatment1ExhaustDewPoint 3 "Not available" 2 "Error" 1 "Exceeded the dew point" 0 "Not exceeded the dew point" ;
VAL_ 3221225472 Aftertreatment1IntakeDewPoint 3 "Not available" 2 "Error" 1 "Exceeded the dew point" 0 "Not exceeded the dew point" ;
VAL_ 3221225472 ActlEngPrcntTorqueHighResolution 8 "1111  not available" 7 "0875" 1 "0125" 0 "0000" ;
VAL_ 3221225472 EngStarterMode 13 "error legacy implementation only use 1110" 15 "not available" 14 "error" 12 "starter inhibited  reason unknown" 8 "starter inhibited due to starter overtemp" 7 "starter inhibited due to active immobilizer" 6 "starter inhibited due to driveline engaged or other transmission inhibit" 5 "starter inhibited due to engine not ready for start preheating" 4 "starter inhibited due to engine already running" 3 "start finished starter not active after having been actively engaged after 50ms mode goes to 0000" 2 "starter active gear engaged" 1 "starter active gear not engaged" 0 "start not requested" ;
VAL_ 3221225472 PrkngBrakeActuatorFullyActivated 3 "Not available" 2 "Error" 1 "Parking Brake Actuator fully activated" 0 "Parking Brake Actuator not fully activated" ;
VAL_ 3221225472 XBRActiveCtrlMode 15 "Not available" 4 "1110 Reserved for SAE assignment" 3 "Maximum mode of XBR acceleration control being executed" 2 "Addition mode of XBR acceleration control being executed" 1 "Drivers brake demand being executed no external brake demand" 0 "No brake demand being executed default mode" ;
VAL_ 3221225472 XBRSystemState 3 "not available" 2 "No external brake demand will be accepted eg because of fault in brake system" 1 "Only external brake demand of highest XBR Priority 00 will be accepted eg because the temperature limit of the" 0 "Any external brake demand will be accepted brake system fully operational" ;
VAL_ 3221225472 FoundationBrakeUse 3 "Not available" 2 "Reserved" 1 "Foundation brakes in use" 0 "Foundation brakes not in use" ;
VAL_ 3221225472 HillHolderMode 7 "Not available" 6 "Hill holder not functional" 3 "101 Reserved" 2 "Active but will change to inactive in a short time This mode may be used to warn the driver" 1 "Active" 0 "Inactive" ;
VAL_ 3221225472 HaltBrakeMode 7 "Not available" 6 "Reserved" 3 "101 Not defined" 2 "Active but not functioning properly This mode may be used to warn the driver" 1 "Active" 0 "Inactive" ;
VAL_ 3221225472 BrakeTempWarning 3 "not available" 2 "Reserved" 1 "Active" 0 "Not Active" ;
VAL_ 3221225472 RearAxleGroupEngagementStatus 3 "not available" 2 "error" 1 "rear axle group engaged" 0 "rear axle group disengaged" ;
VAL_ 3221225472 FrontAxleGroupEngagementStatus 3 "not available" 2 "error" 1 "front axle group engaged" 0 "front axle group disengaged" ;
VAL_ 3221225472 DiffLockStateCentralRear 3 "Not available" 2 "Error" 1 "Differential lock engaged" 0 "Differential lock disengaged" ;
VAL_ 3221225472 DiffLockStateCentralFront 3 "Not available" 2 "Error" 1 "Differential lock engaged" 0 "Differential lock disengaged" ;
VAL_ 3221225472 DiffLockStateCentral 3 "Not available" 2 "Error" 1 "Differential lock engaged" 0 "Differential lock disengaged" ;
VAL_ 3221225472 DiffLockStateRearAxle2 3 "Not available" 2 "Error" 1 "Differential lock engaged" 0 "Differential lock disengaged" ;
VAL_ 3221225472 DiffLockStateRearAxle1 3 "Not available" 2 "Error" 1 "Differential lock engaged" 0 "Differential lock disengaged" ;
VAL_ 3221225472 DiffLockStateFrontAxle2 3 "Not available" 2 "Error" 1 "Differential lock engaged" 0 "Differential lock disengaged" ;
VAL_ 3221225472 DiffLockStateFrontAxle1 3 "Not available" 2 "Error" 1 "Differential lock engaged" 0 "Differential lock disengaged" ;
VAL_ 3221225472 EngStartEnableDevice2Config 15 "not available" 5 "1110  reserved" 4 "electric intake air heater installed" 3 "ether injection installed" 2 "fuelled start installed" 1 "glow plugs installed" 0 "no start enable device 2 installed" ;
VAL_ 3221225472 EngStartEnableDevice1Config 15 "not available" 5 "1110  reserved" 4 "electric intake air heater installed" 3 "ether injection installed" 2 "fuelled start installed" 1 "glow plugs installed" 0 "no start enable device 1 installed" ;
VAL_ 3221225472 EngStartEnableDevice2 3 "not available" 2 "reserved" 1 "start enable ON" 0 "start enable OFF" ;
VAL_ 3221225472 EngStartEnableDevice1 3 "not available" 2 "reserved" 1 "start enable ON" 0 "start enable OFF" ;
VAL_ 3221225472 TransOilLevelRq 3 "Dont care / take no action" 2 "Reserved" 1 "Transmission oil level reading desired" 0 "No transmission oil level reading desired" ;
VAL_ 3221225472 FifthWheelReleaseCtrl 3 "Not Available" 2 "Error" 1 "Coupler Unlocked trailer can be unhitched or hitched" 0 "Coupler Locked" ;
VAL_ 3221225472 FfthWhlRleaseCtrlSecurityLockout 3 "Not Available" 2 "Error" 1 "Fifth wheel release Enabled" 0 "Fifth wheel release Disabled" ;
VAL_ 3221225472 TransferCaseSelectorSwitch 3 "and 100 should be supported as well For reporting the status of the transfer case see SPN 3645" ;
VAL_ 3221225472 RqCabZoneHeating 3 "Dont care/take no action" 2 "Reserved" 1 "Heat cab zone" 0 "Do not cab engine zone" ;
VAL_ 3221225472 RqEngZoneHeating 3 "Dont care/take no action" 2 "Reserved" 1 "Heat engine zone" 0 "Do not heat engine zone" ;
VAL_ 3221225472 AuxHeaterModeRq 15 "Dont care/take no action" 14 "Reserved" 3 "Normal mode" 2 "Economy mode" 1 "Off due to ADR per European Regulations for Transport of hazardous materials" 0 "Deactivate auxiliary heater" ;
VAL_ 3221225472 EngAutomaticStartEnableSwitch 3 "Not available" 2 "Error" 1 "Switch in the on state" 0 "Switch in the off state" ;
VAL_ 3221225472 AtomaticGearShiftingEnableSwitch 3 "Not available" 2 "Error" 1 "Automated Gear Shifting is enabled" 0 "Automated Gear Shifting is disabled" ;
VAL_ 3221225472 DslPrtcltFltrRgnrtionForceSwitch 3 "not available" 2 "error" 1 "active" 0 "not active" ;
VAL_ 3221225472 DslPrtcltFltrRgnrtnInhibitSwitch 3 "not available" 2 "error" 1 "active" 0 "not active" ;
VAL_ 3221225472 VhclLmtngSpdGovernorEnableSwitch 3 "Not available" 2 "Error" 1 "Switched enabled" 0 "Switch disabled" ;
VAL_ 3221225472 VhclLmtngSpdGvrnrIncrementSwitch 3 "Not available" 2 "Error" 1 "Switch in the on state  increase" 0 "Switch in the off state" ;
VAL_ 3221225472 VhclLmtngSpdGvrnrDecrementSwitch 3 "Not available" 2 "Error" 1 "Switch in the on state  decrease" 0 "Switch in the off state" ;
VAL_ 3221225472 SeatBeltSwitch 3 "Not Available" 2 "Error  Switch state cannot be determined" 1 "OK  Seat Belt is buckled" 0 "NOT Buckled" ;
VAL_ 3221225472 OperatorSeatDirectionSwitch 3 "Not Available" 2 "Error" 1 "Operator seat is facing forward" 0 "Operator seat not facing forward" ;
VAL_ 3221225472 BatteryMainSwitchHoldRq 3 "Dont care/take no action" 2 "undefined" 1 "Hold Battery Main Switch" 0 "Release Battery Main Switch" ;
VAL_ 3221225472 AuxHeaterCoolantPumpRq 3 "Dont care/take no action" 2 "Reserved" 1 "Activate water pump" 0 "Deactivate water pump" ;
VAL_ 3221225472 EngFuelFilterRestrictedLampCmd 3 "Not available" 2 "Flash 1 hz" 1 "Lamp On" 0 "Lamp Off" ;
VAL_ 3221225472 EngAirFilterRestrictionLampCmd 3 "Not available" 2 "Reserved" 1 "Lamp On" 0 "Lamp Off" ;
VAL_ 3221225472 EngIdleManagementActiveLampCmd 3 "Not available" 2 "Reserved" 1 "Lamp On" 0 "Lamp Off" ;
VAL_ 3221225472 EngCoolantLevelLowLampCmd 3 "Not available" 2 "Reserved" 1 "Lamp On" 0 "Lamp Off" ;
VAL_ 3221225472 EngCoolantTempHighLampCmd 3 "Not available" 2 "Reserved" 1 "Lamp On" 0 "Lamp Off" ;
VAL_ 3221225472 EngOilPressLowLampCmd 3 "Not available" 2 "Reserved" 1 "Lamp On" 0 "Lamp Off" ;
VAL_ 3221225472 CmprssnBrkEnblSwtchIndctrLampCmd 3 "Not available" 2 "Reserved" 1 "Lamp ON" 0 "Lamp OFF" ;
VAL_ 3221225472 EngBrakeActiveLampCmd 3 "Not available" 2 "Reserved" 1 "Lamp On" 0 "Lamp Off" ;
VAL_ 3221225472 OBDMalfunctionIndicatorLampCmd 3 "Not available" 2 "Reserved" 1 "Lamp On" 0 "Lamp Off" ;
VAL_ 3221225472 EngRedStopLampCmd 3 "Not available" 2 "Reserved" 1 "Lamp On" 0 "Lamp Off" ;
VAL_ 3221225472 EngAmberWarningLampCmd 3 "Not available" 2 "Reserved" 1 "Lamp On" 0 "Lamp Off" ;
VAL_ 3221225472 EngProtectLampCmd 3 "Not available" 2 "Reserved" 1 "Lamp On" 0 "Lamp Off" ;
VAL_ 3221225472 RolloverSensorType 15 "not available" 14 "Error  Type of sensor cannot be determined unknown sensor" 7 "optical sensor" 6 "lidar sensor" 5 "radar sensor" 4 "fiberoptic sensor" 3 "sonic sensor" 2 "rollrate sensor" 1 "pressure sensor" 0 "acceleration sensor" ;
VAL_ 3221225472 RearCollisionSensor4Type 15 "not available" 14 "Error  Type of sensor cannot be determined unknown sensor" 7 "optical sensor" 6 "lidar sensor" 5 "radar sensor" 4 "fiberoptic sensor" 3 "sonic sensor" 2 "rollrate sensor" 1 "pressure sensor" 0 "acceleration sensor" ;
VAL_ 3221225472 RearCollisionSensor3Type 15 "not available" 14 "Error  Type of sensor cannot be determined unknown sensor" 7 "optical sensor" 6 "lidar sensor" 5 "radar sensor" 4 "fiberoptic sensor" 3 "sonic sensor" 2 "rollrate sensor" 1 "pressure sensor" 0 "acceleration sensor" ;
VAL_ 3221225472 RearCollisionSensor2Type 15 "not available" 14 "Error  Type of sensor cannot be determined unknown sensor" 7 "optical sensor" 6 "lidar sensor" 5 "radar sensor" 4 "fiberoptic sensor" 3 "sonic sensor" 2 "rollrate sensor" 1 "pressure sensor" 0 "acceleration sensor" ;
VAL_ 3221225472 RearCollisionSensor1Type 15 "not available" 14 "Error  Type of sensor cannot be determined unknown sensor" 7 "optical sensor" 6 "lidar sensor" 5 "radar sensor" 4 "fiberoptic sensor" 3 "sonic sensor" 2 "rollrate sensor" 1 "pressure sensor" 0 "acceleration sensor" ;
VAL_ 3221225472 SideCollisionSensorRearRightType 15 "not available" 14 "Error  Type of sensor cannot be determined unknown sensor" 7 "optical sensor" 6 "lidar sensor" 5 "radar sensor" 4 "fiberoptic sensor" 3 "sonic sensor" 2 "rollrate sensor" 1 "pressure sensor" 0 "acceleration sensor" ;
VAL_ 3221225472 SdCllisionSensorMidRearRightType 15 "not available" 14 "Error  Type of sensor cannot be determined unknown sensor" 7 "optical sensor" 6 "lidar sensor" 5 "radar sensor" 4 "fiberoptic sensor" 3 "sonic sensor" 2 "rollrate sensor" 1 "pressure sensor" 0 "acceleration sensor" ;
VAL_ 3221225472 SdCllsionSensorMidFrontRightType 15 "not available" 14 "Error  Type of sensor cannot be determined unknown sensor" 7 "optical sensor" 6 "lidar sensor" 5 "radar sensor" 4 "fiberoptic sensor" 3 "sonic sensor" 2 "rollrate sensor" 1 "pressure sensor" 0 "acceleration sensor" ;
VAL_ 3221225472 SdeCollisionSensorFrontRightType 15 "not available" 14 "Error  Type of sensor cannot be determined unknown sensor" 7 "optical sensor" 6 "lidar sensor" 5 "radar sensor" 4 "fiberoptic sensor" 3 "sonic sensor" 2 "rollrate sensor" 1 "pressure sensor" 0 "acceleration sensor" ;
VAL_ 3221225472 SideCollisionSensorRearLeftType 15 "not available" 14 "Error  Type of sensor cannot be determined unknown sensor" 7 "optical sensor" 6 "lidar sensor" 5 "radar sensor" 4 "fiberoptic sensor" 3 "sonic sensor" 2 "rollrate sensor" 1 "pressure sensor" 0 "acceleration sensor" ;
VAL_ 3221225472 SdCollisionSensorMidRearLeftType 15 "not available" 14 "Error  Type of sensor cannot be determined unknown sensor" 7 "optical sensor" 6 "lidar sensor" 5 "radar sensor" 4 "fiberoptic sensor" 3 "sonic sensor" 2 "rollrate sensor" 1 "pressure sensor" 0 "acceleration sensor" ;
VAL_ 3221225472 SdCllisionSensorMidFrontLeftType 15 "not available" 14 "Error  Type of sensor cannot be determined unknown sensor" 7 "optical sensor" 6 "lidar sensor" 5 "radar sensor" 4 "fiberoptic sensor" 3 "sonic sensor" 2 "rollrate sensor" 1 "pressure sensor" 0 "acceleration sensor" ;
VAL_ 3221225472 SideCollisionSensorFrontLeftType 15 "not available" 14 "Error  Type of sensor cannot be determined unknown sensor" 7 "optical sensor" 6 "lidar sensor" 5 "radar sensor" 4 "fiberoptic sensor" 3 "sonic sensor" 2 "rollrate sensor" 1 "pressure sensor" 0 "acceleration sensor" ;
VAL_ 3221225472 FrontalCollisionSensor4Type 15 "not available" 14 "Error  Type of sensor cannot be determined unknown sensor" 7 "optical sensor" 6 "lidar sensor" 5 "radar sensor" 4 "fiberoptic sensor" 3 "sonic sensor" 2 "rollrate sensor" 1 "pressure sensor" 0 "acceleration sensor" ;
VAL_ 3221225472 FrontalCollisionSensor3Type 15 "not available" 14 "Error  Type of sensor cannot be determined unknown sensor" 7 "optical sensor" 6 "lidar sensor" 5 "radar sensor" 4 "fiberoptic sensor" 3 "sonic sensor" 2 "rollrate sensor" 1 "pressure sensor" 0 "acceleration sensor" ;
VAL_ 3221225472 FrontalCollisionSensor2Type 15 "not available" 14 "Error  Type of sensor cannot be determined unknown sensor" 7 "optical sensor" 6 "lidar sensor" 5 "radar sensor" 4 "fiberoptic sensor" 3 "sonic sensor" 2 "rollrate sensor" 1 "pressure sensor" 0 "acceleration sensor" ;
VAL_ 3221225472 FrontalCollisionSensor1Type 15 "not available" 14 "Error  Type of sensor cannot be determined unknown sensor" 7 "optical sensor" 6 "lidar sensor" 5 "radar sensor" 4 "fiberoptic sensor" 3 "sonic sensor" 2 "rollrate sensor" 1 "pressure sensor" 0 "acceleration sensor" ;
VAL_ 3221225472 CrashType 4 "side crash left" 16 "rollover" 8 "side crash right" 2 "rear crash" 1 "frontal crash" ;
VAL_ 3221225472 Joystick9Button9PressedStatus 3 "Not Available" 2 "Error Indicator" 1 "Button pressed" 0 "Button not pressed" ;
VAL_ 3221225472 Joystick9Button10PressedStatus 3 "Not Available" 2 "Error Indicator" 1 "Button pressed" 0 "Button not pressed" ;
VAL_ 3221225472 Joystick9Button11PressedStatus 3 "Not Available" 2 "Error Indicator" 1 "Button pressed" 0 "Button not pressed" ;
VAL_ 3221225472 Joystick9Button12PressedStatus 3 "Not Available" 2 "Error Indicator" 1 "Button pressed" 0 "Button not pressed" ;
VAL_ 3221225472 Joystick9Button5PressedStatus 3 "Not Available" 2 "Error Indicator" 1 "Button pressed" 0 "Button not pressed" ;
VAL_ 3221225472 Joystick9Button6PressedStatus 3 "Not Available" 2 "Error Indicator" 1 "Button pressed" 0 "Button not pressed" ;
VAL_ 3221225472 Joystick9Button7PressedStatus 3 "Not Available" 2 "Error Indicator" 1 "Button pressed" 0 "Button not pressed" ;
VAL_ 3221225472 Joystick9Button8PressedStatus 3 "Not Available" 2 "Error Indicator" 1 "Button pressed" 0 "Button not pressed" ;
VAL_ 3221225472 Joystick9Button1PressedStatus 3 "Not Available" 2 "Error Indicator" 1 "Button pressed" 0 "Button not pressed" ;
VAL_ 3221225472 Joystick9Button2PressedStatus 3 "Not Available" 2 "Error Indicator" 1 "Button pressed" 0 "Button not pressed" ;
VAL_ 3221225472 Joystick9Button3PressedStatus 3 "Not Available" 2 "Error Indicator" 1 "Button pressed" 0 "Button not pressed" ;
VAL_ 3221225472 Joystick9Button4PressedStatus 3 "Not Available" 2 "Error Indicator" 1 "Button pressed" 0 "Button not pressed" ;
VAL_ 3221225472 Joystick9XAxisDetentPosStatus 3 "Not Available" 2 "Error Indicator" 1 "In the Detent Position" 0 "Not in the Detent Position" ;
VAL_ 3221225472 Joystick9YAxisDetentPosStatus 3 "Not Available" 2 "Error Indicator" 1 "In the Detent Position" 0 "Not in the Detent Position" ;
